AUTOSAR XML (schema 00044)
package /TI_F29H85x/Cdd_Xbar
  ecuc definition collection myEcuParameterDefinition: module=Cdd
  module definition Cdd: api-service-prefix=Cdd_Xbar, refined-module-def=Cdd, variants pre-compile  # Configuration of the CddXbar module.
    container CddXbarConfiguration  # This container contains the configuration parameters and sub containers of the CDD XBar module.
      container CddXbarInputXbarConfig  # Configuration for Input Crossbar
        container CddXbarInputXbarInstanceConfig [0..64]: multiplicity set at pre-compile  # Configuration for Input Crossbar instance, one per output line available
          enumeration CddXbarInputXbarInputSourceSelection: {CDD_XBAR_GPIO_AIO}, origin=Texas Instruments, set at pre-compile, default-value=CDD_XBAR_GPIO_AIO  # Selects GPIO/AIO or LOGIC HIGH or LOGIC LOW as input to the input xbar.
          enumeration CddXbarInputXbarInput: {CDD_XBAR_INPUT1}, origin=Texas Instruments, set at pre-compile, default-value=CDD_XBAR_INPUT1  # Input number of input crossbar.
          boolean CddXbarInputXbarInputSelectConfigurationLock: origin=Texas Instruments, set at pre-compile, default-value=false  # Option to lock the current Input Group for any further configuration on Input Crossbar until System Reset. Once locked, cannot be unlocked without reset.
          reference CddXbarInputXbarInputSource [0..1]: multiplicity set at pre-compile, origin=Texas Instruments, set at pre-compile, destination=PortPin  # Reference to GPIO/AIO Pin, obtained from the configuration of PORT plugin.
      container CddXbarOutputXbarConfig  # Configuration for Output Crossbar
        boolean CddXbarOutputXbarConfigurationLock: origin=Texas Instruments, set at pre-compile, default-value=false  # Option to lock the Output crossbar instance for any further input and output inversion configuration until System Reset. Cannot be unlocked once locked unless reset.
        container CddXbarOutputXbarInstanceConfig [0..16]: multiplicity set at pre-compile  # Configuration for Output Crossbar Instance, one per output line available
          enumeration CddXbarOutputXbarOutputLine: {CDD_XBAR_OUTPUT1}, origin=Texas Instruments, set at pre-compile, default-value=CDD_XBAR_OUTPUT1  # Number of Output Line instance to be set for Output Crossbar.
          enumeration CddXbarOutputXbarOutputPulseStretch: {CDD_XBAR_SYSTICKS_STRETCH_OFF}, origin=Texas Instruments, set at pre-compile, default-value=CDD_XBAR_SYSTICKS_STRETCH_OFF  # Output Line pulse stretch in Sys Clock ticks for Output Crossbar.
          boolean CddXbarOutputXbarOutputInversion: origin=Texas Instruments, set at pre-compile, default-value=false  # Option to invert the output signal for the selected output line of the Output Crossbar instance.
          boolean CddXbarOutputXbarOutputLatch: origin=Texas Instruments, set at pre-compile, default-value=false  # Option to select latch as output of selected output line for Output Crossbar instance.
          container CddXbarOutputXbarInput [1..10]: multiplicity set at pre-compile  # Configuration for Output Crossbar Instance inputs
            enumeration CddXbarOutputXbarInputGroup: {CDD_XBAR_INPUT_GROUP_0}, origin=Texas Instruments, set at pre-compile, default-value=CDD_XBAR_INPUT_GROUP_0  # Number of Input Group to be chosen for Output Crossbar.
            enumeration CddXbarOutputXbarInputLine [1..32]: {CDD_XBAR_OUT_CMPSS1_CTRIPOUTH}, multiplicity set at pre-compile, origin=Texas Instruments, set at pre-compile, default-value=CDD_XBAR_OUT_CMPSS1_CTRIPOUTH  # Number of Input Line from the Group selected to be chosen for Output Crossbar.
          container CddXbarOutputXbarOutputFlagConfig  # Configuration for output crossbar output latch
            boolean CddXbarOutputXbarInversionBeforeLatch: origin=Texas Instruments, set at pre-compile, default-value=false  # Option to invert the signal before latching for the selected output line for Output Crossbar instance.
            enumeration CddXbarOutputXbarOutputLatchInitSts: {CDD_XBAR_OUTPUTDEFAULT}, origin=Texas Instruments, set at pre-compile, default-value=CDD_XBAR_OUTPUTDEFAULT  # Force or clear the output latch of individual output line for Output Crossbar during initialization
      container CddXbarEpwmXbarConfig  # Configuration for EPWM Crossbar
        boolean CddXbarEpwmXbarConfigurationLock: origin=Texas Instruments, set at pre-compile, default-value=false  # Option to lock the EPWM crossbar instance for any further configuration until System Reset. Cannot be unlocked once locked unless reset.
        container CddXbarEpwmXbarInstanceConfig [0..16]: multiplicity set at pre-compile  # Configuration for EPWM Crossbar Instance, one per output line available
          enumeration CddXbarEpwmXbarOutputLine: {CDD_XBAR_TRIP2}, origin=Texas Instruments, set at pre-compile, default-value=CDD_XBAR_TRIP2  # Number of Output Line instance to be set for EPWM Crossbar. TRIP1 is reserved.
          boolean CddXbarEpwmXbarOutputInversion: origin=Texas Instruments, set at pre-compile, default-value=false  # Option to invert the output signal for the selected output line of the EPWM Crossbar instance.
          container CddXbarEpwmXbarInput [1..10]: multiplicity set at pre-compile  # Configuration for EPWM Crossbar Instance inputs
            enumeration CddXbarEpwmXbarInputGroup: {CDD_XBAR_INPUT_GROUP_0}, origin=Texas Instruments, set at pre-compile, default-value=CDD_XBAR_INPUT_GROUP_0  # Number of Input Group to be chosen for EPWM Crossbar.
            enumeration CddXbarEpwmXbarInputLine [1..32]: {CDD_XBAR_EPWM_CMPSS1_CTRIPH}, multiplicity set at pre-compile, origin=Texas Instruments, set at pre-compile, default-value=CDD_XBAR_EPWM_CMPSS1_CTRIPH  # Number of Input Line from the Group selected to be chosen for EPWM Crossbar.
      container CddXbarClbXbarConfig  # Configuration for CLB Crossbar
        boolean CddXbarClbXbarConfigurationLock: origin=Texas Instruments, set at pre-compile, default-value=false  # Option to lock the CLB crossbar instance for any further configuration until System Reset. Cannot be unlocked once locked unless reset.
        container CddXbarClbXbarInstanceConfig [0..8]: multiplicity set at pre-compile  # Configuration for CLB Crossbar Instance, one per output line available
          enumeration CddXbarClbXbarOutputLine: {CDD_XBAR_AUXSIG1}, origin=Texas Instruments, set at pre-compile, default-value=CDD_XBAR_AUXSIG1  # Number of Output Line instance to be set for CLB Crossbar.
          boolean CddXbarClbXbarOutputInversion: origin=Texas Instruments, set at pre-compile, default-value=false  # Option to invert the output signal for the selected output line of the CLB Crossbar instance.
          container CddXbarClbXbarInput [1..8]: multiplicity set at pre-compile  # Configuration for CLB Crossbar Instance inputs
            enumeration CddXbarClbXbarInputGroup: {CDD_XBAR_INPUT_GROUP_0}, origin=Texas Instruments, set at pre-compile, default-value=CDD_XBAR_INPUT_GROUP_0  # Number of Input Group to be chosen for CLB Crossbar.
            enumeration CddXbarClbXbarInputLine [1..32]: {CDD_XBAR_CLB_CMPSS1_CTRIPH}, multiplicity set at pre-compile, origin=Texas Instruments, set at pre-compile, default-value=CDD_XBAR_CLB_CMPSS1_CTRIPH  # Number of Input Line from the Group selected to be chosen for CLB Crossbar.
      container CddXbarMindbXbarConfig  # Configuration for MINDB Crossbar
        boolean CddXbarMindbXbarConfigurationLock: origin=Texas Instruments, set at pre-compile, default-value=false  # Option to lock the MINDB crossbar instance for any further configuration until System Reset. Cannot be unlocked once locked unless reset.
        container CddXbarMindbXbarInstanceConfig [0..16]: multiplicity set at pre-compile  # Configuration for MINDB Crossbar Instance, one per output line available
          enumeration CddXbarMindbXbarOutputLine: {CDD_XBAR_MINDBXBAR1}, origin=Texas Instruments, set at pre-compile, default-value=CDD_XBAR_MINDBXBAR1  # Number of Output Line instance to be set for MINDB Crossbar.
          boolean CddXbarMindbXbarOutputInversion: origin=Texas Instruments, set at pre-compile, default-value=false  # Option to invert the output signal for the selected output line of the MINDB Crossbar instance.
          container CddXbarMindbXbarInput [1..3]: multiplicity set at pre-compile  # Configuration for MINDB Crossbar Instance inputs
            enumeration CddXbarMindbXbarInputGroup: {CDD_XBAR_INPUT_GROUP_0}, origin=Texas Instruments, set at pre-compile, default-value=CDD_XBAR_INPUT_GROUP_0  # Number of Input Group to be chosen for MINDB Crossbar.
            enumeration CddXbarMindbXbarInputLine [1..32]: {CDD_XBAR_MINDB_EPWM1A_DB_NO_HR}, multiplicity set at pre-compile, origin=Texas Instruments, set at pre-compile, default-value=CDD_XBAR_MINDB_EPWM1A_DB_NO_HR  # Number of Input Line from the Group selected to be chosen for MINDB Crossbar.
      container CddXbarIclXbarConfig  # Configuration for ICL Crossbar
        boolean CddXbarIclXbarConfigurationLock: origin=Texas Instruments, set at pre-compile, default-value=false  # Option to lock the ICL crossbar instance for any further configuration until System Reset. Cannot be unlocked once locked unless reset.
        container CddXbarIclXbarInstanceConfig [0..16]: multiplicity set at pre-compile  # Configuration for ICL Crossbar Instance, one per output line available
          enumeration CddXbarIclXbarOutputLine: {CDD_XBAR_ICLXBAR1}, origin=Texas Instruments, set at pre-compile, default-value=CDD_XBAR_ICLXBAR1  # Number of Output Line instance to be set for ICL Crossbar.
          boolean CddXbarIclXbarOutputInversion: origin=Texas Instruments, set at pre-compile, default-value=false  # Option to invert the output signal for the selected output line of the ICL Crossbar instance.
          container CddXbarIclXbarInput [1..3]: multiplicity set at pre-compile  # Configuration for ICL Crossbar Instance inputs
            enumeration CddXbarIclXbarInputGroup: {CDD_XBAR_INPUT_GROUP_0}, origin=Texas Instruments, set at pre-compile, default-value=CDD_XBAR_INPUT_GROUP_0  # Number of Input Group to be chosen for ICL Crossbar.
            enumeration CddXbarIclXbarInputLine [1..32]: {CDD_XBAR_ICL_EPWM1A_MINDB}, multiplicity set at pre-compile, origin=Texas Instruments, set at pre-compile, default-value=CDD_XBAR_ICL_EPWM1A_MINDB  # Number of Input Line from the Group selected to be chosen for ICL Crossbar.
    container CddXbarGeneral  # Contains the general configuration parameters of the module.
      boolean CddXbarDevErrorDetect: origin=Texas Instruments, set at pre-compile, default-value=false  # Switches the Development Error Detection and Reporting ON or OFF for this module.
      boolean CddXbarAPIEnable: origin=Texas Instruments, set at pre-compile, default-value=true  # Enables or Disables the APIs of this module.
      boolean CddXbarVersionInfoApi [0..1]: multiplicity set at pre-compile, origin=Texas Instruments, set at pre-compile, default-value=true  # Switches the Cdd_Xbar_GetVersionInfo function ON or OFF.
      boolean CddXbarInputFlagApi [0..1]: multiplicity set at pre-compile, origin=Texas Instruments, set at pre-compile, default-value=true  # Switches Cdd_Xbar_InputFlagStatus() and Cdd_Xbar_InputFlagClear() ON or OFF.
