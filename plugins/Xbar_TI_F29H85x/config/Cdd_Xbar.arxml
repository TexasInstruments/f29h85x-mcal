AUTOSAR XML (schema 00044)
package /TI_F29H85x/Cdd_Xbar
  ecuc definition collection myEcuParameterDefinition: module=Cdd
  module definition Cdd: api-service-prefix=Cdd_Xbar, refined-module-def=Cdd, variants pre-compile  # Configuration of the CddXbar module.
    container CddXbarConfiguration  # This container contains the configuration parameters and sub containers of the CDD XBar module.
      container CddXbarInputXbarConfig  # Configuration for Input Crossbar
        container CddXbarInputXbarInstanceConfig [0..64]: multiplicity set at pre-compile  # Configuration for Input Crossbar instance, one per output line available
          enumeration CddXbarInputXbarInputSourceSelection: {CDD_XBAR_GPIO_AIO, CDD_XBAR_LOGIC_HIGH, CDD_XBAR_LOGIC_LOW}, origin=Texas Instruments, set at pre-compile, default-value=CDD_XBAR_GPIO_AIO  # Selects GPIO/AIO or LOGIC HIGH or LOGIC LOW as input to the input xbar.
          enumeration CddXbarInputXbarInput: {CDD_XBAR_INPUT1, CDD_XBAR_INPUT2, CDD_XBAR_INPUT3, CDD_XBAR_INPUT4, CDD_XBAR_INPUT5, CDD_XBAR_INPUT6, CDD_XBAR_INPUT7, CDD_XBAR_INPUT8, CDD_XBAR_INPUT9, CDD_XBAR_INPUT10, CDD_XBAR_INPUT11, CDD_XBAR_INPUT12, CDD_XBAR_INPUT13, CDD_XBAR_INPUT14, CDD_XBAR_INPUT15, CDD_XBAR_INPUT16, CDD_XBAR_INPUT17, CDD_XBAR_INPUT18, CDD_XBAR_INPUT19, CDD_XBAR_INPUT20, CDD_XBAR_INPUT21, CDD_XBAR_INPUT22, CDD_XBAR_INPUT23, CDD_XBAR_INPUT24, CDD_XBAR_INPUT25, CDD_XBAR_INPUT26, CDD_XBAR_INPUT27, CDD_XBAR_INPUT28, CDD_XBAR_INPUT29, CDD_XBAR_INPUT30, CDD_XBAR_INPUT31, CDD_XBAR_INPUT32, CDD_XBAR_INPUT33, CDD_XBAR_INPUT34, CDD_XBAR_INPUT35, CDD_XBAR_INPUT36, CDD_XBAR_INPUT37, CDD_XBAR_INPUT38, CDD_XBAR_INPUT39, CDD_XBAR_INPUT40, CDD_XBAR_INPUT41, CDD_XBAR_INPUT42, CDD_XBAR_INPUT43, CDD_XBAR_INPUT44, CDD_XBAR_INPUT45, CDD_XBAR_INPUT46, CDD_XBAR_INPUT47, CDD_XBAR_INPUT48, CDD_XBAR_INPUT49, CDD_XBAR_INPUT50, CDD_XBAR_INPUT51, CDD_XBAR_INPUT52, CDD_XBAR_INPUT53, CDD_XBAR_INPUT54, CDD_XBAR_INPUT55, CDD_XBAR_INPUT56, CDD_XBAR_INPUT57, CDD_XBAR_INPUT58, CDD_XBAR_INPUT59, CDD_XBAR_INPUT60, CDD_XBAR_INPUT61, CDD_XBAR_INPUT62, CDD_XBAR_INPUT63, CDD_XBAR_INPUT64}, origin=Texas Instruments, set at pre-compile, default-value=CDD_XBAR_INPUT1  # Input number of input crossbar.
          boolean CddXbarInputXbarInputSelectConfigurationLock: origin=Texas Instruments, set at pre-compile, default-value=false  # Option to lock the current Input Group for any further configuration on Input Crossbar until System Reset. Once locked, cannot be unlocked without reset.
          reference CddXbarInputXbarInputSource [0..1]: multiplicity set at pre-compile, origin=Texas Instruments, set at pre-compile, destination=PortPin  # Reference to GPIO/AIO Pin, obtained from the configuration of PORT plugin.
      container CddXbarOutputXbarConfig  # Configuration for Output Crossbar
        boolean CddXbarOutputXbarConfigurationLock: origin=Texas Instruments, set at pre-compile, default-value=false  # Option to lock the Output crossbar instance for any further input and output inversion configuration until System Reset. Cannot be unlocked once locked unless reset.
        container CddXbarOutputXbarInstanceConfig [0..16]: multiplicity set at pre-compile  # Configuration for Output Crossbar Instance, one per output line available
          enumeration CddXbarOutputXbarOutputLine: {CDD_XBAR_OUTPUT1, CDD_XBAR_OUTPUT2, CDD_XBAR_OUTPUT3, CDD_XBAR_OUTPUT4, CDD_XBAR_OUTPUT5, CDD_XBAR_OUTPUT6, CDD_XBAR_OUTPUT7, CDD_XBAR_OUTPUT8, CDD_XBAR_OUTPUT9, CDD_XBAR_OUTPUT10, CDD_XBAR_OUTPUT11, CDD_XBAR_OUTPUT12, CDD_XBAR_OUTPUT13, CDD_XBAR_OUTPUT14, CDD_XBAR_OUTPUT15, CDD_XBAR_OUTPUT16}, origin=Texas Instruments, set at pre-compile, default-value=CDD_XBAR_OUTPUT1  # Number of Output Line instance to be set for Output Crossbar.
          enumeration CddXbarOutputXbarOutputPulseStretch: {CDD_XBAR_SYSTICKS_STRETCH_OFF, CDD_XBAR_SYSTICKS_16, CDD_XBAR_SYSTICKS_32}, origin=Texas Instruments, set at pre-compile, default-value=CDD_XBAR_SYSTICKS_STRETCH_OFF  # Output Line pulse stretch in Sys Clock ticks for Output Crossbar.
          boolean CddXbarOutputXbarOutputInversion: origin=Texas Instruments, set at pre-compile, default-value=false  # Option to invert the output signal for the selected output line of the Output Crossbar instance.
          boolean CddXbarOutputXbarOutputLatch: origin=Texas Instruments, set at pre-compile, default-value=false  # Option to select latch as output of selected output line for Output Crossbar instance.
          container CddXbarOutputXbarInput [1..10]: multiplicity set at pre-compile  # Configuration for Output Crossbar Instance inputs
            enumeration CddXbarOutputXbarInputGroup: {CDD_XBAR_INPUT_GROUP_0, CDD_XBAR_INPUT_GROUP_1, CDD_XBAR_INPUT_GROUP_2, CDD_XBAR_INPUT_GROUP_3, CDD_XBAR_INPUT_GROUP_4, CDD_XBAR_INPUT_GROUP_5, CDD_XBAR_INPUT_GROUP_6, CDD_XBAR_INPUT_GROUP_7, CDD_XBAR_INPUT_GROUP_8, CDD_XBAR_INPUT_GROUP_9}, origin=Texas Instruments, set at pre-compile, default-value=CDD_XBAR_INPUT_GROUP_0  # Number of Input Group to be chosen for Output Crossbar.
            enumeration CddXbarOutputXbarInputLine [1..32]: {CDD_XBAR_OUT_CMPSS1_CTRIPOUTH}, multiplicity set at pre-compile, origin=Texas Instruments, set at pre-compile, default-value=CDD_XBAR_OUT_CMPSS1_CTRIPOUTH  # Number of Input Line from the Group selected to be chosen for Output Crossbar.
          container CddXbarOutputXbarOutputFlagConfig  # Configuration for output crossbar output latch
            boolean CddXbarOutputXbarInversionBeforeLatch: origin=Texas Instruments, set at pre-compile, default-value=false  # Option to invert the signal before latching for the selected output line for Output Crossbar instance.
            enumeration CddXbarOutputXbarOutputLatchInitSts: {CDD_XBAR_OUTPUTDEFAULT, CDD_XBAR_OUTPUTCLEARFLAG, CDD_XBAR_OUTPUTFORCEFLAG}, origin=Texas Instruments, set at pre-compile, default-value=CDD_XBAR_OUTPUTDEFAULT  # Force or clear the output latch of individual output line for Output Crossbar during initialization
      container CddXbarEpwmXbarConfig  # Configuration for EPWM Crossbar
        boolean CddXbarEpwmXbarConfigurationLock: origin=Texas Instruments, set at pre-compile, default-value=false  # Option to lock the EPWM crossbar instance for any further configuration until System Reset. Cannot be unlocked once locked unless reset.
        container CddXbarEpwmXbarInstanceConfig [0..16]: multiplicity set at pre-compile  # Configuration for EPWM Crossbar Instance, one per output line available
          enumeration CddXbarEpwmXbarOutputLine: {CDD_XBAR_TRIP2, CDD_XBAR_TRIP3, CDD_XBAR_TRIP4, CDD_XBAR_TRIP5, CDD_XBAR_TRIP6, CDD_XBAR_TRIP7, CDD_XBAR_TRIP8, CDD_XBAR_TRIP9, CDD_XBAR_TRIP10, CDD_XBAR_TRIP11, CDD_XBAR_TRIP12, CDD_XBAR_TRIP13, CDD_XBAR_TRIP14, CDD_XBAR_TRIP15, CDD_XBAR_TRIP16}, origin=Texas Instruments, set at pre-compile, default-value=CDD_XBAR_TRIP2  # Number of Output Line instance to be set for EPWM Crossbar. TRIP1 is reserved.
          boolean CddXbarEpwmXbarOutputInversion: origin=Texas Instruments, set at pre-compile, default-value=false  # Option to invert the output signal for the selected output line of the EPWM Crossbar instance.
          container CddXbarEpwmXbarInput [1..10]: multiplicity set at pre-compile  # Configuration for EPWM Crossbar Instance inputs
            enumeration CddXbarEpwmXbarInputGroup: {CDD_XBAR_INPUT_GROUP_0, CDD_XBAR_INPUT_GROUP_1, CDD_XBAR_INPUT_GROUP_2, CDD_XBAR_INPUT_GROUP_3, CDD_XBAR_INPUT_GROUP_4, CDD_XBAR_INPUT_GROUP_5, CDD_XBAR_INPUT_GROUP_6, CDD_XBAR_INPUT_GROUP_7, CDD_XBAR_INPUT_GROUP_8, CDD_XBAR_INPUT_GROUP_9}, origin=Texas Instruments, set at pre-compile, default-value=CDD_XBAR_INPUT_GROUP_0  # Number of Input Group to be chosen for EPWM Crossbar.
            enumeration CddXbarEpwmXbarInputLine [1..32]: {CDD_XBAR_EPWM_CMPSS1_CTRIPH}, multiplicity set at pre-compile, origin=Texas Instruments, set at pre-compile, default-value=CDD_XBAR_EPWM_CMPSS1_CTRIPH  # Number of Input Line from the Group selected to be chosen for EPWM Crossbar.
      container CddXbarClbXbarConfig  # Configuration for CLB Crossbar
        boolean CddXbarClbXbarConfigurationLock: origin=Texas Instruments, set at pre-compile, default-value=false  # Option to lock the CLB crossbar instance for any further configuration until System Reset. Cannot be unlocked once locked unless reset.
        container CddXbarClbXbarInstanceConfig [0..8]: multiplicity set at pre-compile  # Configuration for CLB Crossbar Instance, one per output line available
          enumeration CddXbarClbXbarOutputLine: {CDD_XBAR_AUXSIG1, CDD_XBAR_AUXSIG2, CDD_XBAR_AUXSIG3, CDD_XBAR_AUXSIG4, CDD_XBAR_AUXSIG5, CDD_XBAR_AUXSIG6, CDD_XBAR_AUXSIG7, CDD_XBAR_AUXSIG8}, origin=Texas Instruments, set at pre-compile, default-value=CDD_XBAR_AUXSIG1  # Number of Output Line instance to be set for CLB Crossbar.
          boolean CddXbarClbXbarOutputInversion: origin=Texas Instruments, set at pre-compile, default-value=false  # Option to invert the output signal for the selected output line of the CLB Crossbar instance.
          container CddXbarClbXbarInput [1..8]: multiplicity set at pre-compile  # Configuration for CLB Crossbar Instance inputs
            enumeration CddXbarClbXbarInputGroup: {CDD_XBAR_INPUT_GROUP_0, CDD_XBAR_INPUT_GROUP_1, CDD_XBAR_INPUT_GROUP_2, CDD_XBAR_INPUT_GROUP_3, CDD_XBAR_INPUT_GROUP_4, CDD_XBAR_INPUT_GROUP_5, CDD_XBAR_INPUT_GROUP_6, CDD_XBAR_INPUT_GROUP_7}, origin=Texas Instruments, set at pre-compile, default-value=CDD_XBAR_INPUT_GROUP_0  # Number of Input Group to be chosen for CLB Crossbar.
            enumeration CddXbarClbXbarInputLine [1..32]: {CDD_XBAR_CLB_CMPSS1_CTRIPH}, multiplicity set at pre-compile, origin=Texas Instruments, set at pre-compile, default-value=CDD_XBAR_CLB_CMPSS1_CTRIPH  # Number of Input Line from the Group selected to be chosen for CLB Crossbar.
      container CddXbarMindbXbarConfig  # Configuration for MINDB Crossbar
        boolean CddXbarMindbXbarConfigurationLock: origin=Texas Instruments, set at pre-compile, default-value=false  # Option to lock the MINDB crossbar instance for any further configuration until System Reset. Cannot be unlocked once locked unless reset.
        container CddXbarMindbXbarInstanceConfig [0..16]: multiplicity set at pre-compile  # Configuration for MINDB Crossbar Instance, one per output line available
          enumeration CddXbarMindbXbarOutputLine: {CDD_XBAR_MINDBXBAR1, CDD_XBAR_MINDBXBAR2, CDD_XBAR_MINDBXBAR3, CDD_XBAR_MINDBXBAR4, CDD_XBAR_MINDBXBAR5, CDD_XBAR_MINDBXBAR6, CDD_XBAR_MINDBXBAR7, CDD_XBAR_MINDBXBAR8, CDD_XBAR_MINDBXBAR9, CDD_XBAR_MINDBXBAR10, CDD_XBAR_MINDBXBAR11, CDD_XBAR_MINDBXBAR12, CDD_XBAR_MINDBXBAR13, CDD_XBAR_MINDBXBAR14, CDD_XBAR_MINDBXBAR15, CDD_XBAR_MINDBXBAR16}, origin=Texas Instruments, set at pre-compile, default-value=CDD_XBAR_MINDBXBAR1  # Number of Output Line instance to be set for MINDB Crossbar.
          boolean CddXbarMindbXbarOutputInversion: origin=Texas Instruments, set at pre-compile, default-value=false  # Option to invert the output signal for the selected output line of the MINDB Crossbar instance.
          container CddXbarMindbXbarInput [1..3]: multiplicity set at pre-compile  # Configuration for MINDB Crossbar Instance inputs
            enumeration CddXbarMindbXbarInputGroup: {CDD_XBAR_INPUT_GROUP_0, CDD_XBAR_INPUT_GROUP_1, CDD_XBAR_INPUT_GROUP_2}, origin=Texas Instruments, set at pre-compile, default-value=CDD_XBAR_INPUT_GROUP_0  # Number of Input Group to be chosen for MINDB Crossbar.
            enumeration CddXbarMindbXbarInputLine [1..32]: {CDD_XBAR_MINDB_EPWM1A_DB_NO_HR}, multiplicity set at pre-compile, origin=Texas Instruments, set at pre-compile, default-value=CDD_XBAR_MINDB_EPWM1A_DB_NO_HR  # Number of Input Line from the Group selected to be chosen for MINDB Crossbar.
      container CddXbarIclXbarConfig  # Configuration for ICL Crossbar
        boolean CddXbarIclXbarConfigurationLock: origin=Texas Instruments, set at pre-compile, default-value=false  # Option to lock the ICL crossbar instance for any further configuration until System Reset. Cannot be unlocked once locked unless reset.
        container CddXbarIclXbarInstanceConfig [0..16]: multiplicity set at pre-compile  # Configuration for ICL Crossbar Instance, one per output line available
          enumeration CddXbarIclXbarOutputLine: {CDD_XBAR_ICLXBAR1, CDD_XBAR_ICLXBAR2, CDD_XBAR_ICLXBAR3, CDD_XBAR_ICLXBAR4, CDD_XBAR_ICLXBAR5, CDD_XBAR_ICLXBAR6, CDD_XBAR_ICLXBAR7, CDD_XBAR_ICLXBAR8, CDD_XBAR_ICLXBAR9, CDD_XBAR_ICLXBAR10, CDD_XBAR_ICLXBAR11, CDD_XBAR_ICLXBAR12, CDD_XBAR_ICLXBAR13, CDD_XBAR_ICLXBAR14, CDD_XBAR_ICLXBAR15, CDD_XBAR_ICLXBAR16}, origin=Texas Instruments, set at pre-compile, default-value=CDD_XBAR_ICLXBAR1  # Number of Output Line instance to be set for ICL Crossbar.
          boolean CddXbarIclXbarOutputInversion: origin=Texas Instruments, set at pre-compile, default-value=false  # Option to invert the output signal for the selected output line of the ICL Crossbar instance.
          container CddXbarIclXbarInput [1..3]: multiplicity set at pre-compile  # Configuration for ICL Crossbar Instance inputs
            enumeration CddXbarIclXbarInputGroup: {CDD_XBAR_INPUT_GROUP_0, CDD_XBAR_INPUT_GROUP_1, CDD_XBAR_INPUT_GROUP_2}, origin=Texas Instruments, set at pre-compile, default-value=CDD_XBAR_INPUT_GROUP_0  # Number of Input Group to be chosen for ICL Crossbar.
            enumeration CddXbarIclXbarInputLine [1..32]: {CDD_XBAR_ICL_EPWM1A_MINDB}, multiplicity set at pre-compile, origin=Texas Instruments, set at pre-compile, default-value=CDD_XBAR_ICL_EPWM1A_MINDB  # Number of Input Line from the Group selected to be chosen for ICL Crossbar.
    container CddXbarGeneral  # Contains the general configuration parameters of the module.
      boolean CddXbarDevErrorDetect: origin=Texas Instruments, set at pre-compile, default-value=false  # Switches the Development Error Detection and Reporting ON or OFF for this module.
      boolean CddXbarVersionInfoApi: origin=Texas Instruments, set at pre-compile, default-value=true  # Switches the Cdd_Xbar_GetVersionInfo function ON or OFF.
      boolean CddXbarInputFlagApi: origin=Texas Instruments, set at pre-compile, default-value=true  # Switches Cdd_Xbar_InputFlagStatus() and Cdd_Xbar_InputFlagClear() ON or OFF.
      reference CddXbarInputFlag [0..1]: multiplicity set at pre-compile, origin=Texas Instruments, set at pre-compile, destination=CddXbarInputFlag  # Reference to the Cdd Xbar input flag. This flag is used to flag the inputs of the X-Bars to provide software knowledge of the input sources which got triggered
      reference CddXbarOutputXbarFlag [0..1]: multiplicity set at pre-compile, origin=Texas Instruments, set at pre-compile, destination=CddXbarOutputXbarFlag  # Reference to the Cdd Xbar output xbar flag.
