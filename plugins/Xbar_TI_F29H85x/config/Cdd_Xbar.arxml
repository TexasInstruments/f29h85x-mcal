AUTOSAR XML (schema 00044)
package /TI_F29H85x/Cdd_Xbar
  ecuc definition collection myEcuParameterDefinition: module=Cdd
  module definition Cdd: api-service-prefix=Cdd_Xbar, refined-module-def=Cdd, variants pre-compile  # Configuration of the CddXbar module.
    container CddXbarConfiguration  # This container contains the configuration parameters and sub containers of the CDD XBar module.
      container CddXbarInputXbarConfig  # Configuration for Input Crossbar
        container CddXbarInputXbarInstanceConfig [0..64]: multiplicity set at pre-compile  # Configuration for Input Crossbar instance, one per output line available
          enumeration CddXbarInputXbarInputSourceSelection: {CDD_XBAR_GPIO_AIO, CDD_XBAR_LOGIC_HIGH, CDD_XBAR_LOGIC_LOW}, origin=Texas Instruments, set at pre-compile, default-value=CDD_XBAR_GPIO_AIO  # Selects GPIO/AIO or LOGIC HIGH or LOGIC LOW as input to the input xbar.
          enumeration CddXbarInputXbarInput: {CDD_XBAR_INPUT1, CDD_XBAR_INPUT2, CDD_XBAR_INPUT3, CDD_XBAR_INPUT4, CDD_XBAR_INPUT5, CDD_XBAR_INPUT6, CDD_XBAR_INPUT7, CDD_XBAR_INPUT8, CDD_XBAR_INPUT9, CDD_XBAR_INPUT10, CDD_XBAR_INPUT11, CDD_XBAR_INPUT12, CDD_XBAR_INPUT13, CDD_XBAR_INPUT14, CDD_XBAR_INPUT15, CDD_XBAR_INPUT16, CDD_XBAR_INPUT17, CDD_XBAR_INPUT18, CDD_XBAR_INPUT19, CDD_XBAR_INPUT20, CDD_XBAR_INPUT21, CDD_XBAR_INPUT22, CDD_XBAR_INPUT23, CDD_XBAR_INPUT24, CDD_XBAR_INPUT25, CDD_XBAR_INPUT26, CDD_XBAR_INPUT27, CDD_XBAR_INPUT28, CDD_XBAR_INPUT29, CDD_XBAR_INPUT30, CDD_XBAR_INPUT31, CDD_XBAR_INPUT32, CDD_XBAR_INPUT33, CDD_XBAR_INPUT34, CDD_XBAR_INPUT35, CDD_XBAR_INPUT36, CDD_XBAR_INPUT37, CDD_XBAR_INPUT38, CDD_XBAR_INPUT39, CDD_XBAR_INPUT40, CDD_XBAR_INPUT41, CDD_XBAR_INPUT42, CDD_XBAR_INPUT43, CDD_XBAR_INPUT44, CDD_XBAR_INPUT45, CDD_XBAR_INPUT46, CDD_XBAR_INPUT47, CDD_XBAR_INPUT48, CDD_XBAR_INPUT49, CDD_XBAR_INPUT50, CDD_XBAR_INPUT51, CDD_XBAR_INPUT52, CDD_XBAR_INPUT53, CDD_XBAR_INPUT54, CDD_XBAR_INPUT55, CDD_XBAR_INPUT56, CDD_XBAR_INPUT57, CDD_XBAR_INPUT58, CDD_XBAR_INPUT59, CDD_XBAR_INPUT60, CDD_XBAR_INPUT61, CDD_XBAR_INPUT62, CDD_XBAR_INPUT63, CDD_XBAR_INPUT64}, origin=Texas Instruments, set at pre-compile, default-value=CDD_XBAR_INPUT1  # Input number of input crossbar.
          enumeration CddXbarExternalInterruptEdge: {CDD_XBAR_INT_TYPE_DISABLED, CDD_XBAR_INT_TYPE_NEGATIVE_EDGE, CDD_XBAR_INT_TYPE_POSITIVE_EDGE, CDD_XBAR_INT_TYPE_BOTH_EDGE}, origin=Texas Instruments, set at pre-compile, default-value=CDD_XBAR_INT_TYPE_DISABLED  # External Interrupt Edge configuration. INPUT_XBAR to XINT Connections: INPUT_XBAR4 connects to XINT1 INPUT_XBAR5 connects to XINT2 INPUT_XBAR6 connects to XINT3 INPUT_XBAR13 connects to XINT4 INPUT_XBAR14 connects to XINT5 Note: For input crossbars that are not connected to XINT, this configuration will be disabled: CDD_XBAR_INT_TYPE_DISABLED.
          boolean CddXbarInputXbarInputSelectConfigurationLock: origin=Texas Instruments, set at pre-compile, default-value=false  # Option to lock the current Input Group for any further configuration on Input Crossbar until System Reset. Once locked, cannot be unlocked without reset.
          reference CddXbarInputXbarInputSource [0..1]: multiplicity set at pre-compile, origin=Texas Instruments, set at pre-compile, destination=PortPin  # Reference to GPIO/AIO Pin, obtained from the configuration of PORT plugin.
      container CddXbarOutputXbarConfig  # Configuration for Output Crossbar
        boolean CddXbarOutputXbarConfigurationLock: origin=Texas Instruments, set at pre-compile, default-value=false  # Option to lock the Output crossbar instance for any further input and output inversion configuration until System Reset. Cannot be unlocked once locked unless reset.
        container CddXbarOutputXbarInstanceConfig [0..16]: multiplicity set at pre-compile  # Configuration for Output Crossbar Instance, one per output line available
          enumeration CddXbarOutputXbarOutputLine: {CDD_XBAR_OUTPUT1, CDD_XBAR_OUTPUT2, CDD_XBAR_OUTPUT3, CDD_XBAR_OUTPUT4, CDD_XBAR_OUTPUT5, CDD_XBAR_OUTPUT6, CDD_XBAR_OUTPUT7, CDD_XBAR_OUTPUT8, CDD_XBAR_OUTPUT9, CDD_XBAR_OUTPUT10, CDD_XBAR_OUTPUT11, CDD_XBAR_OUTPUT12, CDD_XBAR_OUTPUT13, CDD_XBAR_OUTPUT14, CDD_XBAR_OUTPUT15, CDD_XBAR_OUTPUT16}, origin=Texas Instruments, set at pre-compile, default-value=CDD_XBAR_OUTPUT1  # Number of Output Line instance to be set for Output Crossbar.
          enumeration CddXbarOutputXbarOutputPulseStretch: {CDD_XBAR_SYSTICKS_STRETCH_OFF, CDD_XBAR_SYSTICKS_16, CDD_XBAR_SYSTICKS_32}, origin=Texas Instruments, set at pre-compile, default-value=CDD_XBAR_SYSTICKS_STRETCH_OFF  # Output Line pulse stretch in Sys Clock ticks for Output Crossbar.
          boolean CddXbarOutputXbarOutputInversion: origin=Texas Instruments, set at pre-compile, default-value=false  # Option to invert the output signal for the selected output line of the Output Crossbar instance.
          boolean CddXbarOutputXbarOutputLatch: origin=Texas Instruments, set at pre-compile, default-value=false  # Option to select latch as output of selected output line for Output Crossbar instance.
          container CddXbarOutputXbarInput [1..10]: multiplicity set at pre-compile  # Configuration for Output Crossbar Instance inputs
            enumeration CddXbarOutputXbarInputGroup: {CDD_XBAR_INPUT_GROUP_0, CDD_XBAR_INPUT_GROUP_1, CDD_XBAR_INPUT_GROUP_2, CDD_XBAR_INPUT_GROUP_3, CDD_XBAR_INPUT_GROUP_4, CDD_XBAR_INPUT_GROUP_5, CDD_XBAR_INPUT_GROUP_6, CDD_XBAR_INPUT_GROUP_7, CDD_XBAR_INPUT_GROUP_8, CDD_XBAR_INPUT_GROUP_9}, origin=Texas Instruments, set at pre-compile, default-value=CDD_XBAR_INPUT_GROUP_0  # Number of Input Group to be chosen for Output Crossbar.
            enumeration CddXbarOutputXbarInputLine [1..32]: {CDD_XBAR_OUT_ADCAEVT1, CDD_XBAR_OUT_ADCAEVT2, CDD_XBAR_OUT_ADCAEVT3, CDD_XBAR_OUT_ADCAEVT4, CDD_XBAR_OUT_ADCA_EXTMUXSEL0, CDD_XBAR_OUT_ADCA_EXTMUXSEL1, CDD_XBAR_OUT_ADCA_EXTMUXSEL2, CDD_XBAR_OUT_ADCA_EXTMUXSEL3, CDD_XBAR_OUT_ADCBEVT1, CDD_XBAR_OUT_ADCBEVT2, CDD_XBAR_OUT_ADCBEVT3, CDD_XBAR_OUT_ADCBEVT4, CDD_XBAR_OUT_ADCB_EXTMUXSEL0, CDD_XBAR_OUT_ADCB_EXTMUXSEL1, CDD_XBAR_OUT_ADCB_EXTMUXSEL2, CDD_XBAR_OUT_ADCB_EXTMUXSEL3, CDD_XBAR_OUT_ADCCEVT1, CDD_XBAR_OUT_ADCCEVT2, CDD_XBAR_OUT_ADCCEVT3, CDD_XBAR_OUT_ADCCEVT4, CDD_XBAR_OUT_ADCC_EXTMUXSEL0, CDD_XBAR_OUT_ADCC_EXTMUXSEL1, CDD_XBAR_OUT_ADCC_EXTMUXSEL2, CDD_XBAR_OUT_ADCC_EXTMUXSEL3, CDD_XBAR_OUT_ADCDEVT1, CDD_XBAR_OUT_ADCDEVT2, CDD_XBAR_OUT_ADCDEVT3, CDD_XBAR_OUT_ADCDEVT4, CDD_XBAR_OUT_ADCD_EXTMUXSEL0, CDD_XBAR_OUT_ADCD_EXTMUXSEL1, CDD_XBAR_OUT_ADCD_EXTMUXSEL2, CDD_XBAR_OUT_ADCD_EXTMUXSEL3, CDD_XBAR_OUT_ADCEEVT1, CDD_XBAR_OUT_ADCEEVT2, CDD_XBAR_OUT_ADCEEVT3, CDD_XBAR_OUT_ADCEEVT4, CDD_XBAR_OUT_ADCE_EXTMUXSEL0, CDD_XBAR_OUT_ADCE_EXTMUXSEL1, CDD_XBAR_OUT_ADCE_EXTMUXSEL2, CDD_XBAR_OUT_ADCE_EXTMUXSEL3, CDD_XBAR_OUT_ADCSOCA, CDD_XBAR_OUT_ADCSOCB, CDD_XBAR_OUT_CLB1_OUT0, CDD_XBAR_OUT_CLB1_OUT1, CDD_XBAR_OUT_CLB1_OUT2, CDD_XBAR_OUT_CLB1_OUT3, CDD_XBAR_OUT_CLB1_OUT4, CDD_XBAR_OUT_CLB1_OUT5, CDD_XBAR_OUT_CLB1_OUT6, CDD_XBAR_OUT_CLB1_OUT7, CDD_XBAR_OUT_CLB2_OUT0, CDD_XBAR_OUT_CLB2_OUT1, CDD_XBAR_OUT_CLB2_OUT2, CDD_XBAR_OUT_CLB2_OUT3, CDD_XBAR_OUT_CLB2_OUT4, CDD_XBAR_OUT_CLB2_OUT5, CDD_XBAR_OUT_CLB2_OUT6, CDD_XBAR_OUT_CLB2_OUT7, CDD_XBAR_OUT_CLB3_OUT0, CDD_XBAR_OUT_CLB3_OUT1, CDD_XBAR_OUT_CLB3_OUT2, CDD_XBAR_OUT_CLB3_OUT3, CDD_XBAR_OUT_CLB3_OUT4, CDD_XBAR_OUT_CLB3_OUT5, CDD_XBAR_OUT_CLB3_OUT6, CDD_XBAR_OUT_CLB3_OUT7, CDD_XBAR_OUT_CLB4_OUT0, CDD_XBAR_OUT_CLB4_OUT1, CDD_XBAR_OUT_CLB4_OUT2, CDD_XBAR_OUT_CLB4_OUT3, CDD_XBAR_OUT_CLB4_OUT4, CDD_XBAR_OUT_CLB4_OUT5, CDD_XBAR_OUT_CLB4_OUT6, CDD_XBAR_OUT_CLB4_OUT7, CDD_XBAR_OUT_CLB5_OUT0, CDD_XBAR_OUT_CLB5_OUT1, CDD_XBAR_OUT_CLB5_OUT2, CDD_XBAR_OUT_CLB5_OUT3, CDD_XBAR_OUT_CLB5_OUT4, CDD_XBAR_OUT_CLB5_OUT5, CDD_XBAR_OUT_CLB5_OUT6, CDD_XBAR_OUT_CLB5_OUT7, CDD_XBAR_OUT_CLB6_OUT0, CDD_XBAR_OUT_CLB6_OUT1, CDD_XBAR_OUT_CLB6_OUT2, CDD_XBAR_OUT_CLB6_OUT3, CDD_XBAR_OUT_CLB6_OUT4, CDD_XBAR_OUT_CLB6_OUT5, CDD_XBAR_OUT_CLB6_OUT6, CDD_XBAR_OUT_CLB6_OUT7, CDD_XBAR_OUT_CLBXBAR1, CDD_XBAR_OUT_CLBXBAR2, CDD_XBAR_OUT_CLBXBAR3, CDD_XBAR_OUT_CLBXBAR4, CDD_XBAR_OUT_CLBXBAR5, CDD_XBAR_OUT_CLBXBAR6, CDD_XBAR_OUT_CLBXBAR7, CDD_XBAR_OUT_CLBXBAR8, CDD_XBAR_OUT_CMPSS10_CTRIPOUTH, CDD_XBAR_OUT_CMPSS10_CTRIPOUTL, CDD_XBAR_OUT_CMPSS11_CTRIPOUTH, CDD_XBAR_OUT_CMPSS11_CTRIPOUTL, CDD_XBAR_OUT_CMPSS12_CTRIPOUTH, CDD_XBAR_OUT_CMPSS12_CTRIPOUTL, CDD_XBAR_OUT_CMPSS1_CTRIPOUTH, CDD_XBAR_OUT_CMPSS1_CTRIPOUTL, CDD_XBAR_OUT_CMPSS2_CTRIPOUTH, CDD_XBAR_OUT_CMPSS2_CTRIPOUTL, CDD_XBAR_OUT_CMPSS3_CTRIPOUTH, CDD_XBAR_OUT_CMPSS3_CTRIPOUTL, CDD_XBAR_OUT_CMPSS4_CTRIPOUTH, CDD_XBAR_OUT_CMPSS4_CTRIPOUTL, CDD_XBAR_OUT_CMPSS5_CTRIPOUTH, CDD_XBAR_OUT_CMPSS5_CTRIPOUTL, CDD_XBAR_OUT_CMPSS6_CTRIPOUTH, CDD_XBAR_OUT_CMPSS6_CTRIPOUTL, CDD_XBAR_OUT_CMPSS7_CTRIPOUTH, CDD_XBAR_OUT_CMPSS7_CTRIPOUTL, CDD_XBAR_OUT_CMPSS8_CTRIPOUTH, CDD_XBAR_OUT_CMPSS8_CTRIPOUTL, CDD_XBAR_OUT_CMPSS9_CTRIPOUTH, CDD_XBAR_OUT_CMPSS9_CTRIPOUTL, CDD_XBAR_OUT_CPU1_ADCCHECKEVT1, CDD_XBAR_OUT_CPU1_ADCCHECKEVT2, CDD_XBAR_OUT_CPU1_ADCCHECKEVT3, CDD_XBAR_OUT_CPU1_ADCCHECKEVT4, CDD_XBAR_OUT_CPU2_ADCCHECKEVT1, CDD_XBAR_OUT_CPU2_ADCCHECKEVT2, CDD_XBAR_OUT_CPU2_ADCCHECKEVT3, CDD_XBAR_OUT_CPU2_ADCCHECKEVT4, CDD_XBAR_OUT_CPU3_ADCCHECKEVT1, CDD_XBAR_OUT_CPU3_ADCCHECKEVT2, CDD_XBAR_OUT_CPU3_ADCCHECKEVT3, CDD_XBAR_OUT_CPU3_ADCCHECKEVT4, CDD_XBAR_OUT_ECAP1_OUT, CDD_XBAR_OUT_ECAP1_TRIPOUT, CDD_XBAR_OUT_ECAP2_OUT, CDD_XBAR_OUT_ECAP2_TRIPOUT, CDD_XBAR_OUT_ECAP3_OUT, CDD_XBAR_OUT_ECAP3_TRIPOUT, CDD_XBAR_OUT_ECAP4_OUT, CDD_XBAR_OUT_ECAP4_TRIPOUT, CDD_XBAR_OUT_ECAP5_OUT, CDD_XBAR_OUT_ECAP5_TRIPOUT, CDD_XBAR_OUT_ECAP6_OUT, CDD_XBAR_OUT_ECAP6_TRIPOUT, CDD_XBAR_OUT_ECAT_SYNC0, CDD_XBAR_OUT_ECAT_SYNC1, CDD_XBAR_OUT_EPG1OUT0, CDD_XBAR_OUT_EPG1OUT1, CDD_XBAR_OUT_EPG1OUT2, CDD_XBAR_OUT_EPG1OUT3, CDD_XBAR_OUT_EQEP1_INDEX_SYNCOUT, CDD_XBAR_OUT_EQEP1_STROBE_SYNCOUT, CDD_XBAR_OUT_EQEP2_INDEX_SYNCOUT, CDD_XBAR_OUT_EQEP2_STROBE_SYNCOUT, CDD_XBAR_OUT_EQEP3_INDEX_SYNCOUT, CDD_XBAR_OUT_EQEP3_STROBE_SYNCOUT, CDD_XBAR_OUT_EQEP4_INDEX_SYNCOUT, CDD_XBAR_OUT_EQEP4_STROBE_SYNCOUT, CDD_XBAR_OUT_EQEP5_INDEX_SYNCOUT, CDD_XBAR_OUT_EQEP5_STROBE_SYNCOUT, CDD_XBAR_OUT_EQEP6_INDEX_SYNCOUT, CDD_XBAR_OUT_EQEP6_STROBE_SYNCOUT, CDD_XBAR_OUT_ESM_GEN_EVENT, CDD_XBAR_OUT_EXTSYNCOUT, CDD_XBAR_OUT_FSIRXA_TRIG1, CDD_XBAR_OUT_FSIRXA_TRIG2, CDD_XBAR_OUT_FSIRXA_TRIG3, CDD_XBAR_OUT_FSIRXB_TRIG1, CDD_XBAR_OUT_FSIRXB_TRIG2, CDD_XBAR_OUT_FSIRXB_TRIG3, CDD_XBAR_OUT_FSIRXC_TRIG1, CDD_XBAR_OUT_FSIRXC_TRIG2, CDD_XBAR_OUT_FSIRXC_TRIG3, CDD_XBAR_OUT_FSIRXD_TRIG1, CDD_XBAR_OUT_FSIRXD_TRIG2, CDD_XBAR_OUT_FSIRXD_TRIG3, CDD_XBAR_OUT_INPUTXBAR1, CDD_XBAR_OUT_INPUTXBAR2, CDD_XBAR_OUT_INPUTXBAR3, CDD_XBAR_OUT_INPUTXBAR4, CDD_XBAR_OUT_INPUTXBAR5, CDD_XBAR_OUT_INPUTXBAR6, CDD_XBAR_OUT_INPUTXBAR7, CDD_XBAR_OUT_INPUTXBAR8, CDD_XBAR_OUT_MCANA_FEVT0, CDD_XBAR_OUT_MCANA_FEVT1, CDD_XBAR_OUT_MCANA_FEVT2, CDD_XBAR_OUT_MCANB_FEVT0, CDD_XBAR_OUT_MCANB_FEVT1, CDD_XBAR_OUT_MCANB_FEVT2, CDD_XBAR_OUT_MCANC_FEVT0, CDD_XBAR_OUT_MCANC_FEVT1, CDD_XBAR_OUT_MCANC_FEVT2, CDD_XBAR_OUT_MCAND_FEVT0, CDD_XBAR_OUT_MCAND_FEVT1, CDD_XBAR_OUT_MCAND_FEVT2, CDD_XBAR_OUT_MCANE_FEVT0, CDD_XBAR_OUT_MCANE_FEVT1, CDD_XBAR_OUT_MCANE_FEVT2, CDD_XBAR_OUT_MCANF_FEVT0, CDD_XBAR_OUT_MCANF_FEVT1, CDD_XBAR_OUT_MCANF_FEVT2, CDD_XBAR_OUT_SD1FLT1_COMPH, CDD_XBAR_OUT_SD1FLT1_COMPL, CDD_XBAR_OUT_SD1FLT2_COMPH, CDD_XBAR_OUT_SD1FLT2_COMPL, CDD_XBAR_OUT_SD1FLT3_COMPH, CDD_XBAR_OUT_SD1FLT3_COMPL, CDD_XBAR_OUT_SD1FLT4_COMPH, CDD_XBAR_OUT_SD1FLT4_COMPL, CDD_XBAR_OUT_SD2FLT1_COMPH, CDD_XBAR_OUT_SD2FLT1_COMPL, CDD_XBAR_OUT_SD2FLT2_COMPH, CDD_XBAR_OUT_SD2FLT2_COMPL, CDD_XBAR_OUT_SD2FLT3_COMPH, CDD_XBAR_OUT_SD2FLT3_COMPL, CDD_XBAR_OUT_SD2FLT4_COMPH, CDD_XBAR_OUT_SD2FLT4_COMPL, CDD_XBAR_OUT_SD3FLT1_COMPH, CDD_XBAR_OUT_SD3FLT1_COMPL, CDD_XBAR_OUT_SD3FLT2_COMPH, CDD_XBAR_OUT_SD3FLT2_COMPL, CDD_XBAR_OUT_SD3FLT3_COMPH, CDD_XBAR_OUT_SD3FLT3_COMPL, CDD_XBAR_OUT_SD3FLT4_COMPH, CDD_XBAR_OUT_SD3FLT4_COMPL, CDD_XBAR_OUT_SD4FLT1_COMPH, CDD_XBAR_OUT_SD4FLT1_COMPL, CDD_XBAR_OUT_SD4FLT2_COMPH, CDD_XBAR_OUT_SD4FLT2_COMPL, CDD_XBAR_OUT_SD4FLT3_COMPH, CDD_XBAR_OUT_SD4FLT3_COMPL, CDD_XBAR_OUT_SD4FLT4_COMPH, CDD_XBAR_OUT_SD4FLT4_COMPL, CDD_XBAR_OUT_WADI1OUT0, CDD_XBAR_OUT_WADI1OUT1, CDD_XBAR_OUT_WADI1OUT2, CDD_XBAR_OUT_WADI1OUT3, CDD_XBAR_OUT_WADI1OUT4, CDD_XBAR_OUT_WADI1OUT5, CDD_XBAR_OUT_WADI1OUT6, CDD_XBAR_OUT_WADI1OUT7, CDD_XBAR_OUT_WADI2OUT0, CDD_XBAR_OUT_WADI2OUT1, CDD_XBAR_OUT_WADI2OUT2, CDD_XBAR_OUT_WADI2OUT3, CDD_XBAR_OUT_WADI2OUT4, CDD_XBAR_OUT_WADI2OUT5, CDD_XBAR_OUT_WADI2OUT6, CDD_XBAR_OUT_WADI2OUT7, CDD_XBAR_OUT_XCLKOUT}, multiplicity set at pre-compile, origin=Texas Instruments, set at pre-compile, default-value=CDD_XBAR_OUT_ADCAEVT1  # Number of Input Line from the Group selected to be chosen for Output Crossbar.
          container CddXbarOutputXbarOutputFlagConfig  # Configuration for output crossbar output latch
            boolean CddXbarOutputXbarInversionBeforeLatch: origin=Texas Instruments, set at pre-compile, default-value=false  # Option to invert the signal before latching for the selected output line for Output Crossbar instance.
            enumeration CddXbarOutputXbarOutputLatchInitSts: {CDD_XBAR_OUTPUTDEFAULT, CDD_XBAR_OUTPUTCLEARFLAG, CDD_XBAR_OUTPUTFORCEFLAG}, origin=Texas Instruments, set at pre-compile, default-value=CDD_XBAR_OUTPUTDEFAULT  # Force or clear the output latch of individual output line for Output Crossbar during initialization
      container CddXbarEpwmXbarConfig  # Configuration for EPWM Crossbar
        boolean CddXbarEpwmXbarConfigurationLock: origin=Texas Instruments, set at pre-compile, default-value=false  # Option to lock the EPWM crossbar instance for any further configuration until System Reset. Cannot be unlocked once locked unless reset.
        container CddXbarEpwmXbarInstanceConfig [0..16]: multiplicity set at pre-compile  # Configuration for EPWM Crossbar Instance, one per output line available
          enumeration CddXbarEpwmXbarOutputLine: {CDD_XBAR_TRIP1, CDD_XBAR_TRIP2, CDD_XBAR_TRIP3, CDD_XBAR_TRIP4, CDD_XBAR_TRIP5, CDD_XBAR_TRIP6, CDD_XBAR_TRIP7, CDD_XBAR_TRIP8, CDD_XBAR_TRIP9, CDD_XBAR_TRIP10, CDD_XBAR_TRIP11, CDD_XBAR_TRIP12, CDD_XBAR_TRIP13, CDD_XBAR_TRIP14, CDD_XBAR_TRIP15, CDD_XBAR_TRIP16}, origin=Texas Instruments, set at pre-compile, default-value=CDD_XBAR_TRIP1  # Number of Output Line instance to be set for EPWM Crossbar. TRIP1 is reserved.
          boolean CddXbarEpwmXbarOutputInversion: origin=Texas Instruments, set at pre-compile, default-value=false  # Option to invert the output signal for the selected output line of the EPWM Crossbar instance.
          container CddXbarEpwmXbarInput [1..10]: multiplicity set at pre-compile  # Configuration for EPWM Crossbar Instance inputs
            enumeration CddXbarEpwmXbarInputGroup: {CDD_XBAR_INPUT_GROUP_0, CDD_XBAR_INPUT_GROUP_1, CDD_XBAR_INPUT_GROUP_2, CDD_XBAR_INPUT_GROUP_3, CDD_XBAR_INPUT_GROUP_4, CDD_XBAR_INPUT_GROUP_5, CDD_XBAR_INPUT_GROUP_6, CDD_XBAR_INPUT_GROUP_7, CDD_XBAR_INPUT_GROUP_8, CDD_XBAR_INPUT_GROUP_9}, origin=Texas Instruments, set at pre-compile, default-value=CDD_XBAR_INPUT_GROUP_0  # Number of Input Group to be chosen for EPWM Crossbar.
            enumeration CddXbarEpwmXbarInputLine [1..32]: {CDD_XBAR_EPWM_ADCAEVT1, CDD_XBAR_EPWM_ADCAEVT2, CDD_XBAR_EPWM_ADCAEVT3, CDD_XBAR_EPWM_ADCAEVT4, CDD_XBAR_EPWM_ADCBEVT1, CDD_XBAR_EPWM_ADCBEVT2, CDD_XBAR_EPWM_ADCBEVT3, CDD_XBAR_EPWM_ADCBEVT4, CDD_XBAR_EPWM_ADCCEVT1, CDD_XBAR_EPWM_ADCCEVT2, CDD_XBAR_EPWM_ADCCEVT3, CDD_XBAR_EPWM_ADCCEVT4, CDD_XBAR_EPWM_ADCDEVT1, CDD_XBAR_EPWM_ADCDEVT2, CDD_XBAR_EPWM_ADCDEVT3, CDD_XBAR_EPWM_ADCDEVT4, CDD_XBAR_EPWM_ADCEEVT1, CDD_XBAR_EPWM_ADCEEVT2, CDD_XBAR_EPWM_ADCEEVT3, CDD_XBAR_EPWM_ADCEEVT4, CDD_XBAR_EPWM_ADCSOCA, CDD_XBAR_EPWM_ADCSOCB, CDD_XBAR_EPWM_CLB1_OUT4, CDD_XBAR_EPWM_CLB1_OUT5, CDD_XBAR_EPWM_CLB2_OUT4, CDD_XBAR_EPWM_CLB2_OUT5, CDD_XBAR_EPWM_CLB3_OUT4, CDD_XBAR_EPWM_CLB3_OUT5, CDD_XBAR_EPWM_CLB4_OUT4, CDD_XBAR_EPWM_CLB4_OUT5, CDD_XBAR_EPWM_CLB5_OUT4, CDD_XBAR_EPWM_CLB5_OUT5, CDD_XBAR_EPWM_CLB6_OUT4, CDD_XBAR_EPWM_CLB6_OUT5, CDD_XBAR_EPWM_CMPSS10_CTRIPH, CDD_XBAR_EPWM_CMPSS10_CTRIPL, CDD_XBAR_EPWM_CMPSS11_CTRIPH, CDD_XBAR_EPWM_CMPSS11_CTRIPL, CDD_XBAR_EPWM_CMPSS12_CTRIPH, CDD_XBAR_EPWM_CMPSS12_CTRIPL, CDD_XBAR_EPWM_CMPSS1_CTRIPH, CDD_XBAR_EPWM_CMPSS1_CTRIPL, CDD_XBAR_EPWM_CMPSS2_CTRIPH, CDD_XBAR_EPWM_CMPSS2_CTRIPL, CDD_XBAR_EPWM_CMPSS3_CTRIPH, CDD_XBAR_EPWM_CMPSS3_CTRIPL, CDD_XBAR_EPWM_CMPSS4_CTRIPH, CDD_XBAR_EPWM_CMPSS4_CTRIPL, CDD_XBAR_EPWM_CMPSS5_CTRIPH, CDD_XBAR_EPWM_CMPSS5_CTRIPL, CDD_XBAR_EPWM_CMPSS6_CTRIPH, CDD_XBAR_EPWM_CMPSS6_CTRIPL, CDD_XBAR_EPWM_CMPSS7_CTRIPH, CDD_XBAR_EPWM_CMPSS7_CTRIPL, CDD_XBAR_EPWM_CMPSS8_CTRIPH, CDD_XBAR_EPWM_CMPSS8_CTRIPL, CDD_XBAR_EPWM_CMPSS9_CTRIPH, CDD_XBAR_EPWM_CMPSS9_CTRIPL, CDD_XBAR_EPWM_CPU1_ADCCHECKEVT1, CDD_XBAR_EPWM_CPU1_ADCCHECKEVT2, CDD_XBAR_EPWM_CPU1_ADCCHECKEVT3, CDD_XBAR_EPWM_CPU1_ADCCHECKEVT4, CDD_XBAR_EPWM_CPU2_ADCCHECKEVT1, CDD_XBAR_EPWM_CPU2_ADCCHECKEVT2, CDD_XBAR_EPWM_CPU2_ADCCHECKEVT3, CDD_XBAR_EPWM_CPU2_ADCCHECKEVT4, CDD_XBAR_EPWM_CPU3_ADCCHECKEVT1, CDD_XBAR_EPWM_CPU3_ADCCHECKEVT2, CDD_XBAR_EPWM_CPU3_ADCCHECKEVT3, CDD_XBAR_EPWM_CPU3_ADCCHECKEVT4, CDD_XBAR_EPWM_ECAP1_OUT, CDD_XBAR_EPWM_ECAP1_TRIPOUT, CDD_XBAR_EPWM_ECAP2_OUT, CDD_XBAR_EPWM_ECAP2_TRIPOUT, CDD_XBAR_EPWM_ECAP3_OUT, CDD_XBAR_EPWM_ECAP3_TRIPOUT, CDD_XBAR_EPWM_ECAP4_OUT, CDD_XBAR_EPWM_ECAP4_TRIPOUT, CDD_XBAR_EPWM_ECAP5_OUT, CDD_XBAR_EPWM_ECAP5_TRIPOUT, CDD_XBAR_EPWM_ECAP6_OUT, CDD_XBAR_EPWM_ECAP6_TRIPOUT, CDD_XBAR_EPWM_ECAT_SYNC0, CDD_XBAR_EPWM_ECAT_SYNC1, CDD_XBAR_EPWM_EPWM10_DE_ACTIVE, CDD_XBAR_EPWM_EPWM10_DE_DEMONTRIP, CDD_XBAR_EPWM_EPWM10_TRIPOUT, CDD_XBAR_EPWM_EPWM11_DE_ACTIVE, CDD_XBAR_EPWM_EPWM11_DE_DEMONTRIP, CDD_XBAR_EPWM_EPWM11_TRIPOUT, CDD_XBAR_EPWM_EPWM12_DE_ACTIVE, CDD_XBAR_EPWM_EPWM12_DE_DEMONTRIP, CDD_XBAR_EPWM_EPWM12_TRIPOUT, CDD_XBAR_EPWM_EPWM13_DE_ACTIVE, CDD_XBAR_EPWM_EPWM13_DE_DEMONTRIP, CDD_XBAR_EPWM_EPWM13_TRIPOUT, CDD_XBAR_EPWM_EPWM14_DE_ACTIVE, CDD_XBAR_EPWM_EPWM14_DE_DEMONTRIP, CDD_XBAR_EPWM_EPWM14_TRIPOUT, CDD_XBAR_EPWM_EPWM15_DE_ACTIVE, CDD_XBAR_EPWM_EPWM15_DE_DEMONTRIP, CDD_XBAR_EPWM_EPWM15_TRIPOUT, CDD_XBAR_EPWM_EPWM16_DE_ACTIVE, CDD_XBAR_EPWM_EPWM16_DE_DEMONTRIP, CDD_XBAR_EPWM_EPWM16_TRIPOUT, CDD_XBAR_EPWM_EPWM17_DE_ACTIVE, CDD_XBAR_EPWM_EPWM17_DE_DEMONTRIP, CDD_XBAR_EPWM_EPWM17_TRIPOUT, CDD_XBAR_EPWM_EPWM18_DE_ACTIVE, CDD_XBAR_EPWM_EPWM18_DE_DEMONTRIP, CDD_XBAR_EPWM_EPWM18_TRIPOUT, CDD_XBAR_EPWM_EPWM1_DE_ACTIVE, CDD_XBAR_EPWM_EPWM1_DE_DEMONTRIP, CDD_XBAR_EPWM_EPWM1_TRIPOUT, CDD_XBAR_EPWM_EPWM2_DE_ACTIVE, CDD_XBAR_EPWM_EPWM2_DE_DEMONTRIP, CDD_XBAR_EPWM_EPWM2_TRIPOUT, CDD_XBAR_EPWM_EPWM3_DE_ACTIVE, CDD_XBAR_EPWM_EPWM3_DE_DEMONTRIP, CDD_XBAR_EPWM_EPWM3_TRIPOUT, CDD_XBAR_EPWM_EPWM4_DE_ACTIVE, CDD_XBAR_EPWM_EPWM4_DE_DEMONTRIP, CDD_XBAR_EPWM_EPWM4_TRIPOUT, CDD_XBAR_EPWM_EPWM5_DE_ACTIVE, CDD_XBAR_EPWM_EPWM5_DE_DEMONTRIP, CDD_XBAR_EPWM_EPWM5_TRIPOUT, CDD_XBAR_EPWM_EPWM6_DE_ACTIVE, CDD_XBAR_EPWM_EPWM6_DE_DEMONTRIP, CDD_XBAR_EPWM_EPWM6_TRIPOUT, CDD_XBAR_EPWM_EPWM7_DE_ACTIVE, CDD_XBAR_EPWM_EPWM7_DE_DEMONTRIP, CDD_XBAR_EPWM_EPWM7_TRIPOUT, CDD_XBAR_EPWM_EPWM8_DE_ACTIVE, CDD_XBAR_EPWM_EPWM8_DE_DEMONTRIP, CDD_XBAR_EPWM_EPWM8_TRIPOUT, CDD_XBAR_EPWM_EPWM9_DE_ACTIVE, CDD_XBAR_EPWM_EPWM9_DE_DEMONTRIP, CDD_XBAR_EPWM_EPWM9_TRIPOUT, CDD_XBAR_EPWM_ESM_GEN_EVENT, CDD_XBAR_EPWM_EXTSYNCOUT, CDD_XBAR_EPWM_FSIRXA_TRIG1, CDD_XBAR_EPWM_FSIRXB_TRIG1, CDD_XBAR_EPWM_FSIRXC_TRIG1, CDD_XBAR_EPWM_FSIRXD_TRIG1, CDD_XBAR_EPWM_INPUTXBAR1, CDD_XBAR_EPWM_INPUTXBAR10, CDD_XBAR_EPWM_INPUTXBAR11, CDD_XBAR_EPWM_INPUTXBAR12, CDD_XBAR_EPWM_INPUTXBAR13, CDD_XBAR_EPWM_INPUTXBAR14, CDD_XBAR_EPWM_INPUTXBAR15, CDD_XBAR_EPWM_INPUTXBAR16, CDD_XBAR_EPWM_INPUTXBAR17, CDD_XBAR_EPWM_INPUTXBAR18, CDD_XBAR_EPWM_INPUTXBAR19, CDD_XBAR_EPWM_INPUTXBAR2, CDD_XBAR_EPWM_INPUTXBAR20, CDD_XBAR_EPWM_INPUTXBAR21, CDD_XBAR_EPWM_INPUTXBAR22, CDD_XBAR_EPWM_INPUTXBAR23, CDD_XBAR_EPWM_INPUTXBAR24, CDD_XBAR_EPWM_INPUTXBAR25, CDD_XBAR_EPWM_INPUTXBAR26, CDD_XBAR_EPWM_INPUTXBAR27, CDD_XBAR_EPWM_INPUTXBAR28, CDD_XBAR_EPWM_INPUTXBAR29, CDD_XBAR_EPWM_INPUTXBAR3, CDD_XBAR_EPWM_INPUTXBAR30, CDD_XBAR_EPWM_INPUTXBAR31, CDD_XBAR_EPWM_INPUTXBAR32, CDD_XBAR_EPWM_INPUTXBAR4, CDD_XBAR_EPWM_INPUTXBAR5, CDD_XBAR_EPWM_INPUTXBAR6, CDD_XBAR_EPWM_INPUTXBAR7, CDD_XBAR_EPWM_INPUTXBAR8, CDD_XBAR_EPWM_INPUTXBAR9, CDD_XBAR_EPWM_MCANA_FEVT0, CDD_XBAR_EPWM_MCANA_FEVT1, CDD_XBAR_EPWM_MCANA_FEVT2, CDD_XBAR_EPWM_MCANB_FEVT0, CDD_XBAR_EPWM_MCANB_FEVT1, CDD_XBAR_EPWM_MCANB_FEVT2, CDD_XBAR_EPWM_MCANC_FEVT0, CDD_XBAR_EPWM_MCANC_FEVT1, CDD_XBAR_EPWM_MCANC_FEVT2, CDD_XBAR_EPWM_MCAND_FEVT0, CDD_XBAR_EPWM_MCAND_FEVT1, CDD_XBAR_EPWM_MCAND_FEVT2, CDD_XBAR_EPWM_MCANE_FEVT0, CDD_XBAR_EPWM_MCANE_FEVT1, CDD_XBAR_EPWM_MCANE_FEVT2, CDD_XBAR_EPWM_MCANF_FEVT0, CDD_XBAR_EPWM_MCANF_FEVT1, CDD_XBAR_EPWM_MCANF_FEVT2, CDD_XBAR_EPWM_SD1FLT1_COMPH, CDD_XBAR_EPWM_SD1FLT1_COMPL, CDD_XBAR_EPWM_SD1FLT2_COMPH, CDD_XBAR_EPWM_SD1FLT2_COMPL, CDD_XBAR_EPWM_SD1FLT3_COMPH, CDD_XBAR_EPWM_SD1FLT3_COMPL, CDD_XBAR_EPWM_SD1FLT4_COMPH, CDD_XBAR_EPWM_SD1FLT4_COMPL, CDD_XBAR_EPWM_SD2FLT1_COMPH, CDD_XBAR_EPWM_SD2FLT1_COMPL, CDD_XBAR_EPWM_SD2FLT2_COMPH, CDD_XBAR_EPWM_SD2FLT2_COMPL, CDD_XBAR_EPWM_SD2FLT3_COMPH, CDD_XBAR_EPWM_SD2FLT3_COMPL, CDD_XBAR_EPWM_SD2FLT4_COMPH, CDD_XBAR_EPWM_SD2FLT4_COMPL, CDD_XBAR_EPWM_SD3FLT1_COMPH, CDD_XBAR_EPWM_SD3FLT1_COMPL, CDD_XBAR_EPWM_SD3FLT2_COMPH, CDD_XBAR_EPWM_SD3FLT2_COMPL, CDD_XBAR_EPWM_SD3FLT3_COMPH, CDD_XBAR_EPWM_SD3FLT3_COMPL, CDD_XBAR_EPWM_SD3FLT4_COMPH, CDD_XBAR_EPWM_SD3FLT4_COMPL, CDD_XBAR_EPWM_SD4FLT1_COMPH, CDD_XBAR_EPWM_SD4FLT1_COMPL, CDD_XBAR_EPWM_SD4FLT2_COMPH, CDD_XBAR_EPWM_SD4FLT2_COMPL, CDD_XBAR_EPWM_SD4FLT3_COMPH, CDD_XBAR_EPWM_SD4FLT3_COMPL, CDD_XBAR_EPWM_SD4FLT4_COMPH, CDD_XBAR_EPWM_SD4FLT4_COMPL, CDD_XBAR_EPWM_WADI1_ERROR_BUS_O_0, CDD_XBAR_EPWM_WADI1_ERROR_BUS_O_1, CDD_XBAR_EPWM_WADI1_ERROR_BUS_O_10, CDD_XBAR_EPWM_WADI1_ERROR_BUS_O_11, CDD_XBAR_EPWM_WADI1_ERROR_BUS_O_2, CDD_XBAR_EPWM_WADI1_ERROR_BUS_O_3, CDD_XBAR_EPWM_WADI1_ERROR_BUS_O_4, CDD_XBAR_EPWM_WADI1_ERROR_BUS_O_5, CDD_XBAR_EPWM_WADI1_ERROR_BUS_O_6, CDD_XBAR_EPWM_WADI1_ERROR_BUS_O_7, CDD_XBAR_EPWM_WADI1_ERROR_BUS_O_8, CDD_XBAR_EPWM_WADI1_ERROR_BUS_O_9, CDD_XBAR_EPWM_WADI2_ERROR_BUS_O_0, CDD_XBAR_EPWM_WADI2_ERROR_BUS_O_1, CDD_XBAR_EPWM_WADI2_ERROR_BUS_O_10, CDD_XBAR_EPWM_WADI2_ERROR_BUS_O_11, CDD_XBAR_EPWM_WADI2_ERROR_BUS_O_2, CDD_XBAR_EPWM_WADI2_ERROR_BUS_O_3, CDD_XBAR_EPWM_WADI2_ERROR_BUS_O_4, CDD_XBAR_EPWM_WADI2_ERROR_BUS_O_5, CDD_XBAR_EPWM_WADI2_ERROR_BUS_O_6, CDD_XBAR_EPWM_WADI2_ERROR_BUS_O_7, CDD_XBAR_EPWM_WADI2_ERROR_BUS_O_8, CDD_XBAR_EPWM_WADI2_ERROR_BUS_O_9}, multiplicity set at pre-compile, origin=Texas Instruments, set at pre-compile, default-value=CDD_XBAR_EPWM_ADCAEVT1  # Number of Input Line from the Group selected to be chosen for EPWM Crossbar.
      container CddXbarClbXbarConfig  # Configuration for CLB Crossbar
        boolean CddXbarClbXbarConfigurationLock: origin=Texas Instruments, set at pre-compile, default-value=false  # Option to lock the CLB crossbar instance for any further configuration until System Reset. Cannot be unlocked once locked unless reset.
        container CddXbarClbXbarInstanceConfig [0..8]: multiplicity set at pre-compile  # Configuration for CLB Crossbar Instance, one per output line available
          enumeration CddXbarClbXbarOutputLine: {CDD_XBAR_AUXSIG1, CDD_XBAR_AUXSIG2, CDD_XBAR_AUXSIG3, CDD_XBAR_AUXSIG4, CDD_XBAR_AUXSIG5, CDD_XBAR_AUXSIG6, CDD_XBAR_AUXSIG7, CDD_XBAR_AUXSIG8}, origin=Texas Instruments, set at pre-compile, default-value=CDD_XBAR_AUXSIG1  # Number of Output Line instance to be set for CLB Crossbar.
          boolean CddXbarClbXbarOutputInversion: origin=Texas Instruments, set at pre-compile, default-value=false  # Option to invert the output signal for the selected output line of the CLB Crossbar instance.
          container CddXbarClbXbarInput [1..8]: multiplicity set at pre-compile  # Configuration for CLB Crossbar Instance inputs
            enumeration CddXbarClbXbarInputGroup: {CDD_XBAR_INPUT_GROUP_0, CDD_XBAR_INPUT_GROUP_1, CDD_XBAR_INPUT_GROUP_2, CDD_XBAR_INPUT_GROUP_3, CDD_XBAR_INPUT_GROUP_4, CDD_XBAR_INPUT_GROUP_5, CDD_XBAR_INPUT_GROUP_6, CDD_XBAR_INPUT_GROUP_7}, origin=Texas Instruments, set at pre-compile, default-value=CDD_XBAR_INPUT_GROUP_0  # Number of Input Group to be chosen for CLB Crossbar.
            enumeration CddXbarClbXbarInputLine [1..32]: {CDD_XBAR_CLB_ADCAEVT1, CDD_XBAR_CLB_ADCAEVT2, CDD_XBAR_CLB_ADCAEVT3, CDD_XBAR_CLB_ADCAEVT4, CDD_XBAR_CLB_ADCBEVT1, CDD_XBAR_CLB_ADCBEVT2, CDD_XBAR_CLB_ADCBEVT3, CDD_XBAR_CLB_ADCBEVT4, CDD_XBAR_CLB_ADCCEVT1, CDD_XBAR_CLB_ADCCEVT2, CDD_XBAR_CLB_ADCCEVT3, CDD_XBAR_CLB_ADCCEVT4, CDD_XBAR_CLB_ADCDEVT1, CDD_XBAR_CLB_ADCDEVT2, CDD_XBAR_CLB_ADCDEVT3, CDD_XBAR_CLB_ADCDEVT4, CDD_XBAR_CLB_ADCEEVT1, CDD_XBAR_CLB_ADCEEVT2, CDD_XBAR_CLB_ADCEEVT3, CDD_XBAR_CLB_ADCEEVT4, CDD_XBAR_CLB_ADCSOCA, CDD_XBAR_CLB_ADCSOCB, CDD_XBAR_CLB_CLB1_OUT12, CDD_XBAR_CLB_CLB1_OUT13, CDD_XBAR_CLB_CLB2_OUT12, CDD_XBAR_CLB_CLB2_OUT13, CDD_XBAR_CLB_CLB3_OUT12, CDD_XBAR_CLB_CLB3_OUT13, CDD_XBAR_CLB_CLB4_OUT12, CDD_XBAR_CLB_CLB4_OUT13, CDD_XBAR_CLB_CLB5_OUT12, CDD_XBAR_CLB_CLB5_OUT13, CDD_XBAR_CLB_CLB6_OUT12, CDD_XBAR_CLB_CLB6_OUT13, CDD_XBAR_CLB_CMPSS10_CTRIPH, CDD_XBAR_CLB_CMPSS10_CTRIPL, CDD_XBAR_CLB_CMPSS11_CTRIPH, CDD_XBAR_CLB_CMPSS11_CTRIPL, CDD_XBAR_CLB_CMPSS12_CTRIPH, CDD_XBAR_CLB_CMPSS12_CTRIPL, CDD_XBAR_CLB_CMPSS1_CTRIPH, CDD_XBAR_CLB_CMPSS1_CTRIPL, CDD_XBAR_CLB_CMPSS2_CTRIPH, CDD_XBAR_CLB_CMPSS2_CTRIPL, CDD_XBAR_CLB_CMPSS3_CTRIPH, CDD_XBAR_CLB_CMPSS3_CTRIPL, CDD_XBAR_CLB_CMPSS4_CTRIPH, CDD_XBAR_CLB_CMPSS4_CTRIPL, CDD_XBAR_CLB_CMPSS5_CTRIPH, CDD_XBAR_CLB_CMPSS5_CTRIPL, CDD_XBAR_CLB_CMPSS6_CTRIPH, CDD_XBAR_CLB_CMPSS6_CTRIPL, CDD_XBAR_CLB_CMPSS7_CTRIPH, CDD_XBAR_CLB_CMPSS7_CTRIPL, CDD_XBAR_CLB_CMPSS8_CTRIPH, CDD_XBAR_CLB_CMPSS8_CTRIPL, CDD_XBAR_CLB_CMPSS9_CTRIPH, CDD_XBAR_CLB_CMPSS9_CTRIPL, CDD_XBAR_CLB_CPU1_ADCCHECKEVT1, CDD_XBAR_CLB_CPU1_ADCCHECKEVT2, CDD_XBAR_CLB_CPU1_ADCCHECKEVT3, CDD_XBAR_CLB_CPU1_ADCCHECKEVT4, CDD_XBAR_CLB_CPU1_ERAD_EVT10, CDD_XBAR_CLB_CPU1_ERAD_EVT11, CDD_XBAR_CLB_CPU1_ERAD_EVT8, CDD_XBAR_CLB_CPU1_ERAD_EVT9, CDD_XBAR_CLB_CPU2_ADCCHECKEVT1, CDD_XBAR_CLB_CPU2_ADCCHECKEVT2, CDD_XBAR_CLB_CPU2_ADCCHECKEVT3, CDD_XBAR_CLB_CPU2_ADCCHECKEVT4, CDD_XBAR_CLB_CPU2_ERAD_EVT10, CDD_XBAR_CLB_CPU2_ERAD_EVT11, CDD_XBAR_CLB_CPU2_ERAD_EVT8, CDD_XBAR_CLB_CPU2_ERAD_EVT9, CDD_XBAR_CLB_CPU3_ADCCHECKEVT1, CDD_XBAR_CLB_CPU3_ADCCHECKEVT2, CDD_XBAR_CLB_CPU3_ADCCHECKEVT3, CDD_XBAR_CLB_CPU3_ADCCHECKEVT4, CDD_XBAR_CLB_CPU3_ERAD_EVT10, CDD_XBAR_CLB_CPU3_ERAD_EVT11, CDD_XBAR_CLB_CPU3_ERAD_EVT8, CDD_XBAR_CLB_CPU3_ERAD_EVT9, CDD_XBAR_CLB_ECAP1_OUT, CDD_XBAR_CLB_ECAP1_TRIPOUT, CDD_XBAR_CLB_ECAP2_OUT, CDD_XBAR_CLB_ECAP2_TRIPOUT, CDD_XBAR_CLB_ECAP3_OUT, CDD_XBAR_CLB_ECAP3_TRIPOUT, CDD_XBAR_CLB_ECAP4_OUT, CDD_XBAR_CLB_ECAP4_TRIPOUT, CDD_XBAR_CLB_ECAP5_OUT, CDD_XBAR_CLB_ECAP5_TRIPOUT, CDD_XBAR_CLB_ECAP6_OUT, CDD_XBAR_CLB_ECAP6_TRIPOUT, CDD_XBAR_CLB_ECAT_SYNC0, CDD_XBAR_CLB_ECAT_SYNC1, CDD_XBAR_CLB_ESM_GEN_EVENT, CDD_XBAR_CLB_EXTSYNCOUT, CDD_XBAR_CLB_FSIRXA_TRIG1, CDD_XBAR_CLB_FSIRXA_TRIG2, CDD_XBAR_CLB_FSIRXA_TRIG3, CDD_XBAR_CLB_FSIRXB_TRIG1, CDD_XBAR_CLB_FSIRXB_TRIG2, CDD_XBAR_CLB_FSIRXB_TRIG3, CDD_XBAR_CLB_FSIRXC_TRIG1, CDD_XBAR_CLB_FSIRXC_TRIG2, CDD_XBAR_CLB_FSIRXC_TRIG3, CDD_XBAR_CLB_FSIRXD_TRIG1, CDD_XBAR_CLB_FSIRXD_TRIG2, CDD_XBAR_CLB_FSIRXD_TRIG3, CDD_XBAR_CLB_INPUTXBAR1, CDD_XBAR_CLB_INPUTXBAR10, CDD_XBAR_CLB_INPUTXBAR11, CDD_XBAR_CLB_INPUTXBAR12, CDD_XBAR_CLB_INPUTXBAR13, CDD_XBAR_CLB_INPUTXBAR14, CDD_XBAR_CLB_INPUTXBAR15, CDD_XBAR_CLB_INPUTXBAR16, CDD_XBAR_CLB_INPUTXBAR17, CDD_XBAR_CLB_INPUTXBAR18, CDD_XBAR_CLB_INPUTXBAR19, CDD_XBAR_CLB_INPUTXBAR2, CDD_XBAR_CLB_INPUTXBAR20, CDD_XBAR_CLB_INPUTXBAR21, CDD_XBAR_CLB_INPUTXBAR22, CDD_XBAR_CLB_INPUTXBAR23, CDD_XBAR_CLB_INPUTXBAR24, CDD_XBAR_CLB_INPUTXBAR25, CDD_XBAR_CLB_INPUTXBAR26, CDD_XBAR_CLB_INPUTXBAR27, CDD_XBAR_CLB_INPUTXBAR28, CDD_XBAR_CLB_INPUTXBAR29, CDD_XBAR_CLB_INPUTXBAR3, CDD_XBAR_CLB_INPUTXBAR30, CDD_XBAR_CLB_INPUTXBAR31, CDD_XBAR_CLB_INPUTXBAR32, CDD_XBAR_CLB_INPUTXBAR4, CDD_XBAR_CLB_INPUTXBAR5, CDD_XBAR_CLB_INPUTXBAR6, CDD_XBAR_CLB_INPUTXBAR7, CDD_XBAR_CLB_INPUTXBAR8, CDD_XBAR_CLB_INPUTXBAR9, CDD_XBAR_CLB_MCANA_FEVT0, CDD_XBAR_CLB_MCANA_FEVT1, CDD_XBAR_CLB_MCANA_FEVT2, CDD_XBAR_CLB_MCANB_FEVT0, CDD_XBAR_CLB_MCANB_FEVT1, CDD_XBAR_CLB_MCANB_FEVT2, CDD_XBAR_CLB_MCANC_FEVT0, CDD_XBAR_CLB_MCANC_FEVT1, CDD_XBAR_CLB_MCANC_FEVT2, CDD_XBAR_CLB_MCAND_FEVT0, CDD_XBAR_CLB_MCAND_FEVT1, CDD_XBAR_CLB_MCAND_FEVT2, CDD_XBAR_CLB_MCANE_FEVT0, CDD_XBAR_CLB_MCANE_FEVT1, CDD_XBAR_CLB_MCANE_FEVT2, CDD_XBAR_CLB_MCANF_FEVT0, CDD_XBAR_CLB_MCANF_FEVT1, CDD_XBAR_CLB_MCANF_FEVT2, CDD_XBAR_CLB_SD1FLT1_COMPH, CDD_XBAR_CLB_SD1FLT1_COMPL, CDD_XBAR_CLB_SD1FLT2_COMPH, CDD_XBAR_CLB_SD1FLT2_COMPL, CDD_XBAR_CLB_SD1FLT3_COMPH, CDD_XBAR_CLB_SD1FLT3_COMPL, CDD_XBAR_CLB_SD1FLT4_COMPH, CDD_XBAR_CLB_SD1FLT4_COMPL, CDD_XBAR_CLB_SD2FLT1_COMPH, CDD_XBAR_CLB_SD2FLT1_COMPL, CDD_XBAR_CLB_SD2FLT2_COMPH, CDD_XBAR_CLB_SD2FLT2_COMPL, CDD_XBAR_CLB_SD2FLT3_COMPH, CDD_XBAR_CLB_SD2FLT3_COMPL, CDD_XBAR_CLB_SD2FLT4_COMPH, CDD_XBAR_CLB_SD2FLT4_COMPL, CDD_XBAR_CLB_SD3FLT1_COMPH, CDD_XBAR_CLB_SD3FLT1_COMPL, CDD_XBAR_CLB_SD3FLT2_COMPH, CDD_XBAR_CLB_SD3FLT2_COMPL, CDD_XBAR_CLB_SD3FLT3_COMPH, CDD_XBAR_CLB_SD3FLT3_COMPL, CDD_XBAR_CLB_SD3FLT4_COMPH, CDD_XBAR_CLB_SD3FLT4_COMPL, CDD_XBAR_CLB_SD4FLT1_COMPH, CDD_XBAR_CLB_SD4FLT1_COMPL, CDD_XBAR_CLB_SD4FLT2_COMPH, CDD_XBAR_CLB_SD4FLT2_COMPL, CDD_XBAR_CLB_SD4FLT3_COMPH, CDD_XBAR_CLB_SD4FLT3_COMPL, CDD_XBAR_CLB_SD4FLT4_COMPH, CDD_XBAR_CLB_SD4FLT4_COMPL, CDD_XBAR_CLB_WADI1OUT0, CDD_XBAR_CLB_WADI1OUT1, CDD_XBAR_CLB_WADI1OUT2, CDD_XBAR_CLB_WADI1OUT3, CDD_XBAR_CLB_WADI1OUT4, CDD_XBAR_CLB_WADI1OUT5, CDD_XBAR_CLB_WADI1OUT6, CDD_XBAR_CLB_WADI1OUT7, CDD_XBAR_CLB_WADI2OUT0, CDD_XBAR_CLB_WADI2OUT1, CDD_XBAR_CLB_WADI2OUT2, CDD_XBAR_CLB_WADI2OUT3, CDD_XBAR_CLB_WADI2OUT4, CDD_XBAR_CLB_WADI2OUT5, CDD_XBAR_CLB_WADI2OUT6, CDD_XBAR_CLB_WADI2OUT7}, multiplicity set at pre-compile, origin=Texas Instruments, set at pre-compile, default-value=CDD_XBAR_CLB_ADCAEVT1  # Number of Input Line from the Group selected to be chosen for CLB Crossbar.
      container CddXbarMindbXbarConfig  # Configuration for MINDB Crossbar
        boolean CddXbarMindbXbarConfigurationLock: origin=Texas Instruments, set at pre-compile, default-value=false  # Option to lock the MINDB crossbar instance for any further configuration until System Reset. Cannot be unlocked once locked unless reset.
        container CddXbarMindbXbarInstanceConfig [0..16]: multiplicity set at pre-compile  # Configuration for MINDB Crossbar Instance, one per output line available
          enumeration CddXbarMindbXbarOutputLine: {CDD_XBAR_MINDBXBAR1, CDD_XBAR_MINDBXBAR2, CDD_XBAR_MINDBXBAR3, CDD_XBAR_MINDBXBAR4, CDD_XBAR_MINDBXBAR5, CDD_XBAR_MINDBXBAR6, CDD_XBAR_MINDBXBAR7, CDD_XBAR_MINDBXBAR8, CDD_XBAR_MINDBXBAR9, CDD_XBAR_MINDBXBAR10, CDD_XBAR_MINDBXBAR11, CDD_XBAR_MINDBXBAR12, CDD_XBAR_MINDBXBAR13, CDD_XBAR_MINDBXBAR14, CDD_XBAR_MINDBXBAR15, CDD_XBAR_MINDBXBAR16}, origin=Texas Instruments, set at pre-compile, default-value=CDD_XBAR_MINDBXBAR1  # Number of Output Line instance to be set for MINDB Crossbar.
          boolean CddXbarMindbXbarOutputInversion: origin=Texas Instruments, set at pre-compile, default-value=false  # Option to invert the output signal for the selected output line of the MINDB Crossbar instance.
          container CddXbarMindbXbarInput [1..3]: multiplicity set at pre-compile  # Configuration for MINDB Crossbar Instance inputs
            enumeration CddXbarMindbXbarInputGroup: {CDD_XBAR_INPUT_GROUP_0, CDD_XBAR_INPUT_GROUP_1, CDD_XBAR_INPUT_GROUP_2}, origin=Texas Instruments, set at pre-compile, default-value=CDD_XBAR_INPUT_GROUP_0  # Number of Input Group to be chosen for MINDB Crossbar.
            enumeration CddXbarMindbXbarInputLine [1..32]: {CDD_XBAR_MINDB_CLB1_OUT12, CDD_XBAR_MINDB_CLB1_OUT13, CDD_XBAR_MINDB_CLB2_OUT12, CDD_XBAR_MINDB_CLB2_OUT13, CDD_XBAR_MINDB_CLB3_OUT12, CDD_XBAR_MINDB_CLB3_OUT13, CDD_XBAR_MINDB_CLB4_OUT12, CDD_XBAR_MINDB_CLB4_OUT13, CDD_XBAR_MINDB_CLB5_OUT12, CDD_XBAR_MINDB_CLB5_OUT13, CDD_XBAR_MINDB_CLB6_OUT12, CDD_XBAR_MINDB_CLB6_OUT13, CDD_XBAR_MINDB_EPWM10A_DB_NO_HR, CDD_XBAR_MINDB_EPWM10B_DB_NO_HR, CDD_XBAR_MINDB_EPWM11A_DB_NO_HR, CDD_XBAR_MINDB_EPWM11B_DB_NO_HR, CDD_XBAR_MINDB_EPWM12A_DB_NO_HR, CDD_XBAR_MINDB_EPWM12B_DB_NO_HR, CDD_XBAR_MINDB_EPWM13A_DB_NO_HR, CDD_XBAR_MINDB_EPWM13B_DB_NO_HR, CDD_XBAR_MINDB_EPWM14A_DB_NO_HR, CDD_XBAR_MINDB_EPWM14B_DB_NO_HR, CDD_XBAR_MINDB_EPWM15A_DB_NO_HR, CDD_XBAR_MINDB_EPWM15B_DB_NO_HR, CDD_XBAR_MINDB_EPWM16A_DB_NO_HR, CDD_XBAR_MINDB_EPWM16B_DB_NO_HR, CDD_XBAR_MINDB_EPWM17A_DB_NO_HR, CDD_XBAR_MINDB_EPWM17B_DB_NO_HR, CDD_XBAR_MINDB_EPWM18A_DB_NO_HR, CDD_XBAR_MINDB_EPWM18B_DB_NO_HR, CDD_XBAR_MINDB_EPWM1A_DB_NO_HR, CDD_XBAR_MINDB_EPWM1B_DB_NO_HR, CDD_XBAR_MINDB_EPWM2A_DB_NO_HR, CDD_XBAR_MINDB_EPWM2B_DB_NO_HR, CDD_XBAR_MINDB_EPWM3A_DB_NO_HR, CDD_XBAR_MINDB_EPWM3B_DB_NO_HR, CDD_XBAR_MINDB_EPWM4A_DB_NO_HR, CDD_XBAR_MINDB_EPWM4B_DB_NO_HR, CDD_XBAR_MINDB_EPWM5A_DB_NO_HR, CDD_XBAR_MINDB_EPWM5B_DB_NO_HR, CDD_XBAR_MINDB_EPWM6A_DB_NO_HR, CDD_XBAR_MINDB_EPWM6B_DB_NO_HR, CDD_XBAR_MINDB_EPWM7A_DB_NO_HR, CDD_XBAR_MINDB_EPWM7B_DB_NO_HR, CDD_XBAR_MINDB_EPWM8A_DB_NO_HR, CDD_XBAR_MINDB_EPWM8B_DB_NO_HR, CDD_XBAR_MINDB_EPWM9A_DB_NO_HR, CDD_XBAR_MINDB_EPWM9B_DB_NO_HR}, multiplicity set at pre-compile, origin=Texas Instruments, set at pre-compile, default-value=CDD_XBAR_MINDB_CLB1_OUT12  # Number of Input Line from the Group selected to be chosen for MINDB Crossbar.
      container CddXbarIclXbarConfig  # Configuration for ICL Crossbar
        boolean CddXbarIclXbarConfigurationLock: origin=Texas Instruments, set at pre-compile, default-value=false  # Option to lock the ICL crossbar instance for any further configuration until System Reset. Cannot be unlocked once locked unless reset.
        container CddXbarIclXbarInstanceConfig [0..16]: multiplicity set at pre-compile  # Configuration for ICL Crossbar Instance, one per output line available
          enumeration CddXbarIclXbarOutputLine: {CDD_XBAR_ICLXBAR1, CDD_XBAR_ICLXBAR2, CDD_XBAR_ICLXBAR3, CDD_XBAR_ICLXBAR4, CDD_XBAR_ICLXBAR5, CDD_XBAR_ICLXBAR6, CDD_XBAR_ICLXBAR7, CDD_XBAR_ICLXBAR8, CDD_XBAR_ICLXBAR9, CDD_XBAR_ICLXBAR10, CDD_XBAR_ICLXBAR11, CDD_XBAR_ICLXBAR12, CDD_XBAR_ICLXBAR13, CDD_XBAR_ICLXBAR14, CDD_XBAR_ICLXBAR15, CDD_XBAR_ICLXBAR16}, origin=Texas Instruments, set at pre-compile, default-value=CDD_XBAR_ICLXBAR1  # Number of Output Line instance to be set for ICL Crossbar.
          boolean CddXbarIclXbarOutputInversion: origin=Texas Instruments, set at pre-compile, default-value=false  # Option to invert the output signal for the selected output line of the ICL Crossbar instance.
          container CddXbarIclXbarInput [1..3]: multiplicity set at pre-compile  # Configuration for ICL Crossbar Instance inputs
            enumeration CddXbarIclXbarInputGroup: {CDD_XBAR_INPUT_GROUP_0, CDD_XBAR_INPUT_GROUP_1, CDD_XBAR_INPUT_GROUP_2}, origin=Texas Instruments, set at pre-compile, default-value=CDD_XBAR_INPUT_GROUP_0  # Number of Input Group to be chosen for ICL Crossbar.
            enumeration CddXbarIclXbarInputLine [1..32]: {CDD_XBAR_ICL_CLB1_OUT12, CDD_XBAR_ICL_CLB1_OUT13, CDD_XBAR_ICL_CLB2_OUT12, CDD_XBAR_ICL_CLB2_OUT13, CDD_XBAR_ICL_CLB3_OUT12, CDD_XBAR_ICL_CLB3_OUT13, CDD_XBAR_ICL_CLB4_OUT12, CDD_XBAR_ICL_CLB4_OUT13, CDD_XBAR_ICL_CLB5_OUT12, CDD_XBAR_ICL_CLB5_OUT13, CDD_XBAR_ICL_CLB6_OUT12, CDD_XBAR_ICL_CLB6_OUT13, CDD_XBAR_ICL_EPWM10A_MINDB, CDD_XBAR_ICL_EPWM10B_MINDB, CDD_XBAR_ICL_EPWM11A_MINDB, CDD_XBAR_ICL_EPWM11B_MINDB, CDD_XBAR_ICL_EPWM12A_MINDB, CDD_XBAR_ICL_EPWM12B_MINDB, CDD_XBAR_ICL_EPWM13A_MINDB, CDD_XBAR_ICL_EPWM13B_MINDB, CDD_XBAR_ICL_EPWM14A_MINDB, CDD_XBAR_ICL_EPWM14B_MINDB, CDD_XBAR_ICL_EPWM15A_MINDB, CDD_XBAR_ICL_EPWM15B_MINDB, CDD_XBAR_ICL_EPWM16A_MINDB, CDD_XBAR_ICL_EPWM16B_MINDB, CDD_XBAR_ICL_EPWM17A_MINDB, CDD_XBAR_ICL_EPWM17B_MINDB, CDD_XBAR_ICL_EPWM18A_MINDB, CDD_XBAR_ICL_EPWM18B_MINDB, CDD_XBAR_ICL_EPWM1A_MINDB, CDD_XBAR_ICL_EPWM1B_MINDB, CDD_XBAR_ICL_EPWM2A_MINDB, CDD_XBAR_ICL_EPWM2B_MINDB, CDD_XBAR_ICL_EPWM3A_MINDB, CDD_XBAR_ICL_EPWM3B_MINDB, CDD_XBAR_ICL_EPWM4A_MINDB, CDD_XBAR_ICL_EPWM4B_MINDB, CDD_XBAR_ICL_EPWM5A_MINDB, CDD_XBAR_ICL_EPWM5B_MINDB, CDD_XBAR_ICL_EPWM6A_MINDB, CDD_XBAR_ICL_EPWM6B_MINDB, CDD_XBAR_ICL_EPWM7A_MINDB, CDD_XBAR_ICL_EPWM7B_MINDB, CDD_XBAR_ICL_EPWM8A_MINDB, CDD_XBAR_ICL_EPWM8B_MINDB, CDD_XBAR_ICL_EPWM9A_MINDB, CDD_XBAR_ICL_EPWM9B_MINDB}, multiplicity set at pre-compile, origin=Texas Instruments, set at pre-compile, default-value=CDD_XBAR_ICL_CLB1_OUT12  # Number of Input Line from the Group selected to be chosen for ICL Crossbar.
    container CddXbarGeneral  # Contains the general configuration parameters of the module.
      boolean CddXbarDevErrorDetect: origin=Texas Instruments, set at pre-compile, default-value=false  # Switches the Development Error Detection and Reporting ON or OFF for this module.
      boolean CddXbarVersionInfoApi: origin=Texas Instruments, set at pre-compile, default-value=true  # Switches the Cdd_Xbar_GetVersionInfo function ON or OFF.
      boolean CddXbarInputFlagApi: origin=Texas Instruments, set at pre-compile, default-value=true  # Switches Cdd_Xbar_InputFlagStatus() and Cdd_Xbar_InputFlagClear() ON or OFF.
      reference CddXbarInputFlag [0..1]: multiplicity set at pre-compile, origin=Texas Instruments, set at pre-compile, destination=CddXbarInputFlag  # Reference to the Cdd Xbar input flag. This flag is used to flag the inputs of the X-Bars to provide software knowledge of the input sources which got triggered
      reference CddXbarOutputXbarFlag [0..1]: multiplicity set at pre-compile, origin=Texas Instruments, set at pre-compile, destination=CddXbarOutputXbarFlag  # Reference to the Cdd Xbar output xbar flag.
