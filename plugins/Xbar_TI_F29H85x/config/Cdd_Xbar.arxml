AUTOSAR XML (schema 00044)
package /TI_F29H85x
  ecuc definition collection ecuParameterDefinition: module=Cdd_Xbar
  module definition Cdd_Xbar: refined-module-def=Cdd, variants pre-compile  # CDD XBAR module configuration enables to configure all types of crossbars.
    container CddXbarConfiguration  # This container contains the configuration parameters and sub containers of the CDD XBar module.
      container CddXbarInputXbarConfig  # Configuration for Input Crossbar
        container CddXbarInputXbarInstanceConfig [0..*]  # Configuration for Input Crossbar instance, one per output line available
          enumeration CddXbarInputXbarInputSourceSelection: {undefined}, origin=Texas Instruments, set at pre-compile  # Selects GPIO/AIO or LOGIC HIGH or LOGIC LOW as input to the input xbar.
          enumeration CddXbarInputXbarInput: {undefined}, origin=Texas Instruments, set at pre-compile  # Input number of input crossbar.
          boolean CddXbarInputXbarInputSelectConfigurationLock: origin=Texas Instruments, set at pre-compile, default-value=false  # Option to lock the current Input Group for any further configuration on Input Crossbar until System Reset. Once locked, cannot be unlocked without reset.
          reference CddXbarInputXbarInputSource [0..1]: origin=Texas Instruments, set at pre-compile, destination=PortPin  # Reference to GPIO/AIO Pin, obtained from the configuration of PORT plugin.
      container CddXbarOutputXbarConfig  # Configuration for Output Crossbar
        boolean CddXbarOutputXbarConfigurationLock: origin=Texas Instruments, set at pre-compile, default-value=false  # Option to lock the Output crossbar instance for any further input and output inversion configuration until System Reset. Cannot be unlocked once locked unless reset.
        container CddXbarOutputXbarInstanceConfig [0..*]  # Configuration for Output Crossbar Instance, one per output line available
          enumeration CddXbarOutputXbarOutputLine: {undefined}, origin=Texas Instruments, set at pre-compile  # Number of Output Line instance to be set for Output Crossbar.
          enumeration CddXbarOutputXbarOutputPulseStretch: {undefined}, origin=Texas Instruments, set at pre-compile  # Output Line pulse stretch in Sys Clock ticks for Output Crossbar.
          boolean CddXbarOutputXbarOutputInversion: origin=Texas Instruments, set at pre-compile, default-value=false  # Option to invert the output signal for the selected output line of the Output Crossbar instance.
          boolean CddXbarOutputXbarOutputLatch: origin=Texas Instruments, set at pre-compile, default-value=false  # Option to select latch as output of selected output line for Output Crossbar instance.
          container CddXbarOutputXbarInput [1..*]  # Configuration for Output Crossbar Instance inputs
            enumeration CddXbarOutputXbarInputGroup: {undefined}, origin=Texas Instruments, set at pre-compile  # Number of Input Group to be chosen for Output Crossbar.
            enumeration CddXbarOutputXbarInputLine [1..*]: {undefined}, origin=Texas Instruments, set at pre-compile  # Number of Input Line from the Group selected to be chosen for Output Crossbar.
          container CddXbarOutputXbarOutputFlagConfig  # Configuration for output crossbar output latch
            boolean CddXbarOutputXbarInversionBeforeLatch: origin=Texas Instruments, set at pre-compile, default-value=false  # Option to invert the signal before latching for the selected output line for Output Crossbar instance.
            enumeration CddXbarOutputXbarOutputLatchInitSts: {undefined}, origin=Texas Instruments, set at pre-compile  # Force or clear the output latch of individual output line for Output Crossbar during initialization
      container CddXbarEpwmXbarConfig  # Configuration for EPWM Crossbar
        boolean CddXbarEpwmXbarConfigurationLock: origin=Texas Instruments, set at pre-compile, default-value=false  # Option to lock the EPWM crossbar instance for any further configuration until System Reset. Cannot be unlocked once locked unless reset.
        container CddXbarEpwmXbarInstanceConfig [0..*]  # Configuration for EPWM Crossbar Instance, one per output line available
          enumeration CddXbarEpwmXbarOutputLine: {undefined}, origin=Texas Instruments, set at pre-compile  # Number of Output Line instance to be set for EPWM Crossbar. TRIP1 is reserved.
          boolean CddXbarEpwmXbarOutputInversion: origin=Texas Instruments, set at pre-compile, default-value=false  # Option to invert the output signal for the selected output line of the EPWM Crossbar instance.
          container CddXbarEpwmXbarInput [1..*]  # Configuration for EPWM Crossbar Instance inputs
            enumeration CddXbarEpwmXbarInputGroup: {undefined}, origin=Texas Instruments, set at pre-compile  # Number of Input Group to be chosen for EPWM Crossbar.
            enumeration CddXbarEpwmXbarInputLine [1..*]: {undefined}, origin=Texas Instruments, set at pre-compile  # Number of Input Line from the Group selected to be chosen for EPWM Crossbar.
      container CddXbarClbXbarConfig  # Configuration for CLB Crossbar
        boolean CddXbarClbXbarConfigurationLock: origin=Texas Instruments, set at pre-compile, default-value=false  # Option to lock the CLB crossbar instance for any further configuration until System Reset. Cannot be unlocked once locked unless reset.
        container CddXbarClbXbarInstanceConfig [0..*]  # Configuration for CLB Crossbar Instance, one per output line available
          enumeration CddXbarClbXbarOutputLine: {undefined}, origin=Texas Instruments, set at pre-compile  # Number of Output Line instance to be set for CLB Crossbar.
          boolean CddXbarClbXbarOutputInversion: origin=Texas Instruments, set at pre-compile, default-value=false  # Option to invert the output signal for the selected output line of the CLB Crossbar instance.
          container CddXbarClbXbarInput [1..*]  # Configuration for CLB Crossbar Instance inputs
            enumeration CddXbarClbXbarInputGroup: {undefined}, origin=Texas Instruments, set at pre-compile  # Number of Input Group to be chosen for CLB Crossbar.
            enumeration CddXbarClbXbarInputLine [1..*]: {undefined}, origin=Texas Instruments, set at pre-compile  # Number of Input Line from the Group selected to be chosen for CLB Crossbar.
      container CddXbarMindbXbarConfig  # Configuration for MINDB Crossbar
        boolean CddXbarMindbXbarConfigurationLock: origin=Texas Instruments, set at pre-compile, default-value=false  # Option to lock the MINDB crossbar instance for any further configuration until System Reset. Cannot be unlocked once locked unless reset.
        container CddXbarMindbXbarInstanceConfig [0..*]  # Configuration for MINDB Crossbar Instance, one per output line available
          enumeration CddXbarMindbXbarOutputLine: {undefined}, origin=Texas Instruments, set at pre-compile  # Number of Output Line instance to be set for MINDB Crossbar.
          boolean CddXbarMindbXbarOutputInversion: origin=Texas Instruments, set at pre-compile, default-value=false  # Option to invert the output signal for the selected output line of the MINDB Crossbar instance.
          container CddXbarMindbXbarInput [1..*]  # Configuration for MINDB Crossbar Instance inputs
            enumeration CddXbarMindbXbarInputGroup: {undefined}, origin=Texas Instruments, set at pre-compile  # Number of Input Group to be chosen for MINDB Crossbar.
            enumeration CddXbarMindbXbarInputLine [1..*]: {undefined}, origin=Texas Instruments, set at pre-compile  # Number of Input Line from the Group selected to be chosen for MINDB Crossbar.
      container CddXbarIclXbarConfig  # Configuration for ICL Crossbar
        boolean CddXbarIclXbarConfigurationLock: origin=Texas Instruments, set at pre-compile, default-value=false  # Option to lock the ICL crossbar instance for any further configuration until System Reset. Cannot be unlocked once locked unless reset.
        container CddXbarIclXbarInstanceConfig [0..*]  # Configuration for ICL Crossbar Instance, one per output line available
          enumeration CddXbarIclXbarOutputLine: {undefined}, origin=Texas Instruments, set at pre-compile  # Number of Output Line instance to be set for ICL Crossbar.
          boolean CddXbarIclXbarOutputInversion: origin=Texas Instruments, set at pre-compile, default-value=false  # Option to invert the output signal for the selected output line of the ICL Crossbar instance.
          container CddXbarIclXbarInput [1..*]  # Configuration for ICL Crossbar Instance inputs
            enumeration CddXbarIclXbarInputGroup: {undefined}, origin=Texas Instruments, set at pre-compile  # Number of Input Group to be chosen for ICL Crossbar.
            enumeration CddXbarIclXbarInputLine [1..*]: {undefined}, origin=Texas Instruments, set at pre-compile  # Number of Input Line from the Group selected to be chosen for ICL Crossbar.
    container CddXbarGeneral  # Contains the general configuration parameters of the module.
      boolean CddXbarDevErrorDetect: origin=Texas Instruments, set at pre-compile, default-value=false  # Switches the Development Error Detection and Reporting ON or OFF for this module.
      boolean CddXbarAPIEnable: origin=Texas Instruments, set at pre-compile, default-value=true  # Enables or Disables the APIs of this module.
      boolean CddXbarVersionInfoApi [0..1]: multiplicity set at pre-compile, origin=Texas Instruments, set at pre-compile, default-value=true  # Switches the Cdd_Xbar_GetVersionInfo function ON or OFF.
      boolean CddXbarInputFlagApi [0..1]: multiplicity set at pre-compile, origin=Texas Instruments, set at pre-compile, default-value=true  # Switches Cdd_Xbar_InputFlagStatus() and Cdd_Xbar_InputFlagClear() ON or OFF.
