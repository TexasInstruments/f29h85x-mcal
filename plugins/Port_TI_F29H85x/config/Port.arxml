AUTOSAR XML (schema 00044)
package /TI_F29H85x
  ecuc definition collection myEcuParameterDefinition: module=Port
  module definition Port: post-build-variant-support=true, refined-module-def=Port, variants post-build/pre-compile  # Configuration of the Port module.
    container PortConfigSet  # This container contains the configuration parameters and sub containers of the AUTOSAR Port module.
      container PortContainer [1..*]  # Container collecting the PortPins.
        integer PortNumberOfPortPins: 1.., set at pre-compile  # The number of specified PortPins in this PortContainer.
        container PortPin [1..*]  # Configuration of the individual port pins.
          enumeration PortPinPeripheral: {undefined}, origin=Texas Instruments, set at post-build in variant post-build / pre-compile in variant pre-compile  # Available Peripherals for the pin package
          enumeration PortPinPeripheralInstance: {undefined}, origin=Texas Instruments, set at post-build in variant post-build / pre-compile in variant pre-compile  # Available instances for the Peripheral selected
          enumeration PortPinPeripheralSignal: {undefined}, origin=Texas Instruments, set at post-build in variant post-build / pre-compile in variant pre-compile  # Select specific type of peripheral signal pin of interest
          enumeration PortPhysicalPinId: {undefined}, origin=Texas Instruments, set at pre-compile  # Identifying The physical Pin Number on the selected Pin Package.
          enumeration PortPinName: {undefined}, origin=Texas Instruments, post-build-variant-value=true, set at post-build in variant post-build / pre-compile in variant pre-compile  # Device Pin Name for reference.
          integer PortPinId: set at post-build in variant post-build / pre-compile in variant pre-compile, symbolic-name-value=true  # Pin Id of the port pin. This value will be assigned to the symbolic name derived from the port pin container short name.
          boolean PortIsPinConfigurable: origin=Texas Instruments, post-build-variant-value=true, set at post-build in variant post-build / pre-compile in variant pre-compile  # Whether configuration is supported for this pin.
          boolean PortIsAnalogModeSupported: origin=Texas Instruments, post-build-variant-value=true, set at post-build in variant post-build / pre-compile in variant pre-compile  # Whether analog mode is supported for this pin.
          boolean PortIsAGPIO: origin=Texas Instruments, post-build-variant-value=true, set at post-build in variant post-build / pre-compile in variant pre-compile  # Whether this pin is AGPIO.
          boolean PortIsAIO: origin=Texas Instruments, post-build-variant-value=true, set at post-build in variant post-build / pre-compile in variant pre-compile  # Whether this pin is AIO.
          boolean PortIsGPIO: origin=Texas Instruments, post-build-variant-value=true, set at post-build in variant post-build / pre-compile in variant pre-compile  # Whether this pin is GPIO.
          enumeration PortAnalogMode: {PORT_ANALOG_DISABLED, PORT_ANALOG_ENABLED}, origin=Texas Instruments, post-build-variant-value=true, set at post-build in variant post-build / pre-compile in variant pre-compile  # Select whether the pin operates in Analog Mode.
          enumeration PortPinInitialMode: {undefined}, post-build-variant-value=true, set at post-build in variant post-build / pre-compile in variant pre-compile  # Port pin mode from mode list for use with Port_Init() function.
          enumeration PortPinDirection: {undefined}, post-build-variant-value=true, set at post-build in variant post-build / pre-compile in variant pre-compile  # The initial direction of the pin (IN or OUT). If the direction is not changeable, the value configured here is fixed.
          boolean PortPinDirectionChangeable: post-build-variant-value=true, set at post-build in variant post-build / pre-compile in variant pre-compile, default-value=False  # Parameter to indicate if the direction is changeable on a port pin during runtime.
          enumeration PortPinPadConfig: {PORT_PIN_TYPE_STD, PORT_PIN_TYPE_OPEN_DRAIN, PORT_PIN_TYPE_NA}, origin=Texas Instruments, post-build-variant-value=true, set at post-build in variant post-build / pre-compile in variant pre-compile  # Enable Push-Pull or Open Drain functionality.
          boolean PortPinPullUpConfig: origin=Texas Instruments, post-build-variant-value=true, set at post-build in variant post-build / pre-compile in variant pre-compile, default-value=false  # Enable Pull Up.
          enumeration PortPinQualificationMode: {PORT_QUAL_SYNC, PORT_QUAL_3SAMPLE, PORT_QUAL_6SAMPLE, PORT_QUAL_ASYNC, PORT_QUAL_NA}, origin=Texas Instruments, post-build-variant-value=true, set at post-build in variant post-build / pre-compile in variant pre-compile  # Synchronization mode of the peripheral signals.
          integer PortPinQualificationPeriod: -9223372036854775808..9223372036854775807, origin=Texas Instruments, post-build-variant-value=true, set at post-build in variant post-build / pre-compile in variant pre-compile, default-value=1  # Qualification period of the peripheral signals. NOTE: Qualification period can be set for the pair of 8 GPIOs For Instance: Qualification sampling period for GPIO0 to GPIO7: 0x00,QUALPRDx = PLLSYSCLK 0x01,QUALPRDx = PLLSYSCLK/2 0x02,QUALPRDx = PLLSYSCLK/4 .... 0xFF,QUALPRDx = PLLSYSCLK/510 Reset type: SYSRSn
          enumeration PortPinLevelValue: {PORT_PIN_LEVEL_HIGH, PORT_PIN_LEVEL_LOW, PORT_PIN_LEVEL_NA}, post-build-variant-value=true, set at post-build in variant post-build / pre-compile in variant pre-compile  # Port Pin Level value from Port pin list.
          enumeration PortPinCoreSelect: {PORT_CORE_CPU1, PORT_CORE_CPU2, PORT_CORE_CPU3}, origin=Texas Instruments, post-build-variant-value=true, set at post-build in variant post-build / pre-compile in variant pre-compile, default-value=PORT_CORE_CPU1  # Selection of core to which pin is to be mapped.
          boolean PortEnableWakeUpPinLPM: origin=Texas Instruments, set at post-build in variant post-build / pre-compile in variant pre-compile, default-value=false  # Use/Don't use the GPIO Pin as a wakeup source for the low power modes - standby/halt.
          enumeration PortPinMode [1..*]: {undefined}, multiplicity set at post-build in variant post-build / pre-compile in variant pre-compile, post-build-variant-multiplicity=true, post-build-variant-value=true, set at post-build in variant post-build / pre-compile in variant pre-compile  # Port pin mode from mode list.
          boolean PortPinModeChangeable: post-build-variant-value=true, set at post-build in variant post-build / pre-compile in variant pre-compile, default-value=false  # Parameter to indicate if the mode is changeable on a port pin during runtime. True: Port Pin mode changeable allowed. False: Port Pin mode changeable not permitted.
    container PortGeneral  # Module wide configuration parameters of the PORT driver.
      boolean PortDevErrorDetect: set at pre-compile, default-value=false  # Switches the development error detection and notification on or off.
      boolean PortSetPinDirectionApi: set at pre-compile, default-value=true  # Pre-processor switch to enable / disable the use of the function Port_SetPinDirection().
      boolean PortSetPinModeApi: set at pre-compile, default-value=true  # Pre-processor switch to enable / disable the use of the function Port_SetPinMode().
      boolean PortVersionInfoApi: set at pre-compile, default-value=false  # Pre-processor switch to enable / disable the API to read out the modules version information.
      enumeration PortDeviceVariant: {undefined}, origin=Texas Instruments, set at pre-compile  # Select package variant for F29H85x.
