AUTOSAR XML (schema 00044)
package /TI_F29H85x
  ecuc definition collection myEcuParameterDefinition: module=Port
  module definition Port: post-build-variant-support=true, refined-module-def=Port, variants post-build/pre-compile  # Configuration of the Port module.
    container PortConfigSet  # This container contains the configuration parameters and sub containers of the AUTOSAR Port module.
      container PortContainer [1..*]: multiplicity set at pre-compile in variant pre-compile / post-build in variant post-build  # Container collecting the PortPins.
        integer PortNumberOfPortPins: 1..1, set at pre-compile, default-value=1  # The number of specified PortPins in this PortContainer.
        container PortPin [1..*]: multiplicity set at pre-compile in variant pre-compile / post-build in variant post-build  # Configuration of the individual port pins.
          enumeration PortPinPeripheral: {GPIO}, origin=Texas Instruments, set at post-build in variant post-build / pre-compile in variant pre-compile, default-value=GPIO  # Available Peripherals for the pin package
          enumeration PortPinPeripheralInstance: {GPIO0}, origin=Texas Instruments, set at post-build in variant post-build / pre-compile in variant pre-compile, default-value=GPIO0  # Available instances for the Peripheral selected
          enumeration PortPinPeripheralSignal: {GPIO0}, origin=Texas Instruments, set at post-build in variant post-build / pre-compile in variant pre-compile, default-value=GPIO0  # Select specific type of peripheral signal pin of interest
          enumeration PortPhysicalPinId: {A8}, origin=Texas Instruments, set at pre-compile, default-value=A8  # Identifying The physical Pin Number on the selected Pin Package.
          enumeration PortPinName: {GPIO0}, origin=Texas Instruments, post-build-variant-value=true, set at post-build in variant post-build / pre-compile in variant pre-compile, default-value=GPIO0  # Device Pin Name for reference.
          integer PortPinId: 0..256, set at pre-compile, symbolic-name-value=true, default-value=0  # Pin Id of the port pin. This value will be assigned to the symbolic name derived from the port pin container short name.
          boolean PortIsPinConfigurable: origin=Texas Instruments, post-build-variant-value=true, set at post-build in variant post-build / pre-compile in variant pre-compile, default-value=true  # Whether configuration is supported for this pin.
          boolean PortIsAnalogModeSupported: origin=Texas Instruments, post-build-variant-value=true, set at post-build in variant post-build / pre-compile in variant pre-compile, default-value=false  # Whether analog mode is supported for this pin.
          boolean PortIsAGPIO: origin=Texas Instruments, post-build-variant-value=true, set at post-build in variant post-build / pre-compile in variant pre-compile, default-value=true  # Whether this pin is AGPIO.
          boolean PortIsAIO: origin=Texas Instruments, post-build-variant-value=true, set at post-build in variant post-build / pre-compile in variant pre-compile, default-value=true  # Whether this pin is AIO.
          boolean PortIsGPIO: origin=Texas Instruments, post-build-variant-value=true, set at post-build in variant post-build / pre-compile in variant pre-compile, default-value=true  # Whether this pin is GPIO.
          enumeration PortAnalogMode: {PORT_ANALOG_DISABLED, PORT_ANALOG_ENABLED}, origin=Texas Instruments, post-build-variant-value=true, set at post-build in variant post-build / pre-compile in variant pre-compile, default-value=PORT_ANALOG_ENABLED  # Select whether the pin operates in Analog Mode.
          enumeration PortPinInitialMode: {PORT_MUXMODE_NA}, post-build-variant-value=true, set at post-build in variant post-build / pre-compile in variant pre-compile, default-value=PORT_MUXMODE_NA  # Port pin mode from mode list for use with Port_Init() function.
          enumeration PortPinDirection: {PORT_PIN_IN}, post-build-variant-value=true, set at post-build in variant post-build / pre-compile in variant pre-compile, default-value=PORT_PIN_IN  # The initial direction of the pin (IN or OUT). If the direction is not changeable, the value configured here is fixed.
          boolean PortPinDirectionChangeable: post-build-variant-value=true, set at post-build in variant post-build / pre-compile in variant pre-compile, default-value=False  # Parameter to indicate if the direction is changeable on a port pin during runtime.
          enumeration PortPinPadConfig: {PORT_PIN_TYPE_STD, PORT_PIN_TYPE_OPEN_DRAIN, PORT_PIN_TYPE_NA}, origin=Texas Instruments, post-build-variant-value=true, set at post-build in variant post-build / pre-compile in variant pre-compile, default-value=PORT_PIN_TYPE_STD  # Enable Push-Pull or Open Drain functionality.
          boolean PortPinPullUpConfig: origin=Texas Instruments, post-build-variant-value=true, set at post-build in variant post-build / pre-compile in variant pre-compile, default-value=false  # Enable Pull Up.
          enumeration PortPinQualificationMode: {PORT_QUAL_SYNC, PORT_QUAL_3SAMPLE, PORT_QUAL_6SAMPLE, PORT_QUAL_ASYNC, PORT_QUAL_NA}, origin=Texas Instruments, post-build-variant-value=true, set at post-build in variant post-build / pre-compile in variant pre-compile, default-value=PORT_QUAL_SYNC  # Synchronization mode of the peripheral signals.
          integer PortPinQualificationPeriod: 0..510, origin=Texas Instruments, post-build-variant-value=true, set at post-build in variant post-build / pre-compile in variant pre-compile, default-value=1  # Qualification period of the peripheral signals. NOTE: The PortPinQualificationPeriod should be set to the same value for each pair of 8 consecutive GPIOs. For Instance: Qualification sampling period for GPIO0 to GPIO7: 0x00,QUALPRDx = PLLSYSCLK 0x01,QUALPRDx = PLLSYSCLK/2 0x02,QUALPRDx = PLLSYSCLK/4 .... 0xFF,QUALPRDx = PLLSYSCLK/510 Reset type: SYSRSn
          enumeration PortPinLevelValue: {PORT_PIN_LEVEL_HIGH, PORT_PIN_LEVEL_LOW, PORT_PIN_LEVEL_NA}, post-build-variant-value=true, set at post-build in variant post-build / pre-compile in variant pre-compile, default-value=PORT_PIN_LEVEL_LOW  # Port Pin Level value from Port pin list.
          enumeration PortPinCoreSelect: {PORT_CORE_CPU1, PORT_CORE_CPU2, PORT_CORE_CPU3}, origin=Texas Instruments, post-build-variant-value=true, set at post-build in variant post-build / pre-compile in variant pre-compile, default-value=PORT_CORE_CPU1  # Selection of core to which pin is to be mapped.
          boolean PortEnableWakeUpPinLPM: origin=Texas Instruments, set at post-build in variant post-build / pre-compile in variant pre-compile, default-value=false  # Use/Don't use the GPIO Pin as a wakeup source for the low power modes - standby/halt.
          enumeration PortPinMode: {PORT_MUXMODE_NA}, multiplicity set at post-build in variant post-build / pre-compile in variant pre-compile, post-build-variant-value=true, set at post-build in variant post-build / pre-compile in variant pre-compile, default-value=PORT_MUXMODE_NA  # Port pin mode from mode list.
          boolean PortPinModeChangeable: post-build-variant-value=true, set at post-build in variant post-build / pre-compile in variant pre-compile, default-value=false  # Parameter to indicate if the mode is changeable on a port pin during runtime. True: Port Pin mode changeable allowed. False: Port Pin mode changeable not permitted.
    container PortGeneral  # Module wide configuration parameters of the PORT driver.
      boolean PortDevErrorDetect: set at pre-compile, default-value=false  # Switches the development error detection and notification on or off.
      boolean PortSetPinDirectionApi: set at pre-compile, default-value=true  # Pre-processor switch to enable / disable the use of the function Port_SetPinDirection().
      boolean PortSetPinModeApi: set at pre-compile, default-value=true  # Pre-processor switch to enable / disable the use of the function Port_SetPinMode().
      boolean PortVersionInfoApi: set at pre-compile, default-value=false  # Pre-processor switch to enable / disable the API to read out the modules version information.
      boolean PortLockConfiguration: origin=Texas Instruments, set at post-build in variant post-build / pre-compile in variant pre-compile, default-value=false  # Lock All pins configuration.
      enumeration PortDeviceVariant: {F29H85x, F29H85x_100PZS, F29H85x_144RFS, F29H85x_176PTS, F29H85x_256ZEX, F29H859DU_Q1, F29H859TM_Q1, F29H859TU_Q1, F29P329SJ_Q1, F29P329SM_Q1, F29P589DM_Q1, F29P589DU_Q1}, origin=Texas Instruments, set at pre-compile, default-value=F29H85x_256ZEX  # Select package variant for F29H85x.
