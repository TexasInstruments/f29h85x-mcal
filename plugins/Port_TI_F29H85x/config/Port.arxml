AUTOSAR XML (schema 00044)
package /TI_F29H85x
  ecuc definition collection myEcuParameterDefinition: module=Port
  module definition Port: post-build-variant-support=true, refined-module-def=Port, variants post-build/pre-compile  # Configuration of the Port module.
    container PortConfigSet  # This container contains the configuration parameters and sub containers of the AUTOSAR Port module.
      container PortContainer [1..*]: multiplicity set at pre-compile in variant pre-compile / post-build in variant post-build  # Container collecting the PortPins.
        integer PortNumberOfPortPins: 1..256, set at pre-compile, default-value=1  # The number of specified PortPins in this PortContainer.
        container PortPin [1..*]: multiplicity set at pre-compile in variant pre-compile / post-build in variant post-build  # Configuration of the individual port pins.
          enumeration PortPinPeripheral: {ADC_EXTMUXSEL, AIO, ANALOG, EPWM, FSIRX, FSITX, GPIO, I2C, JTAG, LIN, MCAN, OTHER, OUTPUTXBAR, PMBUS, SD, SENT, SPI, UART, XTAL}, origin=Texas Instruments, set at post-build in variant post-build / pre-compile in variant pre-compile, default-value=ADC_EXTMUXSEL  # Available Peripherals for the pin package
          enumeration PortPinPeripheralInstance: {ADCA_EXTMUXSEL, ADCB_EXTMUXSEL, ADCC_EXTMUXSEL, ADCD_EXTMUXSEL, ADCE_EXTMUXSEL, AIO160, AIO161, AIO162, AIO163, AIO164, AIO165, AIO166, AIO167, AIO168, AIO169, AIO170, AIO171, AIO172, AIO173, AIO174, AIO175, AIO176, AIO177, AIO178, AIO179, AIO180, AIO181, AIO182, AIO183, AIO184, AIO185, AIO186, AIO187, AIO188, AIO189, AIO190, AIO191, AIO192, AIO193, AIO194, AIO195, AIO196, AIO197, AIO198, AIO199, AIO200, AIO201, AIO202, AIO203, AIO204, AIO205, AIO206, AIO207, AIO208, AIO209, AIO210, AIO211, AIO212, AIO213, ANALOG, EPWM1, EPWM10, EPWM11, EPWM12, EPWM13, EPWM14, EPWM15, EPWM16, EPWM17, EPWM18, EPWM2, EPWM3, EPWM4, EPWM5, EPWM6, EPWM7, EPWM8, EPWM9, FSIRXA, FSIRXB, FSIRXC, FSIRXD, FSITXA, FSITXB, FSITXC, FSITXD, GPIO0, GPIO1, GPIO10, GPIO100, GPIO101, GPIO103, GPIO105, GPIO11, GPIO12, GPIO127, GPIO13, GPIO14, GPIO15, GPIO16, GPIO17, GPIO18, GPIO19, GPIO2, GPIO20, GPIO21, GPIO219, GPIO22, GPIO220, GPIO221, GPIO222, GPIO223, GPIO224, GPIO225, GPIO226, GPIO227, GPIO228, GPIO229, GPIO23, GPIO230, GPIO231, GPIO232, GPIO233, GPIO234, GPIO235, GPIO236, GPIO237, GPIO238, GPIO239, GPIO24, GPIO240, GPIO241, GPIO242, GPIO243, GPIO244, GPIO245, GPIO246, GPIO247, GPIO248, GPIO249, GPIO25, GPIO26, GPIO27, GPIO28, GPIO29, GPIO3, GPIO30, GPIO31, GPIO32, GPIO33, GPIO34, GPIO35, GPIO36, GPIO37, GPIO38, GPIO39, GPIO4, GPIO40, GPIO41, GPIO42, GPIO43, GPIO44, GPIO45, GPIO46, GPIO47, GPIO48, GPIO49, GPIO5, GPIO50, GPIO51, GPIO52, GPIO53, GPIO54, GPIO55, GPIO56, GPIO57, GPIO58, GPIO59, GPIO6, GPIO60, GPIO61, GPIO62, GPIO63, GPIO64, GPIO65, GPIO66, GPIO67, GPIO68, GPIO69, GPIO7, GPIO70, GPIO71, GPIO72, GPIO73, GPIO74, GPIO75, GPIO76, GPIO77, GPIO78, GPIO79, GPIO8, GPIO80, GPIO81, GPIO82, GPIO83, GPIO84, GPIO85, GPIO86, GPIO87, GPIO88, GPIO89, GPIO9, GPIO90, GPIO91, GPIO92, GPIO93, GPIO94, GPIO95, GPIO96, GPIO97, GPIO98, GPIO99, I2CA, I2CB, INPUTXBAR, JTAG, LINA, LINB, MCANA, MCANB, MCANC, MCAND, MCANE, MCANF, OTHER, OUTPUTXBAR1, OUTPUTXBAR10, OUTPUTXBAR11, OUTPUTXBAR12, OUTPUTXBAR13, OUTPUTXBAR14, OUTPUTXBAR15, OUTPUTXBAR16, OUTPUTXBAR2, OUTPUTXBAR3, OUTPUTXBAR4, OUTPUTXBAR5, OUTPUTXBAR6, OUTPUTXBAR7, OUTPUTXBAR8, OUTPUTXBAR9, PMBUSA, SD1, SD2, SD3, SD4, SENT1, SENT2, SENT3, SENT4, SENT5, SENT6, SPIA, SPIB, SPIC, SPID, SPIE, UARTA, UARTB, UARTC, UARTD, UARTE, UARTF, XTAL}, origin=Texas Instruments, set at post-build in variant post-build / pre-compile in variant pre-compile, default-value=ADCA_EXTMUXSEL  # Available instances for the Peripheral selected
          enumeration PortPinPeripheralSignal: {A0_C24_DACA_OUT, A10_GPIO228, A11_GPIO229, A12, A13, A14_B14_C14_D14_E14, A15_B15_C15_D15_E15, A1_C25, A2_D24, A3_D25, A4_D28, A5_D29, A6_E24_GPIO224, A7_E25_GPIO225, A8_GPIO226, A9_GPIO227, ADCA_EXTMUXSEL0, ADCA_EXTMUXSEL1, ADCA_EXTMUXSEL2, ADCA_EXTMUXSEL3, ADCB_EXTMUXSEL0, ADCB_EXTMUXSEL1, ADCB_EXTMUXSEL2, ADCB_EXTMUXSEL3, ADCC_EXTMUXSEL0, ADCC_EXTMUXSEL1, ADCC_EXTMUXSEL2, ADCC_EXTMUXSEL3, ADCD_EXTMUXSEL0, ADCD_EXTMUXSEL1, ADCD_EXTMUXSEL2, ADCD_EXTMUXSEL3, ADCE_EXTMUXSEL0, ADCE_EXTMUXSEL1, ADCE_EXTMUXSEL2, ADCE_EXTMUXSEL3, ADCSOCAO, ADCSOCBO, AIO160, AIO161, AIO162, AIO163, AIO164, AIO165, AIO166, AIO167, AIO168, AIO169, AIO170, AIO171, AIO172, AIO173, AIO174, AIO175, AIO176, AIO177, AIO178, AIO179, AIO180, AIO181, AIO182, AIO183, AIO184, AIO185, AIO186, AIO187, AIO188, AIO189, AIO190, AIO191, AIO192, AIO193, AIO194, AIO195, AIO196, AIO197, AIO198, AIO199, AIO200, AIO201, AIO202, AIO203, AIO204, AIO205, AIO206, AIO207, AIO208, AIO209, AIO210, AIO211, AIO212, AIO213, B0_C26_VDAC, B10_GPIO234, B11_GPIO235, B12, B13, B16, B17, B1_C27, B2_D26, B3_D27, B4_D30, B5_D31, B6_E26_GPIO230, B7_E27_GPIO231, B8_GPIO232, B9_GPIO233, C0_E28, C10, C11, C12, C13, C16, C17, C1_E29, C2_E30, C3_E31, C4, C5, C6_GPIO236, C7_GPIO237, C8_GPIO238, C9_GPIO239, D0_B24, D10, D11, D12, D13, D16, D17, D1_B25, D2_B26, D3_B27, D4_B28_GPIO240, D5_B29_GPIO241, D6_B30_GPIO242, D7_B31_GPIO243, D8_C28_GPIO244, D9_C29_GPIO245, E0_A24_DACB_OUT, E10, E11, E12, E13, E16, E17, E1_A25, E2_A26, E3_A27, E4_A28_GPIO246, E5_A29_GPIO247, E6_A30_GPIO248, E7_A31_GPIO249, E8_C30, E9_C31, EPWM10_A, EPWM10_B, EPWM11_A, EPWM11_B, EPWM12_A, EPWM12_B, EPWM13_A, EPWM13_B, EPWM14_A, EPWM14_B, EPWM15_A, EPWM15_B, EPWM16_A, EPWM16_B, EPWM17_A, EPWM17_B, EPWM18_A, EPWM18_B, EPWM1_A, EPWM1_B, EPWM2_A, EPWM2_B, EPWM3_A, EPWM3_B, EPWM4_A, EPWM4_B, EPWM5_A, EPWM5_B, EPWM6_A, EPWM6_B, EPWM7_A, EPWM7_B, EPWM8_A, EPWM8_B, EPWM9_A, EPWM9_B, ERRORSTS, FSIRXA_CLK, FSIRXA_D0, FSIRXA_D1, FSIRXB_CLK, FSIRXB_D0, FSIRXB_D1, FSIRXC_CLK, FSIRXC_D0, FSIRXC_D1, FSIRXD_CLK, FSIRXD_D0, FSIRXD_D1, FSITXA_CLK, FSITXA_D0, FSITXA_D1, FSITXB_CLK, FSITXB_D0, FSITXB_D1, FSITXC_CLK, FSITXC_D0, FSITXC_D1, FSITXD_CLK, FSITXD_D0, FSITXD_D1, GPIO0, GPIO1, GPIO10, GPIO100, GPIO101, GPIO103, GPIO105, GPIO11, GPIO12, GPIO127, GPIO13, GPIO14, GPIO15, GPIO16, GPIO17, GPIO18, GPIO19, GPIO2, GPIO20, GPIO21, GPIO219, GPIO22, GPIO220, GPIO221, GPIO222, GPIO223, GPIO224, GPIO225, GPIO226, GPIO227, GPIO228, GPIO229, GPIO23, GPIO230, GPIO231, GPIO232, GPIO233, GPIO234, GPIO235, GPIO236, GPIO237, GPIO238, GPIO239, GPIO24, GPIO240, GPIO241, GPIO242, GPIO243, GPIO244, GPIO245, GPIO246, GPIO247, GPIO248, GPIO249, GPIO25, GPIO26, GPIO27, GPIO28, GPIO29, GPIO3, GPIO30, GPIO31, GPIO32, GPIO33, GPIO34, GPIO35, GPIO36, GPIO37, GPIO38, GPIO39, GPIO4, GPIO40, GPIO41, GPIO42, GPIO43, GPIO44, GPIO45, GPIO46, GPIO47, GPIO48, GPIO49, GPIO5, GPIO50, GPIO51, GPIO52, GPIO53, GPIO54, GPIO55, GPIO56, GPIO57, GPIO58, GPIO59, GPIO6, GPIO60, GPIO61, GPIO62, GPIO63, GPIO64, GPIO65, GPIO66, GPIO67, GPIO68, GPIO69, GPIO7, GPIO70, GPIO71, GPIO72, GPIO73, GPIO74, GPIO75, GPIO76, GPIO77, GPIO78, GPIO79, GPIO8, GPIO80, GPIO81, GPIO82, GPIO83, GPIO84, GPIO85, GPIO86, GPIO87, GPIO88, GPIO89, GPIO9, GPIO90, GPIO91, GPIO92, GPIO93, GPIO94, GPIO95, GPIO96, GPIO97, GPIO98, GPIO99, I2CA_SCL, I2CA_SDA, I2CB_SCL, I2CB_SDA, INPUTXBAR1, INPUTXBAR10, INPUTXBAR11, INPUTXBAR12, INPUTXBAR13, INPUTXBAR14, INPUTXBAR15, INPUTXBAR16, INPUTXBAR17, INPUTXBAR18, INPUTXBAR19, INPUTXBAR2, INPUTXBAR20, INPUTXBAR21, INPUTXBAR22, INPUTXBAR23, INPUTXBAR24, INPUTXBAR25, INPUTXBAR26, INPUTXBAR27, INPUTXBAR28, INPUTXBAR29, INPUTXBAR3, INPUTXBAR30, INPUTXBAR31, INPUTXBAR32, INPUTXBAR33, INPUTXBAR34, INPUTXBAR35, INPUTXBAR36, INPUTXBAR37, INPUTXBAR38, INPUTXBAR39, INPUTXBAR4, INPUTXBAR40, INPUTXBAR41, INPUTXBAR42, INPUTXBAR43, INPUTXBAR44, INPUTXBAR45, INPUTXBAR46, INPUTXBAR47, INPUTXBAR48, INPUTXBAR49, INPUTXBAR5, INPUTXBAR50, INPUTXBAR51, INPUTXBAR52, INPUTXBAR53, INPUTXBAR54, INPUTXBAR55, INPUTXBAR56, INPUTXBAR57, INPUTXBAR58, INPUTXBAR59, INPUTXBAR6, INPUTXBAR60, INPUTXBAR61, INPUTXBAR62, INPUTXBAR63, INPUTXBAR64, INPUTXBAR7, INPUTXBAR8, INPUTXBAR9, LINA_RX, LINA_TX, LINB_RX, LINB_TX, MCANA_RX, MCANA_TX, MCANB_RX, MCANB_TX, MCANC_RX, MCANC_TX, MCAND_RX, MCAND_TX, MCANE_RX, MCANE_TX, MCANF_RX, MCANF_TX, OUTPUTXBAR1, OUTPUTXBAR10, OUTPUTXBAR11, OUTPUTXBAR12, OUTPUTXBAR13, OUTPUTXBAR14, OUTPUTXBAR15, OUTPUTXBAR16, OUTPUTXBAR2, OUTPUTXBAR3, OUTPUTXBAR4, OUTPUTXBAR5, OUTPUTXBAR6, OUTPUTXBAR7, OUTPUTXBAR8, OUTPUTXBAR9, PMBUSA_ALERT, PMBUSA_CTL, PMBUSA_SCL, PMBUSA_SDA, SD1_C1, SD1_C2, SD1_C3, SD1_C4, SD1_D1, SD1_D2, SD1_D3, SD1_D4, SD2_C1, SD2_C2, SD2_C3, SD2_C4, SD2_D1, SD2_D2, SD2_D3, SD2_D4, SD3_C1, SD3_C2, SD3_C3, SD3_C4, SD3_D1, SD3_D2, SD3_D3, SD3_D4, SD4_C1, SD4_C2, SD4_C3, SD4_C4, SD4_D1, SD4_D2, SD4_D3, SD4_D4, SENT1, SENT2, SENT3, SENT4, SENT5, SENT6, SPIA_CLK, SPIA_PICO, SPIA_POCI, SPIA_PTE, SPIB_CLK, SPIB_PICO, SPIB_POCI, SPIB_PTE, SPIC_CLK, SPIC_PICO, SPIC_POCI, SPIC_PTE, SPID_CLK, SPID_PICO, SPID_POCI, SPID_PTE, SPIE_CLK, SPIE_PICO, SPIE_POCI, SPIE_PTE, SYNCOUT, TDI, TDO, UARTA_RX, UARTA_TX, UARTB_RX, UARTB_TX, UARTC_RX, UARTC_TX, UARTD_RX, UARTD_TX, UARTE_RX, UARTE_TX, UARTF_RX, UARTF_TX, X1, X2, XCLKOUT}, origin=Texas Instruments, set at post-build in variant post-build / pre-compile in variant pre-compile, default-value=A0_C24_DACA_OUT  # Select specific type of peripheral signal pin of interest
          enumeration PortPhysicalPinId: {PORT_PIN_1, PORT_PIN_10, PORT_PIN_100, PORT_PIN_102, PORT_PIN_103, PORT_PIN_104, PORT_PIN_105, PORT_PIN_106, PORT_PIN_107, PORT_PIN_108, PORT_PIN_109, PORT_PIN_11, PORT_PIN_110, PORT_PIN_111, PORT_PIN_112, PORT_PIN_113, PORT_PIN_114, PORT_PIN_115, PORT_PIN_116, PORT_PIN_117, PORT_PIN_118, PORT_PIN_119, PORT_PIN_12, PORT_PIN_120, PORT_PIN_121, PORT_PIN_123, PORT_PIN_124, PORT_PIN_125, PORT_PIN_126, PORT_PIN_127, PORT_PIN_128, PORT_PIN_129, PORT_PIN_13, PORT_PIN_130, PORT_PIN_131, PORT_PIN_132, PORT_PIN_133, PORT_PIN_134, PORT_PIN_135, PORT_PIN_136, PORT_PIN_138, PORT_PIN_139, PORT_PIN_14, PORT_PIN_140, PORT_PIN_141, PORT_PIN_142, PORT_PIN_143, PORT_PIN_144, PORT_PIN_145, PORT_PIN_146, PORT_PIN_148, PORT_PIN_149, PORT_PIN_15, PORT_PIN_150, PORT_PIN_151, PORT_PIN_154, PORT_PIN_155, PORT_PIN_156, PORT_PIN_157, PORT_PIN_158, PORT_PIN_159, PORT_PIN_16, PORT_PIN_160, PORT_PIN_161, PORT_PIN_162, PORT_PIN_163, PORT_PIN_164, PORT_PIN_165, PORT_PIN_166, PORT_PIN_167, PORT_PIN_17, PORT_PIN_170, PORT_PIN_171, PORT_PIN_172, PORT_PIN_173, PORT_PIN_174, PORT_PIN_175, PORT_PIN_176, PORT_PIN_18, PORT_PIN_19, PORT_PIN_2, PORT_PIN_20, PORT_PIN_21, PORT_PIN_22, PORT_PIN_23, PORT_PIN_24, PORT_PIN_25, PORT_PIN_26, PORT_PIN_27, PORT_PIN_28, PORT_PIN_29, PORT_PIN_30, PORT_PIN_31, PORT_PIN_32, PORT_PIN_33, PORT_PIN_34, PORT_PIN_35, PORT_PIN_36, PORT_PIN_37, PORT_PIN_38, PORT_PIN_39, PORT_PIN_4, PORT_PIN_40, PORT_PIN_41, PORT_PIN_42, PORT_PIN_43, PORT_PIN_44, PORT_PIN_45, PORT_PIN_46, PORT_PIN_47, PORT_PIN_48, PORT_PIN_49, PORT_PIN_5, PORT_PIN_50, PORT_PIN_51, PORT_PIN_52, PORT_PIN_53, PORT_PIN_54, PORT_PIN_55, PORT_PIN_56, PORT_PIN_57, PORT_PIN_58, PORT_PIN_59, PORT_PIN_6, PORT_PIN_60, PORT_PIN_61, PORT_PIN_62, PORT_PIN_63, PORT_PIN_64, PORT_PIN_65, PORT_PIN_66, PORT_PIN_67, PORT_PIN_68, PORT_PIN_69, PORT_PIN_7, PORT_PIN_70, PORT_PIN_71, PORT_PIN_72, PORT_PIN_73, PORT_PIN_74, PORT_PIN_75, PORT_PIN_76, PORT_PIN_77, PORT_PIN_78, PORT_PIN_79, PORT_PIN_8, PORT_PIN_80, PORT_PIN_81, PORT_PIN_82, PORT_PIN_83, PORT_PIN_84, PORT_PIN_85, PORT_PIN_86, PORT_PIN_87, PORT_PIN_88, PORT_PIN_89, PORT_PIN_9, PORT_PIN_90, PORT_PIN_91, PORT_PIN_92, PORT_PIN_93, PORT_PIN_94, PORT_PIN_95, PORT_PIN_96, PORT_PIN_97, PORT_PIN_98, PORT_PIN_99, PORT_PIN_A10, PORT_PIN_A11, PORT_PIN_A12, PORT_PIN_A13, PORT_PIN_A14, PORT_PIN_A15, PORT_PIN_A2, PORT_PIN_A3, PORT_PIN_A4, PORT_PIN_A5, PORT_PIN_A6, PORT_PIN_A7, PORT_PIN_A8, PORT_PIN_A9, PORT_PIN_B1, PORT_PIN_B10, PORT_PIN_B11, PORT_PIN_B12, PORT_PIN_B13, PORT_PIN_B14, PORT_PIN_B15, PORT_PIN_B16, PORT_PIN_B2, PORT_PIN_B3, PORT_PIN_B4, PORT_PIN_B5, PORT_PIN_B6, PORT_PIN_B7, PORT_PIN_B8, PORT_PIN_B9, PORT_PIN_C1, PORT_PIN_C10, PORT_PIN_C11, PORT_PIN_C12, PORT_PIN_C13, PORT_PIN_C14, PORT_PIN_C15, PORT_PIN_C16, PORT_PIN_C2, PORT_PIN_C3, PORT_PIN_C4, PORT_PIN_C5, PORT_PIN_C6, PORT_PIN_C7, PORT_PIN_C8, PORT_PIN_C9, PORT_PIN_D1, PORT_PIN_D10, PORT_PIN_D11, PORT_PIN_D12, PORT_PIN_D13, PORT_PIN_D14, PORT_PIN_D15, PORT_PIN_D16, PORT_PIN_D2, PORT_PIN_D3, PORT_PIN_D4, PORT_PIN_D5, PORT_PIN_D6, PORT_PIN_D7, PORT_PIN_D8, PORT_PIN_D9, PORT_PIN_E1, PORT_PIN_E13, PORT_PIN_E14, PORT_PIN_E16, PORT_PIN_E2, PORT_PIN_E3, PORT_PIN_E4, PORT_PIN_E5, PORT_PIN_F1, PORT_PIN_F13, PORT_PIN_F16, PORT_PIN_F2, PORT_PIN_F3, PORT_PIN_F4, PORT_PIN_F5, PORT_PIN_G1, PORT_PIN_G13, PORT_PIN_G14, PORT_PIN_G15, PORT_PIN_G16, PORT_PIN_G2, PORT_PIN_G3, PORT_PIN_G4, PORT_PIN_G5, PORT_PIN_H1, PORT_PIN_H13, PORT_PIN_H14, PORT_PIN_H15, PORT_PIN_H16, PORT_PIN_H2, PORT_PIN_H3, PORT_PIN_H4, PORT_PIN_H5, PORT_PIN_J1, PORT_PIN_J13, PORT_PIN_J14, PORT_PIN_J15, PORT_PIN_J16, PORT_PIN_J2, PORT_PIN_J3, PORT_PIN_J4, PORT_PIN_J5, PORT_PIN_K1, PORT_PIN_K13, PORT_PIN_K14, PORT_PIN_K15, PORT_PIN_K16, PORT_PIN_K2, PORT_PIN_K3, PORT_PIN_K4, PORT_PIN_K5, PORT_PIN_L1, PORT_PIN_L14, PORT_PIN_L15, PORT_PIN_L16, PORT_PIN_L2, PORT_PIN_L3, PORT_PIN_L4, PORT_PIN_L5, PORT_PIN_M1, PORT_PIN_M13, PORT_PIN_M14, PORT_PIN_M15, PORT_PIN_M16, PORT_PIN_M2, PORT_PIN_M3, PORT_PIN_M4, PORT_PIN_M5, PORT_PIN_M6, PORT_PIN_M7, PORT_PIN_M8, PORT_PIN_M9, PORT_PIN_N10, PORT_PIN_N11, PORT_PIN_N12, PORT_PIN_N13, PORT_PIN_N14, PORT_PIN_N15, PORT_PIN_N16, PORT_PIN_N3, PORT_PIN_N4, PORT_PIN_N5, PORT_PIN_N6, PORT_PIN_N7, PORT_PIN_N8, PORT_PIN_N9, PORT_PIN_P1, PORT_PIN_P10, PORT_PIN_P11, PORT_PIN_P12, PORT_PIN_P13, PORT_PIN_P14, PORT_PIN_P15, PORT_PIN_P16, PORT_PIN_P2, PORT_PIN_P3, PORT_PIN_P4, PORT_PIN_P5, PORT_PIN_P6, PORT_PIN_P7, PORT_PIN_P8, PORT_PIN_P9, PORT_PIN_R1, PORT_PIN_R10, PORT_PIN_R11, PORT_PIN_R12, PORT_PIN_R13, PORT_PIN_R14, PORT_PIN_R16, PORT_PIN_R2, PORT_PIN_R3, PORT_PIN_R5, PORT_PIN_R6, PORT_PIN_R7, PORT_PIN_R8, PORT_PIN_R9, PORT_PIN_T10, PORT_PIN_T11, PORT_PIN_T12, PORT_PIN_T13, PORT_PIN_T14, PORT_PIN_T2, PORT_PIN_T3, PORT_PIN_T5, PORT_PIN_T6, PORT_PIN_T7, PORT_PIN_T8, PORT_PIN_T9}, origin=Texas Instruments, set at pre-compile, default-value=PORT_PIN_1  # Identifying The physical Pin Number on the selected Pin Package.
          enumeration PortPinName: {A0_C24_DACA_OUT, A10_GPIO228, A11_GPIO229, A12, A13, A14_B14_C14_D14_E14, A15_B15_C15_D15_E15, A1_C25, A2_D24, A3_D25, A4_D28, A5_D29, A6_E24_GPIO224, A7_E25_GPIO225, A8_GPIO226, A9_GPIO227, B0_C26_VDAC, B10_GPIO234, B11_GPIO235, B12, B13, B16, B17, B1_C27, B2_D26, B3_D27, B4_D30, B5_D31, B6_E26_GPIO230, B7_E27_GPIO231, B8_GPIO232, B9_GPIO233, C0_E28, C10, C11, C12, C13, C16, C17, C1_E29, C2_E30, C3_E31, C4, C5, C6_GPIO236, C7_GPIO237, C8_GPIO238, C9_GPIO239, D0_B24, D10, D11, D12, D13, D16, D17, D1_B25, D2_B26, D3_B27, D4_B28_GPIO240, D5_B29_GPIO241, D6_B30_GPIO242, D7_B31_GPIO243, D8_C28_GPIO244, D9_C29_GPIO245, E0_A24_DACB_OUT, E10, E11, E12, E13, E16, E17, E1_A25, E2_A26, E3_A27, E4_A28_GPIO246, E5_A29_GPIO247, E6_A30_GPIO248, E7_A31_GPIO249, E8_C30, E9_C31, FLT3, GPIO0, GPIO1, GPIO10, GPIO100, GPIO101, GPIO103, GPIO105, GPIO11, GPIO12, GPIO127, GPIO13, GPIO14, GPIO15, GPIO16, GPIO17, GPIO18, GPIO19, GPIO2, GPIO20, GPIO21, GPIO219_ERRORSTS, GPIO22, GPIO220_X1, GPIO221_X2, GPIO222_TDI, GPIO223_TDO, GPIO23, GPIO24, GPIO25, GPIO26, GPIO27, GPIO28, GPIO29, GPIO3, GPIO30, GPIO31, GPIO32, GPIO33, GPIO34, GPIO35, GPIO36, GPIO37, GPIO38, GPIO39, GPIO4, GPIO40, GPIO41, GPIO42, GPIO43, GPIO44, GPIO45, GPIO46, GPIO47, GPIO48, GPIO49, GPIO5, GPIO50, GPIO51, GPIO52, GPIO53, GPIO54, GPIO55, GPIO56, GPIO57, GPIO58, GPIO59, GPIO6, GPIO60, GPIO61, GPIO62, GPIO63, GPIO64, GPIO65, GPIO66, GPIO67, GPIO68, GPIO69, GPIO7, GPIO70, GPIO71, GPIO72, GPIO73, GPIO74, GPIO75, GPIO76, GPIO77, GPIO78, GPIO79, GPIO8, GPIO80, GPIO81, GPIO82, GPIO83, GPIO84, GPIO85, GPIO86, GPIO87, GPIO88, GPIO89, GPIO9, GPIO90, GPIO91, GPIO92, GPIO93, GPIO94, GPIO95, GPIO96, GPIO97, GPIO98, GPIO99, TCK, TMS, VDD, VDDA, VDDIO, VREFHIAB, VREFHICDE, VREFLOAB, VREFLOCDE, VREGENZ, VSS, VSSA, VSSOSC, XRSn}, origin=Texas Instruments, post-build-variant-value=true, set at post-build in variant post-build / pre-compile in variant pre-compile, default-value=A0_C24_DACA_OUT  # Device Pin Name for reference.
          integer PortPinId: 0..256, set at pre-compile, symbolic-name-value=true, default-value=0  # Pin Id of the port pin. This value will be assigned to the symbolic name derived from the port pin container short name.
          boolean PortIsPinConfigurable: origin=Texas Instruments, post-build-variant-value=true, set at post-build in variant post-build / pre-compile in variant pre-compile, default-value=true  # Whether configuration is supported for this pin.
          boolean PortIsAnalogModeSupported: origin=Texas Instruments, post-build-variant-value=true, set at post-build in variant post-build / pre-compile in variant pre-compile, default-value=false  # Whether analog mode is supported for this pin.
          boolean PortIsAGPIO: origin=Texas Instruments, post-build-variant-value=true, set at post-build in variant post-build / pre-compile in variant pre-compile, default-value=true  # Whether this pin is AGPIO.
          boolean PortIsAIO: origin=Texas Instruments, post-build-variant-value=true, set at post-build in variant post-build / pre-compile in variant pre-compile, default-value=true  # Whether this pin is AIO.
          boolean PortIsGPIO: origin=Texas Instruments, post-build-variant-value=true, set at post-build in variant post-build / pre-compile in variant pre-compile, default-value=true  # Whether this pin is GPIO.
          enumeration PortAnalogMode: {PORT_ANALOG_DISABLED, PORT_ANALOG_ENABLED}, origin=Texas Instruments, post-build-variant-value=true, set at post-build in variant post-build / pre-compile in variant pre-compile, default-value=PORT_ANALOG_ENABLED  # Select whether the pin operates in Analog Mode.
          enumeration PortPinInitialMode: {ADCA_EXTMUXSEL0, ADCA_EXTMUXSEL1, ADCA_EXTMUXSEL2, ADCA_EXTMUXSEL3, ADCB_EXTMUXSEL0, ADCB_EXTMUXSEL1, ADCB_EXTMUXSEL2, ADCB_EXTMUXSEL3, ADCC_EXTMUXSEL0, ADCC_EXTMUXSEL1, ADCC_EXTMUXSEL2, ADCC_EXTMUXSEL3, ADCD_EXTMUXSEL0, ADCD_EXTMUXSEL1, ADCD_EXTMUXSEL2, ADCD_EXTMUXSEL3, ADCE_EXTMUXSEL0, ADCE_EXTMUXSEL1, ADCE_EXTMUXSEL2, ADCE_EXTMUXSEL3, ADCSOCAO, ADCSOCBO, AIO160, AIO161, AIO162, AIO163, AIO164, AIO165, AIO166, AIO167, AIO168, AIO169, AIO170, AIO171, AIO172, AIO173, AIO174, AIO175, AIO176, AIO177, AIO178, AIO179, AIO180, AIO181, AIO182, AIO183, AIO184, AIO185, AIO186, AIO187, AIO188, AIO189, AIO190, AIO191, AIO192, AIO193, AIO194, AIO195, AIO196, AIO197, AIO198, AIO199, AIO200, AIO201, AIO202, AIO203, AIO204, AIO205, AIO206, AIO207, AIO208, AIO209, AIO210, AIO211, AIO212, AIO213, EMIF1_A0, EMIF1_A1, EMIF1_A10, EMIF1_A11, EMIF1_A12, EMIF1_A13, EMIF1_A14, EMIF1_A15, EMIF1_A16, EMIF1_A17, EMIF1_A18, EMIF1_A19, EMIF1_A2, EMIF1_A3, EMIF1_A4, EMIF1_A5, EMIF1_A6, EMIF1_A7, EMIF1_A8, EMIF1_A9, EMIF1_BA0, EMIF1_BA1, EMIF1_CAS, EMIF1_CLK, EMIF1_CS0n, EMIF1_CS2n, EMIF1_CS3n, EMIF1_CS4n, EMIF1_D0, EMIF1_D1, EMIF1_D10, EMIF1_D11, EMIF1_D12, EMIF1_D13, EMIF1_D14, EMIF1_D15, EMIF1_D16, EMIF1_D17, EMIF1_D18, EMIF1_D19, EMIF1_D2, EMIF1_D20, EMIF1_D21, EMIF1_D22, EMIF1_D23, EMIF1_D24, EMIF1_D25, EMIF1_D26, EMIF1_D27, EMIF1_D28, EMIF1_D29, EMIF1_D3, EMIF1_D30, EMIF1_D31, EMIF1_D4, EMIF1_D5, EMIF1_D6, EMIF1_D7, EMIF1_D8, EMIF1_D9, EMIF1_DQM0, EMIF1_DQM1, EMIF1_DQM2, EMIF1_DQM3, EMIF1_OEn, EMIF1_RAS, EMIF1_RNW, EMIF1_SDCKE, EMIF1_WAIT, EMIF1_WEn, EPWM10_A, EPWM10_B, EPWM11_A, EPWM11_B, EPWM12_A, EPWM12_B, EPWM13_A, EPWM13_B, EPWM14_A, EPWM14_B, EPWM15_A, EPWM15_B, EPWM16_A, EPWM16_B, EPWM17_A, EPWM17_B, EPWM18_A, EPWM18_B, EPWM1_A, EPWM1_B, EPWM2_A, EPWM2_B, EPWM3_A, EPWM3_B, EPWM4_A, EPWM4_B, EPWM5_A, EPWM5_B, EPWM6_A, EPWM6_B, EPWM7_A, EPWM7_B, EPWM8_A, EPWM8_B, EPWM9_A, EPWM9_B, ERRORSTS, ESC_GPI0, ESC_GPI1, ESC_GPI10, ESC_GPI11, ESC_GPI12, ESC_GPI13, ESC_GPI14, ESC_GPI15, ESC_GPI16, ESC_GPI17, ESC_GPI18, ESC_GPI19, ESC_GPI2, ESC_GPI20, ESC_GPI21, ESC_GPI22, ESC_GPI23, ESC_GPI24, ESC_GPI25, ESC_GPI26, ESC_GPI27, ESC_GPI28, ESC_GPI29, ESC_GPI3, ESC_GPI30, ESC_GPI31, ESC_GPI4, ESC_GPI5, ESC_GPI6, ESC_GPI7, ESC_GPI8, ESC_GPI9, ESC_GPO0, ESC_GPO1, ESC_GPO10, ESC_GPO11, ESC_GPO12, ESC_GPO13, ESC_GPO14, ESC_GPO15, ESC_GPO16, ESC_GPO17, ESC_GPO18, ESC_GPO19, ESC_GPO2, ESC_GPO20, ESC_GPO21, ESC_GPO22, ESC_GPO23, ESC_GPO24, ESC_GPO25, ESC_GPO26, ESC_GPO27, ESC_GPO28, ESC_GPO29, ESC_GPO3, ESC_GPO30, ESC_GPO31, ESC_GPO4, ESC_GPO5, ESC_GPO6, ESC_GPO7, ESC_GPO8, ESC_GPO9, ESC_I2C_SCL, ESC_I2C_SDA, ESC_LATCH0, ESC_LATCH1, ESC_LED_ERR, ESC_LED_LINK0_ACTIVE, ESC_LED_LINK1_ACTIVE, ESC_LED_RUN, ESC_LED_STATE_RUN, ESC_MDIO_CLK, ESC_MDIO_DATA, ESC_PDI_UC_IRQ, ESC_PHY0_LINKSTATUS, ESC_PHY1_LINKSTATUS, ESC_PHY_CLK, ESC_PHY_RESETn, ESC_RX0_CLK, ESC_RX0_DATA0, ESC_RX0_DATA1, ESC_RX0_DATA2, ESC_RX0_DATA3, ESC_RX0_DV, ESC_RX0_ERR, ESC_RX1_CLK, ESC_RX1_DATA0, ESC_RX1_DATA1, ESC_RX1_DATA2, ESC_RX1_DATA3, ESC_RX1_DV, ESC_RX1_ERR, ESC_SYNC0, ESC_SYNC1, ESC_TX0_CLK, ESC_TX0_DATA0, ESC_TX0_DATA1, ESC_TX0_DATA2, ESC_TX0_DATA3, ESC_TX0_ENA, ESC_TX1_CLK, ESC_TX1_DATA0, ESC_TX1_DATA1, ESC_TX1_DATA2, ESC_TX1_DATA3, ESC_TX1_ENA, FSIRXA_CLK, FSIRXA_D0, FSIRXA_D1, FSIRXB_CLK, FSIRXB_D0, FSIRXB_D1, FSIRXC_CLK, FSIRXC_D0, FSIRXC_D1, FSIRXD_CLK, FSIRXD_D0, FSIRXD_D1, FSITXA_CLK, FSITXA_D0, FSITXA_D1, FSITXB_CLK, FSITXB_D0, FSITXB_D1, FSITXC_CLK, FSITXC_D0, FSITXC_D1, FSITXD_CLK, FSITXD_D0, FSITXD_D1, GPIO0, GPIO1, GPIO10, GPIO100, GPIO101, GPIO103, GPIO105, GPIO11, GPIO12, GPIO127, GPIO13, GPIO14, GPIO15, GPIO16, GPIO17, GPIO18, GPIO19, GPIO2, GPIO20, GPIO21, GPIO219, GPIO22, GPIO220, GPIO221, GPIO222, GPIO223, GPIO224, GPIO225, GPIO226, GPIO227, GPIO228, GPIO229, GPIO23, GPIO230, GPIO231, GPIO232, GPIO233, GPIO234, GPIO235, GPIO236, GPIO237, GPIO238, GPIO239, GPIO24, GPIO240, GPIO241, GPIO242, GPIO243, GPIO244, GPIO245, GPIO246, GPIO247, GPIO248, GPIO249, GPIO25, GPIO26, GPIO27, GPIO28, GPIO29, GPIO3, GPIO30, GPIO31, GPIO32, GPIO33, GPIO34, GPIO35, GPIO36, GPIO37, GPIO38, GPIO39, GPIO4, GPIO40, GPIO41, GPIO42, GPIO43, GPIO44, GPIO45, GPIO46, GPIO47, GPIO48, GPIO49, GPIO5, GPIO50, GPIO51, GPIO52, GPIO53, GPIO54, GPIO55, GPIO56, GPIO57, GPIO58, GPIO59, GPIO6, GPIO60, GPIO61, GPIO62, GPIO63, GPIO64, GPIO65, GPIO66, GPIO67, GPIO68, GPIO69, GPIO7, GPIO70, GPIO71, GPIO72, GPIO73, GPIO74, GPIO75, GPIO76, GPIO77, GPIO78, GPIO79, GPIO8, GPIO80, GPIO81, GPIO82, GPIO83, GPIO84, GPIO85, GPIO86, GPIO87, GPIO88, GPIO89, GPIO9, GPIO90, GPIO91, GPIO92, GPIO93, GPIO94, GPIO95, GPIO96, GPIO97, GPIO98, GPIO99, I2CA_SCL, I2CA_SDA, I2CB_SCL, I2CB_SDA, LINA_RX, LINA_TX, LINB_RX, LINB_TX, MCANA_RX, MCANA_TX, MCANB_RX, MCANB_TX, MCANC_RX, MCANC_TX, MCAND_RX, MCAND_TX, MCANE_RX, MCANE_TX, MCANF_RX, MCANF_TX, OUTPUTXBAR1, OUTPUTXBAR10, OUTPUTXBAR11, OUTPUTXBAR12, OUTPUTXBAR13, OUTPUTXBAR14, OUTPUTXBAR15, OUTPUTXBAR16, OUTPUTXBAR2, OUTPUTXBAR3, OUTPUTXBAR4, OUTPUTXBAR5, OUTPUTXBAR6, OUTPUTXBAR7, OUTPUTXBAR8, OUTPUTXBAR9, PMBUSA_ALERT, PMBUSA_CTL, PMBUSA_SCL, PMBUSA_SDA, PORT_MUXMODE_NA, SD1_C1, SD1_C2, SD1_C3, SD1_C4, SD1_D1, SD1_D2, SD1_D3, SD1_D4, SD2_C1, SD2_C2, SD2_C3, SD2_C4, SD2_D1, SD2_D2, SD2_D3, SD2_D4, SD3_C1, SD3_C2, SD3_C3, SD3_C4, SD3_D1, SD3_D2, SD3_D3, SD3_D4, SD4_C1, SD4_C2, SD4_C3, SD4_C4, SD4_D1, SD4_D2, SD4_D3, SD4_D4, SENT1, SENT2, SENT3, SENT4, SENT5, SENT6, SPIA_CLK, SPIA_PICO, SPIA_POCI, SPIA_PTE, SPIB_CLK, SPIB_PICO, SPIB_POCI, SPIB_PTE, SPIC_CLK, SPIC_PICO, SPIC_POCI, SPIC_PTE, SPID_CLK, SPID_PICO, SPID_POCI, SPID_PTE, SPIE_CLK, SPIE_PICO, SPIE_POCI, SPIE_PTE, SYNCOUT, TDI, TDO, UARTA_RX, UARTA_TX, UARTB_RX, UARTB_TX, UARTC_RX, UARTC_TX, UARTD_RX, UARTD_TX, UARTE_RX, UARTE_TX, UARTF_RX, UARTF_TX, XCLKOUT}, post-build-variant-value=true, set at post-build in variant post-build / pre-compile in variant pre-compile, default-value=ADCA_EXTMUXSEL0  # Port pin mode from mode list for use with Port_Init() function.
          enumeration PortPinDirection: {PORT_PIN_IN, PORT_PIN_NA, PORT_PIN_OUT}, post-build-variant-value=true, set at post-build in variant post-build / pre-compile in variant pre-compile, default-value=PORT_PIN_IN  # The initial direction of the pin (IN or OUT). If the direction is not changeable, the value configured here is fixed.
          boolean PortPinDirectionChangeable: post-build-variant-value=true, set at post-build in variant post-build / pre-compile in variant pre-compile, default-value=False  # Parameter to indicate if the direction is changeable on a port pin during runtime.
          enumeration PortPinPadConfig: {PORT_PIN_TYPE_STD, PORT_PIN_TYPE_OPEN_DRAIN, PORT_PIN_TYPE_NA}, origin=Texas Instruments, post-build-variant-value=true, set at post-build in variant post-build / pre-compile in variant pre-compile, default-value=PORT_PIN_TYPE_STD  # Enable Push-Pull or Open Drain functionality.
          boolean PortPinPullUpConfig: origin=Texas Instruments, post-build-variant-value=true, set at post-build in variant post-build / pre-compile in variant pre-compile, default-value=false  # Enable Pull Up.
          enumeration PortPinQualificationMode: {PORT_QUAL_SYNC, PORT_QUAL_3SAMPLE, PORT_QUAL_6SAMPLE, PORT_QUAL_ASYNC, PORT_QUAL_NA}, origin=Texas Instruments, post-build-variant-value=true, set at post-build in variant post-build / pre-compile in variant pre-compile, default-value=PORT_QUAL_SYNC  # Synchronization mode of the peripheral signals.
          integer PortPinQualificationPeriod: 0..510, origin=Texas Instruments, post-build-variant-value=true, set at post-build in variant post-build / pre-compile in variant pre-compile, default-value=1  # Qualification period of the peripheral signals. NOTE: The PortPinQualificationPeriod should be set to the same value for each pair of 8 consecutive GPIOs. For Instance: Qualification sampling period for GPIO0 to GPIO7: 0x00,QUALPRDx = PLLSYSCLK 0x01,QUALPRDx = PLLSYSCLK/2 0x02,QUALPRDx = PLLSYSCLK/4 .... 0xFF,QUALPRDx = PLLSYSCLK/510 Reset type: SYSRSn
          enumeration PortPinLevelValue: {PORT_PIN_LEVEL_HIGH, PORT_PIN_LEVEL_LOW, PORT_PIN_LEVEL_NA}, post-build-variant-value=true, set at post-build in variant post-build / pre-compile in variant pre-compile, default-value=PORT_PIN_LEVEL_LOW  # Port Pin Level value from Port pin list.
          enumeration PortPinCoreSelect: {PORT_CORE_CPU1, PORT_CORE_CPU2, PORT_CORE_CPU3}, origin=Texas Instruments, post-build-variant-value=true, set at post-build in variant post-build / pre-compile in variant pre-compile, default-value=PORT_CORE_CPU1  # Selection of core to which pin is to be mapped.
          boolean PortEnableWakeUpPinLPM: origin=Texas Instruments, set at post-build in variant post-build / pre-compile in variant pre-compile, default-value=false  # Use/Don't use the GPIO Pin as a wakeup source for the low power modes - standby/halt.
          boolean PortIOBufferDriveConfig: origin=Texas Instruments, set at post-build in variant post-build / pre-compile in variant pre-compile, default-value=false  # Selects the IO buffer drive strength for AGPIO-capable pins via the IODRVSEL register bit. TRUE = high-drive strength. FALSE = normal drive strength. Only applicable to AGPIO pins.
          boolean PortIOBufferModeConfig: origin=Texas Instruments, set at post-build in variant post-build / pre-compile in variant pre-compile, default-value=false  # Selects the IO buffer voltage mode for AGPIO-capable pins via the IOMODESEL register bit. TRUE = 1.35 V mode. FALSE = 3.3 V mode. Only applicable to AGPIO pins.
          enumeration PortPinMode: {ADCA_EXTMUXSEL0, ADCA_EXTMUXSEL1, ADCA_EXTMUXSEL2, ADCA_EXTMUXSEL3, ADCB_EXTMUXSEL0, ADCB_EXTMUXSEL1, ADCB_EXTMUXSEL2, ADCB_EXTMUXSEL3, ADCC_EXTMUXSEL0, ADCC_EXTMUXSEL1, ADCC_EXTMUXSEL2, ADCC_EXTMUXSEL3, ADCD_EXTMUXSEL0, ADCD_EXTMUXSEL1, ADCD_EXTMUXSEL2, ADCD_EXTMUXSEL3, ADCE_EXTMUXSEL0, ADCE_EXTMUXSEL1, ADCE_EXTMUXSEL2, ADCE_EXTMUXSEL3, ADCSOCAO, ADCSOCBO, AIO160, AIO161, AIO162, AIO163, AIO164, AIO165, AIO166, AIO167, AIO168, AIO169, AIO170, AIO171, AIO172, AIO173, AIO174, AIO175, AIO176, AIO177, AIO178, AIO179, AIO180, AIO181, AIO182, AIO183, AIO184, AIO185, AIO186, AIO187, AIO188, AIO189, AIO190, AIO191, AIO192, AIO193, AIO194, AIO195, AIO196, AIO197, AIO198, AIO199, AIO200, AIO201, AIO202, AIO203, AIO204, AIO205, AIO206, AIO207, AIO208, AIO209, AIO210, AIO211, AIO212, AIO213, EMIF1_A0, EMIF1_A1, EMIF1_A10, EMIF1_A11, EMIF1_A12, EMIF1_A13, EMIF1_A14, EMIF1_A15, EMIF1_A16, EMIF1_A17, EMIF1_A18, EMIF1_A19, EMIF1_A2, EMIF1_A3, EMIF1_A4, EMIF1_A5, EMIF1_A6, EMIF1_A7, EMIF1_A8, EMIF1_A9, EMIF1_BA0, EMIF1_BA1, EMIF1_CAS, EMIF1_CLK, EMIF1_CS0n, EMIF1_CS2n, EMIF1_CS3n, EMIF1_CS4n, EMIF1_D0, EMIF1_D1, EMIF1_D10, EMIF1_D11, EMIF1_D12, EMIF1_D13, EMIF1_D14, EMIF1_D15, EMIF1_D16, EMIF1_D17, EMIF1_D18, EMIF1_D19, EMIF1_D2, EMIF1_D20, EMIF1_D21, EMIF1_D22, EMIF1_D23, EMIF1_D24, EMIF1_D25, EMIF1_D26, EMIF1_D27, EMIF1_D28, EMIF1_D29, EMIF1_D3, EMIF1_D30, EMIF1_D31, EMIF1_D4, EMIF1_D5, EMIF1_D6, EMIF1_D7, EMIF1_D8, EMIF1_D9, EMIF1_DQM0, EMIF1_DQM1, EMIF1_DQM2, EMIF1_DQM3, EMIF1_OEn, EMIF1_RAS, EMIF1_RNW, EMIF1_SDCKE, EMIF1_WAIT, EMIF1_WEn, EPWM10_A, EPWM10_B, EPWM11_A, EPWM11_B, EPWM12_A, EPWM12_B, EPWM13_A, EPWM13_B, EPWM14_A, EPWM14_B, EPWM15_A, EPWM15_B, EPWM16_A, EPWM16_B, EPWM17_A, EPWM17_B, EPWM18_A, EPWM18_B, EPWM1_A, EPWM1_B, EPWM2_A, EPWM2_B, EPWM3_A, EPWM3_B, EPWM4_A, EPWM4_B, EPWM5_A, EPWM5_B, EPWM6_A, EPWM6_B, EPWM7_A, EPWM7_B, EPWM8_A, EPWM8_B, EPWM9_A, EPWM9_B, ERRORSTS, ESC_GPI0, ESC_GPI1, ESC_GPI10, ESC_GPI11, ESC_GPI12, ESC_GPI13, ESC_GPI14, ESC_GPI15, ESC_GPI16, ESC_GPI17, ESC_GPI18, ESC_GPI19, ESC_GPI2, ESC_GPI20, ESC_GPI21, ESC_GPI22, ESC_GPI23, ESC_GPI24, ESC_GPI25, ESC_GPI26, ESC_GPI27, ESC_GPI28, ESC_GPI29, ESC_GPI3, ESC_GPI30, ESC_GPI31, ESC_GPI4, ESC_GPI5, ESC_GPI6, ESC_GPI7, ESC_GPI8, ESC_GPI9, ESC_GPO0, ESC_GPO1, ESC_GPO10, ESC_GPO11, ESC_GPO12, ESC_GPO13, ESC_GPO14, ESC_GPO15, ESC_GPO16, ESC_GPO17, ESC_GPO18, ESC_GPO19, ESC_GPO2, ESC_GPO20, ESC_GPO21, ESC_GPO22, ESC_GPO23, ESC_GPO24, ESC_GPO25, ESC_GPO26, ESC_GPO27, ESC_GPO28, ESC_GPO29, ESC_GPO3, ESC_GPO30, ESC_GPO31, ESC_GPO4, ESC_GPO5, ESC_GPO6, ESC_GPO7, ESC_GPO8, ESC_GPO9, ESC_I2C_SCL, ESC_I2C_SDA, ESC_LATCH0, ESC_LATCH1, ESC_LED_ERR, ESC_LED_LINK0_ACTIVE, ESC_LED_LINK1_ACTIVE, ESC_LED_RUN, ESC_LED_STATE_RUN, ESC_MDIO_CLK, ESC_MDIO_DATA, ESC_PDI_UC_IRQ, ESC_PHY0_LINKSTATUS, ESC_PHY1_LINKSTATUS, ESC_PHY_CLK, ESC_PHY_RESETn, ESC_RX0_CLK, ESC_RX0_DATA0, ESC_RX0_DATA1, ESC_RX0_DATA2, ESC_RX0_DATA3, ESC_RX0_DV, ESC_RX0_ERR, ESC_RX1_CLK, ESC_RX1_DATA0, ESC_RX1_DATA1, ESC_RX1_DATA2, ESC_RX1_DATA3, ESC_RX1_DV, ESC_RX1_ERR, ESC_SYNC0, ESC_SYNC1, ESC_TX0_CLK, ESC_TX0_DATA0, ESC_TX0_DATA1, ESC_TX0_DATA2, ESC_TX0_DATA3, ESC_TX0_ENA, ESC_TX1_CLK, ESC_TX1_DATA0, ESC_TX1_DATA1, ESC_TX1_DATA2, ESC_TX1_DATA3, ESC_TX1_ENA, FSIRXA_CLK, FSIRXA_D0, FSIRXA_D1, FSIRXB_CLK, FSIRXB_D0, FSIRXB_D1, FSIRXC_CLK, FSIRXC_D0, FSIRXC_D1, FSIRXD_CLK, FSIRXD_D0, FSIRXD_D1, FSITXA_CLK, FSITXA_D0, FSITXA_D1, FSITXB_CLK, FSITXB_D0, FSITXB_D1, FSITXC_CLK, FSITXC_D0, FSITXC_D1, FSITXD_CLK, FSITXD_D0, FSITXD_D1, GPIO0, GPIO1, GPIO10, GPIO100, GPIO101, GPIO103, GPIO105, GPIO11, GPIO12, GPIO127, GPIO13, GPIO14, GPIO15, GPIO16, GPIO17, GPIO18, GPIO19, GPIO2, GPIO20, GPIO21, GPIO219, GPIO22, GPIO220, GPIO221, GPIO222, GPIO223, GPIO224, GPIO225, GPIO226, GPIO227, GPIO228, GPIO229, GPIO23, GPIO230, GPIO231, GPIO232, GPIO233, GPIO234, GPIO235, GPIO236, GPIO237, GPIO238, GPIO239, GPIO24, GPIO240, GPIO241, GPIO242, GPIO243, GPIO244, GPIO245, GPIO246, GPIO247, GPIO248, GPIO249, GPIO25, GPIO26, GPIO27, GPIO28, GPIO29, GPIO3, GPIO30, GPIO31, GPIO32, GPIO33, GPIO34, GPIO35, GPIO36, GPIO37, GPIO38, GPIO39, GPIO4, GPIO40, GPIO41, GPIO42, GPIO43, GPIO44, GPIO45, GPIO46, GPIO47, GPIO48, GPIO49, GPIO5, GPIO50, GPIO51, GPIO52, GPIO53, GPIO54, GPIO55, GPIO56, GPIO57, GPIO58, GPIO59, GPIO6, GPIO60, GPIO61, GPIO62, GPIO63, GPIO64, GPIO65, GPIO66, GPIO67, GPIO68, GPIO69, GPIO7, GPIO70, GPIO71, GPIO72, GPIO73, GPIO74, GPIO75, GPIO76, GPIO77, GPIO78, GPIO79, GPIO8, GPIO80, GPIO81, GPIO82, GPIO83, GPIO84, GPIO85, GPIO86, GPIO87, GPIO88, GPIO89, GPIO9, GPIO90, GPIO91, GPIO92, GPIO93, GPIO94, GPIO95, GPIO96, GPIO97, GPIO98, GPIO99, I2CA_SCL, I2CA_SDA, I2CB_SCL, I2CB_SDA, LINA_RX, LINA_TX, LINB_RX, LINB_TX, MCANA_RX, MCANA_TX, MCANB_RX, MCANB_TX, MCANC_RX, MCANC_TX, MCAND_RX, MCAND_TX, MCANE_RX, MCANE_TX, MCANF_RX, MCANF_TX, OUTPUTXBAR1, OUTPUTXBAR10, OUTPUTXBAR11, OUTPUTXBAR12, OUTPUTXBAR13, OUTPUTXBAR14, OUTPUTXBAR15, OUTPUTXBAR16, OUTPUTXBAR2, OUTPUTXBAR3, OUTPUTXBAR4, OUTPUTXBAR5, OUTPUTXBAR6, OUTPUTXBAR7, OUTPUTXBAR8, OUTPUTXBAR9, PMBUSA_ALERT, PMBUSA_CTL, PMBUSA_SCL, PMBUSA_SDA, PORT_MUXMODE_NA, SD1_C1, SD1_C2, SD1_C3, SD1_C4, SD1_D1, SD1_D2, SD1_D3, SD1_D4, SD2_C1, SD2_C2, SD2_C3, SD2_C4, SD2_D1, SD2_D2, SD2_D3, SD2_D4, SD3_C1, SD3_C2, SD3_C3, SD3_C4, SD3_D1, SD3_D2, SD3_D3, SD3_D4, SD4_C1, SD4_C2, SD4_C3, SD4_C4, SD4_D1, SD4_D2, SD4_D3, SD4_D4, SENT1, SENT2, SENT3, SENT4, SENT5, SENT6, SPIA_CLK, SPIA_PICO, SPIA_POCI, SPIA_PTE, SPIB_CLK, SPIB_PICO, SPIB_POCI, SPIB_PTE, SPIC_CLK, SPIC_PICO, SPIC_POCI, SPIC_PTE, SPID_CLK, SPID_PICO, SPID_POCI, SPID_PTE, SPIE_CLK, SPIE_PICO, SPIE_POCI, SPIE_PTE, SYNCOUT, TDI, TDO, UARTA_RX, UARTA_TX, UARTB_RX, UARTB_TX, UARTC_RX, UARTC_TX, UARTD_RX, UARTD_TX, UARTE_RX, UARTE_TX, UARTF_RX, UARTF_TX, XCLKOUT}, multiplicity set at post-build in variant post-build / pre-compile in variant pre-compile, post-build-variant-value=true, set at post-build in variant post-build / pre-compile in variant pre-compile, default-value=ADCA_EXTMUXSEL0  # Port pin mode from mode list. NOTE: While configuring the PortPinMode, ensure that the selected mux mode is available for the specific device variant by checking the datasheet as the pinmuxmode list contains a superset of values for all the variants.
          boolean PortPinModeChangeable: post-build-variant-value=true, set at post-build in variant post-build / pre-compile in variant pre-compile, default-value=false  # Parameter to indicate if the mode is changeable on a port pin during runtime. True: Port Pin mode changeable allowed. False: Port Pin mode changeable not permitted.
    container PortGeneral  # Module wide configuration parameters of the PORT driver.
      boolean PortDevErrorDetect: set at pre-compile, default-value=false  # Switches the development error detection and notification on or off.
      boolean PortSetPinDirectionApi: set at pre-compile, default-value=true  # Pre-processor switch to enable / disable the use of the function Port_SetPinDirection().
      boolean PortSetPinModeApi: set at pre-compile, default-value=true  # Pre-processor switch to enable / disable the use of the function Port_SetPinMode().
      boolean PortVersionInfoApi: set at pre-compile, default-value=false  # Pre-processor switch to enable / disable the API to read out the modules version information.
      boolean PortLockConfiguration: origin=Texas Instruments, set at post-build in variant post-build / pre-compile in variant pre-compile, default-value=false  # Lock All pins configuration.
      enumeration PortAGPIOFilter: {PORT_AGPIO_FILTER_0, PORT_AGPIO_FILTER_1, PORT_AGPIO_FILTER_2, PORT_AGPIO_FILTER_3}, origin=Texas Instruments, set at post-build in variant post-build / pre-compile in variant pre-compile, default-value=PORT_AGPIO_FILTER_0  # AGPIOFILTER - Analog GPIO input filter selection (global, applies to all AGPIO pins): PORT_AGPIO_FILTER_0 (00): Filter bypass configuration (min ACQPS = 90ns) PORT_AGPIO_FILTER_1 (01): 333 Ohm filter setting (min ACQPS = 125ns) PORT_AGPIO_FILTER_2 (10): 500 Ohm filter setting (min ACQPS = 160ns) PORT_AGPIO_FILTER_3 (11): 1 kOhm filter setting (min ACQPS = 230ns)
