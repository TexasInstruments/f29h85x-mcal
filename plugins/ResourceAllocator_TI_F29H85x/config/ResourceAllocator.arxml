AUTOSAR XML (schema 00044)
package /TI_F29H85x
  module definition ResourceAllocator: variants pre-compile  # Configuration of the Resource Allocator which maps resources such as hardware instances, channels, memory etc. to each CPU within Mcu.
    container ResourceAllocatorGeneral  # General configuration (parameters) of the Resource Allocator module.
      enumeration Mode: {CONFIGURE, SETUP}, origin=Texas Instruments, set at pre-compile, default-value=CONFIGURE  # Selects Mode being used: SETUP mode: Board designers define system-level settings and allocate resources to cores CONFIGURE mode: Application developers use only resources allocated to their core
      enumeration Device: {F29H859DU_Q1, F29H859TM_Q1, F29H859TU_Q1, F29P329SJ_Q1, F29P329SM_Q1, F29P589DM_Q1, F29P589DU_Q1}, origin=Texas Instruments, set at pre-compile, default-value=F29H859DU_Q1  # Selects Device being used.
      enumeration Variant: {F29H859DU6_Q, F29H859TM8_Q, F29H859TU8_Q, F29P329SJ1_Q, F29P329SM1_Q, F29P329SM2_Q, F29P589DM5_Q, F29P589DU5_Q}, origin=Texas Instruments, set at pre-compile, default-value=F29P589DU5_Q  # Selects Variant being used.
      enumeration Package: {F29H859DU6_Q_100PZS, F29H859DU6_Q_144RFS, F29H859DU6_Q_176PTS, F29H859DU6_Q_256ZEX, F29H859TM8_Q_100PZS, F29H859TM8_Q_144RFS, F29H859TU8_Q_100PZS, F29H859TU8_Q_144RFS, F29H859TU8_Q_176PTS, F29H859TU8_Q_256ZEX, F29P329SJ1_Q_100PZS, F29P329SJ1_Q_144RFS, F29P329SM1_Q_100PZS, F29P329SM1_Q_144RFS, F29P329SM2_Q_100PZS, F29P329SM2_Q_144RFS, F29P589DM5_Q_100PZS, F29P589DM5_Q_144RFS, F29P589DM5_Q_176PTS, F29P589DM5_Q_256ZEX, F29P589DU5_Q_100PZS, F29P589DU5_Q_144RFS, F29P589DU5_Q_176PTS, F29P589DU5_Q_256ZEX}, origin=Texas Instruments, set at pre-compile, default-value=F29P589DU5_Q_256ZEX  # Selects Package being used.
      boolean CPU1_Lockstep: origin=Texas Instruments, set at pre-compile, default-value=false  # Selects whether lockstep mode is enabled or not.
      reference CurrentContext: origin=Texas Instruments, set at pre-compile, destination=Context  # Selects Current Context to be used for this MCAL instance.
      container Context: multiplicity set at pre-compile  # This container contains the driver configuration (parameters) for the Context
        enumeration Core: {CPU1}, origin=Texas Instruments, set at pre-compile, default-value=CPU1  # Selects Core for which this Context is configured.
        container Can [0..1]: multiplicity set at pre-compile  # Configuration container for Context specific settings for the Can module.
          container CanAllocatedInstance [0..6]: multiplicity set at pre-compile  # Configuration of a Can instance allocated to this context.
            enumeration InstanceName: {MCANA, MCANB, MCANC, MCAND, MCANE, MCANF}, origin=Texas Instruments, set at pre-compile, default-value=MCANA  # Selects the Can instance to be allocated.
            boolean DebugHaltEnabled: origin=Texas Instruments, set at pre-compile, default-value=true  # Controls whether the peripheral DBGHALT signal is activated when the CPU enters HALT mode
            boolean StandbyModeEnabled: origin=Texas Instruments, set at pre-compile, default-value=true  # Controls whether the peripheral clock is gated when the CPU enters STANDBY mode
            enumeration Frame: {FRAME0, FRAME1, FRAME2, FRAME3}, origin=Texas Instruments, set at pre-compile, default-value=FRAME0  # Selects the peripheral frame. Frames enable simultaneous access from different initiators to peripherals without arbitration stalls, each with its own base address.
            string BaseAddr: origin=Texas Instruments, set at pre-compile, default-value=MCANA_DRIVER_BASE_FRAME(0U)  # Base address of the Can instance. This field represents the macro as defined in hw_memmap.h
        container Spi [0..1]: multiplicity set at pre-compile  # Configuration container for Context specific settings for the Spi module.
          container SpiAllocatedInstance [0..5]: multiplicity set at pre-compile  # Configuration for Spi Instance.
            enumeration InstanceName: {SPIA, SPIB, SPIC, SPID, SPIE}, origin=Texas Instruments, set at pre-compile, default-value=SPIA  # Selects the Spi instance to be allocated.
            boolean DebugHaltEnabled: origin=Texas Instruments, set at pre-compile, default-value=true  # Controls whether the peripheral DBGHALT signal is activated when the CPU enters HALT mode
            boolean StandbyModeEnabled: origin=Texas Instruments, set at pre-compile, default-value=true  # Controls whether the peripheral clock is gated when the CPU enters STANDBY mode
            enumeration Frame: {FRAME0, FRAME1, FRAME2, FRAME3}, origin=Texas Instruments, set at pre-compile, default-value=FRAME0  # Selects the peripheral frame. Frames enable simultaneous access from different initiators to peripherals without arbitration stalls, each with its own base address.
            string BaseAddr: origin=Texas Instruments, set at pre-compile, default-value=SPIA_BASE_FRAME(0U)  # Base address of the Spi instance. This field represents the macro as defined in hw_memmap.h
        container Lin [0..1]: multiplicity set at pre-compile  # Configuration container for Context specific settings for the Lin module.
          container LinAllocatedInstance [0..2]: multiplicity set at pre-compile  # Configuration for Lin Instance.
            enumeration InstanceName: {LINA, LINB}, origin=Texas Instruments, set at pre-compile, default-value=LINA  # Selects the Lin instance to be allocated.
            boolean DebugHaltEnabled: origin=Texas Instruments, set at pre-compile, default-value=true  # Controls whether the peripheral DBGHALT signal is activated when the CPU enters HALT mode
            boolean StandbyModeEnabled: origin=Texas Instruments, set at pre-compile, default-value=true  # Controls whether the peripheral clock is gated when the CPU enters STANDBY mode
            enumeration Frame: {FRAME0, FRAME1, FRAME2, FRAME3}, origin=Texas Instruments, set at pre-compile, default-value=FRAME0  # Selects the peripheral frame. Frames enable simultaneous access from different initiators to peripherals without arbitration stalls, each with its own base address.
            string BaseAddr: origin=Texas Instruments, set at pre-compile, default-value=LINA_BASE_FRAME(0U)  # Base address of the Lin instance. This field represents the macro as defined in hw_memmap.h
        container Cdd_Adc [0..1]: multiplicity set at pre-compile  # Configuration container for Context specific settings for the Cdd_Adc module.
          container Cdd_AdcAllocatedInstance [0..5]: multiplicity set at pre-compile  # Configuration for Cdd_Adc Instance.
            enumeration InstanceName: {CDD_ADCA, CDD_ADCB, CDD_ADCC, CDD_ADCD, CDD_ADCE}, origin=Texas Instruments, set at pre-compile, default-value=CDD_ADCA  # Selects the Adc instance to be allocated.
            boolean DebugHaltEnabled: origin=Texas Instruments, set at pre-compile, default-value=true  # Controls whether the peripheral DBGHALT signal is activated when the CPU enters HALT mode
            boolean StandbyModeEnabled: origin=Texas Instruments, set at pre-compile, default-value=true  # Controls whether the peripheral clock is gated when the CPU enters STANDBY mode
            enumeration Frame: {FRAME0, FRAME1, FRAME2, FRAME3}, origin=Texas Instruments, set at pre-compile, default-value=FRAME0  # Selects the peripheral frame. Frames enable simultaneous access from different initiators to peripherals without arbitration stalls, each with its own base address.
            string BaseAddr: origin=Texas Instruments, set at pre-compile, default-value=ADCA_BASE_FRAME(0U)  # Base address of the Cdd_Adc instance. This field represents the macro as defined in hw_memmap.h
          container CddAdcSafetyCheckerInstance [0..10]: multiplicity set at pre-compile  # Configuration of ADC safety checker instances.
            enumeration SafetyCheckerInstance: {ADCSAFETYCHECK1, ADCSAFETYCHECK2, ADCSAFETYCHECK3, ADCSAFETYCHECK4, ADCSAFETYCHECK5, ADCSAFETYCHECK6, ADCSAFETYCHECK7, ADCSAFETYCHECK8, ADCSAFETYCHECK9, ADCSAFETYCHECK10}, origin=Texas Instruments, set at pre-compile, default-value=ADCSAFETYCHECK1  # Selects the adc safety checker instances to be allocated.
            boolean DebugHaltEnabled: origin=Texas Instruments, set at pre-compile, default-value=true  # Controls whether the peripheral DBGHALT signal is activated when the CPU enters HALT mode
            boolean StandbyModeEnabled: origin=Texas Instruments, set at pre-compile, default-value=true  # Controls whether the peripheral clock is gated when the CPU enters STANDBY mode
            enumeration Frame: {FRAME0, FRAME1, FRAME2, FRAME3}, origin=Texas Instruments, set at pre-compile, default-value=FRAME0  # Selects the peripheral frame. Frames enable simultaneous access from different initiators to peripherals without arbitration stalls, each with its own base address.
            string BaseAddr: origin=Texas Instruments, set at pre-compile, default-value=ADCSAFETYCHECK1_BASE_FRAME(0U)  # Base address of the Cdd_Adc safety checker instance. This field represents the macro as defined in hw_memmap.h
          container CddAdcCheckerInterruptEvtInstance [0..1]: multiplicity set at pre-compile  # Configuration of ADC safety checker interrupt event instances.
            enumeration SafetyCheckerIntEvtInstance: {ADCSAFETYCHECKINTEVT1, ADCSAFETYCHECKINTEVT2, ADCSAFETYCHECKINTEVT3}, origin=Texas Instruments, set at pre-compile, default-value=ADCSAFETYCHECKINTEVT1  # Selects the safety checker interrupt event instances to be allocated.
            boolean DebugHaltEnabled: origin=Texas Instruments, set at pre-compile, default-value=true  # Controls whether the peripheral DBGHALT signal is activated when the CPU enters HALT mode
            boolean StandbyModeEnabled: origin=Texas Instruments, set at pre-compile, default-value=true  # Controls whether the peripheral clock is gated when the CPU enters STANDBY mode
            enumeration Frame: {FRAME0, FRAME1, FRAME2, FRAME3}, origin=Texas Instruments, set at pre-compile, default-value=FRAME0  # Selects the peripheral frame. Frames enable simultaneous access from different initiators to peripherals without arbitration stalls, each with its own base address.
            string BaseAddr: origin=Texas Instruments, set at pre-compile, default-value=ADCSAFETYCHECKINTEVT1_BASE_FRAME(0U)  # Base address of the Cdd_Adc safety checker instance. This field represents the macro as defined in hw_memmap.h
          container CddAdcGlobalSoftwareForce [0..1]: multiplicity set at pre-compile  # Configuration of global software force. This is linked to global software trigger feature in ADC. This should be added only once.
            enumeration Frame: {FRAME0, FRAME1, FRAME2, FRAME3}, origin=Texas Instruments, set at pre-compile, default-value=FRAME0  # Selects frmae for global software force registers. Frames enable simultaneous access from different initiators to peripherals without arbitration stalls, each with its own base address.
            string GlbSwFrcBaseAddr: origin=Texas Instruments, set at pre-compile, default-value=ADCGLOBAL_BASE_FRAME(0U)  # Base address of the Cdd_Adc global software force registers. This field represents the macro as defined in hw_memmap.h
        container Cdd_Ecap [0..1]: multiplicity set at pre-compile  # Configuration container for Context specific settings for the Cdd_Ecap module.
          container Cdd_EcapAllocatedInstance [0..6]: multiplicity set at pre-compile  # Configuration for Cdd_Ecap Instance.
            enumeration InstanceName: {ECAP1, ECAP2, ECAP3, ECAP4, ECAP5, ECAP6}, origin=Texas Instruments, set at pre-compile, default-value=ECAP1  # Selects the Cdd_Ecap instance to be allocated.
            boolean DebugHaltEnabled: origin=Texas Instruments, set at pre-compile, default-value=true  # Controls whether the peripheral DBGHALT signal is activated when the CPU enters HALT mode
            boolean StandbyModeEnabled: origin=Texas Instruments, set at pre-compile, default-value=true  # Controls whether the peripheral clock is gated when the CPU enters STANDBY mode
            enumeration Frame: {FRAME0, FRAME1, FRAME2, FRAME3}, origin=Texas Instruments, set at pre-compile, default-value=FRAME0  # Selects the peripheral frame. Frames enable simultaneous access from different initiators to peripherals without arbitration stalls, each with its own base address.
            string BaseAddr: origin=Texas Instruments, set at pre-compile, default-value=ECAP1_BASE_FRAME(0U)  # Base address of the Cdd_Ecap instance. This field represents the macro as defined in hw_memmap.h
        container Cdd_Dma [0..1]: multiplicity set at pre-compile  # Configuration container for Context specific settings for the Cdd_Dma module. This container defines which DMA channels are assigned to this specific CPU context.
          container CddDmaAllocatedChannel [0..20]: multiplicity set at pre-compile  # Configuration of a DMA channel allocated to this CPU context. Each allocated channel can only be used by this context..
            reference ChannelRef: origin=Texas Instruments, set at pre-compile, destination=CddDmaChannel  # Reference to a specific DMA channel from the available DMA hardware instances. This links to a channel defined in the Cdd_Dma hardware instance configuration, allocating it exclusively to this CPU context.
        container Cdd_I2c [0..1]: multiplicity set at pre-compile  # Configuration container for Context specific settings for the Cdd_I2c module.
          container Cdd_I2cAllocatedInstance [0..2]: multiplicity set at pre-compile  # Configuration for Cdd_I2c Instance.
            enumeration InstanceName: {I2CA, I2CB}, origin=Texas Instruments, set at pre-compile, default-value=I2CA  # Selects the Cdd_I2c instance to be allocated.
            boolean DebugHaltEnabled: origin=Texas Instruments, set at pre-compile, default-value=true  # Controls whether the peripheral DBGHALT signal is activated when the CPU enters HALT mode
            boolean StandbyModeEnabled: origin=Texas Instruments, set at pre-compile, default-value=true  # Controls whether the peripheral clock is gated when the CPU enters STANDBY mode
            enumeration Frame: {FRAME0, FRAME1, FRAME2, FRAME3}, origin=Texas Instruments, set at pre-compile, default-value=FRAME0  # Selects the peripheral frame. Frames enable simultaneous access from different initiators to peripherals without arbitration stalls, each with its own base address.
            string BaseAddr: origin=Texas Instruments, set at pre-compile, default-value=I2CA_BASE_FRAME(0U)  # Base address of the Cdd_I2c instance. This field represents the macro as defined in hw_memmap.h
        container Cdd_Pwm [0..1]: multiplicity set at pre-compile  # Configuration container for Context specific settings for the Cdd_Pwm module.
          container Cdd_PwmAllocatedInstance [0..18]: multiplicity set at pre-compile  # Configuration for Cdd_Pwm Instance.
            enumeration InstanceName: {EPWM1, EPWM2, EPWM3, EPWM4, EPWM5, EPWM6, EPWM7, EPWM8, EPWM9, EPWM10, EPWM11, EPWM12, EPWM13, EPWM14, EPWM15, EPWM16, EPWM17, EPWM18}, origin=Texas Instruments, set at pre-compile, default-value=EPWM1  # Selects the Pwm instance to be allocated.
            boolean DebugHaltEnabled: origin=Texas Instruments, set at pre-compile, default-value=true  # Controls whether the peripheral DBGHALT signal is activated when the CPU enters HALT mode
            boolean StandbyModeEnabled: origin=Texas Instruments, set at pre-compile, default-value=true  # Controls whether the peripheral clock is gated when the CPU enters STANDBY mode
            enumeration Frame: {FRAME0, FRAME1, FRAME2, FRAME3}, origin=Texas Instruments, set at pre-compile, default-value=FRAME0  # Selects the peripheral frame. Frames enable simultaneous access from different initiators to peripherals without arbitration stalls, each with its own base address.
            string BaseAddr: origin=Texas Instruments, set at pre-compile, default-value=EPWM1_BASE_FRAME(0U)  # Base address of the Cdd_Pwm instance. This field represents the macro as defined in hw_memmap.h
            string XlinkBaseAddr: origin=Texas Instruments, set at pre-compile, default-value=EPWM1XLINK_BASE_FRAME(0U)  # Base address of the Cdd_Pwm instance. This field represents the macro as defined in hw_memmap.h
          container CddPwmHrpwmCalInstance [0..3]: multiplicity set at pre-compile  # Configuration of Hrpwm calibration instances.
            enumeration InstanceName: {HRPWMCAL1, HRPWMCAL2, HRPWMCAL3}, origin=Texas Instruments, set at pre-compile, default-value=HRPWMCAL1  # Selects the Hrpwm calibration instance instance to be allocated.
            enumeration Frame: {FRAME0, FRAME1, FRAME2, FRAME3}, origin=Texas Instruments, set at pre-compile, default-value=FRAME0  # Selects the peripheral frame. Frames enable simultaneous access from different initiators to peripherals without arbitration stalls, each with its own base address.
            string BaseAddr: origin=Texas Instruments, set at pre-compile, default-value=HRPWMCAL1_BASE_FRAME(0U)  # Base address of the Cdd_Pwm instance. This field represents the macro as defined in hw_memmap.h
        container Cdd_Sent [0..1]: multiplicity set at pre-compile  # Configuration container for Context specific settings for the Cdd_Sent module.
          container Cdd_SentAllocatedInstance [0..6]: multiplicity set at pre-compile  # Configuration of a Cdd_Sent instance allocated to this context.
            enumeration InstanceName: {SENT1, SENT2, SENT3, SENT4, SENT5, SENT6}, origin=Texas Instruments, set at pre-compile, default-value=SENT1  # Selects the Cdd_Sent instance to be allocated.
            boolean DebugHaltEnabled: origin=Texas Instruments, set at pre-compile, default-value=true  # Controls whether the peripheral DBGHALT signal is activated when the CPU enters HALT mode
            boolean StandbyModeEnabled: origin=Texas Instruments, set at pre-compile, default-value=true  # Controls whether the peripheral clock is gated when the CPU enters STANDBY mode
            enumeration Frame: {FRAME0, FRAME1, FRAME2, FRAME3}, origin=Texas Instruments, set at pre-compile, default-value=FRAME0  # Selects the peripheral frame. Frames enable simultaneous access from different initiators to peripherals without arbitration stalls, each with its own base address.
            string BaseAddr: origin=Texas Instruments, set at pre-compile, default-value=SENT1_BASE_FRAME(0U)  # Base address of the Cdd_Sent instance. This field represents the macro as defined in hw_memmap.h
        container Cdd_Uart [0..1]: multiplicity set at pre-compile  # Configuration container for Context specific settings for the Cdd_Uart module.
          container Cdd_UartAllocatedInstance [0..6]: multiplicity set at pre-compile  # Configuration of a Cdd_Uart instance allocated to this context.
            enumeration InstanceName: {UARTA, UARTB, UARTC, UARTD, UARTE, UARTF}, origin=Texas Instruments, set at pre-compile, default-value=UARTA  # Selects the Cdd_Uart instance to be allocated.
            boolean DebugHaltEnabled: origin=Texas Instruments, set at pre-compile, default-value=true  # Controls whether the peripheral DBGHALT signal is activated when the CPU enters HALT mode
            boolean StandbyModeEnabled: origin=Texas Instruments, set at pre-compile, default-value=true  # Controls whether the peripheral clock is gated when the CPU enters STANDBY mode
            enumeration Frame: {FRAME0, FRAME1, FRAME2, FRAME3}, origin=Texas Instruments, set at pre-compile, default-value=FRAME0  # Selects the peripheral frame. Frames enable simultaneous access from different initiators to peripherals without arbitration stalls, each with its own base address.
            string BaseAddr: origin=Texas Instruments, set at pre-compile, default-value=UARTA_BASE_FRAME(0U)  # Base address of the Cdd_Uart instance. This field represents the macro as defined in hw_memmap.h
        container Cdd_Cmpss [0..1]: multiplicity set at pre-compile  # Configuration container for Context specific settings for the Cdd_Cmpss module.
          container Cdd_CmpssAllocatedInstance [0..12]: multiplicity set at pre-compile  # Configuration of a Cdd_Cmpss instance allocated to this context.
            enumeration InstanceName: {CMPSS1, CMPSS2, CMPSS3, CMPSS4, CMPSS5, CMPSS6, CMPSS7, CMPSS8, CMPSS9, CMPSS10, CMPSS11, CMPSS12}, origin=Texas Instruments, set at pre-compile, default-value=CMPSS1  # Selects the Cdd_Cmpss instance to be allocated.
            boolean DebugHaltEnabled: origin=Texas Instruments, set at pre-compile, default-value=true  # Controls whether the peripheral DBGHALT signal is activated when the CPU enters HALT mode
            boolean StandbyModeEnabled: origin=Texas Instruments, set at pre-compile, default-value=true  # Controls whether the peripheral clock is gated when the CPU enters STANDBY mode
            enumeration Frame: {FRAME0, FRAME1, FRAME2, FRAME3}, origin=Texas Instruments, set at pre-compile, default-value=FRAME0  # Selects the peripheral frame. Frames enable simultaneous access from different initiators to peripherals without arbitration stalls, each with its own base address.
            string BaseAddr: origin=Texas Instruments, set at pre-compile, default-value=CMPSS1_BASE_FRAME(0U)  # Base address of the Cdd_Cmpss instance. This field represents the macro as defined in hw_memmap.h
            enumeration CMPSSHPMuxSelect: {CMPSS_INPUT_SIGNAL_MUX0_AIO160, CMPSS_INPUT_SIGNAL_MUX0_AIO164, CMPSS_INPUT_SIGNAL_MUX0_AIO172, CMPSS_INPUT_SIGNAL_MUX0_AIO180, CMPSS_INPUT_SIGNAL_MUX0_AIO181, CMPSS_INPUT_SIGNAL_MUX0_AIO193, CMPSS_INPUT_SIGNAL_MUX0_AIO195, CMPSS_INPUT_SIGNAL_MUX0_AIO198, CMPSS_INPUT_SIGNAL_MUX0_GPIO224, CMPSS_INPUT_SIGNAL_MUX0_GPIO238, CMPSS_INPUT_SIGNAL_MUX0_GPIO244, CMPSS_INPUT_SIGNAL_MUX1_AIO162, CMPSS_INPUT_SIGNAL_MUX1_AIO170, CMPSS_INPUT_SIGNAL_MUX1_AIO174, CMPSS_INPUT_SIGNAL_MUX1_AIO182, CMPSS_INPUT_SIGNAL_MUX1_AIO203, CMPSS_INPUT_SIGNAL_MUX1_AIO206, CMPSS_INPUT_SIGNAL_MUX1_AIO208, CMPSS_INPUT_SIGNAL_MUX1_AIO209, CMPSS_INPUT_SIGNAL_MUX1_AIO213, CMPSS_INPUT_SIGNAL_MUX1_GPIO241, CMPSS_INPUT_SIGNAL_MUX1_GPIO246, CMPSS_INPUT_SIGNAL_MUX1_GPIO248, CMPSS_INPUT_SIGNAL_MUX2_0p9xVREF_HIAB, CMPSS_INPUT_SIGNAL_MUX2_AIO163, CMPSS_INPUT_SIGNAL_MUX2_AIO171, CMPSS_INPUT_SIGNAL_MUX2_AIO175, CMPSS_INPUT_SIGNAL_MUX2_AIO192, CMPSS_INPUT_SIGNAL_MUX2_AIO207, CMPSS_INPUT_SIGNAL_MUX2_AIO210, CMPSS_INPUT_SIGNAL_MUX2_AIO211, CMPSS_INPUT_SIGNAL_MUX2_AIO212, CMPSS_INPUT_SIGNAL_MUX2_GPIO225, CMPSS_INPUT_SIGNAL_MUX2_GPIO247, CMPSS_INPUT_SIGNAL_MUX2_GPIO249, CMPSS_INPUT_SIGNAL_MUX3_0p9xVREF_HIAB, CMPSS_INPUT_SIGNAL_MUX3_0p9xVREF_HICDE, CMPSS_INPUT_SIGNAL_MUX3_AIO173, CMPSS_INPUT_SIGNAL_MUX3_AIO194, CMPSS_INPUT_SIGNAL_MUX3_AIO195, CMPSS_INPUT_SIGNAL_MUX3_AIO199, CMPSS_INPUT_SIGNAL_MUX3_AIO203, CMPSS_INPUT_SIGNAL_MUX3_GPIO226, CMPSS_INPUT_SIGNAL_MUX3_GPIO239, CMPSS_INPUT_SIGNAL_MUX3_TemperatureSensor, CMPSS_INPUT_SIGNAL_MUX4_AIO204, CMPSS_INPUT_SIGNAL_MUX4_AIO205, CMPSS_INPUT_SIGNAL_MUX4_GPIO226, CMPSS_INPUT_SIGNAL_MUX4_GPIO227, CMPSS_INPUT_SIGNAL_MUX4_GPIO228, CMPSS_INPUT_SIGNAL_MUX4_GPIO229, CMPSS_INPUT_SIGNAL_MUX4_GPIO230, CMPSS_INPUT_SIGNAL_MUX4_GPIO231, CMPSS_INPUT_SIGNAL_MUX4_GPIO232, CMPSS_INPUT_SIGNAL_MUX4_GPIO233, CMPSS_INPUT_SIGNAL_MUX4_GPIO242, CMPSS_INPUT_SIGNAL_MUX4_GPIO243, CMPSS_INPUT_SIGNAL_MUX5_AIO166, CMPSS_INPUT_SIGNAL_MUX5_AIO167, CMPSS_INPUT_SIGNAL_MUX5_AIO168, CMPSS_INPUT_SIGNAL_MUX5_AIO169, CMPSS_INPUT_SIGNAL_MUX5_AIO178, CMPSS_INPUT_SIGNAL_MUX5_AIO179, CMPSS_INPUT_SIGNAL_MUX5_AIO186, CMPSS_INPUT_SIGNAL_MUX5_AIO187, CMPSS_INPUT_SIGNAL_MUX5_AIO188, CMPSS_INPUT_SIGNAL_MUX5_GPIO237, CMPSS_INPUT_SIGNAL_MUX5_GPIO238, CMPSS_INPUT_SIGNAL_MUX5_GPIO239, CMPSS_INPUT_SIGNAL_MUX6_AIO160, CMPSS_INPUT_SIGNAL_MUX6_AIO161, CMPSS_INPUT_SIGNAL_MUX6_AIO168, CMPSS_INPUT_SIGNAL_MUX6_AIO169, CMPSS_INPUT_SIGNAL_MUX6_AIO170, CMPSS_INPUT_SIGNAL_MUX6_AIO172, CMPSS_INPUT_SIGNAL_MUX6_AIO180, CMPSS_INPUT_SIGNAL_MUX6_AIO192, CMPSS_INPUT_SIGNAL_MUX6_AIO193, CMPSS_INPUT_SIGNAL_MUX6_AIO202, CMPSS_INPUT_SIGNAL_MUX6_GPIO232, CMPSS_INPUT_SIGNAL_MUX6_GPIO233}, origin=TI_F29H85x, set at pre-compile, default-value=CMPSS_INPUT_SIGNAL_MUX0_AIO160  # HP positive input mux select for this CMPSS instance. Selects the input signal for the comparator HP positive input. Written to CMPHPMXSEL (CMP1-CMP10) or CMPHPMXSEL1 (CMP11-CMP12) register during Mcu_Init() via Mcu_Priv_ConfigureCMPSSASysCtl(). Value format: CMPSS_INPUT_SIGNAL_MUX<index>_<SignalName>.
            enumeration CMPSSLPMuxSelect: {CMPSS_INPUT_SIGNAL_MUX0_AIO160, CMPSS_INPUT_SIGNAL_MUX0_AIO164, CMPSS_INPUT_SIGNAL_MUX0_AIO172, CMPSS_INPUT_SIGNAL_MUX0_AIO180, CMPSS_INPUT_SIGNAL_MUX0_AIO181, CMPSS_INPUT_SIGNAL_MUX0_AIO193, CMPSS_INPUT_SIGNAL_MUX0_AIO195, CMPSS_INPUT_SIGNAL_MUX0_AIO198, CMPSS_INPUT_SIGNAL_MUX0_GPIO224, CMPSS_INPUT_SIGNAL_MUX0_GPIO238, CMPSS_INPUT_SIGNAL_MUX0_GPIO244, CMPSS_INPUT_SIGNAL_MUX1_AIO162, CMPSS_INPUT_SIGNAL_MUX1_AIO170, CMPSS_INPUT_SIGNAL_MUX1_AIO174, CMPSS_INPUT_SIGNAL_MUX1_AIO182, CMPSS_INPUT_SIGNAL_MUX1_AIO203, CMPSS_INPUT_SIGNAL_MUX1_AIO206, CMPSS_INPUT_SIGNAL_MUX1_AIO208, CMPSS_INPUT_SIGNAL_MUX1_AIO209, CMPSS_INPUT_SIGNAL_MUX1_AIO213, CMPSS_INPUT_SIGNAL_MUX1_GPIO241, CMPSS_INPUT_SIGNAL_MUX1_GPIO246, CMPSS_INPUT_SIGNAL_MUX1_GPIO248, CMPSS_INPUT_SIGNAL_MUX2_0p9xVREF_HIAB, CMPSS_INPUT_SIGNAL_MUX2_AIO163, CMPSS_INPUT_SIGNAL_MUX2_AIO171, CMPSS_INPUT_SIGNAL_MUX2_AIO175, CMPSS_INPUT_SIGNAL_MUX2_AIO192, CMPSS_INPUT_SIGNAL_MUX2_AIO207, CMPSS_INPUT_SIGNAL_MUX2_AIO210, CMPSS_INPUT_SIGNAL_MUX2_AIO211, CMPSS_INPUT_SIGNAL_MUX2_AIO212, CMPSS_INPUT_SIGNAL_MUX2_GPIO225, CMPSS_INPUT_SIGNAL_MUX2_GPIO247, CMPSS_INPUT_SIGNAL_MUX2_GPIO249, CMPSS_INPUT_SIGNAL_MUX3_0p9xVREF_HIAB, CMPSS_INPUT_SIGNAL_MUX3_0p9xVREF_HICDE, CMPSS_INPUT_SIGNAL_MUX3_AIO173, CMPSS_INPUT_SIGNAL_MUX3_AIO194, CMPSS_INPUT_SIGNAL_MUX3_AIO195, CMPSS_INPUT_SIGNAL_MUX3_AIO199, CMPSS_INPUT_SIGNAL_MUX3_AIO203, CMPSS_INPUT_SIGNAL_MUX3_GPIO226, CMPSS_INPUT_SIGNAL_MUX3_GPIO239, CMPSS_INPUT_SIGNAL_MUX3_GPIO240, CMPSS_INPUT_SIGNAL_MUX3_GPIO245, CMPSS_INPUT_SIGNAL_MUX4_AIO176, CMPSS_INPUT_SIGNAL_MUX4_AIO177, CMPSS_INPUT_SIGNAL_MUX4_AIO183, CMPSS_INPUT_SIGNAL_MUX4_AIO184, CMPSS_INPUT_SIGNAL_MUX4_AIO185, CMPSS_INPUT_SIGNAL_MUX4_AIO204, CMPSS_INPUT_SIGNAL_MUX4_AIO205, CMPSS_INPUT_SIGNAL_MUX4_GPIO234, CMPSS_INPUT_SIGNAL_MUX4_GPIO235, CMPSS_INPUT_SIGNAL_MUX4_GPIO236, CMPSS_INPUT_SIGNAL_MUX4_GPIO242, CMPSS_INPUT_SIGNAL_MUX4_GPIO243, CMPSS_INPUT_SIGNAL_MUX5_AIO166, CMPSS_INPUT_SIGNAL_MUX5_AIO167, CMPSS_INPUT_SIGNAL_MUX5_AIO168, CMPSS_INPUT_SIGNAL_MUX5_AIO169, CMPSS_INPUT_SIGNAL_MUX5_AIO189, CMPSS_INPUT_SIGNAL_MUX5_AIO190, CMPSS_INPUT_SIGNAL_MUX5_AIO191, CMPSS_INPUT_SIGNAL_MUX5_AIO196, CMPSS_INPUT_SIGNAL_MUX5_AIO197, CMPSS_INPUT_SIGNAL_MUX5_AIO200, CMPSS_INPUT_SIGNAL_MUX5_AIO201, CMPSS_INPUT_SIGNAL_MUX5_AIO202, CMPSS_INPUT_SIGNAL_MUX6_AIO160, CMPSS_INPUT_SIGNAL_MUX6_AIO161, CMPSS_INPUT_SIGNAL_MUX6_AIO168, CMPSS_INPUT_SIGNAL_MUX6_AIO169, CMPSS_INPUT_SIGNAL_MUX6_AIO170, CMPSS_INPUT_SIGNAL_MUX6_AIO172, CMPSS_INPUT_SIGNAL_MUX6_AIO180, CMPSS_INPUT_SIGNAL_MUX6_AIO192, CMPSS_INPUT_SIGNAL_MUX6_AIO193, CMPSS_INPUT_SIGNAL_MUX6_AIO202, CMPSS_INPUT_SIGNAL_MUX6_GPIO232, CMPSS_INPUT_SIGNAL_MUX6_GPIO233}, origin=TI_F29H85x, set at pre-compile, default-value=CMPSS_INPUT_SIGNAL_MUX0_AIO160  # LP positive input mux select for this CMPSS instance. Selects the input signal for the comparator LP positive input. Written to CMPLPMXSEL (CMP1-CMP10) or CMPLPMXSEL1 (CMP11-CMP12) register during Mcu_Init() via Mcu_Priv_ConfigureCMPSSASysCtl(). Value format: CMPSS_INPUT_SIGNAL_MUX<index>_<SignalName>.
            enumeration CMPSSHNMuxSelect: {CMPSS_NEG_INPUT_SIGNAL_MUX0_AIO161, CMPSS_NEG_INPUT_SIGNAL_MUX0_AIO162, CMPSS_NEG_INPUT_SIGNAL_MUX0_AIO165, CMPSS_NEG_INPUT_SIGNAL_MUX0_AIO173, CMPSS_NEG_INPUT_SIGNAL_MUX0_AIO194, CMPSS_NEG_INPUT_SIGNAL_MUX0_AIO199, CMPSS_NEG_INPUT_SIGNAL_MUX0_AIO206, CMPSS_NEG_INPUT_SIGNAL_MUX0_GPIO224, CMPSS_NEG_INPUT_SIGNAL_MUX0_GPIO225, CMPSS_NEG_INPUT_SIGNAL_MUX0_GPIO230, CMPSS_NEG_INPUT_SIGNAL_MUX0_GPIO240, CMPSS_NEG_INPUT_SIGNAL_MUX0_GPIO245, CMPSS_NEG_INPUT_SIGNAL_MUX1_AIO163, CMPSS_NEG_INPUT_SIGNAL_MUX1_AIO164, CMPSS_NEG_INPUT_SIGNAL_MUX1_AIO171, CMPSS_NEG_INPUT_SIGNAL_MUX1_AIO174, CMPSS_NEG_INPUT_SIGNAL_MUX1_AIO175, CMPSS_NEG_INPUT_SIGNAL_MUX1_AIO182, CMPSS_NEG_INPUT_SIGNAL_MUX1_AIO198, CMPSS_NEG_INPUT_SIGNAL_MUX1_AIO207, CMPSS_NEG_INPUT_SIGNAL_MUX1_AIO213, CMPSS_NEG_INPUT_SIGNAL_MUX1_GPIO241, CMPSS_NEG_INPUT_SIGNAL_MUX1_GPIO246, CMPSS_NEG_INPUT_SIGNAL_MUX1_GPIO248}, origin=TI_F29H85x, set at pre-compile, default-value=CMPSS_NEG_INPUT_SIGNAL_MUX0_AIO161  # HN negative input mux select for this CMPSS instance. Selects the input signal for the comparator HN negative input. Written to CMPHNMXSEL register during Mcu_Init() via Mcu_Priv_ConfigureCMPSSASysCtl(). Value format: CMPSS_NEG_INPUT_SIGNAL_MUX<index>_<SignalName>.
            enumeration CMPSSLNMuxSelect: {CMPSS_NEG_INPUT_SIGNAL_MUX0_AIO161, CMPSS_NEG_INPUT_SIGNAL_MUX0_AIO162, CMPSS_NEG_INPUT_SIGNAL_MUX0_AIO165, CMPSS_NEG_INPUT_SIGNAL_MUX0_AIO173, CMPSS_NEG_INPUT_SIGNAL_MUX0_AIO194, CMPSS_NEG_INPUT_SIGNAL_MUX0_AIO199, CMPSS_NEG_INPUT_SIGNAL_MUX0_AIO206, CMPSS_NEG_INPUT_SIGNAL_MUX0_GPIO224, CMPSS_NEG_INPUT_SIGNAL_MUX0_GPIO225, CMPSS_NEG_INPUT_SIGNAL_MUX0_GPIO230, CMPSS_NEG_INPUT_SIGNAL_MUX0_GPIO240, CMPSS_NEG_INPUT_SIGNAL_MUX0_GPIO245, CMPSS_NEG_INPUT_SIGNAL_MUX1_AIO163, CMPSS_NEG_INPUT_SIGNAL_MUX1_AIO164, CMPSS_NEG_INPUT_SIGNAL_MUX1_AIO171, CMPSS_NEG_INPUT_SIGNAL_MUX1_AIO174, CMPSS_NEG_INPUT_SIGNAL_MUX1_AIO175, CMPSS_NEG_INPUT_SIGNAL_MUX1_AIO182, CMPSS_NEG_INPUT_SIGNAL_MUX1_AIO198, CMPSS_NEG_INPUT_SIGNAL_MUX1_AIO207, CMPSS_NEG_INPUT_SIGNAL_MUX1_AIO213, CMPSS_NEG_INPUT_SIGNAL_MUX1_GPIO241, CMPSS_NEG_INPUT_SIGNAL_MUX1_GPIO246, CMPSS_NEG_INPUT_SIGNAL_MUX1_GPIO248}, origin=TI_F29H85x, set at pre-compile, default-value=CMPSS_NEG_INPUT_SIGNAL_MUX0_AIO161  # LN negative input mux select for this CMPSS instance. Selects the input signal for the comparator LN negative input. Written to CMPLNMXSEL register during Mcu_Init() via Mcu_Priv_ConfigureCMPSSASysCtl(). Value format: CMPSS_NEG_INPUT_SIGNAL_MUX<index>_<SignalName>.
        container Eqep [0..1]: multiplicity set at pre-compile  # Configuration container for Context specific settings for the Eqep module.
          container EqepAllocatedInstance [0..6]: multiplicity set at pre-compile  # Configuration of a Eqep instance allocated to this context.
            enumeration InstanceName: {EQEP1, EQEP2, EQEP3, EQEP4, EQEP5, EQEP6}, origin=Texas Instruments, set at pre-compile, default-value=EQEP1  # Selects the Eqep instance to be allocated.
            boolean DebugHaltEnabled: origin=Texas Instruments, set at pre-compile, default-value=true  # Controls whether the peripheral DBGHALT signal is activated when the CPU enters HALT mode
            boolean StandbyModeEnabled: origin=Texas Instruments, set at pre-compile, default-value=true  # Controls whether the peripheral clock is gated when the CPU enters STANDBY mode
            enumeration Frame: {FRAME0, FRAME1, FRAME2, FRAME3}, origin=Texas Instruments, set at pre-compile, default-value=FRAME0  # Selects the peripheral frame. Frames enable simultaneous access from different initiators to peripherals without arbitration stalls, each with its own base address.
            string BaseAddr: origin=Texas Instruments, set at pre-compile, default-value=EQEP1_BASE_FRAME(0U)  # Base address of the Eqep instance. This field represents the macro as defined in hw_memmap.h
        container Sdfm [0..1]: multiplicity set at pre-compile  # Configuration container for Context specific settings for the Sdfm module.
          container SdfmAllocatedInstance [0..4]: multiplicity set at pre-compile  # Configuration of a Sdfm instance allocated to this context.
            enumeration InstanceName: {SDFM1, SDFM2, SDFM3, SDFM4}, origin=Texas Instruments, set at pre-compile, default-value=SDFM1  # Selects the Sdfm instance to be allocated.
            boolean DebugHaltEnabled: origin=Texas Instruments, set at pre-compile, default-value=true  # Controls whether the peripheral DBGHALT signal is activated when the CPU enters HALT mode
            boolean StandbyModeEnabled: origin=Texas Instruments, set at pre-compile, default-value=true  # Controls whether the peripheral clock is gated when the CPU enters STANDBY mode
            enumeration Frame: {FRAME0, FRAME1, FRAME2, FRAME3}, origin=Texas Instruments, set at pre-compile, default-value=FRAME0  # Selects the peripheral frame. Frames enable simultaneous access from different initiators to peripherals without arbitration stalls, each with its own base address.
            string BaseAddr: origin=Texas Instruments, set at pre-compile, default-value=SDFM1_BASE_FRAME(0U)  # Base address of the Sdfm instance. This field represents the macro as defined in hw_memmap.h
        container Pmbus [0..1]: multiplicity set at pre-compile  # Configuration container for Context specific settings for the Pmbus module.
          container PmbusAllocatedInstance [0..1]: multiplicity set at pre-compile  # Configuration of a Pmbus instance allocated to this context.
            enumeration InstanceName: {PMBUSA}, origin=Texas Instruments, set at pre-compile, default-value=PMBUSA  # Selects the Pmbus instance to be allocated.
            boolean DebugHaltEnabled: origin=Texas Instruments, set at pre-compile, default-value=true  # Controls whether the peripheral DBGHALT signal is activated when the CPU enters HALT mode
            boolean StandbyModeEnabled: origin=Texas Instruments, set at pre-compile, default-value=true  # Controls whether the peripheral clock is gated when the CPU enters STANDBY mode
            enumeration Frame: {FRAME0, FRAME1, FRAME2, FRAME3}, origin=Texas Instruments, set at pre-compile, default-value=FRAME0  # Selects the peripheral frame. Frames enable simultaneous access from different initiators to peripherals without arbitration stalls, each with its own base address.
            string BaseAddr: origin=Texas Instruments, set at pre-compile, default-value=PMBUSA_BASE_FRAME(0U)  # Base address of the Pmbus instance. This field represents the macro as defined in hw_memmap.h
        container Dac [0..1]: multiplicity set at pre-compile  # Configuration container for Context specific settings for the Dac module.
          container DacAllocatedInstance [0..2]: multiplicity set at pre-compile  # Configuration of a Dac instance allocated to this context.
            enumeration InstanceName: {DACA, DACB}, origin=Texas Instruments, set at pre-compile, default-value=DACA  # Selects the Dac instance to be allocated.
            boolean DebugHaltEnabled: origin=Texas Instruments, set at pre-compile, default-value=true  # Controls whether the peripheral DBGHALT signal is activated when the CPU enters HALT mode
            boolean StandbyModeEnabled: origin=Texas Instruments, set at pre-compile, default-value=true  # Controls whether the peripheral clock is gated when the CPU enters STANDBY mode
            enumeration Frame: {FRAME0, FRAME1, FRAME2, FRAME3}, origin=Texas Instruments, set at pre-compile, default-value=FRAME0  # Selects the peripheral frame. Frames enable simultaneous access from different initiators to peripherals without arbitration stalls, each with its own base address.
            string BaseAddr: origin=Texas Instruments, set at pre-compile, default-value=DACA_BASE_FRAME(0U)  # Base address of the Dac instance. This field represents the macro as defined in hw_memmap.h
        container Clb [0..1]: multiplicity set at pre-compile  # Configuration container for Context specific settings for the Clb module.
          container ClbAllocatedInstance [0..6]: multiplicity set at pre-compile  # Configuration of a Clb instance allocated to this context.
            enumeration InstanceName: {CLB1, CLB2, CLB3, CLB4, CLB5, CLB6}, origin=Texas Instruments, set at pre-compile, default-value=CLB1  # Selects the Clb instance to be allocated.
            boolean DebugHaltEnabled: origin=Texas Instruments, set at pre-compile, default-value=true  # Controls whether the peripheral DBGHALT signal is activated when the CPU enters HALT mode
            boolean StandbyModeEnabled: origin=Texas Instruments, set at pre-compile, default-value=true  # Controls whether the peripheral clock is gated when the CPU enters STANDBY mode
            enumeration Frame: {FRAME0, FRAME1, FRAME2, FRAME3}, origin=Texas Instruments, set at pre-compile, default-value=FRAME0  # Selects the peripheral frame. Frames enable simultaneous access from different initiators to peripherals without arbitration stalls, each with its own base address.
            string BaseAddr: origin=Texas Instruments, set at pre-compile, default-value=CLB1_BASE_FRAME(0U)  # Base address of the Clb instance. This field represents the macro as defined in hw_memmap.h
        container FsiTx [0..1]: multiplicity set at pre-compile  # Configuration container for Context specific settings for the FsiTx module.
          container FsiTxAllocatedInstance [0..4]: multiplicity set at pre-compile  # Configuration of a FsiTx instance allocated to this context.
            enumeration InstanceName: {FSITXA, FSITXB, FSITXC, FSITXD}, origin=Texas Instruments, set at pre-compile, default-value=FSITXA  # Selects the FsiTx instance to be allocated.
            boolean DebugHaltEnabled: origin=Texas Instruments, set at pre-compile, default-value=true  # Controls whether the peripheral DBGHALT signal is activated when the CPU enters HALT mode
            boolean StandbyModeEnabled: origin=Texas Instruments, set at pre-compile, default-value=true  # Controls whether the peripheral clock is gated when the CPU enters STANDBY mode
            enumeration Frame: {FRAME0, FRAME1, FRAME2, FRAME3}, origin=Texas Instruments, set at pre-compile, default-value=FRAME0  # Selects the peripheral frame. Frames enable simultaneous access from different initiators to peripherals without arbitration stalls, each with its own base address.
            string BaseAddr: origin=Texas Instruments, set at pre-compile, default-value=FSITXA_BASE_FRAME(0U)  # Base address of the FsiTx instance. This field represents the macro as defined in hw_memmap.h
        container FsiRx [0..1]: multiplicity set at pre-compile  # Configuration container for Context specific settings for the FsiRx module.
          container FsiRxAllocatedInstance [0..4]: multiplicity set at pre-compile  # Configuration of a FsiRx instance allocated to this context.
            enumeration InstanceName: {FSIRXA, FSIRXB, FSIRXC, FSIRXD}, origin=Texas Instruments, set at pre-compile, default-value=FSIRXA  # Selects the FsiRx instance to be allocated.
            boolean DebugHaltEnabled: origin=Texas Instruments, set at pre-compile, default-value=true  # Controls whether the peripheral DBGHALT signal is activated when the CPU enters HALT mode
            boolean StandbyModeEnabled: origin=Texas Instruments, set at pre-compile, default-value=true  # Controls whether the peripheral clock is gated when the CPU enters STANDBY mode
            enumeration Frame: {FRAME0, FRAME1, FRAME2, FRAME3}, origin=Texas Instruments, set at pre-compile, default-value=FRAME0  # Selects the peripheral frame. Frames enable simultaneous access from different initiators to peripherals without arbitration stalls, each with its own base address.
            string BaseAddr: origin=Texas Instruments, set at pre-compile, default-value=FSIRXA_BASE_FRAME(0U)  # Base address of the FsiRx instance. This field represents the macro as defined in hw_memmap.h
        container Dcc [0..1]: multiplicity set at pre-compile  # Configuration container for Context specific settings for the Dcc module.
          container DccAllocatedInstance [0..3]: multiplicity set at pre-compile  # Configuration of a Dcc instance allocated to this context.
            enumeration InstanceName: {DCC1, DCC2, DCC3}, origin=Texas Instruments, set at pre-compile, default-value=DCC1  # Selects the Dcc instance to be allocated.
            boolean DebugHaltEnabled: origin=Texas Instruments, set at pre-compile, default-value=true  # Controls whether the peripheral DBGHALT signal is activated when the CPU enters HALT mode
            boolean StandbyModeEnabled: origin=Texas Instruments, set at pre-compile, default-value=true  # Controls whether the peripheral clock is gated when the CPU enters STANDBY mode
            enumeration Frame: {FRAME0, FRAME1, FRAME2, FRAME3}, origin=Texas Instruments, set at pre-compile, default-value=FRAME0  # Selects the peripheral frame. Frames enable simultaneous access from different initiators to peripherals without arbitration stalls, each with its own base address.
            string BaseAddr: origin=Texas Instruments, set at pre-compile, default-value=DCC1_BASE_FRAME(0U)  # Base address of the Dcc instance. This field represents the macro as defined in hw_memmap.h
        container Epg [0..1]: multiplicity set at pre-compile  # Configuration container for Context specific settings for the Epg module.
          container EpgAllocatedInstance [0..1]: multiplicity set at pre-compile  # Configuration of a Epg instance allocated to this context.
            enumeration InstanceName: {EPG1}, origin=Texas Instruments, set at pre-compile, default-value=EPG1  # Selects the Epg instance to be allocated.
            boolean DebugHaltEnabled: origin=Texas Instruments, set at pre-compile, default-value=true  # Controls whether the peripheral DBGHALT signal is activated when the CPU enters HALT mode
            boolean StandbyModeEnabled: origin=Texas Instruments, set at pre-compile, default-value=true  # Controls whether the peripheral clock is gated when the CPU enters STANDBY mode
            enumeration Frame: {FRAME0, FRAME1, FRAME2, FRAME3}, origin=Texas Instruments, set at pre-compile, default-value=FRAME0  # Selects the peripheral frame. Frames enable simultaneous access from different initiators to peripherals without arbitration stalls, each with its own base address.
        container Wadi [0..1]: multiplicity set at pre-compile  # Configuration container for Context specific settings for the Wadi module.
          container WadiAllocatedInstance [0..2]: multiplicity set at pre-compile  # Configuration of a Wadi instance allocated to this context.
            enumeration InstanceName: {WADI1, WADI2}, origin=Texas Instruments, set at pre-compile, default-value=WADI1  # Selects the Wadi instance to be allocated.
            boolean DebugHaltEnabled: origin=Texas Instruments, set at pre-compile, default-value=true  # Controls whether the peripheral DBGHALT signal is activated when the CPU enters HALT mode
            boolean StandbyModeEnabled: origin=Texas Instruments, set at pre-compile, default-value=true  # Controls whether the peripheral clock is gated when the CPU enters STANDBY mode
            enumeration Frame: {FRAME0, FRAME1, FRAME2, FRAME3}, origin=Texas Instruments, set at pre-compile, default-value=FRAME0  # Selects the peripheral frame. Frames enable simultaneous access from different initiators to peripherals without arbitration stalls, each with its own base address.
      container ASysCtl [0..1]: multiplicity set at pre-compile  # Configuration container for ASysCtl (Analog System Control) module. Controls analog subsystem initialization including temperature sensor, analog reference, voltage regulator, brown-out reset, internal test node, and CMPSS mux configuration.
        container TemperatureSensor  # Configuration for the on-chip temperature sensor (TSNSCTL register).
          boolean TemperatureSensorEnable: origin=Texas Instruments, set at pre-compile, default-value=false  # Enables the on-chip temperature sensor. When enabled, the sensor monitors die temperature and provides readings that can be used by the ADC for temperature measurement. When disabled, the sensor is powered off to save power. Must be enabled before Adc can perform temperature measurements.
        container AnalogReference  # Configuration for the analog reference control (ANAREFCTL register). Controls ADC reference source and voltage range for ADC-A/B and ADC-C/D/E groups.
          enumeration AnalogRefABMode: {REFERENCE_INTERNAL, REFERENCE_EXTERNAL}, origin=Texas Instruments, set at pre-compile, default-value=REFERENCE_INTERNAL  # Selects the voltage reference source for ADC modules A and B: INTERNAL: Uses the on-chip bandgap reference for stable, self-contained operation. No external reference pin connection required. EXTERNAL: Allows connection of a precision external reference voltage on the VREFHI pin for higher accuracy measurements. AnalogRefABVoltage setting has no effect in this mode.
          enumeration AnalogRefABVoltage: {REFERENCE_3_3V, REFERENCE_2_5V}, origin=Texas Instruments, set at pre-compile, default-value=REFERENCE_3_3V  # Selects the internal reference voltage level for ADC modules A and B: REFERENCE_3_3V: Selects the 1.65V internal reference, suitable for use with a 3.3V analog supply. REFERENCE_2_5V: Selects the 2.5V internal reference, suitable for use with a 2.5V analog supply. Only applicable when AnalogRefABMode is set to INTERNAL. Has no effect when external reference is selected.
          enumeration AnalogRefCDEMode: {REFERENCE_INTERNAL, REFERENCE_EXTERNAL}, origin=Texas Instruments, set at pre-compile, default-value=REFERENCE_INTERNAL  # Selects the voltage reference source for ADC modules C, D, and E: REFERENCE_INTERNAL: Uses the on-chip bandgap reference for stable, self-contained operation. No external reference pin connection required. REFERENCE_EXTERNAL: Allows connection of a precision external reference voltage on the VREFHI pin for higher accuracy measurements. AnalogRefCDEVoltage setting has no effect in this mode.
          enumeration AnalogRefCDEVoltage: {REFERENCE_3_3V, REFERENCE_2_5V}, origin=Texas Instruments, set at pre-compile, default-value=REFERENCE_3_3V  # Selects the internal reference voltage level for ADC modules C, D, and E: REFERENCE_3_3V: Selects the 1.65V internal reference, suitable for use with a 3.3V analog supply. REFERENCE_2_5V: Selects the 2.5V internal reference, suitable for use with a 2.5V analog supply. Only applicable when AnalogRefCDEMode is set to INTERNAL. Has no effect when external reference is selected.
        container VoltageRegulator  # Configuration for the internal voltage regulator (VREGCTL register).
          boolean VMONMaskEnable: origin=Texas Instruments, set at pre-compile, default-value=false  # Enables the VMON function mask on a TRIM load. When true, masks the generation of POR/BOR for a fixed duration whenever TRIM bits are changed, preventing spurious resets during TRIM operations. When false, POR/BOR generation is not masked on a TRIM load.
          boolean VREGPowerDown: origin=Texas Instruments, set at pre-compile, default-value=false  # Powers down the internal voltage regulator that provides the Core VDD supply for the device. When false (default), the internal regulator is enabled and regulates the Core VDD voltage. When true, the internal regulator is powered down and an external Core VDD supply must be provided. On devices where VREGENZ is not bonded out, this parameter must be used to disable the internal VREG when an external supply is used.
        container BrownOutReset  # Configuration for Brown-Out Reset Level (VMONCTL register).
          boolean BORLDisable: origin=Texas Instruments, set at pre-compile, default-value=false  # Disables the brown-out reset level circuit that monitors the supply voltage. When false (default), the brown-out reset circuit is active and triggers a reset if the supply voltage drops below the brown-out threshold, preventing unpredictable behavior during power supply fluctuations. When true, the brown-out reset level monitor is disabled.
        container InternalTestNode  # Configuration for the internal analog test node (INTERNALTESTCTL register). Key-protection sequence is applied automatically.
          enumeration InternalTestNodeSelect: {MCU_ASYSCTL_TEST_NODE_NO_CONN, MCU_ASYSCTL_TEST_NODE_VDDCORE, MCU_ASYSCTL_TEST_NODE_VDDA, MCU_ASYSCTL_TEST_NODE_VSSA, MCU_ASYSCTL_TEST_NODE_VREFLOA, MCU_ASYSCTL_TEST_NODE_VREFLOB, MCU_ASYSCTL_TEST_NODE_CDAC1H, MCU_ASYSCTL_TEST_NODE_CDAC1L, MCU_ASYSCTL_TEST_NODE_CDAC2H, MCU_ASYSCTL_TEST_NODE_CDAC2L, MCU_ASYSCTL_TEST_NODE_CDAC3H, MCU_ASYSCTL_TEST_NODE_CDAC3L, MCU_ASYSCTL_TEST_NODE_CDAC4H, MCU_ASYSCTL_TEST_NODE_CDAC4L, MCU_ASYSCTL_TEST_NODE_CDAC5H, MCU_ASYSCTL_TEST_NODE_CDAC5L, MCU_ASYSCTL_TEST_NODE_CDAC6H, MCU_ASYSCTL_TEST_NODE_CDAC6L, MCU_ASYSCTL_TEST_NODE_CDAC7H, MCU_ASYSCTL_TEST_NODE_CDAC7L, MCU_ASYSCTL_TEST_NODE_CDAC8H, MCU_ASYSCTL_TEST_NODE_CDAC8L, MCU_ASYSCTL_TEST_NODE_CDAC9H, MCU_ASYSCTL_TEST_NODE_CDAC9L, MCU_ASYSCTL_TEST_NODE_CDAC10H, MCU_ASYSCTL_TEST_NODE_CDAC10L, MCU_ASYSCTL_TEST_NODE_CDAC11H, MCU_ASYSCTL_TEST_NODE_CDAC11L, MCU_ASYSCTL_TEST_NODE_ENZ_CALIB_GAIN_3P3}, origin=Texas Instruments, set at pre-compile, default-value=MCU_ASYSCTL_TEST_NODE_NO_CONN  # Selects which internal analog signal is routed to the analog test node for diagnostic purposes. Allows internal signals such as temperature sensor output, voltage references, and regulator outputs to be measured via the ADC for system verification and calibration. The selected signal is connected during Mcu_Init() and can be changed at runtime via Mcu_ASysCtl_SelectInternalTestNode().
      container Cdd_Xbar [0..1]: multiplicity set at pre-compile  # Configuration container for Cdd_Xbar module.
        container CddXbarOutputXbarFlag [0..1]: multiplicity set at pre-compile  # Configuration of a Cdd Xbar Output Xbar flag.
          string InstanceName: origin=Texas Instruments, set at pre-compile, default-value=OUTPUTXBARFlags  # Cdd Xbar Output Xbar flag.
          enumeration Frame: {FRAME0, FRAME1, FRAME2, FRAME3}, origin=Texas Instruments, set at pre-compile, default-value=FRAME0  # Selects the peripheral frame. Frames enable simultaneous access from different initiators to peripherals without arbitration stalls, each with its own base address.
          string BaseAddr: origin=Texas Instruments, set at pre-compile, default-value=OUTPUTXBAR1_FLAGS_BASE_FRAME(0U)  # Base address of the Cdd_Xbar instance. This field represents the macro as defined in hw_memmap.h
        container CddXbarInputFlag [0..1]: multiplicity set at pre-compile  # Configuration of a Cdd_Xbar Input flags.
          string InstanceName: origin=Texas Instruments, set at pre-compile, default-value=INPUTXBARFlags  # Cdd Xbar Input flag.
          enumeration Frame: {FRAME0, FRAME1, FRAME2, FRAME3}, origin=Texas Instruments, set at pre-compile, default-value=FRAME0  # Selects the peripheral frame. Frames enable simultaneous access from different initiators to peripherals without arbitration stalls, each with its own base address.
          string BaseAddr: origin=Texas Instruments, set at pre-compile, default-value=XBAR_BASE_FRAME(0U)  # Base address of the Cdd_Xbar input flag. This field represents the macro as defined in hw_memmap.h
      container Cdd_Dma [0..1]: multiplicity set at pre-compile  # Configuration container for the Cdd_Dma module hardware resources. This defines the available RTDMA hardware instances and their channels that can be allocated to different CPU contexts in the system.
        container CddDmaHwInstance [0..2]: multiplicity set at pre-compile  # Configuration of a RTDMA hardware instance. Each instance represents a physical RTDMA peripheral with its own set of channels. Multiple instances can be configured if the device supports multiple RTDMA peripherals.
          enumeration InstanceName: {RTDMA1}, origin=Texas Instruments, set at pre-compile, default-value=RTDMA1  # The RTDMA hardware instance. This identifies the physical DMA peripheral on the microcontroller. Each instance must be uniquely named and can only be configured once.
          enumeration Frame: {FRAME0, FRAME1, FRAME2, FRAME3}, origin=Texas Instruments, set at pre-compile, default-value=FRAME0  # Selects the peripheral frame. Frames enable simultaneous access from different initiators to peripherals without arbitration stalls, each with its own base address.
          enumeration CddDmaPriorityScheme: {CDD_DMA_PRIORITY_ROUND_ROBIN, CDD_DMA_PRIORITY_SOFTWARE_CONFIG}, origin=Texas Instruments, set at pre-compile, default-value=CDD_DMA_PRIORITY_ROUND_ROBIN  # Specifies the priority scheme round robin or software configured priority for channels. If software configured priority is selected, the priority value shall be specified for every channel.
          enumeration CddDmaEmulationMode: {CDD_DMA_EMULATION_STOP, CDD_DMA_EMULATION_FREE_RUN}, origin=Texas Instruments, set at pre-compile, default-value=CDD_DMA_EMULATION_STOP  # This parameter specifies the action when an emulation halt event occurs. CDD_DMA_EMULATION_STOP: The DMA completes the current read-write operation,then halts. CDD_DMA_EMULATION_FREE_RUN: The DMA continues running during an emulation halt.
          boolean CddDmaMpuEnable: origin=Texas Instruments, set at pre-compile, default-value=false  # Enables/Disables Memory Protection Unit (MPU) which provides memory protection support and prevents illegal accesses.
          container CddDmaMpuRegion [1..16]: multiplicity set at pre-compile  # Configuration container for a DMA Memory Protection Unit (MPU) region. Each MPU region defines a protected memory address range with specific access permissions (read/write/no access) for selected DMA channels.
            enumeration CddDmaMpuRegionId: {CDD_DMA_MPUR1, CDD_DMA_MPUR2, CDD_DMA_MPUR3, CDD_DMA_MPUR4, CDD_DMA_MPUR5, CDD_DMA_MPUR6, CDD_DMA_MPUR7, CDD_DMA_MPUR8, CDD_DMA_MPUR9, CDD_DMA_MPUR10, CDD_DMA_MPUR11, CDD_DMA_MPUR12, CDD_DMA_MPUR13, CDD_DMA_MPUR14, CDD_DMA_MPUR15, CDD_DMA_MPUR16}, origin=Texas Instruments, set at pre-compile, default-value=CDD_DMA_MPUR1  # Specifies the MPU Region Id of RTDMA MPU instance.
            integer CddDmaMpuStartAddress: 0..4294967295, origin=Texas Instruments, set at pre-compile, default-value=0  # DMA MPU Region Start Address. Granularity of 4KB is mandatory e.g., 0x1000, 0x2000, 0x3000,..
            integer CddDmaMpuEndAddress: 0..4294967295, origin=Texas Instruments, set at pre-compile, default-value=0  # DMA MPU Region End Address. Granularity of 4KB is mandatory e.g., 0x0FFF, 0x1FFF, 0x2FFF,..
            enumeration CddDmaMpuAccessPermission: {CDD_DMA_NO_ACCESS, CDD_DMA_READ_ACCESS, CDD_DMA_READ_WRITE_ACCESS}, origin=Texas Instruments, set at pre-compile, default-value=CDD_DMA_NO_ACCESS  # Specifies the MPU Region access permissions of the RTDMA MPU instance.
            reference CddDmaMpuChannelEnable [1..10]: multiplicity set at pre-compile, origin=Texas Instruments, set at pre-compile, destination=CddDmaChannel  # Reference to a DMA channel that will be granted access to this MPU region. Multiple channels can be associated with a single MPU region. Only channels listed here will be allowed to access the memory range defined by this region according to the specified access permissions.
          container CddDmaChannel [1..10]: multiplicity set at pre-compile  # Configuration of a DMA channel within this RTDMA hardware instance. Each channel represents an independent DMA transfer engine that can move data between memory and peripherals. This container defines all available channels (e.g., CH1, CH2, ..., CH10) for the instance, which can then be allocated to specific CPU contexts.
            enumeration ChannelName: {CH1, CH2, CH3, CH4, CH5, CH6, CH7, CH8, CH9, CH10}, origin=Texas Instruments, set at pre-compile, default-value=CH1  # Selects the DMA channel identifier within this RTDMA instance (e.g., CH1, CH2, CH3, ..., CH10). Each channel provides an independent data transfer path and must be uniquely identified within the instance.
            string BaseAddr: origin=Texas Instruments, set at pre-compile, default-value=RTDMA1CH1_BASE_FRAME(0U)  # Base address of the RTDMA channel. This field represents the macro as defined in hw_memmap.h. The address is automatically calculated based on the instance name, channel name, and selected peripheral frame.
            integer CddDmaChannelPriority: 0..3, origin=Texas Instruments, set at pre-compile, default-value=1  # DMA channel priority level for software-configured priority arbitration. Valid values: CDD_DMA_CHPRIORITY0 (0x0 - special condition during arbitration), CDD_DMA_CHPRIORITY1 (0x1 - default priority), CDD_DMA_CHPRIORITY2 (0x2 - medium priority), CDD_DMA_CHPRIORITY3 (0x3 - highest priority). This setting is only used when the DMA instance is configured with software-configured priority scheme; it is ignored in round-robin mode.
      container DLTFifoRegs [0..1]: multiplicity set at pre-compile  # Configuration container for DLTFifoRegs module.
        container DLTFifoRegsAllocatedInstance [0..1]: multiplicity set at pre-compile  # Configuration of a DLTFifoRegs instance.
          enumeration InstanceName: {DLTFIFOREGS}, origin=Texas Instruments, set at pre-compile, default-value=DLTFIFOREGS  # Selects the DLTFifoRegs instance to be allocated.
          enumeration Frame: {FRAME0, FRAME1, FRAME2, FRAME3}, origin=Texas Instruments, set at pre-compile, default-value=FRAME0  # Selects the peripheral frame. Frames enable simultaneous access from different initiators to peripherals without arbitration stalls, each with its own base address.
      container Error_Aggregator [0..1]: multiplicity set at pre-compile  # Configuration container for Error_Aggregator module.
        container Error_AggregatorAllocatedInstance [0..1]: multiplicity set at pre-compile  # Configuration of a Error_Aggregator instance.
          enumeration InstanceName: {ERROR_AGGREGATOR}, origin=Texas Instruments, set at pre-compile, default-value=ERROR_AGGREGATOR  # Selects the Error_Aggregator instance to be allocated.
          enumeration Frame: {FRAME0, FRAME1, FRAME2, FRAME3}, origin=Texas Instruments, set at pre-compile, default-value=FRAME0  # Selects the peripheral frame. Frames enable simultaneous access from different initiators to peripherals without arbitration stalls, each with its own base address.
          string BaseAddr: origin=Texas Instruments, set at pre-compile, default-value=ERRORAGGREGATOR_BASE_FRAME(0U)  # Base address of the Error_Aggregator instance. This field represents the macro as defined in hw_memmap.h
      container ESM [0..1]: multiplicity set at pre-compile  # Configuration container for ESM module.
        container ESMAllocatedInstance [0..1]: multiplicity set at pre-compile  # Configuration of a ESM instance.
          enumeration InstanceName: {ESM}, origin=Texas Instruments, set at pre-compile, default-value=ESM  # Selects the ESM instance to be allocated.
          enumeration Frame: {FRAME0, FRAME1, FRAME2, FRAME3}, origin=Texas Instruments, set at pre-compile, default-value=FRAME0  # Selects the peripheral frame. Frames enable simultaneous access from different initiators to peripherals without arbitration stalls, each with its own base address.
