AUTOSAR XML (schema 00044)
package /TI_F29H85x
  module definition ResourceAllocator: variants pre-compile  # Configuration of the Resource Allocator which maps resources such as hardware instances, channels, memory etc. to each CPU within Mcu.
    container ResourceAllocatorGeneral  # General configuration (parameters) of the Resource Allocator module.
      enumeration Mode: {CONFIGURE, SETUP}, origin=Texas Instruments, set at pre-compile, default-value=CONFIGURE  # Selects Mode being used: SETUP mode: Board designers define system-level settings and allocate resources to cores CONFIGURE mode: Application developers use only resources allocated to their core
      enumeration Device: {F29H859DU_Q1, F29H859TM_Q1, F29H859TU_Q1, F29P329SJ_Q1, F29P329SM_Q1, F29P589DM_Q1, F29P589DU_Q1}, origin=Texas Instruments, set at pre-compile, default-value=F29H859DU_Q1  # Selects Device being used.
      enumeration Variant: {F29H859TU8_Q}, origin=Texas Instruments, set at pre-compile, default-value=F29H859TU8_Q  # Selects Variant being used.
      enumeration Package: {F29H859TU_Q_256ZEX}, origin=Texas Instruments, set at pre-compile, default-value=F29H859TU_Q_256ZEX  # Selects Package being used.
      boolean CPU1_Lockstep: origin=Texas Instruments, set at pre-compile, default-value=false  # Selects whether lockstep mode is enabled or not.
      reference CurrentContext: origin=Texas Instruments, set at pre-compile, destination=Context  # Selects Current Context to be used for this MCAL instance.
      container Context [1..3]: multiplicity set at pre-compile  # This container contains the driver configuration (parameters) for the Context
        enumeration Core: {CPU1}, origin=Texas Instruments, set at pre-compile, default-value=CPU1  # Selects Core for which this Context is configured.
        container Can [0..1]: multiplicity set at pre-compile  # Configuration container for Context specific settings for the Can module.
          container CanAllocatedInstance [0..6]: multiplicity set at pre-compile  # Configuration of a Can instance allocated to this context.
            enumeration InstanceName: {MCANA, MCANB, MCANC, MCAND, MCANE, MCANF}, origin=Texas Instruments, set at pre-compile, default-value=MCANA  # Selects the Can instance to be allocated.
            enumeration Frame: {FRAME0, FRAME1, FRAME2, FRAME3}, origin=Texas Instruments, set at pre-compile, default-value=FRAME0  # Selects the peripheral frame. Frames enable simultaneous access from different initiators to peripherals without arbitration stalls, each with its own base address.
            string BaseAddr: origin=Texas Instruments, set at pre-compile, default-value=MCANA_DRIVER_BASE_FRAME(0)  # Base address of the Can instance. This field represents the macro as defined in hw_memmap.h
        container Wdg  # Configuration container for Context specific settings for the Wdg module.
        container Spi [0..1]: multiplicity set at pre-compile  # Configuration container for Context specific settings for the Spi module.
          container SpiAllocatedInstance [0..5]
            enumeration InstanceName: {SPIA, SPIB, SPIC, SPID, SPIE}, origin=Texas Instruments, set at pre-compile, default-value=SPIA  # Selects the Spi instance to be allocated.
            enumeration Frame: {FRAME0, FRAME1, FRAME2, FRAME3}, origin=Texas Instruments, set at pre-compile, default-value=FRAME0  # Selects the peripheral frame. Frames enable simultaneous access from different initiators to peripherals without arbitration stalls, each with its own base address.
            string BaseAddr: origin=Texas Instruments, set at pre-compile, default-value=SPIA_BASE_FRAME(0)  # Base address of the Spi instance. This field represents the macro as defined in hw_memmap.h
        container Lin [0..1]: multiplicity set at pre-compile  # Configuration container for Context specific settings for the Lin module.
          container LinAllocatedInstance [0..2]
            enumeration InstanceName: {LINA, LINB}, origin=Texas Instruments, set at pre-compile, default-value=LINA  # Selects the Lin instance to be allocated.
            enumeration Frame: {FRAME0, FRAME1, FRAME2, FRAME3}, origin=Texas Instruments, set at pre-compile, default-value=FRAME0  # Selects the peripheral frame. Frames enable simultaneous access from different initiators to peripherals without arbitration stalls, each with its own base address.
            string BaseAddr: origin=Texas Instruments, set at pre-compile, default-value=LINA_BASE_FRAME(0)  # Base address of the Lin instance. This field represents the macro as defined in hw_memmap.h
        container Cdd_Adc  # Configuration container for Context specific settings for the Cdd_Adc module.
        container Cdd_Ecap [0..1]: multiplicity set at pre-compile  # Configuration container for Context specific settings for the Cdd_Ecap module.
          container Cdd_EcapAllocatedInstance [0..6]: multiplicity set at pre-compile  # Configuration for Cdd_Ecap Instance.
            enumeration InstanceName: {ECAP1, ECAP2, ECAP3, ECAP4, ECAP5, ECAP6}, origin=Texas Instruments, set at pre-compile, default-value=ECAP1  # Selects the Cdd_Ecap instance to be allocated.
            enumeration Frame: {FRAME0, FRAME1, FRAME2, FRAME3}, origin=Texas Instruments, set at pre-compile, default-value=FRAME0  # Selects the peripheral frame. Frames enable simultaneous access from different initiators to peripherals without arbitration stalls, each with its own base address.
            string BaseAddr: origin=Texas Instruments, set at pre-compile, default-value=ECAP1_BASE_FRAME(0)  # Base address of the Cdd_Ecap instance. This field represents the macro as defined in hw_memmap.h
        container Cdd_Ipc  # Configuration container for Context specific settings for the Cdd_Ipc module.
        container Cdd_Pwm  # Configuration container for Context specific settings for the Cdd_Pwm module.
        container Cdd_Sent [0..1]: multiplicity set at pre-compile  # Configuration container for Context specific settings for the Cdd_Sent module.
          container Cdd_SentAllocatedInstance [0..6]: multiplicity set at pre-compile  # Configuration of a Cdd_Sent instance allocated to this context.
            enumeration InstanceName: {SENT1, SENT2, SENT3, SENT4, SENT5, SENT6}, origin=Texas Instruments, set at pre-compile, default-value=SENT1  # Selects the Cdd_Sent instance to be allocated.
            enumeration Frame: {FRAME0, FRAME1, FRAME2, FRAME3}, origin=Texas Instruments, set at pre-compile, default-value=FRAME0  # Selects the peripheral frame. Frames enable simultaneous access from different initiators to peripherals without arbitration stalls, each with its own base address.
            string BaseAddr: origin=Texas Instruments, set at pre-compile, default-value=SENT1_BASE_FRAME(0)  # Base address of the Cdd_Sent instance. This field represents the macro as defined in hw_memmap.h
        container Cdd_Uart [0..1]: multiplicity set at pre-compile  # Configuration container for Context specific settings for the Cdd_Uart module.
          container Cdd_UartAllocatedInstance [0..6]: multiplicity set at pre-compile  # Configuration of a Cdd_Uart instance allocated to this context.
            enumeration InstanceName: {UARTA, UARTB, UARTC, UARTD, UARTE, UARTF}, origin=Texas Instruments, set at pre-compile, default-value=UARTA  # Selects the Cdd_Uart instance to be allocated.
            enumeration Frame: {FRAME0, FRAME1, FRAME2, FRAME3}, origin=Texas Instruments, set at pre-compile, default-value=FRAME0  # Selects the peripheral frame. Frames enable simultaneous access from different initiators to peripherals without arbitration stalls, each with its own base address.
            string BaseAddr: origin=Texas Instruments, set at pre-compile, default-value=UARTA_BASE_FRAME(0)  # Base address of the Cdd_Uart instance. This field represents the macro as defined in hw_memmap.h
