AUTOSAR XML (schema 00044)
package /TI_F29H85x
  module definition ResourceAllocator: variants pre-compile  # Configuration of the Resource Allocator which maps resources such as hardware instances, channels, memory etc. to each CPU within Mcu.
    container ResourceAllocatorGeneral  # General configuration (parameters) of the Resource Allocator module.
      enumeration Mode: {CONFIGURE, SETUP}, origin=Texas Instruments, set at pre-compile, default-value=CONFIGURE  # Selects Mode being used: SETUP mode: Board designers define system-level settings and allocate resources to cores CONFIGURE mode: Application developers use only resources allocated to their core
      enumeration Device: {F29H859DU_Q1, F29H859TM_Q1, F29H859TU_Q1, F29P329SJ_Q1, F29P329SM_Q1, F29P589DM_Q1, F29P589DU_Q1}, origin=Texas Instruments, set at pre-compile, default-value=F29H859DU_Q1  # Selects Device being used.
      enumeration Variant: {F29H859TU8_Q}, origin=Texas Instruments, set at pre-compile, default-value=F29H859TU8_Q  # Selects Variant being used.
      enumeration Package: {F29H859TU_Q_256ZEX}, origin=Texas Instruments, set at pre-compile, default-value=F29H859TU_Q_256ZEX  # Selects Package being used.
      boolean CPU1_Lockstep: origin=Texas Instruments, set at pre-compile, default-value=false  # Selects whether lockstep mode is enabled or not.
      reference CurrentContext: origin=Texas Instruments, set at pre-compile, destination=Context  # Selects Current Context to be used for this MCAL instance.
      container Context: multiplicity set at pre-compile  # This container contains the driver configuration (parameters) for the Context
        enumeration Core: {CPU1}, origin=Texas Instruments, set at pre-compile, default-value=CPU1  # Selects Core for which this Context is configured.
        container Can [0..1]: multiplicity set at pre-compile  # Configuration container for Context specific settings for the Can module.
          container CanAllocatedInstance [0..6]: multiplicity set at pre-compile  # Configuration of a Can instance allocated to this context.
            enumeration InstanceName: {MCANA, MCANB, MCANC, MCAND, MCANE, MCANF}, origin=Texas Instruments, set at pre-compile, default-value=MCANA  # Selects the Can instance to be allocated.
            enumeration Frame: {FRAME0, FRAME1, FRAME2, FRAME3}, origin=Texas Instruments, set at pre-compile, default-value=FRAME0  # Selects the peripheral frame. Frames enable simultaneous access from different initiators to peripherals without arbitration stalls, each with its own base address.
            string BaseAddr: origin=Texas Instruments, set at pre-compile, default-value=MCANA_DRIVER_BASE_FRAME(0U)  # Base address of the Can instance. This field represents the macro as defined in hw_memmap.h
        container Spi [0..1]: multiplicity set at pre-compile  # Configuration container for Context specific settings for the Spi module.
          container SpiAllocatedInstance [0..5]: multiplicity set at pre-compile  # Configuration for Spi Instance.
            enumeration InstanceName: {SPIA, SPIB, SPIC, SPID, SPIE}, origin=Texas Instruments, set at pre-compile, default-value=SPIA  # Selects the Spi instance to be allocated.
            enumeration Frame: {FRAME0, FRAME1, FRAME2, FRAME3}, origin=Texas Instruments, set at pre-compile, default-value=FRAME0  # Selects the peripheral frame. Frames enable simultaneous access from different initiators to peripherals without arbitration stalls, each with its own base address.
            string BaseAddr: origin=Texas Instruments, set at pre-compile, default-value=SPIA_BASE_FRAME(0U)  # Base address of the Spi instance. This field represents the macro as defined in hw_memmap.h
        container Lin [0..1]: multiplicity set at pre-compile  # Configuration container for Context specific settings for the Lin module.
          container LinAllocatedInstance [0..2]: multiplicity set at pre-compile  # Configuration for Lin Instance.
            enumeration InstanceName: {LINA, LINB}, origin=Texas Instruments, set at pre-compile, default-value=LINA  # Selects the Lin instance to be allocated.
            enumeration Frame: {FRAME0, FRAME1, FRAME2, FRAME3}, origin=Texas Instruments, set at pre-compile, default-value=FRAME0  # Selects the peripheral frame. Frames enable simultaneous access from different initiators to peripherals without arbitration stalls, each with its own base address.
            string BaseAddr: origin=Texas Instruments, set at pre-compile, default-value=LINA_BASE_FRAME(0U)  # Base address of the Lin instance. This field represents the macro as defined in hw_memmap.h
        container Cdd_Adc [0..1]: multiplicity set at pre-compile  # Configuration container for Context specific settings for the Cdd_Adc module.
          container Cdd_AdcAllocatedInstance [0..5]: multiplicity set at pre-compile  # Configuration for Cdd_Adc Instance.
            enumeration InstanceName: {CDD_ADCA, CDD_ADCB, CDD_ADCC, CDD_ADCD, CDD_ADCE}, origin=Texas Instruments, set at pre-compile, default-value=CDD_ADCA  # Selects the Adc instance to be allocated.
            enumeration Frame: {FRAME0, FRAME1, FRAME2, FRAME3}, origin=Texas Instruments, set at pre-compile, default-value=FRAME0  # Selects the peripheral frame. Frames enable simultaneous access from different initiators to peripherals without arbitration stalls, each with its own base address.
            string BaseAddr: origin=Texas Instruments, set at pre-compile, default-value=ADCA_BASE_FRAME(0U)  # Base address of the Cdd_Adc instance. This field represents the macro as defined in hw_memmap.h
          container CddAdcSafetyCheckerInstance [0..10]: multiplicity set at pre-compile  # Configuration of ADC safety checker instances.
            enumeration SafetyCheckerInstance: {ADCSAFETYCHECK1, ADCSAFETYCHECK2, ADCSAFETYCHECK3, ADCSAFETYCHECK4, ADCSAFETYCHECK5, ADCSAFETYCHECK6, ADCSAFETYCHECK7, ADCSAFETYCHECK8, ADCSAFETYCHECK9, ADCSAFETYCHECK10}, origin=Texas Instruments, set at pre-compile, default-value=ADCSAFETYCHECK1  # Selects the adc safety checker instances to be allocated.
            enumeration Frame: {FRAME0, FRAME1, FRAME2, FRAME3}, origin=Texas Instruments, set at pre-compile, default-value=FRAME0  # Selects the peripheral frame. Frames enable simultaneous access from different initiators to peripherals without arbitration stalls, each with its own base address.
            string BaseAddr: origin=Texas Instruments, set at pre-compile, default-value=ADCSAFETYCHECK1_BASE_FRAME(0U)  # Base address of the Cdd_Adc safety checker instance. This field represents the macro as defined in hw_memmap.h
          container CddAdcCheckerInterruptEvtInstance [0..1]: multiplicity set at pre-compile  # Configuration of ADC safety checker interrupt event instances.
            enumeration SafetyCheckerIntEvtInstance: {ADCSAFETYCHECKINTEVT1, ADCSAFETYCHECKINTEVT2, ADCSAFETYCHECKINTEVT3}, origin=Texas Instruments, set at pre-compile, default-value=ADCSAFETYCHECKINTEVT1  # Selects the safety checker interrupt event instances to be allocated.
            enumeration Frame: {FRAME0, FRAME1, FRAME2, FRAME3}, origin=Texas Instruments, set at pre-compile, default-value=FRAME0  # Selects the peripheral frame. Frames enable simultaneous access from different initiators to peripherals without arbitration stalls, each with its own base address.
            string BaseAddr: origin=Texas Instruments, set at pre-compile, default-value=ADCSAFETYCHECKINTEVT1_BASE_FRAME(0U)  # Base address of the Cdd_Adc safety checker instance. This field represents the macro as defined in hw_memmap.h
          container CddAdcGlobalSoftwareForce [0..1]: multiplicity set at pre-compile  # Configuration of global software force. This is linked to global software trigger feature in ADC. This should be added only once.
            enumeration Frame: {FRAME0, FRAME1, FRAME2, FRAME3}, origin=Texas Instruments, set at pre-compile, default-value=FRAME0  # Selects frmae for global software force registers. Frames enable simultaneous access from different initiators to peripherals without arbitration stalls, each with its own base address.
            string GlbSwFrcBaseAddr: origin=Texas Instruments, set at pre-compile, default-value=ADCGLOBAL_BASE_FRAME(0U)  # Base address of the Cdd_Adc global software force registers. This field represents the macro as defined in hw_memmap.h
        container Cdd_Ecap [0..1]: multiplicity set at pre-compile  # Configuration container for Context specific settings for the Cdd_Ecap module.
          container Cdd_EcapAllocatedInstance [0..6]: multiplicity set at pre-compile  # Configuration for Cdd_Ecap Instance.
            enumeration InstanceName: {ECAP1, ECAP2, ECAP3, ECAP4, ECAP5, ECAP6}, origin=Texas Instruments, set at pre-compile, default-value=ECAP1  # Selects the Cdd_Ecap instance to be allocated.
            enumeration Frame: {FRAME0, FRAME1, FRAME2, FRAME3}, origin=Texas Instruments, set at pre-compile, default-value=FRAME0  # Selects the peripheral frame. Frames enable simultaneous access from different initiators to peripherals without arbitration stalls, each with its own base address.
            string BaseAddr: origin=Texas Instruments, set at pre-compile, default-value=ECAP1_BASE_FRAME(0U)  # Base address of the Cdd_Ecap instance. This field represents the macro as defined in hw_memmap.h
        container Cdd_I2c [0..1]: multiplicity set at pre-compile  # Configuration container for Context specific settings for the Cdd_I2c module.
          container Cdd_I2cAllocatedInstance [0..2]: multiplicity set at pre-compile  # Configuration for Cdd_I2c Instance.
            enumeration InstanceName: {I2CA, I2CB}, origin=Texas Instruments, set at pre-compile, default-value=I2CA  # Selects the Cdd_I2c instance to be allocated.
            enumeration Frame: {FRAME0, FRAME1, FRAME2, FRAME3}, origin=Texas Instruments, set at pre-compile, default-value=FRAME0  # Selects the peripheral frame. Frames enable simultaneous access from different initiators to peripherals without arbitration stalls, each with its own base address.
            string BaseAddr: origin=Texas Instruments, set at pre-compile, default-value=I2CA_BASE_FRAME(0U)  # Base address of the Cdd_I2c instance. This field represents the macro as defined in hw_memmap.h
        container Cdd_Pwm [0..1]: multiplicity set at pre-compile  # Configuration container for Context specific settings for the Cdd_Pwm module.
          container Cdd_PwmAllocatedInstance [0..18]: multiplicity set at pre-compile  # Configuration for Cdd_Pwm Instance.
            enumeration InstanceName: {EPWM1, EPWM2, EPWM3, EPWM4, EPWM5, EPWM6, EPWM7, EPWM8, EPWM9, EPWM10, EPWM11, EPWM12, EPWM13, EPWM14, EPWM15, EPWM16, EPWM17, EPWM18}, origin=Texas Instruments, set at pre-compile, default-value=EPWM1  # Selects the Pwm instance to be allocated.
            enumeration Frame: {FRAME0, FRAME1, FRAME2, FRAME3}, origin=Texas Instruments, set at pre-compile, default-value=FRAME0  # Selects the peripheral frame. Frames enable simultaneous access from different initiators to peripherals without arbitration stalls, each with its own base address.
            string BaseAddr: origin=Texas Instruments, set at pre-compile, default-value=EPWM1_BASE_FRAME(0U)  # Base address of the Cdd_Pwm instance. This field represents the macro as defined in hw_memmap.h
            string XlinkBaseAddr: origin=Texas Instruments, set at pre-compile, default-value=EPWM1XLINK_BASE_FRAME(0U)  # Base address of the Cdd_Pwm instance. This field represents the macro as defined in hw_memmap.h
          container CddPwmHrpwmCalInstance [0..3]: multiplicity set at pre-compile  # Configuration of Hrpwm calibration instances.
            enumeration InstanceName: {HRPWMCAL1, HRPWMCAL2, HRPWMCAL3}, origin=Texas Instruments, set at pre-compile, default-value=HRPWMCAL1  # Selects the Hrpwm calibration instance instance to be allocated.
            enumeration Frame: {FRAME0, FRAME1, FRAME2, FRAME3}, origin=Texas Instruments, set at pre-compile, default-value=FRAME0  # Selects the peripheral frame. Frames enable simultaneous access from different initiators to peripherals without arbitration stalls, each with its own base address.
            string BaseAddr: origin=Texas Instruments, set at pre-compile, default-value=HRPWMCAL1_BASE_FRAME(0U)  # Base address of the Cdd_Pwm instance. This field represents the macro as defined in hw_memmap.h
        container Cdd_Sent [0..1]: multiplicity set at pre-compile  # Configuration container for Context specific settings for the Cdd_Sent module.
          container Cdd_SentAllocatedInstance [0..6]: multiplicity set at pre-compile  # Configuration of a Cdd_Sent instance allocated to this context.
            enumeration InstanceName: {SENT1, SENT2, SENT3, SENT4, SENT5, SENT6}, origin=Texas Instruments, set at pre-compile, default-value=SENT1  # Selects the Cdd_Sent instance to be allocated.
            enumeration Frame: {FRAME0, FRAME1, FRAME2, FRAME3}, origin=Texas Instruments, set at pre-compile, default-value=FRAME0  # Selects the peripheral frame. Frames enable simultaneous access from different initiators to peripherals without arbitration stalls, each with its own base address.
            string BaseAddr: origin=Texas Instruments, set at pre-compile, default-value=SENT1_BASE_FRAME(0U)  # Base address of the Cdd_Sent instance. This field represents the macro as defined in hw_memmap.h
        container Cdd_Uart [0..1]: multiplicity set at pre-compile  # Configuration container for Context specific settings for the Cdd_Uart module.
          container Cdd_UartAllocatedInstance [0..6]: multiplicity set at pre-compile  # Configuration of a Cdd_Uart instance allocated to this context.
            enumeration InstanceName: {UARTA, UARTB, UARTC, UARTD, UARTE, UARTF}, origin=Texas Instruments, set at pre-compile, default-value=UARTA  # Selects the Cdd_Uart instance to be allocated.
            enumeration Frame: {FRAME0, FRAME1, FRAME2, FRAME3}, origin=Texas Instruments, set at pre-compile, default-value=FRAME0  # Selects the peripheral frame. Frames enable simultaneous access from different initiators to peripherals without arbitration stalls, each with its own base address.
            string BaseAddr: origin=Texas Instruments, set at pre-compile, default-value=UARTA_BASE_FRAME(0U)  # Base address of the Cdd_Uart instance. This field represents the macro as defined in hw_memmap.h
      container Cdd_Xbar [0..1]: multiplicity set at pre-compile  # Configuration container for Cdd_Xbar module.
        container CddXbarOutputXbarFlag [0..1]: multiplicity set at pre-compile  # Configuration of a Cdd Xbar Output Xbar flag.
          string InstanceName: origin=Texas Instruments, set at pre-compile, default-value=OUTPUTXBARFlags  # Cdd Xbar Output Xbar flag.
          enumeration Frame: {FRAME0, FRAME1, FRAME2, FRAME3}, origin=Texas Instruments, set at pre-compile, default-value=FRAME0  # Selects the peripheral frame. Frames enable simultaneous access from different initiators to peripherals without arbitration stalls, each with its own base address.
          string BaseAddr: origin=Texas Instruments, set at pre-compile, default-value=OUTPUTXBAR1_FLAGS_BASE_FRAME(0U)  # Base address of the Cdd_Xbar instance. This field represents the macro as defined in hw_memmap.h
        container CddXbarInputFlag [0..1]: multiplicity set at pre-compile  # Configuration of a Cdd_Xbar Input flags.
          string InstanceName: origin=Texas Instruments, set at pre-compile, default-value=INPUTXBARFlags  # Cdd Xbar Input flag.
          enumeration Frame: {FRAME0, FRAME1, FRAME2, FRAME3}, origin=Texas Instruments, set at pre-compile, default-value=FRAME0  # Selects the peripheral frame. Frames enable simultaneous access from different initiators to peripherals without arbitration stalls, each with its own base address.
          string BaseAddr: origin=Texas Instruments, set at pre-compile, default-value=XBAR_BASE_FRAME(0U)  # Base address of the Cdd_Xbar input flag. This field represents the macro as defined in hw_memmap.h
