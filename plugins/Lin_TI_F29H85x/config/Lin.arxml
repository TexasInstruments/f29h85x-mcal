AUTOSAR XML (schema 00044)
package /TI_F29H85x
  ecuc definition collection myEcuParameterDefinition: module=Lin
  module definition Lin [1..*]: post-build-variant-support=true, refined-module-def=Lin, variants post-build/pre-compile  # Configuration of the Lin (LIN driver) module.
    container LinDemEventParameterRefs [0..1]  # Container for the references to DemEventParameter elements which shall be invoked using the API Dem_SetEventStatus in case the corresponding error occurs. The EventId is taken from the referenced DemEventParameter's DemEventId symbolic value. The standardized errors are provided in this container and can be extended by vendor-specific error references.
      symbolic name reference LIN_E_TIMEOUT [0..1]: multiplicity set at pre-compile, set at pre-compile, destination=DemEventParameter  # Reference to the DemEventParameter which shall be issued when the error "Timeout caused by hardware error" has occurred. If the reference is not configured the error shall be reported as DET error.
    container LinGeneral  # This container contains the parameters related to each LIN Driver Unit.
      integer LinIndex: 0..1, set at pre-compile, default-value=0  # Specifies the InstanceId of this module instance. If only one instance is present it shall have the Id 0.
      integer LinTimeoutDuration: 0..65535, set at pre-compile, default-value=65535  # Specifies the maximum number of loops for blocking function until a timeout is raised in short term wait loops
      integer LinWakeupId: 0..63, origin=Texas Instruments, set at pre-compile, default-value=63  # Specifies the LIN ID used to transmit a header instead of a wakeup signal due to hardware constraints. The hardware enters an undefined state when a standard wakeup signal is transmitted. To mitigate this limitation, an unused header frame is utilized as the wakeup signal, which conforms to the LIN2.1 specification
      boolean LinDevErrorDetect: set at pre-compile, default-value=false  # Switches the development error detection and notification on or off.
      boolean LinVersionInfoApi: set at pre-compile, default-value=false  # Switches the Lin_GetVersionInfo function ON or OFF.
      reference LinSysClockRef: origin=Texas Instruments, post-build-variant-value=true, set at post-build in variant post-build / pre-compile in variant pre-compile, destination=McuClockReferencePoint  # Reference to the SYSTEM clock source configuration, which is set in the MCU driver configuration.
    container LinGlobalConfig  # This container contains the global configuration parameter of the Lin driver.
      container LinChannel [1..2]  # This container contains the configuration (parameters) of the LIN Controller(s).
        integer LinChannelBaudRate: 1000..20000, post-build-variant-value=true, set at post-build in variant post-build / pre-compile in variant pre-compile, default-value=1000  # Specifies the baud rate of the LIN channel
        integer LinChannelId: 0..1, set at pre-compile, symbolic-name-value=true, default-value=0  # Identifies the LIN channel. Replaces LIN_CHANNEL_INDEX_NAME from the LIN SWS.
        enumeration LinLoopbackMode: {LIN_LOOPBACK_DISABLED, LIN_LOOPBACK_INTERNAL, LIN_LOOPBACK_EXTERNAL}, origin=Texas Instruments, set at pre-compile, default-value=LIN_LOOPBACK_DISABLED  # Select loopback mode to be used for this Lin instance.
        boolean LinChannelWakeupSupport: set at pre-compile, default-value=False  # Specifies if the LIN hardware channel supports wake up functionality
        enumeration LinISRType: {LIN_ISR_CAT1_RTINT, LIN_ISR_CAT1_INT, LIN_ISR_CAT2}, origin=Texas Instruments, set at pre-compile, default-value=LIN_ISR_CAT2  # Select ISR type to be used for this Lin instance.
        enumeration LinInterruptLineSelect: {LIN_INTERRUPT_LINE_NUM_0, LIN_INTERRUPT_LINE_NUM_1}, origin=Texas Instruments, set at pre-compile, default-value=LIN_INTERRUPT_LINE_NUM_0  # Select interrupt line to be used for this Lin instance.
        reference LinInstance: origin=Texas Instruments, set at pre-compile, destination=LinAllocatedInstance  # Reference to the LIN Instance.
        symbolic name reference LinChannelEcuMWakeupSource [0..1]: multiplicity set at pre-compile, set at pre-compile, destination=EcuMWakeupSource  # This parameter contains a reference to the Wakeup Source for this controller as defined in the ECU State Manager.
        reference LinClockRef: post-build-variant-value=true, set at post-build in variant post-build / pre-compile in variant pre-compile, destination=McuClockReferencePoint  # Reference to the LIN clock source configuration, which is set in the MCU driver configuration.
        container LinBaudrateConfig  # This container contains the baudrate configuration parameter of the Lin driver.
          float LinChannelPrescalar: 0.0..1.6777215E7, origin=Texas Instruments, post-build-variant-value=true, set at post-build in variant post-build / pre-compile in variant pre-compile, default-value=0.0  # Prescalar to derive LINCLK from VCLK
          float LinChannelFractionalDivider: 0.0..15.0, origin=Texas Instruments, post-build-variant-value=true, set at post-build in variant post-build / pre-compile in variant pre-compile, default-value=0.0  # The M field of the BRSR register modifies the integer prescaler P for fine tuning of the baud rate. The M value adds in increments of 1/16 of the P value.
