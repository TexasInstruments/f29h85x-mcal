AUTOSAR XML (schema 00044)
package /TI_F29H85x/Cdd_Ecap
  ecuc definition collection myEcuParameterDefinition: module=Cdd
  module definition Cdd [1..*]: api-service-prefix=Cdd_Ecap, refined-module-def=Cdd, variants pre-compile  # Configuration of Ecap (Enhanced Capture Module) module.
    container CddEcapConfigSet  # This container contains the configuration parameters and sub containers of the AUTOSAR CddEcap module.
      integer CddEcapMaxChannel: 0..5, origin=Texas Instruments, set at pre-compile, default-value=1  # This parameter contains the number of Channels configured. It will be gathered by tools during the configuration stage.
      container CddEcapChannel [1..6]: multiplicity set at pre-compile  # Configuration of an individual CDD ECAP channel.
        string CddEcapChannelId: scope=ECU, origin=Texas Instruments, set at pre-compile, symbolic-name-value=true, default-value=255  # Channel Id of the CDD ECAP channel. This value will be assigned to the symbolic name derived of the CddEcapChannel container short name.
        enumeration CddEcapEmulationMode: {CDD_ECAP_EMULATION_STOP, CDD_ECAP_EMULATION_RUN_TO_ZERO, CDD_ECAP_EMULATION_FREE_RUN}, origin=Texas Instruments, set at pre-compile, default-value=CDD_ECAP_EMULATION_FREE_RUN  # Configures the emulation mode of the Cdd Ecap.
        enumeration CddEcapDefaultStartEdge: {CDD_ECAP_BOTH_EDGES, CDD_ECAP_FALLING_EDGE, CDD_ECAP_RISING_EDGE}, origin=Texas Instruments, set at pre-compile, default-value=CDD_ECAP_RISING_EDGE  # Configures the default-activation-edge which shall be used for this channel if there was no activation-edge configured by the call of service CddEcap_SetActivationCondition().
        enumeration CddEcapInputSelect: {CDD_ECAP_INPUT_INPUTXBAR1, CDD_ECAP_INPUT_INPUTXBAR2, CDD_ECAP_INPUT_INPUTXBAR3, CDD_ECAP_INPUT_INPUTXBAR4, CDD_ECAP_INPUT_INPUTXBAR5, CDD_ECAP_INPUT_INPUTXBAR6, CDD_ECAP_INPUT_INPUTXBAR7, CDD_ECAP_INPUT_INPUTXBAR8, CDD_ECAP_INPUT_INPUTXBAR9, CDD_ECAP_INPUT_INPUTXBAR10, CDD_ECAP_INPUT_INPUTXBAR11, CDD_ECAP_INPUT_INPUTXBAR12, CDD_ECAP_INPUT_INPUTXBAR13, CDD_ECAP_INPUT_INPUTXBAR14, CDD_ECAP_INPUT_INPUTXBAR15, CDD_ECAP_INPUT_INPUTXBAR16, CDD_ECAP_INPUT_ECAP1_CLB1_OUT14, CDD_ECAP_INPUT_ECAP2_CLB1_OUT14, CDD_ECAP_INPUT_ECAP1_CLB1_OUT15, CDD_ECAP_INPUT_ECAP2_CLB1_OUT15, CDD_ECAP_INPUT_ECAP3_CLB2_OUT14, CDD_ECAP_INPUT_ECAP4_CLB2_OUT14, CDD_ECAP_INPUT_ECAP5_CLB2_OUT14, CDD_ECAP_INPUT_ECAP3_CLB2_OUT15, CDD_ECAP_INPUT_ECAP4_CLB2_OUT15, CDD_ECAP_INPUT_ECAP5_CLB2_OUT15, CDD_ECAP_INPUT_ECAP6_CLB3_OUT14, CDD_ECAP_INPUT_ECAP6_CLB3_OUT15, CDD_ECAP_INPUT_ECAP6_CLB4_OUT14, CDD_ECAP_INPUT_ECAP6_CLB4_OUT15, CDD_ECAP_INPUT_ECAP1_CLB5_OUT14, CDD_ECAP_INPUT_ECAP2_CLB5_OUT14, CDD_ECAP_INPUT_ECAP1_CLB5_OUT15, CDD_ECAP_INPUT_ECAP2_CLB5_OUT15, CDD_ECAP_INPUT_ECAP3_CLB6_OUT14, CDD_ECAP_INPUT_ECAP4_CLB6_OUT14, CDD_ECAP_INPUT_ECAP5_CLB6_OUT14, CDD_ECAP_INPUT_ECAP3_CLB6_OUT15, CDD_ECAP_INPUT_ECAP4_CLB6_OUT15, CDD_ECAP_INPUT_ECAP5_CLB6_OUT15, CDD_ECAP_INPUT_OUTPUTXBAR1, CDD_ECAP_INPUT_OUTPUTXBAR2, CDD_ECAP_INPUT_OUTPUTXBAR3, CDD_ECAP_INPUT_OUTPUTXBAR4, CDD_ECAP_INPUT_OUTPUTXBAR5, CDD_ECAP_INPUT_OUTPUTXBAR6, CDD_ECAP_INPUT_OUTPUTXBAR7, CDD_ECAP_INPUT_OUTPUTXBAR8, CDD_ECAP_INPUT_ADC_E_EVENT4, CDD_ECAP_INPUT_ADC_E_EVENT3, CDD_ECAP_INPUT_ADC_E_EVENT2, CDD_ECAP_INPUT_ADC_E_EVENT1, CDD_ECAP_INPUT_ADC_D_EVENT4, CDD_ECAP_INPUT_ADC_D_EVENT3, CDD_ECAP_INPUT_ADC_D_EVENT2, CDD_ECAP_INPUT_ADC_D_EVENT1, CDD_ECAP_INPUT_ADC_C_EVENT4, CDD_ECAP_INPUT_ADC_C_EVENT3, CDD_ECAP_INPUT_ADC_C_EVENT2, CDD_ECAP_INPUT_ADC_C_EVENT1, CDD_ECAP_INPUT_ADC_B_EVENT4, CDD_ECAP_INPUT_ADC_B_EVENT3, CDD_ECAP_INPUT_ADC_B_EVENT2, CDD_ECAP_INPUT_ADC_B_EVENT1, CDD_ECAP_INPUT_ADC_A_EVENT4, CDD_ECAP_INPUT_ADC_A_EVENT3, CDD_ECAP_INPUT_ADC_A_EVENT2, CDD_ECAP_INPUT_ADC_A_EVENT1, CDD_ECAP_INPUT_FSIA_RX_MSR_LINE, CDD_ECAP_INPUT_FSIA_RX_MSR_LINE_RISE, CDD_ECAP_INPUT_FSIA_RX_MSR_LINE_FALL, CDD_ECAP_INPUT_FSIB_RX_MSR_LINE, CDD_ECAP_INPUT_FSIB_RX_MSR_LINE_RISE, CDD_ECAP_INPUT_FSIB_RX_MSR_LINE_FALL, CDD_ECAP_INPUT_FSIC_RX_MSR_LINE, CDD_ECAP_INPUT_FSIC_RX_MSR_LINE_RISE, CDD_ECAP_INPUT_FSIC_RX_MSR_LINE_FALL, CDD_ECAP_INPUT_FSID_RX_MSR_LINE, CDD_ECAP_INPUT_FSID_RX_MSR_LINE_RISE, CDD_ECAP_INPUT_FSID_RX_MSR_LINE_FALL, CDD_ECAP_INPUT_SDFM2_FLT1_COMPARE_LOW, CDD_ECAP_INPUT_SDFM2_FLT2_COMPARE_LOW, CDD_ECAP_INPUT_SDFM2_FLT3_COMPARE_LOW, CDD_ECAP_INPUT_SDFM2_FLT4_COMPARE_LOW, CDD_ECAP_INPUT_SDFM1_FLT1_COMPARE_LOW, CDD_ECAP_INPUT_SDFM1_FLT2_COMPARE_LOW, CDD_ECAP_INPUT_SDFM1_FLT3_COMPARE_LOW, CDD_ECAP_INPUT_SDFM1_FLT4_COMPARE_LOW, CDD_ECAP_INPUT_SDFM2_FLT1_COMPARE_Z, CDD_ECAP_INPUT_SDFM2_FLT2_COMPARE_Z, CDD_ECAP_INPUT_SDFM2_FLT3_COMPARE_Z, CDD_ECAP_INPUT_SDFM2_FLT4_COMPARE_Z, CDD_ECAP_INPUT_SDFM1_FLT1_COMPARE_Z, CDD_ECAP_INPUT_SDFM1_FLT2_COMPARE_Z, CDD_ECAP_INPUT_SDFM1_FLT3_COMPARE_Z, CDD_ECAP_INPUT_SDFM1_FLT4_COMPARE_Z, CDD_ECAP_INPUT_SDFM2_FLT1_COMPARE_HIGH, CDD_ECAP_INPUT_SDFM2_FLT2_COMPARE_HIGH, CDD_ECAP_INPUT_SDFM2_FLT3_COMPARE_HIGH, CDD_ECAP_INPUT_SDFM2_FLT4_COMPARE_HIGH, CDD_ECAP_INPUT_SDFM1_FLT1_COMPARE_HIGH, CDD_ECAP_INPUT_SDFM1_FLT2_COMPARE_HIGH, CDD_ECAP_INPUT_SDFM1_FLT3_COMPARE_HIGH, CDD_ECAP_INPUT_SDFM1_FLT4_COMPARE_HIGH, CDD_ECAP_INPUT_SDFM2_FLT1_COMPARE_HIGH_OR_LOW, CDD_ECAP_INPUT_SDFM2_FLT2_COMPARE_HIGH_OR_LOW, CDD_ECAP_INPUT_SDFM2_FLT3_COMPARE_HIGH_OR_LOW, CDD_ECAP_INPUT_SDFM2_FLT4_COMPARE_HIGH_OR_LOW, CDD_ECAP_INPUT_SDFM1_FLT1_COMPARE_HIGH_OR_LOW, CDD_ECAP_INPUT_SDFM1_FLT2_COMPARE_HIGH_OR_LOW, CDD_ECAP_INPUT_SDFM1_FLT3_COMPARE_HIGH_OR_LOW, CDD_ECAP_INPUT_SDFM1_FLT4_COMPARE_HIGH_OR_LOW, CDD_ECAP_INPUT_ECAP5_ECAP6_DELAY_CLK, CDD_ECAP_INPUT_ECAP6_ECAP5_DELAY_CLK, CDD_ECAP_INPUT_ECATSYNC0, CDD_ECAP_INPUT_ECATSYNC1, CDD_ECAP_INPUT_CMPSS1_CTRIP_LOW, CDD_ECAP_INPUT_CMPSS2_CTRIP_LOW, CDD_ECAP_INPUT_CMPSS3_CTRIP_LOW, CDD_ECAP_INPUT_CMPSS4_CTRIP_LOW, CDD_ECAP_INPUT_CMPSS5_CTRIP_LOW, CDD_ECAP_INPUT_CMPSS6_CTRIP_LOW, CDD_ECAP_INPUT_CMPSS7_CTRIP_LOW, CDD_ECAP_INPUT_CMPSS8_CTRIP_LOW, CDD_ECAP_INPUT_CMPSS1_CTRIP_HIGH, CDD_ECAP_INPUT_CMPSS2_CTRIP_HIGH, CDD_ECAP_INPUT_CMPSS3_CTRIP_HIGH, CDD_ECAP_INPUT_CMPSS4_CTRIP_HIGH, CDD_ECAP_INPUT_CMPSS5_CTRIP_HIGH, CDD_ECAP_INPUT_CMPSS6_CTRIP_HIGH, CDD_ECAP_INPUT_CMPSS7_CTRIP_HIGH, CDD_ECAP_INPUT_CMPSS8_CTRIP_HIGH, CDD_ECAP_INPUT_GPIO8, CDD_ECAP_INPUT_GPIO9, CDD_ECAP_INPUT_GPIO22, CDD_ECAP_INPUT_GPIO23, CDD_ECAP_INPUT_CMPSS1_CTRIP_HIGH_OR_LOW, CDD_ECAP_INPUT_CMPSS2_CTRIP_HIGH_OR_LOW, CDD_ECAP_INPUT_CMPSS3_CTRIP_HIGH_OR_LOW, CDD_ECAP_INPUT_CMPSS4_CTRIP_HIGH_OR_LOW, CDD_ECAP_INPUT_CMPSS5_CTRIP_HIGH_OR_LOW, CDD_ECAP_INPUT_CMPSS6_CTRIP_HIGH_OR_LOW, CDD_ECAP_INPUT_CMPSS7_CTRIP_HIGH_OR_LOW, CDD_ECAP_INPUT_CMPSS8_CTRIP_HIGH_OR_LOW, CDD_ECAP_INPUT_ECAP1_INPUTXBAR7, CDD_ECAP_INPUT_ECAP2_INPUTXBAR8, CDD_ECAP_INPUT_ECAP3_INPUTXBAR9, CDD_ECAP_INPUT_ECAP4_INPUTXBAR10, CDD_ECAP_INPUT_ECAP5_INPUTXBAR11, CDD_ECAP_INPUT_ECAP6_INPUTXBAR12, CDD_ECAP_INPUT_SDFM4_FLT1_COMPARE_LOW, CDD_ECAP_INPUT_SDFM4_FLT2_COMPARE_LOW, CDD_ECAP_INPUT_SDFM4_FLT3_COMPARE_LOW, CDD_ECAP_INPUT_SDFM4_FLT4_COMPARE_LOW, CDD_ECAP_INPUT_SDFM3_FLT1_COMPARE_LOW, CDD_ECAP_INPUT_SDFM3_FLT2_COMPARE_LOW, CDD_ECAP_INPUT_SDFM3_FLT3_COMPARE_LOW, CDD_ECAP_INPUT_SDFM3_FLT4_COMPARE_LOW, CDD_ECAP_INPUT_SDFM4_FLT4_COMPARE_Z, CDD_ECAP_INPUT_SDFM3_FLT4_COMPARE_Z, CDD_ECAP_INPUT_SDFM4_FLT1_COMPARE_HIGH, CDD_ECAP_INPUT_SDFM4_FLT2_COMPARE_HIGH, CDD_ECAP_INPUT_SDFM4_FLT3_COMPARE_HIGH, CDD_ECAP_INPUT_SDFM4_FLT4_COMPARE_HIGH, CDD_ECAP_INPUT_SDFM3_FLT1_COMPARE_HIGH, CDD_ECAP_INPUT_SDFM3_FLT2_COMPARE_HIGH, CDD_ECAP_INPUT_SDFM3_FLT3_COMPARE_HIGH, CDD_ECAP_INPUT_SDFM3_FLT4_COMPARE_HIGH, CDD_ECAP_INPUT_SDFM4_FLT1_COMPARE_HIGH_OR_LOW, CDD_ECAP_INPUT_SDFM4_FLT2_COMPARE_HIGH_OR_LOW, CDD_ECAP_INPUT_SDFM4_FLT3_COMPARE_HIGH_OR_LOW, CDD_ECAP_INPUT_SDFM4_FLT4_COMPARE_HIGH_OR_LOW, CDD_ECAP_INPUT_SDFM3_FLT1_COMPARE_HIGH_OR_LOW, CDD_ECAP_INPUT_SDFM3_FLT2_COMPARE_HIGH_OR_LOW, CDD_ECAP_INPUT_SDFM3_FLT3_COMPARE_HIGH_OR_LOW, CDD_ECAP_INPUT_SDFM3_FLT4_COMPARE_HIGH_OR_LOW, CDD_ECAP_INPUT_EPWM18_DEL_ACTIVE, CDD_ECAP_INPUT_EPWM17_DEL_ACTIVE, CDD_ECAP_INPUT_EPWM16_DEL_ACTIVE, CDD_ECAP_INPUT_EPWM15_DEL_ACTIVE, CDD_ECAP_INPUT_EPWM14_DEL_ACTIVE, CDD_ECAP_INPUT_EPWM13_DEL_ACTIVE, CDD_ECAP_INPUT_EPWM12_DEL_ACTIVE, CDD_ECAP_INPUT_EPWM11_DEL_ACTIVE, CDD_ECAP_INPUT_EPWM10_DEL_ACTIVE, CDD_ECAP_INPUT_EPWM9_DEL_ACTIVE, CDD_ECAP_INPUT_EPWM8_DEL_ACTIVE, CDD_ECAP_INPUT_EPWM7_DEL_ACTIVE, CDD_ECAP_INPUT_EPWM6_DEL_ACTIVE, CDD_ECAP_INPUT_EPWM5_DEL_ACTIVE, CDD_ECAP_INPUT_EPWM4_DEL_ACTIVE, CDD_ECAP_INPUT_EPWM3_DEL_ACTIVE, CDD_ECAP_INPUT_EPWM2_DEL_ACTIVE, CDD_ECAP_INPUT_EPWM1_DEL_ACTIVE, CDD_ECAP_INPUT_GPIO11, CDD_ECAP_INPUT_GPIO12, CDD_ECAP_INPUT_GPIO13, CDD_ECAP_INPUT_GPIO14, CDD_ECAP_INPUT_ECAP1_EPG1_DATAOUT49, CDD_ECAP_INPUT_ECAP2_EPG1_DATAOUT50, CDD_ECAP_INPUT_ECAP3_EPG1_DATAOUT51, CDD_ECAP_INPUT_ECAP4_EPG1_DATAOUT52, CDD_ECAP_INPUT_ECAP5_EPG1_DATAOUT53, CDD_ECAP_INPUT_ECAP6_EPG1_DATAOUT54}, origin=Texas Instruments, set at pre-compile, default-value=CDD_ECAP_INPUT_INPUTXBAR1  # Configures the source to be used in order to give CDD ECAP the required input
        enumeration CddEcapIrqType: {ISR_CAT1_INT, ISR_CAT1_RINT, ISR_CAT2_INT}, origin=Texas Instruments, set at pre-compile, default-value=ISR_CAT1_INT  # Type of Isr function: void functionname(void) CAT1 see description in oil tool : interrupt void func(void) CAT2 see description in oil tool : ISR(func)
        enumeration CddEcapMeasurementMode: {CDD_ECAP_MODE_EDGE_COUNTER, CDD_ECAP_MODE_SIGNAL_EDGE_DETECT, CDD_ECAP_MODE_SIGNAL_MEASUREMENT, CDD_ECAP_MODE_TIMESTAMP}, origin=Texas Instruments, set at pre-compile, default-value=CDD_ECAP_MODE_EDGE_COUNTER  # Configures the measurement mode of this channel.
        enumeration CddEcapPrescaler: {CDD_ECAP_PRESCALAR_1, CDD_ECAP_PRESCALAR_2, CDD_ECAP_PRESCALAR_4, CDD_ECAP_PRESCALAR_6, CDD_ECAP_PRESCALAR_8, CDD_ECAP_PRESCALAR_10, CDD_ECAP_PRESCALAR_12, CDD_ECAP_PRESCALAR_14, CDD_ECAP_PRESCALAR_16, CDD_ECAP_PRESCALAR_18, CDD_ECAP_PRESCALAR_20, CDD_ECAP_PRESCALAR_22, CDD_ECAP_PRESCALAR_24, CDD_ECAP_PRESCALAR_26, CDD_ECAP_PRESCALAR_28, CDD_ECAP_PRESCALAR_30, CDD_ECAP_PRESCALAR_32, CDD_ECAP_PRESCALAR_34, CDD_ECAP_PRESCALAR_36, CDD_ECAP_PRESCALAR_38, CDD_ECAP_PRESCALAR_40, CDD_ECAP_PRESCALAR_42, CDD_ECAP_PRESCALAR_44, CDD_ECAP_PRESCALAR_46, CDD_ECAP_PRESCALAR_48, CDD_ECAP_PRESCALAR_50, CDD_ECAP_PRESCALAR_52, CDD_ECAP_PRESCALAR_54, CDD_ECAP_PRESCALAR_56, CDD_ECAP_PRESCALAR_58, CDD_ECAP_PRESCALAR_60, CDD_ECAP_PRESCALAR_62}, origin=Texas Instruments, set at pre-compile, default-value=CDD_ECAP_PRESCALAR_1  # Configures the prescale value, keep it as 0 if you want to bypass it
        integer CddEcapClkFrequency: 2000000..200000000, origin=Texas Instruments, set at pre-compile, default-value=200000000  # Reference to a container of the type McuClockReferencePoint, to select an input clock.
        boolean CddEcapHREnable: origin=Texas Instruments, set at pre-compile, default-value=false  # This parameter enables HR mode for a particular Cdd Ecap channel.
        reference CddEcapChannelRef: origin=Texas Instruments, set at pre-compile, destination=Cdd_EcapAllocatedInstance  # Reference to the ECAP Channel.
        reference CddEcapFunctionalClock: origin=Texas Instruments, set at pre-compile, destination=McuClockReferencePoint  # Reference to a container of the type McuClockReferencePoint, to select an input clock.
        container CddEcapSignalMeasurement  # This container contains the configuration (parameters) in case the measurement mode is "CddEcapSignalMeasurement"
          enumeration CddEcapSignalMeasurementProperty: {CDD_ECAP_HIGH_TIME, CDD_ECAP_LOW_TIME, CDD_ECAP_PERIOD_TIME}, origin=Texas Instruments, set at pre-compile, default-value=CDD_ECAP_HIGH_TIME  # Configures the property that could be measured in case the mode is "CddEcapSignalMeasurement".
        container CddEcapTimestampMeasurement  # This container contains the configuration (parameters) in case the measurement mode is "CddEcapTimestamp"
          enumeration CddEcapTimestampMeasurementProperty: {CDD_ECAP_CIRCULAR_BUFFER, CDD_ECAP_LINEAR_BUFFER}, origin=Texas Instruments, set at pre-compile, default-value=CDD_ECAP_CIRCULAR_BUFFER  # Configures the handling of the buffer in case the mode is "Timestamp"
          function name CddEcapTimestampNotification [0..1]: multiplicity set at pre-compile, origin=Texas Instruments, set at pre-compile, default-value=NULL_PTR  # Notification function if the number of requested timestamps
        container CddEcapSignalEdgeDetection  # This container contains the configuration (parameters) in case the measurement mode is "CddEcapSignalEdgeDetection"
          function name CddEcapSignalNotification [0..1]: multiplicity set at pre-compile, origin=Texas Instruments, set at pre-compile, default-value=NULL_PTR  # Notification function for signal notification.
    container CddEcapGeneral  # Configuration of general CDD ECAP parameters.
      boolean CddEcapDevErrorDetect: origin=Texas Instruments, set at pre-compile, default-value=false  # Switches the development error detection and notification on or off.
      boolean CddEcapDeInitApi: origin=Texas Instruments, set at pre-compile, default-value=true  # Adds / removes the service CddEcap_DeInit() from the code.
      boolean CddEcapEdgeCountApi: origin=Texas Instruments, set at pre-compile, default-value=false  # Adds / removes all services related to the edge counting functionality as listed below, from the code: CddEcap_ResetEdgeCount(), CddEcap_EnableEdgeCount(), CddEcap_DisableEdgeCount(), CddEcap_GetEdgeNumbers().
      boolean CddEcapEdgeDetectApi: origin=Texas Instruments, set at pre-compile, default-value=false  # Adds / removes the services related to the edge detection functionality, from the code:
      boolean CddEcapGetDutyCycleValuesApi: origin=Texas Instruments, set at pre-compile, default-value=false  # Adds / removes the service CddEcap_GetDutyCycleValues() from the code.
      boolean CddEcapGetInputStateApi: origin=Texas Instruments, set at pre-compile, default-value=false  # Adds / removes the service CddEcap_GetInputState() from the code.
      boolean CddEcapGetTimeElapsedApi: origin=Texas Instruments, set at pre-compile, default-value=false  # Adds / removes the service CddEcap_GetTimeElapsed() from the code.
      boolean CddEcapGetVersionInfoApi: origin=Texas Instruments, set at pre-compile, default-value=false  # Adds / removes the service CddEcap_GetVersionInfo() from the code.
      boolean CddEcapSignalMeasurementApi: origin=Texas Instruments, set at pre-compile, default-value=true  # Adds / removes the services CddEcap_StartSignalMeasurement() and CddEcap_StopSignalMeasurement() from the code.
      boolean CddEcapTimestampApi: origin=Texas Instruments, set at pre-compile, default-value=false  # Adds / removes all services related to the timestamping functionality as listed below from the code: CddEcap_StartTimestamp(), CddEcap_StopTimestamp(), CddEcap_GetTimestampIndex().
      boolean CddEcapHRConfigApi: origin=Texas Instruments, set at pre-compile, default-value=false  # Adds / removes all services related to the high resolution functionality as listed below, from the code: .
