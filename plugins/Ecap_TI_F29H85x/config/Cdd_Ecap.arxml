AUTOSAR XML (schema 00044)
package /TI_F29H85x/Cdd_Ecap
  ecuc definition collection myEcuParameterDefinition: module=Cdd
  module definition Cdd [1..*]: api-service-prefix=Cdd_Ecap, refined-module-def=Cdd, variants pre-compile  # Configuration of Ecap (Enhanced Capture Module) module.
    container CddEcapConfigSet  # This container contains the configuration parameters and sub containers of the AUTOSAR CddEcap module.
      integer CddEcapMaxChannel: 0..5, origin=Texas Instruments, set at pre-compile, default-value=1  # This parameter contains the number of Channels configured. It will be gathered by tools during the configuration stage.
      container CddEcapChannel [1..6]: multiplicity set at pre-compile  # Configuration of an individual CDD ECAP channel.
        integer CddEcapChannelId: 0..5, scope=ECU, origin=Texas Instruments, set at pre-compile, symbolic-name-value=true, default-value=1  # Channel Id of the CDD ECAP channel. This value will be assigned to the symbolic name derived of the CddEcapChannel container short name.
        enumeration CddEcapEmulationMode: {CDD_ECAP_EMULATION_STOP, CDD_ECAP_EMULATION_RUN_TO_ZERO, CDD_ECAP_EMULATION_FREE_RUN}, origin=Texas Instruments, set at pre-compile, default-value=CDD_ECAP_EMULATION_FREE_RUN  # Configures the emulation mode of the Cdd Ecap.
        enumeration CddEcapDefaultStartEdge: {CDD_ECAP_BOTH_EDGES, CDD_ECAP_FALLING_EDGE, CDD_ECAP_RISING_EDGE}, origin=Texas Instruments, set at pre-compile, default-value=CDD_ECAP_RISING_EDGE  # Configures the default-activation-edge which shall be used for this channel if there was no activation-edge configured by the call of service CddEcap_SetActivationCondition().
        enumeration CddEcapInputSelect: {CDD_ECAP_INPUT_INPUTXBAR1}, origin=Texas Instruments, set at pre-compile, default-value=CDD_ECAP_INPUT_INPUTXBAR1  # Configures the source to be used in order to give CDD ECAP the required input
        enumeration CddEcapIrqType: {ISR_CAT1_INT, ISR_CAT1_RINT, ISR_CAT2_INT}, origin=Texas Instruments, set at pre-compile, default-value=ISR_CAT1_INT  # Type of Isr function: void functionname(void) CAT1 see description in oil tool : interrupt void func(void) CAT2 see description in oil tool : ISR(func)
        enumeration CddEcapMeasurementMode: {CDD_ECAP_MODE_EDGE_COUNTER, CDD_ECAP_MODE_SIGNAL_EDGE_DETECT, CDD_ECAP_MODE_SIGNAL_MEASUREMENT, CDD_ECAP_MODE_TIMESTAMP}, origin=Texas Instruments, set at pre-compile, default-value=CDD_ECAP_MODE_EDGE_COUNTER  # Configures the measurement mode of this channel.
        enumeration CddEcapPrescaler: {CDD_ECAP_PRESCALAR_1}, origin=Texas Instruments, set at pre-compile, default-value=CDD_ECAP_PRESCALAR_1  # Configures the prescale value, keep it as 0 if you want to bypass it
        integer CddEcapClkFrequency: 2000000..200000000, origin=Texas Instruments, set at pre-compile, default-value=200000000  # Reference to a container of the type McuClockReferencePoint, to select an input clock.
        boolean CddEcapHREnable: origin=Texas Instruments, set at pre-compile, default-value=false  # This parameter enables HR mode for a particular Cdd Ecap channel.
        reference CddEcapFunctionalClock: origin=Texas Instruments, set at pre-compile, destination=McuClockReferencePoint  # Reference to a container of the type McuClockReferencePoint, to select an input clock.
        container CddEcapSignalMeasurement  # This container contains the configuration (parameters) in case the measurement mode is "CddEcapSignalMeasurement"
          enumeration CddEcapSignalMeasurementProperty: {CDD_ECAP_HIGH_TIME, CDD_ECAP_LOW_TIME, CDD_ECAP_PERIOD_TIME}, origin=Texas Instruments, set at pre-compile, default-value=CDD_ECAP_HIGH_TIME  # Configures the property that could be measured in case the mode is "CddEcapSignalMeasurement".
        container CddEcapTimestampMeasurement  # This container contains the configuration (parameters) in case the measurement mode is "CddEcapTimestamp"
          enumeration CddEcapTimestampMeasurementProperty: {CDD_ECAP_CIRCULAR_BUFFER, CDD_ECAP_LINEAR_BUFFER}, origin=Texas Instruments, set at pre-compile, default-value=CDD_ECAP_CIRCULAR_BUFFER  # Configures the handling of the buffer in case the mode is "Timestamp"
          function name CddEcapTimestampNotification [0..1]: multiplicity set at pre-compile, origin=Texas Instruments, set at pre-compile, default-value=NULL_PTR  # Notification function if the number of requested timestamps
        container CddEcapSignalEdgeDetection  # This container contains the configuration (parameters) in case the measurement mode is "CddEcapSignalEdgeDetection"
          function name CddEcapSignalNotification [0..1]: multiplicity set at pre-compile, origin=Texas Instruments, set at pre-compile, default-value=NULL_PTR  # Notification function for signal notification.
    container CddEcapGeneral  # Configuration of general CDD ECAP parameters.
      boolean CddEcapDevErrorDetect: origin=Texas Instruments, set at pre-compile, default-value=false  # Switches the development error detection and notification on or off.
      boolean CddEcapDeInitApi: origin=Texas Instruments, set at pre-compile, default-value=true  # Adds / removes the service CddEcap_DeInit() from the code.
      boolean CddEcapEdgeCountApi: origin=Texas Instruments, set at pre-compile, default-value=false  # Adds / removes all services related to the edge counting functionality as listed below, from the code: CddEcap_ResetEdgeCount(), CddEcap_EnableEdgeCount(), CddEcap_DisableEdgeCount(), CddEcap_GetEdgeNumbers().
      boolean CddEcapEdgeDetectApi: origin=Texas Instruments, set at pre-compile, default-value=false  # Adds / removes the services related to the edge detection functionality, from the code:
      boolean CddEcapGetDutyCycleValuesApi: origin=Texas Instruments, set at pre-compile, default-value=false  # Adds / removes the service CddEcap_GetDutyCycleValues() from the code.
      boolean CddEcapGetInputStateApi: origin=Texas Instruments, set at pre-compile, default-value=false  # Adds / removes the service CddEcap_GetInputState() from the code.
      boolean CddEcapGetTimeElapsedApi: origin=Texas Instruments, set at pre-compile, default-value=false  # Adds / removes the service CddEcap_GetTimeElapsed() from the code.
      boolean CddEcapGetVersionInfoApi: origin=Texas Instruments, set at pre-compile, default-value=false  # Adds / removes the service CddEcap_GetVersionInfo() from the code.
      boolean CddEcapSignalMeasurementApi: origin=Texas Instruments, set at pre-compile, default-value=true  # Adds / removes the services CddEcap_StartSignalMeasurement() and CddEcap_StopSignalMeasurement() from the code.
      boolean CddEcapTimestampApi: origin=Texas Instruments, set at pre-compile, default-value=false  # Adds / removes all services related to the timestamping functionality as listed below from the code: CddEcap_StartTimestamp(), CddEcap_StopTimestamp(), CddEcap_GetTimestampIndex().
      boolean CddEcapHRConfigApi: origin=Texas Instruments, set at pre-compile, default-value=false  # Adds / removes all services related to the high resolution functionality as listed below, from the code: .
