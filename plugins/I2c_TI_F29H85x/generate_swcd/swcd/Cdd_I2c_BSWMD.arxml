<?xml version="1.0" encoding="UTF-8"?>
[!AUTOSPACING!][!//
[!SELECT "as:modconf('Cdd_I2c/Cdd')[as:path(node:dtos(.))='/TI_F29H85x/Cdd_I2c/Cdd']"!]
[!VAR "HAS_CONTROLLER" = "'false'"!][!//
[!VAR "HAS_TARGET" = "'false'"!][!//
[!VAR "HAS_POLLING" = "'false'"!][!//
[!LOOP "CddI2cHwConfig/*"!][!//
[!IF "CddI2cHwUnitMode = 'CDD_I2C_MODE_CONTROLLER'"!][!//
[!VAR "HAS_CONTROLLER" = "'true'"!][!//
[!ELSEIF "CddI2cHwUnitMode = 'CDD_I2C_MODE_TARGET'"!][!//
[!VAR "HAS_TARGET" = "'true'"!][!//
[!ENDIF!][!//
[!IF "CddI2cHwUseInterrupts = 'false'"!][!//
[!VAR "HAS_POLLING" = "'true'"!][!//
[!ENDIF!][!//
[!ENDLOOP!][!//
<AUTOSAR xmlns="http://autosar.org/schema/r4.0" xmlns:xsi="http://www.w3.org/2001/XMLSchema-instance" xsi:schemaLocation="http://autosar.org/schema/r4.0 AUTOSAR_00044.xsd">
  <AR-PACKAGES>
    <AR-PACKAGE UUID="04fb2c56-48f8-4533-8f7d-e3befe508940">
      <SHORT-NAME>Cdd_I2c_TI_F29H85x</SHORT-NAME>
      <ELEMENTS>
        <BSW-MODULE-DESCRIPTION UUID="b3676678-06d3-40a5-9614-09cdf3041737">
          <SHORT-NAME>Cdd_I2c</SHORT-NAME>
          <CATEGORY>BSW_MODULE</CATEGORY>
          <IMPLEMENTED-ENTRYS>
            <BSW-MODULE-ENTRY-REF-CONDITIONAL>
              <BSW-MODULE-ENTRY-REF DEST="BSW-MODULE-ENTRY">/Cdd_I2c_TI_F29H85x/Cdd_I2c_ModuleEntry/Cdd_I2c_Init</BSW-MODULE-ENTRY-REF>
            </BSW-MODULE-ENTRY-REF-CONDITIONAL>
            <BSW-MODULE-ENTRY-REF-CONDITIONAL>
              <BSW-MODULE-ENTRY-REF DEST="BSW-MODULE-ENTRY">/Cdd_I2c_TI_F29H85x/Cdd_I2c_ModuleEntry/Cdd_I2c_DeInit</BSW-MODULE-ENTRY-REF>
            </BSW-MODULE-ENTRY-REF-CONDITIONAL>
            [!IF "CddI2cGeneral/CddI2cVersionInfoApi = 'true'"!][!//
            <BSW-MODULE-ENTRY-REF-CONDITIONAL>
              <BSW-MODULE-ENTRY-REF DEST="BSW-MODULE-ENTRY">/Cdd_I2c_TI_F29H85x/Cdd_I2c_ModuleEntry/Cdd_I2c_GetVersionInfo</BSW-MODULE-ENTRY-REF>
            </BSW-MODULE-ENTRY-REF-CONDITIONAL>
            [!ENDIF!][!//
            <BSW-MODULE-ENTRY-REF-CONDITIONAL>
              <BSW-MODULE-ENTRY-REF DEST="BSW-MODULE-ENTRY">/Cdd_I2c_TI_F29H85x/Cdd_I2c_ModuleEntry/Cdd_I2c_ResetHwUnit</BSW-MODULE-ENTRY-REF>
            </BSW-MODULE-ENTRY-REF-CONDITIONAL>
            [!IF "$HAS_CONTROLLER = 'true'"!][!//
            <BSW-MODULE-ENTRY-REF-CONDITIONAL>
              <BSW-MODULE-ENTRY-REF DEST="BSW-MODULE-ENTRY">/Cdd_I2c_TI_F29H85x/Cdd_I2c_ModuleEntry/Cdd_I2c_SetupEB</BSW-MODULE-ENTRY-REF>
            </BSW-MODULE-ENTRY-REF-CONDITIONAL>
            <BSW-MODULE-ENTRY-REF-CONDITIONAL>
              <BSW-MODULE-ENTRY-REF DEST="BSW-MODULE-ENTRY">/Cdd_I2c_TI_F29H85x/Cdd_I2c_ModuleEntry/Cdd_I2c_SetupEBDynamic</BSW-MODULE-ENTRY-REF>
            </BSW-MODULE-ENTRY-REF-CONDITIONAL>
            <BSW-MODULE-ENTRY-REF-CONDITIONAL>
              <BSW-MODULE-ENTRY-REF DEST="BSW-MODULE-ENTRY">/Cdd_I2c_TI_F29H85x/Cdd_I2c_ModuleEntry/Cdd_I2c_AsyncTransmit</BSW-MODULE-ENTRY-REF>
            </BSW-MODULE-ENTRY-REF-CONDITIONAL>
            [!IF "CddI2cGeneral/CddI2cCancelApi = 'true'"!][!//
            <BSW-MODULE-ENTRY-REF-CONDITIONAL>
              <BSW-MODULE-ENTRY-REF DEST="BSW-MODULE-ENTRY">/Cdd_I2c_TI_F29H85x/Cdd_I2c_ModuleEntry/Cdd_I2c_Cancel</BSW-MODULE-ENTRY-REF>
            </BSW-MODULE-ENTRY-REF-CONDITIONAL>
            [!ENDIF!][!//
            <BSW-MODULE-ENTRY-REF-CONDITIONAL>
              <BSW-MODULE-ENTRY-REF DEST="BSW-MODULE-ENTRY">/Cdd_I2c_TI_F29H85x/Cdd_I2c_ModuleEntry/Cdd_I2c_GetSequenceResult</BSW-MODULE-ENTRY-REF>
            </BSW-MODULE-ENTRY-REF-CONDITIONAL>
            <BSW-MODULE-ENTRY-REF-CONDITIONAL>
              <BSW-MODULE-ENTRY-REF DEST="BSW-MODULE-ENTRY">/Cdd_I2c_TI_F29H85x/Cdd_I2c_ModuleEntry/Cdd_I2c_GetResult</BSW-MODULE-ENTRY-REF>
            </BSW-MODULE-ENTRY-REF-CONDITIONAL>
            [!IF "CddI2cGeneral/CddI2cStatusApi = 'true'"!][!//
            <BSW-MODULE-ENTRY-REF-CONDITIONAL>
              <BSW-MODULE-ENTRY-REF DEST="BSW-MODULE-ENTRY">/Cdd_I2c_TI_F29H85x/Cdd_I2c_ModuleEntry/Cdd_I2c_GetStatus</BSW-MODULE-ENTRY-REF>
            </BSW-MODULE-ENTRY-REF-CONDITIONAL>
            [!ENDIF!][!//
            [!IF "$HAS_POLLING = 'true'"!][!//
            <BSW-MODULE-ENTRY-REF-CONDITIONAL>
              <BSW-MODULE-ENTRY-REF DEST="BSW-MODULE-ENTRY">/Cdd_I2c_TI_F29H85x/Cdd_I2c_ModuleEntry/Cdd_I2c_MainFunction</BSW-MODULE-ENTRY-REF>
            </BSW-MODULE-ENTRY-REF-CONDITIONAL>
            <BSW-MODULE-ENTRY-REF-CONDITIONAL>
              <BSW-MODULE-ENTRY-REF DEST="BSW-MODULE-ENTRY">/Cdd_I2c_TI_F29H85x/Cdd_I2c_ModuleEntry/Cdd_I2c_PollingModeProcessing</BSW-MODULE-ENTRY-REF>
            </BSW-MODULE-ENTRY-REF-CONDITIONAL>
            [!ENDIF!][!//
            [!ENDIF!][!//
            [!LOOP "CddI2cHwConfig/*"!][!//
            [!IF "CddI2cHwUseInterrupts = 'true'"!][!//
            [!IF "node:value(node:ref(CddI2cHwUnitRef)/InstanceName) = 'I2CA'"!][!//
            <BSW-MODULE-ENTRY-REF-CONDITIONAL>
              <BSW-MODULE-ENTRY-REF DEST="BSW-MODULE-ENTRY">/Cdd_I2c_TI_F29H85x/Cdd_I2c_ModuleEntry/Cdd_I2c_I2CA_ISR</BSW-MODULE-ENTRY-REF>
            </BSW-MODULE-ENTRY-REF-CONDITIONAL>
            [!ENDIF!][!//
            [!IF "node:value(node:ref(CddI2cHwUnitRef)/InstanceName) = 'I2CB'"!][!//
            <BSW-MODULE-ENTRY-REF-CONDITIONAL>
              <BSW-MODULE-ENTRY-REF DEST="BSW-MODULE-ENTRY">/Cdd_I2c_TI_F29H85x/Cdd_I2c_ModuleEntry/Cdd_I2c_I2CB_ISR</BSW-MODULE-ENTRY-REF>
            </BSW-MODULE-ENTRY-REF-CONDITIONAL>
            [!ENDIF!][!//
            [!ENDIF!][!//
            [!ENDLOOP!][!//
            [!IF "$HAS_TARGET = 'true'"!][!//
            <BSW-MODULE-ENTRY-REF-CONDITIONAL>
              <BSW-MODULE-ENTRY-REF DEST="BSW-MODULE-ENTRY">/Cdd_I2c_TI_F29H85x/Cdd_I2c_ModuleEntry/Cdd_I2c_TargetStart</BSW-MODULE-ENTRY-REF>
            </BSW-MODULE-ENTRY-REF-CONDITIONAL>
            <BSW-MODULE-ENTRY-REF-CONDITIONAL>
              <BSW-MODULE-ENTRY-REF DEST="BSW-MODULE-ENTRY">/Cdd_I2c_TI_F29H85x/Cdd_I2c_ModuleEntry/Cdd_I2c_TargetStop</BSW-MODULE-ENTRY-REF>
            </BSW-MODULE-ENTRY-REF-CONDITIONAL>
            <BSW-MODULE-ENTRY-REF-CONDITIONAL>
              <BSW-MODULE-ENTRY-REF DEST="BSW-MODULE-ENTRY">/Cdd_I2c_TI_F29H85x/Cdd_I2c_ModuleEntry/Cdd_I2c_TargetSubmitTxBuffer</BSW-MODULE-ENTRY-REF>
            </BSW-MODULE-ENTRY-REF-CONDITIONAL>
            <BSW-MODULE-ENTRY-REF-CONDITIONAL>
              <BSW-MODULE-ENTRY-REF DEST="BSW-MODULE-ENTRY">/Cdd_I2c_TI_F29H85x/Cdd_I2c_ModuleEntry/Cdd_I2c_TargetSubmitRxBuffer</BSW-MODULE-ENTRY-REF>
            </BSW-MODULE-ENTRY-REF-CONDITIONAL>
            [!ENDIF!][!//
          </IMPLEMENTED-ENTRYS>
          <MODULE-ID>255</MODULE-ID>
          <BSW-MODULE-DEPENDENCYS>
            [!IF "CddI2cGeneral/CddI2cDevErrorDetect = 'true'"!][!//
            <BSW-MODULE-DEPENDENCY UUID="fdeef386-d78b-495e-8197-5f975ba968ef">
              <SHORT-NAME>Det</SHORT-NAME>
              <TARGET-MODULE-ID>15</TARGET-MODULE-ID>
              <TARGET-MODULE-REFS>
                <BSW-MODULE-DESCRIPTION-REF-CONDITIONAL>
                  <BSW-MODULE-DESCRIPTION-REF DEST="BSW-MODULE-DESCRIPTION">/AUTOSAR_Det/Det</BSW-MODULE-DESCRIPTION-REF>
                </BSW-MODULE-DESCRIPTION-REF-CONDITIONAL>
              </TARGET-MODULE-REFS>
            </BSW-MODULE-DEPENDENCY>
            [!ENDIF!][!//
          </BSW-MODULE-DEPENDENCYS>
          <INTERNAL-BEHAVIORS>
            <BSW-INTERNAL-BEHAVIOR UUID="50c52b09-1f60-4ac9-b65c-0fb2d1d55c65">
              <SHORT-NAME>Cdd_I2c_Behavior</SHORT-NAME>
              <EXCLUSIVE-AREAS>
                <EXCLUSIVE-AREA UUID="65f804ba-15ac-4aa5-b8a2-910b190bb586">
                  <SHORT-NAME>CDD_I2C_EXCLUSIVE_AREA_0</SHORT-NAME>
                </EXCLUSIVE-AREA>
              </EXCLUSIVE-AREAS>
              <ENTITYS>
                <BSW-CALLED-ENTITY UUID="c829160a-81cd-4889-b572-2458c2a1cf38">
                  <SHORT-NAME>Cdd_I2c_Init</SHORT-NAME>
                  <REENTRANCY-LEVEL>NON-REENTRANT</REENTRANCY-LEVEL>
                  [!IF "CddI2cGeneral/CddI2cDevErrorDetect = 'true'"!][!//
                  <CALL-POINTS>
                    <BSW-DIRECT-CALL-POINT>
                      <SHORT-NAME>Det</SHORT-NAME>
                      <CALLED-ENTRY-REF DEST="BSW-MODULE-ENTRY">/AUTOSAR_Det/Det/Det_ReportError</CALLED-ENTRY-REF>
                    </BSW-DIRECT-CALL-POINT>
                  </CALL-POINTS>
                  [!ENDIF!][!//
                  <IMPLEMENTED-ENTRY-REF DEST="BSW-MODULE-ENTRY">/Cdd_I2c_TI_F29H85x/Cdd_I2c_ModuleEntry/Cdd_I2c_Init</IMPLEMENTED-ENTRY-REF>
                </BSW-CALLED-ENTITY>
                <BSW-CALLED-ENTITY UUID="ed3fd880-fb67-42af-b387-9406bb757201">
                  <SHORT-NAME>Cdd_I2c_Deinit</SHORT-NAME>
                  <REENTRANCY-LEVEL>NON-REENTRANT</REENTRANCY-LEVEL>
                  [!IF "CddI2cGeneral/CddI2cDevErrorDetect = 'true'"!][!//
                  <CALL-POINTS>
                    <BSW-DIRECT-CALL-POINT>
                      <SHORT-NAME>Det</SHORT-NAME>
                      <CALLED-ENTRY-REF DEST="BSW-MODULE-ENTRY">/AUTOSAR_Det/Det/Det_ReportError</CALLED-ENTRY-REF>
                    </BSW-DIRECT-CALL-POINT>
                  </CALL-POINTS>
                  [!ENDIF!][!//
                  <IMPLEMENTED-ENTRY-REF DEST="BSW-MODULE-ENTRY">/Cdd_I2c_TI_F29H85x/Cdd_I2c_ModuleEntry/Cdd_I2c_DeInit</IMPLEMENTED-ENTRY-REF>
                </BSW-CALLED-ENTITY>
                [!IF "CddI2cGeneral/CddI2cVersionInfoApi = 'true'"!][!//
                <BSW-CALLED-ENTITY UUID="86980e27-0649-429f-9e67-be762df0129a">
                  <SHORT-NAME>Cdd_I2c_GetVersionInfo</SHORT-NAME>
                  <REENTRANCY-LEVEL>SINGLE-CORE-REENTRANT</REENTRANCY-LEVEL>
                  [!IF "CddI2cGeneral/CddI2cDevErrorDetect = 'true'"!][!//
                  <CALL-POINTS>
                    <BSW-DIRECT-CALL-POINT>
                      <SHORT-NAME>Det</SHORT-NAME>
                      <CALLED-ENTRY-REF DEST="BSW-MODULE-ENTRY">/AUTOSAR_Det/Det/Det_ReportError</CALLED-ENTRY-REF>
                    </BSW-DIRECT-CALL-POINT>
                  </CALL-POINTS>
                  [!ENDIF!][!//
                  <IMPLEMENTED-ENTRY-REF DEST="BSW-MODULE-ENTRY">/Cdd_I2c_TI_F29H85x/Cdd_I2c_ModuleEntry/Cdd_I2c_GetVersionInfo</IMPLEMENTED-ENTRY-REF>
                </BSW-CALLED-ENTITY>
                [!ENDIF!][!//
                <BSW-CALLED-ENTITY UUID="ebf410cf-1018-4984-b257-b78498b66f52">
                  <SHORT-NAME>Cdd_I2c_ResetHwUnit</SHORT-NAME>
                  <CAN-ENTER-EXCLUSIVE-AREA-REFS>
                    <CAN-ENTER-EXCLUSIVE-AREA-REF DEST="EXCLUSIVE-AREA">/Cdd_I2c_TI_F29H85x/Cdd_I2c/Cdd_I2c_Behavior/CDD_I2C_EXCLUSIVE_AREA_0</CAN-ENTER-EXCLUSIVE-AREA-REF>
                  </CAN-ENTER-EXCLUSIVE-AREA-REFS>
                  <REENTRANCY-LEVEL>NON-REENTRANT</REENTRANCY-LEVEL>
                  [!IF "CddI2cGeneral/CddI2cDevErrorDetect = 'true'"!][!//
                  <CALL-POINTS>
                    <BSW-DIRECT-CALL-POINT>
                      <SHORT-NAME>Det</SHORT-NAME>
                      <CALLED-ENTRY-REF DEST="BSW-MODULE-ENTRY">/AUTOSAR_Det/Det/Det_ReportError</CALLED-ENTRY-REF>
                    </BSW-DIRECT-CALL-POINT>
                  </CALL-POINTS>
                  [!ENDIF!][!//
                  <IMPLEMENTED-ENTRY-REF DEST="BSW-MODULE-ENTRY">/Cdd_I2c_TI_F29H85x/Cdd_I2c_ModuleEntry/Cdd_I2c_ResetHwUnit</IMPLEMENTED-ENTRY-REF>
                </BSW-CALLED-ENTITY>
                [!IF "$HAS_CONTROLLER = 'true'"!][!//
                <BSW-CALLED-ENTITY UUID="843f0c52-b761-4e0f-a72c-d27696c01126">
                  <SHORT-NAME>Cdd_I2c_SetupEB</SHORT-NAME>
                  <CAN-ENTER-EXCLUSIVE-AREA-REFS>
                    <CAN-ENTER-EXCLUSIVE-AREA-REF DEST="EXCLUSIVE-AREA">/Cdd_I2c_TI_F29H85x/Cdd_I2c/Cdd_I2c_Behavior/CDD_I2C_EXCLUSIVE_AREA_0</CAN-ENTER-EXCLUSIVE-AREA-REF>
                  </CAN-ENTER-EXCLUSIVE-AREA-REFS>
                  <REENTRANCY-LEVEL>SINGLE-CORE-REENTRANT</REENTRANCY-LEVEL>
                  [!IF "CddI2cGeneral/CddI2cDevErrorDetect = 'true'"!][!//
                  <CALL-POINTS>
                    <BSW-DIRECT-CALL-POINT>
                      <SHORT-NAME>Det</SHORT-NAME>
                      <CALLED-ENTRY-REF DEST="BSW-MODULE-ENTRY">/AUTOSAR_Det/Det/Det_ReportError</CALLED-ENTRY-REF>
                    </BSW-DIRECT-CALL-POINT>
                  </CALL-POINTS>
                  [!ENDIF!][!//
                  <IMPLEMENTED-ENTRY-REF DEST="BSW-MODULE-ENTRY">/Cdd_I2c_TI_F29H85x/Cdd_I2c_ModuleEntry/Cdd_I2c_SetupEB</IMPLEMENTED-ENTRY-REF>
                </BSW-CALLED-ENTITY>
                <BSW-CALLED-ENTITY UUID="9e049438-dc22-4dae-8a3c-86c9897ef03c">
                  <SHORT-NAME>Cdd_I2c_SetupEBDynamic</SHORT-NAME>
                  <CAN-ENTER-EXCLUSIVE-AREA-REFS>
                    <CAN-ENTER-EXCLUSIVE-AREA-REF DEST="EXCLUSIVE-AREA">/Cdd_I2c_TI_F29H85x/Cdd_I2c/Cdd_I2c_Behavior/CDD_I2C_EXCLUSIVE_AREA_0</CAN-ENTER-EXCLUSIVE-AREA-REF>
                  </CAN-ENTER-EXCLUSIVE-AREA-REFS>
                  <REENTRANCY-LEVEL>SINGLE-CORE-REENTRANT</REENTRANCY-LEVEL>
                  [!IF "CddI2cGeneral/CddI2cDevErrorDetect = 'true'"!][!//
                  <CALL-POINTS>
                    <BSW-DIRECT-CALL-POINT>
                      <SHORT-NAME>Det</SHORT-NAME>
                      <CALLED-ENTRY-REF DEST="BSW-MODULE-ENTRY">/AUTOSAR_Det/Det/Det_ReportError</CALLED-ENTRY-REF>
                    </BSW-DIRECT-CALL-POINT>
                  </CALL-POINTS>
                  [!ENDIF!][!//
                  <IMPLEMENTED-ENTRY-REF DEST="BSW-MODULE-ENTRY">/Cdd_I2c_TI_F29H85x/Cdd_I2c_ModuleEntry/Cdd_I2c_SetupEBDynamic</IMPLEMENTED-ENTRY-REF>
                </BSW-CALLED-ENTITY>
                <BSW-CALLED-ENTITY UUID="ed9972e0-2b71-4060-8778-c3e16cb46bb3">
                  <SHORT-NAME>Cdd_I2c_AsyncTransmit</SHORT-NAME>
                  <CAN-ENTER-EXCLUSIVE-AREA-REFS>
                    <CAN-ENTER-EXCLUSIVE-AREA-REF DEST="EXCLUSIVE-AREA">/Cdd_I2c_TI_F29H85x/Cdd_I2c/Cdd_I2c_Behavior/CDD_I2C_EXCLUSIVE_AREA_0</CAN-ENTER-EXCLUSIVE-AREA-REF>
                  </CAN-ENTER-EXCLUSIVE-AREA-REFS>
                  <REENTRANCY-LEVEL>SINGLE-CORE-REENTRANT</REENTRANCY-LEVEL>
                  [!IF "CddI2cGeneral/CddI2cDevErrorDetect = 'true'"!][!//
                  <CALL-POINTS>
                    <BSW-DIRECT-CALL-POINT>
                      <SHORT-NAME>Det</SHORT-NAME>
                      <CALLED-ENTRY-REF DEST="BSW-MODULE-ENTRY">/AUTOSAR_Det/Det/Det_ReportError</CALLED-ENTRY-REF>
                    </BSW-DIRECT-CALL-POINT>
                  </CALL-POINTS>
                  [!ENDIF!][!//
                  <IMPLEMENTED-ENTRY-REF DEST="BSW-MODULE-ENTRY">/Cdd_I2c_TI_F29H85x/Cdd_I2c_ModuleEntry/Cdd_I2c_AsyncTransmit</IMPLEMENTED-ENTRY-REF>
                </BSW-CALLED-ENTITY>
                [!IF "CddI2cGeneral/CddI2cCancelApi = 'true'"!][!//
                <BSW-CALLED-ENTITY UUID="d2af5552-cf01-418e-aa05-dff88ffe985d">
                  <SHORT-NAME>Cdd_I2c_Cancel</SHORT-NAME>
                  <CAN-ENTER-EXCLUSIVE-AREA-REFS>
                    <CAN-ENTER-EXCLUSIVE-AREA-REF DEST="EXCLUSIVE-AREA">/Cdd_I2c_TI_F29H85x/Cdd_I2c/Cdd_I2c_Behavior/CDD_I2C_EXCLUSIVE_AREA_0</CAN-ENTER-EXCLUSIVE-AREA-REF>
                  </CAN-ENTER-EXCLUSIVE-AREA-REFS>
                  <REENTRANCY-LEVEL>NON-REENTRANT</REENTRANCY-LEVEL>
                  [!IF "CddI2cGeneral/CddI2cDevErrorDetect = 'true'"!][!//
                  <CALL-POINTS>
                    <BSW-DIRECT-CALL-POINT>
                      <SHORT-NAME>Det</SHORT-NAME>
                      <CALLED-ENTRY-REF DEST="BSW-MODULE-ENTRY">/AUTOSAR_Det/Det/Det_ReportError</CALLED-ENTRY-REF>
                    </BSW-DIRECT-CALL-POINT>
                  </CALL-POINTS>
                  [!ENDIF!][!//
                  <IMPLEMENTED-ENTRY-REF DEST="BSW-MODULE-ENTRY">/Cdd_I2c_TI_F29H85x/Cdd_I2c_ModuleEntry/Cdd_I2c_Cancel</IMPLEMENTED-ENTRY-REF>
                </BSW-CALLED-ENTITY>
                [!ENDIF!][!//
                [!IF "$HAS_POLLING = 'true'"!][!//
                <BSW-SCHEDULABLE-ENTITY UUID="743e0703-5938-46e1-b666-84ce17d1eeee">
                  <SHORT-NAME>Cdd_I2c_MainFunction</SHORT-NAME>
                  <CAN-ENTER-EXCLUSIVE-AREA-REFS>
                    <CAN-ENTER-EXCLUSIVE-AREA-REF DEST="EXCLUSIVE-AREA">/Cdd_I2c_TI_F29H85x/Cdd_I2c/Cdd_I2c_Behavior/CDD_I2C_EXCLUSIVE_AREA_0</CAN-ENTER-EXCLUSIVE-AREA-REF>
                  </CAN-ENTER-EXCLUSIVE-AREA-REFS>
                  <REENTRANCY-LEVEL>SINGLE-CORE-REENTRANT</REENTRANCY-LEVEL>
                  [!IF "CddI2cGeneral/CddI2cDevErrorDetect = 'true'"!][!//
                  <CALL-POINTS>
                    <BSW-DIRECT-CALL-POINT>
                      <SHORT-NAME>Det</SHORT-NAME>
                      <CALLED-ENTRY-REF DEST="BSW-MODULE-ENTRY">/AUTOSAR_Det/Det/Det_ReportError</CALLED-ENTRY-REF>
                    </BSW-DIRECT-CALL-POINT>
                  </CALL-POINTS>
                  [!ENDIF!][!//
                  <IMPLEMENTED-ENTRY-REF DEST="BSW-MODULE-ENTRY">/Cdd_I2c_TI_F29H85x/Cdd_I2c_ModuleEntry/Cdd_I2c_MainFunction</IMPLEMENTED-ENTRY-REF>
                </BSW-SCHEDULABLE-ENTITY>
                [!ENDIF!][!//
                [!IF "$HAS_POLLING = 'true'"!][!//
                <BSW-SCHEDULABLE-ENTITY UUID="3d0290cf-3837-4249-bee7-738b9cdca2c2">
                  <SHORT-NAME>Cdd_I2c_PollingModeProcessing</SHORT-NAME>
                  <REENTRANCY-LEVEL>SINGLE-CORE-REENTRANT</REENTRANCY-LEVEL>
                  [!IF "CddI2cGeneral/CddI2cDevErrorDetect = 'true'"!][!//
                  <CALL-POINTS>
                    <BSW-DIRECT-CALL-POINT>
                      <SHORT-NAME>Det</SHORT-NAME>
                      <CALLED-ENTRY-REF DEST="BSW-MODULE-ENTRY">/AUTOSAR_Det/Det/Det_ReportError</CALLED-ENTRY-REF>
                    </BSW-DIRECT-CALL-POINT>
                  </CALL-POINTS>
                  [!ENDIF!][!//
                  <IMPLEMENTED-ENTRY-REF DEST="BSW-MODULE-ENTRY">/Cdd_I2c_TI_F29H85x/Cdd_I2c_ModuleEntry/Cdd_I2c_PollingModeProcessing</IMPLEMENTED-ENTRY-REF>
                </BSW-SCHEDULABLE-ENTITY>
                [!ENDIF!][!//
                <BSW-CALLED-ENTITY UUID="a07b4a6c-e247-4b63-8d75-a45ad78d3fb2">
                  <SHORT-NAME>Cdd_I2c_GetSequenceResult</SHORT-NAME>
                  <REENTRANCY-LEVEL>SINGLE-CORE-REENTRANT</REENTRANCY-LEVEL>
                  [!IF "CddI2cGeneral/CddI2cDevErrorDetect = 'true'"!][!//
                  <CALL-POINTS>
                    <BSW-DIRECT-CALL-POINT>
                      <SHORT-NAME>Det</SHORT-NAME>
                      <CALLED-ENTRY-REF DEST="BSW-MODULE-ENTRY">/AUTOSAR_Det/Det/Det_ReportError</CALLED-ENTRY-REF>
                    </BSW-DIRECT-CALL-POINT>
                  </CALL-POINTS>
                  [!ENDIF!][!//
                  <IMPLEMENTED-ENTRY-REF DEST="BSW-MODULE-ENTRY">/Cdd_I2c_TI_F29H85x/Cdd_I2c_ModuleEntry/Cdd_I2c_GetSequenceResult</IMPLEMENTED-ENTRY-REF>
                </BSW-CALLED-ENTITY>
                <BSW-CALLED-ENTITY UUID="8432eef8-fb5a-4f16-99d9-ef5d52c2a037">
                  <SHORT-NAME>Cdd_I2c_GetResult</SHORT-NAME>
                  <REENTRANCY-LEVEL>SINGLE-CORE-REENTRANT</REENTRANCY-LEVEL>
                  [!IF "CddI2cGeneral/CddI2cDevErrorDetect = 'true'"!][!//
                  <CALL-POINTS>
                    <BSW-DIRECT-CALL-POINT>
                      <SHORT-NAME>Det</SHORT-NAME>
                      <CALLED-ENTRY-REF DEST="BSW-MODULE-ENTRY">/AUTOSAR_Det/Det/Det_ReportError</CALLED-ENTRY-REF>
                    </BSW-DIRECT-CALL-POINT>
                  </CALL-POINTS>
                  [!ENDIF!][!//
                  <IMPLEMENTED-ENTRY-REF DEST="BSW-MODULE-ENTRY">/Cdd_I2c_TI_F29H85x/Cdd_I2c_ModuleEntry/Cdd_I2c_GetResult</IMPLEMENTED-ENTRY-REF>
                </BSW-CALLED-ENTITY>
                [!IF "CddI2cGeneral/CddI2cStatusApi = 'true'"!][!//
                <BSW-CALLED-ENTITY UUID="cc29335b-84c4-4021-902e-a49217db8eaa">
                  <SHORT-NAME>Cdd_I2c_GetStatus</SHORT-NAME>
                  <REENTRANCY-LEVEL>SINGLE-CORE-REENTRANT</REENTRANCY-LEVEL>
                  <IMPLEMENTED-ENTRY-REF DEST="BSW-MODULE-ENTRY">/Cdd_I2c_TI_F29H85x/Cdd_I2c_ModuleEntry/Cdd_I2c_GetStatus</IMPLEMENTED-ENTRY-REF>
                </BSW-CALLED-ENTITY>
                [!ENDIF!][!//
                [!ENDIF!][!//
                [!IF "$HAS_TARGET = 'true'"!][!//
                <BSW-CALLED-ENTITY UUID="f42af007-7bf3-4b65-8544-26195f8abfb5">
                  <SHORT-NAME>Cdd_I2c_TargetStart</SHORT-NAME>
                  <REENTRANCY-LEVEL>SINGLE-CORE-REENTRANT</REENTRANCY-LEVEL>
                  [!IF "CddI2cGeneral/CddI2cDevErrorDetect = 'true'"!][!//
                  <CALL-POINTS>
                    <BSW-DIRECT-CALL-POINT>
                      <SHORT-NAME>Det</SHORT-NAME>
                      <CALLED-ENTRY-REF DEST="BSW-MODULE-ENTRY">/AUTOSAR_Det/Det/Det_ReportError</CALLED-ENTRY-REF>
                    </BSW-DIRECT-CALL-POINT>
                  </CALL-POINTS>
                  [!ENDIF!][!//
                  <IMPLEMENTED-ENTRY-REF DEST="BSW-MODULE-ENTRY">/Cdd_I2c_TI_F29H85x/Cdd_I2c_ModuleEntry/Cdd_I2c_TargetStart</IMPLEMENTED-ENTRY-REF>
                </BSW-CALLED-ENTITY>
                <BSW-CALLED-ENTITY UUID="d42563e4-ad41-4cac-93b9-85d90cbb2ac2">
                  <SHORT-NAME>Cdd_I2c_TargetStop</SHORT-NAME>
                  <REENTRANCY-LEVEL>SINGLE-CORE-REENTRANT</REENTRANCY-LEVEL>
                  [!IF "CddI2cGeneral/CddI2cDevErrorDetect = 'true'"!][!//
                  <CALL-POINTS>
                    <BSW-DIRECT-CALL-POINT>
                      <SHORT-NAME>Det</SHORT-NAME>
                      <CALLED-ENTRY-REF DEST="BSW-MODULE-ENTRY">/AUTOSAR_Det/Det/Det_ReportError</CALLED-ENTRY-REF>
                    </BSW-DIRECT-CALL-POINT>
                  </CALL-POINTS>
                  [!ENDIF!][!//
                  <IMPLEMENTED-ENTRY-REF DEST="BSW-MODULE-ENTRY">/Cdd_I2c_TI_F29H85x/Cdd_I2c_ModuleEntry/Cdd_I2c_TargetStop</IMPLEMENTED-ENTRY-REF>
                </BSW-CALLED-ENTITY>
                <BSW-CALLED-ENTITY UUID="c30f6b01-6897-4333-bc51-621adb069217">
                  <SHORT-NAME>Cdd_I2c_TargetSubmitTxBuffer</SHORT-NAME>
                  <REENTRANCY-LEVEL>SINGLE-CORE-REENTRANT</REENTRANCY-LEVEL>
                  [!IF "CddI2cGeneral/CddI2cDevErrorDetect = 'true'"!][!//
                  <CALL-POINTS>
                    <BSW-DIRECT-CALL-POINT>
                      <SHORT-NAME>Det</SHORT-NAME>
                      <CALLED-ENTRY-REF DEST="BSW-MODULE-ENTRY">/AUTOSAR_Det/Det/Det_ReportError</CALLED-ENTRY-REF>
                    </BSW-DIRECT-CALL-POINT>
                  </CALL-POINTS>
                  [!ENDIF!][!//
                  <IMPLEMENTED-ENTRY-REF DEST="BSW-MODULE-ENTRY">/Cdd_I2c_TI_F29H85x/Cdd_I2c_ModuleEntry/Cdd_I2c_TargetSubmitTxBuffer</IMPLEMENTED-ENTRY-REF>
                </BSW-CALLED-ENTITY>
                <BSW-CALLED-ENTITY UUID="710627f5-2851-4e3a-b783-6de8f9c5333a">
                  <SHORT-NAME>Cdd_I2c_TargetSubmitRxBuffer</SHORT-NAME>
                  <REENTRANCY-LEVEL>SINGLE-CORE-REENTRANT</REENTRANCY-LEVEL>
                  [!IF "CddI2cGeneral/CddI2cDevErrorDetect = 'true'"!][!//
                  <CALL-POINTS>
                    <BSW-DIRECT-CALL-POINT>
                      <SHORT-NAME>Det</SHORT-NAME>
                      <CALLED-ENTRY-REF DEST="BSW-MODULE-ENTRY">/AUTOSAR_Det/Det/Det_ReportError</CALLED-ENTRY-REF>
                    </BSW-DIRECT-CALL-POINT>
                  </CALL-POINTS>
                  [!ENDIF!][!//
                  <IMPLEMENTED-ENTRY-REF DEST="BSW-MODULE-ENTRY">/Cdd_I2c_TI_F29H85x/Cdd_I2c_ModuleEntry/Cdd_I2c_TargetSubmitRxBuffer</IMPLEMENTED-ENTRY-REF>
                </BSW-CALLED-ENTITY>
                [!ENDIF!][!//
                [!LOOP "CddI2cHwConfig/*"!][!//
                [!IF "CddI2cHwUseInterrupts = 'true'"!][!//
                [!IF "node:value(node:ref(CddI2cHwUnitRef)/InstanceName) = 'I2CA'"!][!//
                <BSW-INTERRUPT-ENTITY UUID="eeb8e9b7-be2f-4d15-bc1a-38f84d873a4e">
                  <SHORT-NAME>Cdd_I2c_I2CA_ISR</SHORT-NAME>
                  <REENTRANCY-LEVEL>NON-REENTRANT</REENTRANCY-LEVEL>
                  <IMPLEMENTED-ENTRY-REF DEST="BSW-MODULE-ENTRY">/Cdd_I2c_TI_F29H85x/Cdd_I2c_ModuleEntry/Cdd_I2c_I2CA_ISR</IMPLEMENTED-ENTRY-REF>
                  [!IF "CddI2cHwIrqType = 'ISR_CAT2_INT'"!][!//
                  <INTERRUPT-CATEGORY>CAT-2</INTERRUPT-CATEGORY>
                  [!ELSE!]
                  <INTERRUPT-CATEGORY>CAT-1</INTERRUPT-CATEGORY>
                  [!ENDIF!][!//
                </BSW-INTERRUPT-ENTITY>
                [!ENDIF!][!//
                [!IF "node:value(node:ref(CddI2cHwUnitRef)/InstanceName) = 'I2CB'"!][!//
                <BSW-INTERRUPT-ENTITY UUID="8d15b55e-c308-4409-b807-caea02acc479">
                  <SHORT-NAME>Cdd_I2c_I2CB_ISR</SHORT-NAME>
                  <REENTRANCY-LEVEL>NON-REENTRANT</REENTRANCY-LEVEL>
                  <IMPLEMENTED-ENTRY-REF DEST="BSW-MODULE-ENTRY">/Cdd_I2c_TI_F29H85x/Cdd_I2c_ModuleEntry/Cdd_I2c_I2CB_ISR</IMPLEMENTED-ENTRY-REF>
                  [!IF "CddI2cHwIrqType = 'ISR_CAT2_INT'"!][!//
                  <INTERRUPT-CATEGORY>CAT-2</INTERRUPT-CATEGORY>
                  [!ELSE!]
                  <INTERRUPT-CATEGORY>CAT-1</INTERRUPT-CATEGORY>
                  [!ENDIF!][!//
                </BSW-INTERRUPT-ENTITY>
                [!ENDIF!][!//
                [!ENDIF!][!//
                [!ENDLOOP!][!//
              </ENTITYS>
              [!IF "$HAS_CONTROLLER = 'true'"!][!//
              [!IF "$HAS_POLLING = 'true'"!][!//
              [!IF "node:exists(CddI2cGeneral/CddI2cMainFunctionPeriod)"!][!//
              <EVENTS>
                <BSW-TIMING-EVENT UUID="38294663-f034-493c-aecd-714bc6ac74c2">
                  <SHORT-NAME>Cdd_I2c_MainFunctionTimingEvent</SHORT-NAME>
                  <STARTS-ON-EVENT-REF DEST="BSW-SCHEDULABLE-ENTITY">/Cdd_I2c_TI_F29H85x/Cdd_I2c/Cdd_I2c_Behavior/Cdd_I2c_MainFunction</STARTS-ON-EVENT-REF>
                  <PERIOD>[!"CddI2cGeneral/CddI2cMainFunctionPeriod"!]</PERIOD>
                </BSW-TIMING-EVENT>
              </EVENTS>
              [!ENDIF!][!//
              [!ENDIF!][!//
              [!ENDIF!][!//
            </BSW-INTERNAL-BEHAVIOR>
          </INTERNAL-BEHAVIORS>
        </BSW-MODULE-DESCRIPTION>
        <BSW-IMPLEMENTATION UUID="11158848-eebe-4b14-80de-2d16d9f4acca">
          <SHORT-NAME>Cdd_I2c_Impl</SHORT-NAME>
          <CODE-DESCRIPTORS>
            <CODE UUID="9a854b76-2d42-49c6-b52b-1214b33f6ee7">
              <SHORT-NAME>Files</SHORT-NAME>
              <ARTIFACT-DESCRIPTORS>
                <AUTOSAR-ENGINEERING-OBJECT>
                  <SHORT-LABEL>include::Cdd_I2c_Hw.h</SHORT-LABEL>
                  <CATEGORY>SWHDR</CATEGORY>
                </AUTOSAR-ENGINEERING-OBJECT>
                <AUTOSAR-ENGINEERING-OBJECT>
                  <SHORT-LABEL>include::Cdd_I2c_Priv.h</SHORT-LABEL>
                  <CATEGORY>SWHDR</CATEGORY>
                </AUTOSAR-ENGINEERING-OBJECT>
                <AUTOSAR-ENGINEERING-OBJECT>
                  <SHORT-LABEL>include::Cdd_I2c_Utils.h</SHORT-LABEL>
                  <CATEGORY>SWHDR</CATEGORY>
                </AUTOSAR-ENGINEERING-OBJECT>
                <AUTOSAR-ENGINEERING-OBJECT>
                  <SHORT-LABEL>include::Cdd_I2c.h</SHORT-LABEL>
                  <CATEGORY>SWHDR</CATEGORY>
                </AUTOSAR-ENGINEERING-OBJECT>
                <AUTOSAR-ENGINEERING-OBJECT>
                  <SHORT-LABEL>src::Cdd_I2c_Hw.c</SHORT-LABEL>
                  <CATEGORY>SWSRC</CATEGORY>
                </AUTOSAR-ENGINEERING-OBJECT>
                <AUTOSAR-ENGINEERING-OBJECT>
                  <SHORT-LABEL>src::Cdd_I2c_Irq.c</SHORT-LABEL>
                  <CATEGORY>SWSRC</CATEGORY>
                </AUTOSAR-ENGINEERING-OBJECT>
                <AUTOSAR-ENGINEERING-OBJECT>
                  <SHORT-LABEL>src::Cdd_I2c_Priv.c</SHORT-LABEL>
                  <CATEGORY>SWSRC</CATEGORY>
                </AUTOSAR-ENGINEERING-OBJECT>
                <AUTOSAR-ENGINEERING-OBJECT>
                  <SHORT-LABEL>src::Cdd_I2c_Utils.c</SHORT-LABEL>
                  <CATEGORY>SWSRC</CATEGORY>
                </AUTOSAR-ENGINEERING-OBJECT>
                <AUTOSAR-ENGINEERING-OBJECT>
                  <SHORT-LABEL>src::Cdd_I2c.c</SHORT-LABEL>
                  <CATEGORY>SWSRC</CATEGORY>
                </AUTOSAR-ENGINEERING-OBJECT>
                <AUTOSAR-ENGINEERING-OBJECT>
                  <SHORT-LABEL>src::Cdd_I2c_Target.c</SHORT-LABEL>
                  <CATEGORY>SWSRC</CATEGORY>
                </AUTOSAR-ENGINEERING-OBJECT>
                <AUTOSAR-ENGINEERING-OBJECT>
                  <SHORT-LABEL>generate::include::Cdd_I2c_Cfg.h</SHORT-LABEL>
                  <CATEGORY>SWHDR</CATEGORY>
                </AUTOSAR-ENGINEERING-OBJECT>
                <AUTOSAR-ENGINEERING-OBJECT>
                  <SHORT-LABEL>generate::src::Cdd_I2c_Cfg.c</SHORT-LABEL>
                  <CATEGORY>SWSRC</CATEGORY>
                </AUTOSAR-ENGINEERING-OBJECT>
              </ARTIFACT-DESCRIPTORS>
            </CODE>
          </CODE-DESCRIPTORS>
          <COMPILERS>
            <COMPILER UUID="2da23763-9513-4d52-8093-d51fc358514e">
              <SHORT-NAME>TI_C29Clang</SHORT-NAME>
              <NAME>TI_C29Clang</NAME>
              <VENDOR>Texas Instruments</VENDOR>
              <VERSION>2.0.0</VERSION>
            </COMPILER>
          </COMPILERS>
          <LINKERS>
            <LINKER UUID="dd72e7e4-b374-44d6-84d8-2c4866fc12fc">
              <SHORT-NAME>TI_C29Linker</SHORT-NAME>
              <NAME>TI_C29Linker</NAME>
              <VENDOR>Texas Instruments</VENDOR>
              <VERSION>2.0.0</VERSION>
            </LINKER>
          </LINKERS>
          <PROGRAMMING-LANGUAGE>C</PROGRAMMING-LANGUAGE>
          <RESOURCE-CONSUMPTION UUID="5691302e-cc74-42bf-8f0c-a84e0d278bbd">
            <SHORT-NAME>ResourceConsumption</SHORT-NAME>
            <MEMORY-SECTIONS>
              <MEMORY-SECTION UUID="ae8dc642-8712-4c87-8586-657e93b743b6">
                <SHORT-NAME>CDD_I2C_CODE</SHORT-NAME>
                <ALIGNMENT>UNSPECIFIED</ALIGNMENT>
                <SW-ADDRMETHOD-REF DEST="SW-ADDR-METHOD">/AUTOSAR_MemMap/SwAddrMethods/CODE</SW-ADDRMETHOD-REF>
                <SYMBOL>CODE</SYMBOL>
              </MEMORY-SECTION>
              <MEMORY-SECTION UUID="790fd171-f8c6-4a01-84b1-8ae698122b5c">
                <SHORT-NAME>CDD_I2C_ISR_CODE</SHORT-NAME>
                <ALIGNMENT>UNSPECIFIED</ALIGNMENT>
                <SW-ADDRMETHOD-REF DEST="SW-ADDR-METHOD">/AUTOSAR_MemMap/SwAddrMethods/CODE</SW-ADDRMETHOD-REF>
                <SYMBOL>ISR_CODE</SYMBOL>
              </MEMORY-SECTION>
              <MEMORY-SECTION UUID="eda4fce0-decd-4eb5-9bad-2bbd579c190d">
                <SHORT-NAME>CDD_I2C_CONFIG_DATA</SHORT-NAME>
                <ALIGNMENT>UNSPECIFIED</ALIGNMENT>
                <SW-ADDRMETHOD-REF DEST="SW-ADDR-METHOD">/AUTOSAR_MemMap/SwAddrMethods/CONST_PBCFG</SW-ADDRMETHOD-REF>
                <SYMBOL>CONFIG_DATA</SYMBOL>
              </MEMORY-SECTION>
              <MEMORY-SECTION UUID="12560d44-2446-4427-aff9-7475e874866c">
                <SHORT-NAME>CDD_I2C_CONFIG_CONST_32</SHORT-NAME>
                <ALIGNMENT>32</ALIGNMENT>
                <SW-ADDRMETHOD-REF DEST="SW-ADDR-METHOD">/AUTOSAR_MemMap/SwAddrMethods/CONST</SW-ADDRMETHOD-REF>
                <SYMBOL>CONFIG_CONST_32</SYMBOL>
              </MEMORY-SECTION>
              <MEMORY-SECTION UUID="00f12352-2396-4dc6-9c68-9ba18ee15801">
                <SHORT-NAME>CDD_I2C_VAR_INIT_UNSPECIFIED</SHORT-NAME>
                <ALIGNMENT>UNSPECIFIED</ALIGNMENT>
                <SW-ADDRMETHOD-REF DEST="SW-ADDR-METHOD">/AUTOSAR_MemMap/SwAddrMethods/VAR_INIT</SW-ADDRMETHOD-REF>
                <SYMBOL>VAR_INIT_UNSPECIFIED</SYMBOL>
              </MEMORY-SECTION>
              <MEMORY-SECTION UUID="c62522cd-8b17-43f3-9766-46ee7161d85f">
                <SHORT-NAME>CDD_I2C_VAR_NO_INIT_UNSPECIFIED</SHORT-NAME>
                <ALIGNMENT>UNSPECIFIED</ALIGNMENT>
                <SW-ADDRMETHOD-REF DEST="SW-ADDR-METHOD">/AUTOSAR_MemMap/SwAddrMethods/VAR_NO_INIT</SW-ADDRMETHOD-REF>
                <SYMBOL>VAR_NO_INIT_UNSPECIFIED</SYMBOL>
              </MEMORY-SECTION>
            </MEMORY-SECTIONS>
          </RESOURCE-CONSUMPTION>
          <SW-VERSION>[!"$moduleSoftwareVer"!]</SW-VERSION>
          <VENDOR-ID>44</VENDOR-ID>
          <AR-RELEASE-VERSION>[!"substring-after($moduleReleaseVer, 'AUTOSAR ')"!]</AR-RELEASE-VERSION>
          <BEHAVIOR-REF DEST="BSW-INTERNAL-BEHAVIOR">/Cdd_I2c_TI_F29H85x/Cdd_I2c/Cdd_I2c_Behavior</BEHAVIOR-REF>
          <VENDOR-SPECIFIC-MODULE-DEF-REFS>
            <VENDOR-SPECIFIC-MODULE-DEF-REF DEST="ECUC-MODULE-DEF">/TI_F29H85x/Cdd_I2c/Cdd</VENDOR-SPECIFIC-MODULE-DEF-REF>
          </VENDOR-SPECIFIC-MODULE-DEF-REFS>
        </BSW-IMPLEMENTATION>
      </ELEMENTS>
      <AR-PACKAGES>
        <AR-PACKAGE UUID="7b772cec-fde3-457a-8a77-c34d6e58d14d">
          <SHORT-NAME>Cdd_I2c_ModuleEntry</SHORT-NAME>
          <ELEMENTS>
            <BSW-MODULE-ENTRY UUID="af4d4359-315f-4ee3-a942-a51bb433a1f8">
              <SHORT-NAME>Cdd_I2c_Init</SHORT-NAME>
              <SERVICE-ID>0</SERVICE-ID>
              <IS-REENTRANT>false</IS-REENTRANT>
              <IS-SYNCHRONOUS>true</IS-SYNCHRONOUS>
              <CALL-TYPE>REGULAR</CALL-TYPE>
              <EXECUTION-CONTEXT>UNSPECIFIED</EXECUTION-CONTEXT>
              <SW-SERVICE-IMPL-POLICY>STANDARD</SW-SERVICE-IMPL-POLICY>
              <BSW-ENTRY-KIND>CONCRETE</BSW-ENTRY-KIND>
            </BSW-MODULE-ENTRY>
            <BSW-MODULE-ENTRY UUID="50714b70-f6b7-493c-bc2a-66ed61a09202">
              <SHORT-NAME>Cdd_I2c_DeInit</SHORT-NAME>
              <SERVICE-ID>1</SERVICE-ID>
              <IS-REENTRANT>false</IS-REENTRANT>
              <IS-SYNCHRONOUS>true</IS-SYNCHRONOUS>
              <CALL-TYPE>REGULAR</CALL-TYPE>
              <EXECUTION-CONTEXT>UNSPECIFIED</EXECUTION-CONTEXT>
              <SW-SERVICE-IMPL-POLICY>STANDARD</SW-SERVICE-IMPL-POLICY>
              <BSW-ENTRY-KIND>CONCRETE</BSW-ENTRY-KIND>
            </BSW-MODULE-ENTRY>
            <BSW-MODULE-ENTRY UUID="6c5c61d8-761d-4506-be52-7fa7b58e9953">
              <SHORT-NAME>Cdd_I2c_GetVersionInfo</SHORT-NAME>
              <SERVICE-ID>2</SERVICE-ID>
              <IS-REENTRANT>true</IS-REENTRANT>
              <IS-SYNCHRONOUS>true</IS-SYNCHRONOUS>
              <CALL-TYPE>REGULAR</CALL-TYPE>
              <EXECUTION-CONTEXT>UNSPECIFIED</EXECUTION-CONTEXT>
              <SW-SERVICE-IMPL-POLICY>STANDARD</SW-SERVICE-IMPL-POLICY>
              <BSW-ENTRY-KIND>CONCRETE</BSW-ENTRY-KIND>
            </BSW-MODULE-ENTRY>
            <BSW-MODULE-ENTRY UUID="509bb7c7-d5d5-4755-aafc-cb7a6e1829c0">
              <SHORT-NAME>Cdd_I2c_ResetHwUnit</SHORT-NAME>
              <SERVICE-ID>12</SERVICE-ID>
              <IS-REENTRANT>false</IS-REENTRANT>
              <IS-SYNCHRONOUS>true</IS-SYNCHRONOUS>
              <CALL-TYPE>REGULAR</CALL-TYPE>
              <EXECUTION-CONTEXT>UNSPECIFIED</EXECUTION-CONTEXT>
              <SW-SERVICE-IMPL-POLICY>STANDARD</SW-SERVICE-IMPL-POLICY>
              <BSW-ENTRY-KIND>CONCRETE</BSW-ENTRY-KIND>
            </BSW-MODULE-ENTRY>
            <BSW-MODULE-ENTRY UUID="0dc69f57-cbaa-480c-a867-3639dc20bf56">
              <SHORT-NAME>Cdd_I2c_SetupEB</SHORT-NAME>
              <SERVICE-ID>3</SERVICE-ID>
              <IS-REENTRANT>true</IS-REENTRANT>
              <IS-SYNCHRONOUS>true</IS-SYNCHRONOUS>
              <CALL-TYPE>REGULAR</CALL-TYPE>
              <EXECUTION-CONTEXT>UNSPECIFIED</EXECUTION-CONTEXT>
              <SW-SERVICE-IMPL-POLICY>STANDARD</SW-SERVICE-IMPL-POLICY>
              <BSW-ENTRY-KIND>CONCRETE</BSW-ENTRY-KIND>
            </BSW-MODULE-ENTRY>
            <BSW-MODULE-ENTRY UUID="0056c5d5-317a-4a35-bfb7-ff04de52eeb7">
              <SHORT-NAME>Cdd_I2c_SetupEBDynamic</SHORT-NAME>
              <SERVICE-ID>4</SERVICE-ID>
              <IS-REENTRANT>true</IS-REENTRANT>
              <IS-SYNCHRONOUS>true</IS-SYNCHRONOUS>
              <CALL-TYPE>REGULAR</CALL-TYPE>
              <EXECUTION-CONTEXT>UNSPECIFIED</EXECUTION-CONTEXT>
              <SW-SERVICE-IMPL-POLICY>STANDARD</SW-SERVICE-IMPL-POLICY>
              <BSW-ENTRY-KIND>CONCRETE</BSW-ENTRY-KIND>
            </BSW-MODULE-ENTRY>
            <BSW-MODULE-ENTRY UUID="3e83d415-5b12-45d0-b650-b5ee84b4a15c">
              <SHORT-NAME>Cdd_I2c_AsyncTransmit</SHORT-NAME>
              <SERVICE-ID>5</SERVICE-ID>
              <IS-REENTRANT>true</IS-REENTRANT>
              <IS-SYNCHRONOUS>false</IS-SYNCHRONOUS>
              <CALL-TYPE>REGULAR</CALL-TYPE>
              <EXECUTION-CONTEXT>UNSPECIFIED</EXECUTION-CONTEXT>
              <SW-SERVICE-IMPL-POLICY>STANDARD</SW-SERVICE-IMPL-POLICY>
              <BSW-ENTRY-KIND>CONCRETE</BSW-ENTRY-KIND>
            </BSW-MODULE-ENTRY>
            <BSW-MODULE-ENTRY UUID="15c6fa01-0629-4521-bcd9-22302c66da27">
              <SHORT-NAME>Cdd_I2c_Cancel</SHORT-NAME>
              <SERVICE-ID>6</SERVICE-ID>
              <IS-REENTRANT>false</IS-REENTRANT>
              <IS-SYNCHRONOUS>true</IS-SYNCHRONOUS>
              <CALL-TYPE>REGULAR</CALL-TYPE>
              <EXECUTION-CONTEXT>UNSPECIFIED</EXECUTION-CONTEXT>
              <SW-SERVICE-IMPL-POLICY>STANDARD</SW-SERVICE-IMPL-POLICY>
              <BSW-ENTRY-KIND>CONCRETE</BSW-ENTRY-KIND>
            </BSW-MODULE-ENTRY>
            <BSW-MODULE-ENTRY UUID="2243f72d-f3ec-4727-bdde-8df5e4905268">
              <SHORT-NAME>Cdd_I2c_MainFunction</SHORT-NAME>
              <SERVICE-ID>9</SERVICE-ID>
              <IS-REENTRANT>true</IS-REENTRANT>
              <IS-SYNCHRONOUS>true</IS-SYNCHRONOUS>
              <CALL-TYPE>SCHEDULED</CALL-TYPE>
              <EXECUTION-CONTEXT>UNSPECIFIED</EXECUTION-CONTEXT>
              <SW-SERVICE-IMPL-POLICY>STANDARD</SW-SERVICE-IMPL-POLICY>
              <BSW-ENTRY-KIND>CONCRETE</BSW-ENTRY-KIND>
            </BSW-MODULE-ENTRY>
            <BSW-MODULE-ENTRY UUID="063d54c5-3427-4a96-9a87-10b045bb7a47">
              <SHORT-NAME>Cdd_I2c_PollingModeProcessing</SHORT-NAME>
              <SERVICE-ID>10</SERVICE-ID>
              <IS-REENTRANT>true</IS-REENTRANT>
              <IS-SYNCHRONOUS>true</IS-SYNCHRONOUS>
              <CALL-TYPE>REGULAR</CALL-TYPE>
              <EXECUTION-CONTEXT>UNSPECIFIED</EXECUTION-CONTEXT>
              <SW-SERVICE-IMPL-POLICY>STANDARD</SW-SERVICE-IMPL-POLICY>
              <BSW-ENTRY-KIND>CONCRETE</BSW-ENTRY-KIND>
            </BSW-MODULE-ENTRY>
            <BSW-MODULE-ENTRY UUID="b29c7de4-3075-4f2c-8a9f-2f10448c020b">
              <SHORT-NAME>Cdd_I2c_GetSequenceResult</SHORT-NAME>
              <SERVICE-ID>8</SERVICE-ID>
              <IS-REENTRANT>true</IS-REENTRANT>
              <IS-SYNCHRONOUS>true</IS-SYNCHRONOUS>
              <CALL-TYPE>REGULAR</CALL-TYPE>
              <EXECUTION-CONTEXT>UNSPECIFIED</EXECUTION-CONTEXT>
              <SW-SERVICE-IMPL-POLICY>STANDARD</SW-SERVICE-IMPL-POLICY>
              <BSW-ENTRY-KIND>CONCRETE</BSW-ENTRY-KIND>
            </BSW-MODULE-ENTRY>
            <BSW-MODULE-ENTRY UUID="0a205713-e6d2-458a-8bef-1161026ef0f5">
              <SHORT-NAME>Cdd_I2c_GetResult</SHORT-NAME>
              <SERVICE-ID>7</SERVICE-ID>
              <IS-REENTRANT>true</IS-REENTRANT>
              <IS-SYNCHRONOUS>true</IS-SYNCHRONOUS>
              <CALL-TYPE>REGULAR</CALL-TYPE>
              <EXECUTION-CONTEXT>UNSPECIFIED</EXECUTION-CONTEXT>
              <SW-SERVICE-IMPL-POLICY>STANDARD</SW-SERVICE-IMPL-POLICY>
              <BSW-ENTRY-KIND>CONCRETE</BSW-ENTRY-KIND>
            </BSW-MODULE-ENTRY>
            <BSW-MODULE-ENTRY UUID="a9380562-75ac-4c5c-9f28-f0da1058c686">
              <SHORT-NAME>Cdd_I2c_GetStatus</SHORT-NAME>
              <SERVICE-ID>11</SERVICE-ID>
              <IS-REENTRANT>true</IS-REENTRANT>
              <IS-SYNCHRONOUS>true</IS-SYNCHRONOUS>
              <CALL-TYPE>REGULAR</CALL-TYPE>
              <EXECUTION-CONTEXT>UNSPECIFIED</EXECUTION-CONTEXT>
              <SW-SERVICE-IMPL-POLICY>STANDARD</SW-SERVICE-IMPL-POLICY>
              <BSW-ENTRY-KIND>CONCRETE</BSW-ENTRY-KIND>
            </BSW-MODULE-ENTRY>
            <BSW-MODULE-ENTRY UUID="e81f7575-81ff-4f10-9b61-d4c109110247">
              <SHORT-NAME>Cdd_I2c_TargetStart</SHORT-NAME>
              <SERVICE-ID>32</SERVICE-ID>
              <IS-REENTRANT>true</IS-REENTRANT>
              <IS-SYNCHRONOUS>true</IS-SYNCHRONOUS>
              <CALL-TYPE>REGULAR</CALL-TYPE>
              <EXECUTION-CONTEXT>UNSPECIFIED</EXECUTION-CONTEXT>
              <SW-SERVICE-IMPL-POLICY>STANDARD</SW-SERVICE-IMPL-POLICY>
              <BSW-ENTRY-KIND>CONCRETE</BSW-ENTRY-KIND>
            </BSW-MODULE-ENTRY>
            <BSW-MODULE-ENTRY UUID="22b162a4-05fe-403b-acfb-754be1bcf85f">
              <SHORT-NAME>Cdd_I2c_TargetStop</SHORT-NAME>
              <SERVICE-ID>33</SERVICE-ID>
              <IS-REENTRANT>true</IS-REENTRANT>
              <IS-SYNCHRONOUS>true</IS-SYNCHRONOUS>
              <CALL-TYPE>REGULAR</CALL-TYPE>
              <EXECUTION-CONTEXT>UNSPECIFIED</EXECUTION-CONTEXT>
              <SW-SERVICE-IMPL-POLICY>STANDARD</SW-SERVICE-IMPL-POLICY>
              <BSW-ENTRY-KIND>CONCRETE</BSW-ENTRY-KIND>
            </BSW-MODULE-ENTRY>
            <BSW-MODULE-ENTRY UUID="40e08241-5048-4e36-8bf5-69e1c80fb1a5">
              <SHORT-NAME>Cdd_I2c_TargetSubmitTxBuffer</SHORT-NAME>
              <SERVICE-ID>34</SERVICE-ID>
              <IS-REENTRANT>true</IS-REENTRANT>
              <IS-SYNCHRONOUS>true</IS-SYNCHRONOUS>
              <CALL-TYPE>REGULAR</CALL-TYPE>
              <EXECUTION-CONTEXT>UNSPECIFIED</EXECUTION-CONTEXT>
              <SW-SERVICE-IMPL-POLICY>STANDARD</SW-SERVICE-IMPL-POLICY>
              <BSW-ENTRY-KIND>CONCRETE</BSW-ENTRY-KIND>
            </BSW-MODULE-ENTRY>
            <BSW-MODULE-ENTRY UUID="a8553e84-60f2-4717-a185-825d4d802d78">
              <SHORT-NAME>Cdd_I2c_TargetSubmitRxBuffer</SHORT-NAME>
              <SERVICE-ID>35</SERVICE-ID>
              <IS-REENTRANT>true</IS-REENTRANT>
              <IS-SYNCHRONOUS>true</IS-SYNCHRONOUS>
              <CALL-TYPE>REGULAR</CALL-TYPE>
              <EXECUTION-CONTEXT>UNSPECIFIED</EXECUTION-CONTEXT>
              <SW-SERVICE-IMPL-POLICY>STANDARD</SW-SERVICE-IMPL-POLICY>
              <BSW-ENTRY-KIND>CONCRETE</BSW-ENTRY-KIND>
            </BSW-MODULE-ENTRY>
            <BSW-MODULE-ENTRY UUID="d701b6b8-07a4-4b4b-8f23-659d958ad6ac">
              <SHORT-NAME>Cdd_I2c_I2CA_ISR</SHORT-NAME>
              <IS-REENTRANT>false</IS-REENTRANT>
              <IS-SYNCHRONOUS>true</IS-SYNCHRONOUS>
              <CALL-TYPE>INTERRUPT</CALL-TYPE>
              [!IF "CddI2cHwIrqType = 'ISR_CAT2_INT'"!][!//
              <EXECUTION-CONTEXT>INTERRUPT-CAT-2</EXECUTION-CONTEXT>
              [!ELSE!]
              <EXECUTION-CONTEXT>INTERRUPT-CAT-1</EXECUTION-CONTEXT>
              [!ENDIF!][!//
              <SW-SERVICE-IMPL-POLICY>STANDARD</SW-SERVICE-IMPL-POLICY>
              <BSW-ENTRY-KIND>CONCRETE</BSW-ENTRY-KIND>
            </BSW-MODULE-ENTRY>
            <BSW-MODULE-ENTRY UUID="70651793-dd36-4916-b1e5-fa94e71ace3f">
              <SHORT-NAME>Cdd_I2c_I2CB_ISR</SHORT-NAME>
              <IS-REENTRANT>false</IS-REENTRANT>
              <IS-SYNCHRONOUS>true</IS-SYNCHRONOUS>
              <CALL-TYPE>INTERRUPT</CALL-TYPE>
              [!IF "CddI2cHwIrqType = 'ISR_CAT2_INT'"!][!//
              <EXECUTION-CONTEXT>INTERRUPT-CAT-2</EXECUTION-CONTEXT>
              [!ELSE!]
              <EXECUTION-CONTEXT>INTERRUPT-CAT-1</EXECUTION-CONTEXT>
              [!ENDIF!][!//
              <SW-SERVICE-IMPL-POLICY>STANDARD</SW-SERVICE-IMPL-POLICY>
              <BSW-ENTRY-KIND>CONCRETE</BSW-ENTRY-KIND>
            </BSW-MODULE-ENTRY>
          </ELEMENTS>
        </AR-PACKAGE>
      </AR-PACKAGES>
    </AR-PACKAGE>
  </AR-PACKAGES>
</AUTOSAR>
[!ENDSELECT!]
