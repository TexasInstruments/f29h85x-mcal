AUTOSAR XML (schema 00044)
package /TI_F29H85x/Cdd_I2c
  ecuc definition collection myEcuParameterDefinition: module=Cdd
  module definition Cdd: api-service-prefix=Cdd_I2c, refined-module-def=Cdd, variants pre-compile  # Configuration of the CDD(Complex device driver) I2C module.
    container CddI2cGeneral  # General configuration settings for Complex device driver
      boolean CddI2cDevErrorDetect: origin=Texas Instruments, set at pre-compile, default-value=true  # I2c Dev Error ON/OFF.
      boolean CddI2cUseInterrupts: origin=Texas Instruments, set at pre-compile, default-value=false  # Switches to activate or deactivate interrupt controlled job processing(ON/OFF).
      boolean CddI2cVersionInfoApi: origin=Texas Instruments, set at pre-compile, default-value=true  # Pre-processor switch to enable/disable the get version info API.
      boolean CddI2cCancelApi: origin=Texas Instruments, set at pre-compile, default-value=false  # Pre-processor switch to enable/disable the cancel API.
      boolean CddI2cStatusApi: origin=Texas Instruments, set at pre-compile, default-value=false  # Pre-processor switch to enable/disable the get status API.
      float CddI2cMainFunctionPeriod [0..1]: 0.0..INF, multiplicity set at pre-compile, origin=Texas Instruments, set at pre-compile, default-value=0.01  # This parameter describes the period for cyclic call to Cdd_I2c_MainFunction. Unit is seconds.
    container CddI2cHwConfig [1..2]: multiplicity set at pre-compile  # This container contains the HW unit initialization parameters
      integer CddI2cHwBaudrate: 10000..400000, scope=ECU, origin=Texas Instruments, set at pre-compile, default-value=400000  # Channel Bit Rate (Range = 10kbps - 400kbps). Value needs to be provided in bits per second.
      integer CddI2cHwUnitFrequency: 7000000..12000000, scope=ECU, origin=Texas Instruments, set at pre-compile, default-value=10000000  # Frequency which the HW unit will utilize(Range = 7 MHz - 12 MHz), please note that this differs from the bus frequency used for communication
      integer CddI2cHwOwnAddress: 0..1023, origin=Texas Instruments, set at pre-compile, default-value=127  # Own address - used in both 7 and 10-bit address mode.
      enumeration CddI2cHwIrqType: {ISR_CAT1_INT, ISR_CAT1_RTINT, ISR_CAT2_INT}, origin=Texas Instruments, set at pre-compile, default-value=ISR_CAT1_RTINT  # This parameters defines the category of the interrupt.
      reference CddI2cHwUnitRef: origin=Texas Instruments, set at pre-compile, destination=Cdd_I2cAllocatedInstance  # Reference to I2c HW unit to use.
      reference CddI2cHwFunctionalClock: origin=Texas Instruments, set at pre-compile, destination=McuClockReferencePoint  # Reference to a container of the type McuClockReferencePoint, to select an input clock.
    container CddI2cChConfig [1..*]: multiplicity set at pre-compile  # This container contains the Channel configurations
      enumeration CddI2cChDirection: {WRITE, READ}, scope=ECU, origin=Texas Instruments, set at pre-compile, default-value=WRITE  # Selection of Channel direction.
      integer CddI2cChTargetAddress: 0..1023, scope=ECU, origin=Texas Instruments, set at pre-compile, default-value=0  # Set target address for channel
      enumeration CddI2cChTargetAddressScheme: {ADDRESS_7_BIT, ADDRESS_10_BIT}, scope=ECU, origin=Texas Instruments, set at pre-compile, default-value=ADDRESS_7_BIT  # Specifies whether channel is 7 bit or 10 bit.
    container CddI2cSeqConfig [1..*]: multiplicity set at pre-compile  # This container contains the Sequence configurations
      function name CddI2cSeqCompleteNotify: origin=Texas Instruments, set at pre-compile, default-value=NULL_PTR  # Function pointer to callback function sequence complete notify
      function name CddI2cSeqErrorNotify: origin=Texas Instruments, set at pre-compile, default-value=NULL_PTR  # Function pointer to callback function sequence complete notify
      enumeration CddI2cSeqRestartModeType: {RESTART_MODE_STOP, RESTART_MODE_NOSTOP}, origin=Texas Instruments, set at pre-compile, default-value=RESTART_MODE_STOP  # I2c transfer mode.
      reference CddI2cSeqHwUnitAssignment: origin=Texas Instruments, set at pre-compile, destination=CddI2cHwConfig  # I2c HW unit reference to use.
      container CddI2cSeqChList [1..*]: multiplicity set at pre-compile  # References to I2c channels and their order within the Sequence.
        reference CddI2cSeqChAssignment: origin=Texas Instruments, set at pre-compile, destination=CddI2cChConfig  # A Sequence reference to a I2c channel.
