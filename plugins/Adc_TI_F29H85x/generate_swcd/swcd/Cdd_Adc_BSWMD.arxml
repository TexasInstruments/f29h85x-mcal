[!AUTOSPACING!][!//
[!VAR "PpbEvtNotification"="num:i(0)"!]
[!LOOP "as:modconf('Cdd_Adc/Cdd')[as:path(node:dtos(.))='/TI_F29H85x/Cdd_Adc/Cdd']/CddAdcConfigSet/CddAdcHwUnit/*/CddAdcPpbConfig/*"!]
    [!IF "not(node:empty(CddAdcPpbEventInterruptNotification))"!]
        [!VAR "PpbEvtNotification"="num:i($PpbEvtNotification+1)"!]
    [!ENDIF!]
[!ENDLOOP!]
<?xml version="1.0" encoding="UTF-8"?>
[!SELECT "as:modconf('Cdd_Adc/Cdd')[as:path(node:dtos(.))='/TI_F29H85x/Cdd_Adc/Cdd']"!]
<AUTOSAR xmlns="http://autosar.org/schema/r4.0" xmlns:xsi="http://www.w3.org/2001/XMLSchema-instance" xsi:schemaLocation="http://autosar.org/schema/r4.0 AUTOSAR_00044.xsd">
  <AR-PACKAGES>
    <AR-PACKAGE UUID="4a6c5ff5-be59-442c-8754-71aa2d3157dc">
      <SHORT-NAME>Cdd_Adc_TI_F29H85x</SHORT-NAME>
      <ELEMENTS>
        <BSW-MODULE-DESCRIPTION UUID="f10365d7-7bbc-479a-8d68-b489f92a46d9">
          <SHORT-NAME>Cdd_Adc</SHORT-NAME>
          <CATEGORY>BSW_MODULE</CATEGORY>
          <IMPLEMENTED-ENTRYS>
          [!LOOP "CddAdcConfigSet/CddAdcHwUnit/*"!]
          [!IF "node:value(CddAdcHwInstance) = 'CDD_ADCA'"!]
            [!LOOP ".//*[@name='CddAdcInterruptSelect']"!]
            [!IF "node:value(.) = 'CDD_ADC_INT1'"!]
            <BSW-MODULE-ENTRY-REF-CONDITIONAL>
              <BSW-MODULE-ENTRY-REF DEST="BSW-MODULE-ENTRY">/Cdd_Adc_TI_F29H85x/Cdd_Adc_ModuleEntry/Cdd_Adc_ADCA_Int1Isr</BSW-MODULE-ENTRY-REF>
            </BSW-MODULE-ENTRY-REF-CONDITIONAL>
            [!ENDIF!]
            [!IF "node:value(.) = 'CDD_ADC_INT2'"!]            
            <BSW-MODULE-ENTRY-REF-CONDITIONAL>
              <BSW-MODULE-ENTRY-REF DEST="BSW-MODULE-ENTRY">/Cdd_Adc_TI_F29H85x/Cdd_Adc_ModuleEntry/Cdd_Adc_ADCA_Int2Isr</BSW-MODULE-ENTRY-REF>
            </BSW-MODULE-ENTRY-REF-CONDITIONAL>
            [!ENDIF!]
            [!IF "node:value(.) = 'CDD_ADC_INT3'"!]
            <BSW-MODULE-ENTRY-REF-CONDITIONAL>
              <BSW-MODULE-ENTRY-REF DEST="BSW-MODULE-ENTRY">/Cdd_Adc_TI_F29H85x/Cdd_Adc_ModuleEntry/Cdd_Adc_ADCA_Int3Isr</BSW-MODULE-ENTRY-REF>
            </BSW-MODULE-ENTRY-REF-CONDITIONAL>
            [!ENDIF!]
            [!IF "node:value(.) = 'CDD_ADC_INT4'"!]            
            <BSW-MODULE-ENTRY-REF-CONDITIONAL>
              <BSW-MODULE-ENTRY-REF DEST="BSW-MODULE-ENTRY">/Cdd_Adc_TI_F29H85x/Cdd_Adc_ModuleEntry/Cdd_Adc_ADCA_Int4Isr</BSW-MODULE-ENTRY-REF>
            </BSW-MODULE-ENTRY-REF-CONDITIONAL>
            [!ENDIF!]
            [!ENDLOOP!]
            [!LOOP "CddAdcPpbConfig/*"!]
            [!IF "(CddAdcPpbTripHighInterruptEnable = 'true' or CddAdcPpbTripLowInterruptEnable = 'true' or CddAdcPpbZeroCrossingInterruptEnable = 'true')"!]
            <BSW-MODULE-ENTRY-REF-CONDITIONAL>
              <BSW-MODULE-ENTRY-REF DEST="BSW-MODULE-ENTRY">/Cdd_Adc_TI_F29H85x/Cdd_Adc_ModuleEntry/Cdd_Adc_ADCA_PpbIntIsr</BSW-MODULE-ENTRY-REF>
            </BSW-MODULE-ENTRY-REF-CONDITIONAL>
            [!BREAK!]
            [!ENDIF!]
            [!ENDLOOP!]
          [!ENDIF!]
          [!IF "node:value(CddAdcHwInstance) = 'CDD_ADCB'"!]
            [!LOOP ".//*[@name='CddAdcInterruptSelect']"!]
            [!IF "node:value(.) = 'CDD_ADC_INT1'"!]
            <BSW-MODULE-ENTRY-REF-CONDITIONAL>
              <BSW-MODULE-ENTRY-REF DEST="BSW-MODULE-ENTRY">/Cdd_Adc_TI_F29H85x/Cdd_Adc_ModuleEntry/Cdd_Adc_ADCB_Int1Isr</BSW-MODULE-ENTRY-REF>
            </BSW-MODULE-ENTRY-REF-CONDITIONAL>
            [!ENDIF!]
            [!IF "node:value(.) = 'CDD_ADC_INT2'"!]           
            <BSW-MODULE-ENTRY-REF-CONDITIONAL>
              <BSW-MODULE-ENTRY-REF DEST="BSW-MODULE-ENTRY">/Cdd_Adc_TI_F29H85x/Cdd_Adc_ModuleEntry/Cdd_Adc_ADCB_Int2Isr</BSW-MODULE-ENTRY-REF>
            </BSW-MODULE-ENTRY-REF-CONDITIONAL>
            [!ENDIF!]
            [!IF "node:value(.) = 'CDD_ADC_INT3'"!] 
            <BSW-MODULE-ENTRY-REF-CONDITIONAL>
              <BSW-MODULE-ENTRY-REF DEST="BSW-MODULE-ENTRY">/Cdd_Adc_TI_F29H85x/Cdd_Adc_ModuleEntry/Cdd_Adc_ADCB_Int3Isr</BSW-MODULE-ENTRY-REF>
            </BSW-MODULE-ENTRY-REF-CONDITIONAL>
            [!ENDIF!]
            [!IF "node:value(.) = 'CDD_ADC_INT4'"!]                
            <BSW-MODULE-ENTRY-REF-CONDITIONAL>
              <BSW-MODULE-ENTRY-REF DEST="BSW-MODULE-ENTRY">/Cdd_Adc_TI_F29H85x/Cdd_Adc_ModuleEntry/Cdd_Adc_ADCB_Int4Isr</BSW-MODULE-ENTRY-REF>
            </BSW-MODULE-ENTRY-REF-CONDITIONAL>
            [!ENDIF!]
            [!ENDLOOP!]
            [!LOOP "CddAdcPpbConfig/*"!]
            [!IF "(CddAdcPpbTripHighInterruptEnable = 'true' or CddAdcPpbTripLowInterruptEnable = 'true' or CddAdcPpbZeroCrossingInterruptEnable = 'true')"!]
            <BSW-MODULE-ENTRY-REF-CONDITIONAL>
              <BSW-MODULE-ENTRY-REF DEST="BSW-MODULE-ENTRY">/Cdd_Adc_TI_F29H85x/Cdd_Adc_ModuleEntry/Cdd_Adc_ADCB_PpbIntIsr</BSW-MODULE-ENTRY-REF>
            </BSW-MODULE-ENTRY-REF-CONDITIONAL>
            [!BREAK!]
            [!ENDIF!]
            [!ENDLOOP!]
          [!ELSE!]
          [!ENDIF!]           
          [!IF "node:value(CddAdcHwInstance) = 'CDD_ADCC'"!]
            [!LOOP ".//*[@name='CddAdcInterruptSelect']"!]
            [!IF "node:value(.) = 'CDD_ADC_INT1'"!]
            <BSW-MODULE-ENTRY-REF-CONDITIONAL>
              <BSW-MODULE-ENTRY-REF DEST="BSW-MODULE-ENTRY">/Cdd_Adc_TI_F29H85x/Cdd_Adc_ModuleEntry/Cdd_Adc_ADCC_Int1Isr</BSW-MODULE-ENTRY-REF>
            </BSW-MODULE-ENTRY-REF-CONDITIONAL>
            [!ENDIF!]
            [!IF "node:value(.) = 'CDD_ADC_INT2'"!]
            <BSW-MODULE-ENTRY-REF-CONDITIONAL>
              <BSW-MODULE-ENTRY-REF DEST="BSW-MODULE-ENTRY">/Cdd_Adc_TI_F29H85x/Cdd_Adc_ModuleEntry/Cdd_Adc_ADCC_Int2Isr</BSW-MODULE-ENTRY-REF>
            </BSW-MODULE-ENTRY-REF-CONDITIONAL>
            [!ENDIF!]
            [!IF "node:value(.) = 'CDD_ADC_INT3'"!]
            <BSW-MODULE-ENTRY-REF-CONDITIONAL>
              <BSW-MODULE-ENTRY-REF DEST="BSW-MODULE-ENTRY">/Cdd_Adc_TI_F29H85x/Cdd_Adc_ModuleEntry/Cdd_Adc_ADCC_Int3Isr</BSW-MODULE-ENTRY-REF>
            </BSW-MODULE-ENTRY-REF-CONDITIONAL>
            [!ENDIF!]
            [!IF "node:value(.) = 'CDD_ADC_INT4'"!]
            <BSW-MODULE-ENTRY-REF-CONDITIONAL>
              <BSW-MODULE-ENTRY-REF DEST="BSW-MODULE-ENTRY">/Cdd_Adc_TI_F29H85x/Cdd_Adc_ModuleEntry/Cdd_Adc_ADCC_Int4Isr</BSW-MODULE-ENTRY-REF>
            </BSW-MODULE-ENTRY-REF-CONDITIONAL>
            [!ENDIF!]
            [!ENDLOOP!]
            [!LOOP "CddAdcPpbConfig/*"!]
            [!IF "(CddAdcPpbTripHighInterruptEnable = 'true' or CddAdcPpbTripLowInterruptEnable = 'true' or CddAdcPpbZeroCrossingInterruptEnable = 'true')"!]
            <BSW-MODULE-ENTRY-REF-CONDITIONAL>
              <BSW-MODULE-ENTRY-REF DEST="BSW-MODULE-ENTRY">/Cdd_Adc_TI_F29H85x/Cdd_Adc_ModuleEntry/Cdd_Adc_ADCC_PpbIntIsr</BSW-MODULE-ENTRY-REF>
            </BSW-MODULE-ENTRY-REF-CONDITIONAL>
            [!BREAK!]
            [!ENDIF!]
            [!ENDLOOP!]
          [!ENDIF!]           
          [!IF "node:value(CddAdcHwInstance) = 'CDD_ADCD'"!]
            [!LOOP ".//*[@name='CddAdcInterruptSelect']"!]
            [!IF "node:value(.) = 'CDD_ADC_INT1'"!]
            <BSW-MODULE-ENTRY-REF-CONDITIONAL>
              <BSW-MODULE-ENTRY-REF DEST="BSW-MODULE-ENTRY">/Cdd_Adc_TI_F29H85x/Cdd_Adc_ModuleEntry/Cdd_Adc_ADCD_Int1Isr</BSW-MODULE-ENTRY-REF>
            </BSW-MODULE-ENTRY-REF-CONDITIONAL>
            [!ENDIF!]
            [!IF "node:value(.) = 'CDD_ADC_INT2'"!]
            <BSW-MODULE-ENTRY-REF-CONDITIONAL>
              <BSW-MODULE-ENTRY-REF DEST="BSW-MODULE-ENTRY">/Cdd_Adc_TI_F29H85x/Cdd_Adc_ModuleEntry/Cdd_Adc_ADCD_Int2Isr</BSW-MODULE-ENTRY-REF>
            </BSW-MODULE-ENTRY-REF-CONDITIONAL>
            [!ENDIF!]
            [!IF "node:value(.) = 'CDD_ADC_INT3'"!]
            <BSW-MODULE-ENTRY-REF-CONDITIONAL>
              <BSW-MODULE-ENTRY-REF DEST="BSW-MODULE-ENTRY">/Cdd_Adc_TI_F29H85x/Cdd_Adc_ModuleEntry/Cdd_Adc_ADCD_Int3Isr</BSW-MODULE-ENTRY-REF>
            </BSW-MODULE-ENTRY-REF-CONDITIONAL>
            [!ENDIF!]
            [!IF "node:value(.) = 'CDD_ADC_INT4'"!]
            <BSW-MODULE-ENTRY-REF-CONDITIONAL>
              <BSW-MODULE-ENTRY-REF DEST="BSW-MODULE-ENTRY">/Cdd_Adc_TI_F29H85x/Cdd_Adc_ModuleEntry/Cdd_Adc_ADCD_Int4Isr</BSW-MODULE-ENTRY-REF>
            </BSW-MODULE-ENTRY-REF-CONDITIONAL>
            [!ENDIF!]
            [!ENDLOOP!]
            [!LOOP "CddAdcPpbConfig/*"!]
            [!IF "(CddAdcPpbTripHighInterruptEnable = 'true' or CddAdcPpbTripLowInterruptEnable = 'true' or CddAdcPpbZeroCrossingInterruptEnable = 'true')"!]
            <BSW-MODULE-ENTRY-REF-CONDITIONAL>
              <BSW-MODULE-ENTRY-REF DEST="BSW-MODULE-ENTRY">/Cdd_Adc_TI_F29H85x/Cdd_Adc_ModuleEntry/Cdd_Adc_ADCD_PpbIntIsr</BSW-MODULE-ENTRY-REF>
            </BSW-MODULE-ENTRY-REF-CONDITIONAL>
            [!BREAK!]            
            [!ENDIF!]
            [!ENDLOOP!]
          [!ENDIF!]           
          [!IF "node:value(CddAdcHwInstance) = 'CDD_ADCE'"!]
            [!LOOP ".//*[@name='CddAdcInterruptSelect']"!]
            [!IF "node:value(.) = 'CDD_ADC_INT1'"!]
            <BSW-MODULE-ENTRY-REF-CONDITIONAL>
              <BSW-MODULE-ENTRY-REF DEST="BSW-MODULE-ENTRY">/Cdd_Adc_TI_F29H85x/Cdd_Adc_ModuleEntry/Cdd_Adc_ADCE_Int1Isr</BSW-MODULE-ENTRY-REF>
            </BSW-MODULE-ENTRY-REF-CONDITIONAL>
            [!ENDIF!]
            [!IF "node:value(.) = 'CDD_ADC_INT2'"!]
            <BSW-MODULE-ENTRY-REF-CONDITIONAL>
              <BSW-MODULE-ENTRY-REF DEST="BSW-MODULE-ENTRY">/Cdd_Adc_TI_F29H85x/Cdd_Adc_ModuleEntry/Cdd_Adc_ADCE_Int2Isr</BSW-MODULE-ENTRY-REF>
            </BSW-MODULE-ENTRY-REF-CONDITIONAL>
            [!ENDIF!]
            [!IF "node:value(.) = 'CDD_ADC_INT3'"!]
            <BSW-MODULE-ENTRY-REF-CONDITIONAL>
              <BSW-MODULE-ENTRY-REF DEST="BSW-MODULE-ENTRY">/Cdd_Adc_TI_F29H85x/Cdd_Adc_ModuleEntry/Cdd_Adc_ADCE_Int3Isr</BSW-MODULE-ENTRY-REF>
            </BSW-MODULE-ENTRY-REF-CONDITIONAL>
            [!ENDIF!]
            [!IF "node:value(.) = 'CDD_ADC_INT4'"!]
            <BSW-MODULE-ENTRY-REF-CONDITIONAL>
              <BSW-MODULE-ENTRY-REF DEST="BSW-MODULE-ENTRY">/Cdd_Adc_TI_F29H85x/Cdd_Adc_ModuleEntry/Cdd_Adc_ADCE_Int4Isr</BSW-MODULE-ENTRY-REF>
            </BSW-MODULE-ENTRY-REF-CONDITIONAL>
            [!ENDIF!]
            [!ENDLOOP!]
            [!LOOP "CddAdcPpbConfig/*"!]
            [!IF "(CddAdcPpbTripHighInterruptEnable = 'true' or CddAdcPpbTripLowInterruptEnable = 'true' or CddAdcPpbZeroCrossingInterruptEnable = 'true')"!]
            <BSW-MODULE-ENTRY-REF-CONDITIONAL>
              <BSW-MODULE-ENTRY-REF DEST="BSW-MODULE-ENTRY">/Cdd_Adc_TI_F29H85x/Cdd_Adc_ModuleEntry/Cdd_Adc_ADCE_PpbIntIsr</BSW-MODULE-ENTRY-REF>
            </BSW-MODULE-ENTRY-REF-CONDITIONAL>
            [!BREAK!]
            [!ENDIF!]
            [!ENDLOOP!]
          [!ENDIF!]
          [!ENDLOOP!]
            [!IF "CddAdcGeneral/CddAdcSafetyCheckerEnable = 'true'"!]
            <BSW-MODULE-ENTRY-REF-CONDITIONAL>
              <BSW-MODULE-ENTRY-REF DEST="BSW-MODULE-ENTRY">/Cdd_Adc_TI_F29H85x/Cdd_Adc_ModuleEntry/Cdd_Adc_ClearCheckerEvt</BSW-MODULE-ENTRY-REF>
            </BSW-MODULE-ENTRY-REF-CONDITIONAL>
            <BSW-MODULE-ENTRY-REF-CONDITIONAL>
              <BSW-MODULE-ENTRY-REF DEST="BSW-MODULE-ENTRY">/Cdd_Adc_TI_F29H85x/Cdd_Adc_ModuleEntry/Cdd_Adc_StartResultChecker</BSW-MODULE-ENTRY-REF>
            </BSW-MODULE-ENTRY-REF-CONDITIONAL>
            <BSW-MODULE-ENTRY-REF-CONDITIONAL>
              <BSW-MODULE-ENTRY-REF DEST="BSW-MODULE-ENTRY">/Cdd_Adc_TI_F29H85x/Cdd_Adc_ModuleEntry/Cdd_Adc_StopResultChecker</BSW-MODULE-ENTRY-REF>
            </BSW-MODULE-ENTRY-REF-CONDITIONAL>
            <BSW-MODULE-ENTRY-REF-CONDITIONAL>
              <BSW-MODULE-ENTRY-REF DEST="BSW-MODULE-ENTRY">/Cdd_Adc_TI_F29H85x/Cdd_Adc_ModuleEntry/Cdd_Adc_ReadCheckerStatus</BSW-MODULE-ENTRY-REF>
            </BSW-MODULE-ENTRY-REF-CONDITIONAL>
            [!ENDIF!]
            [!IF "CddAdcGeneral/CddAdcPpbEnable = 'true'"!]
            <BSW-MODULE-ENTRY-REF-CONDITIONAL>
              <BSW-MODULE-ENTRY-REF DEST="BSW-MODULE-ENTRY">/Cdd_Adc_TI_F29H85x/Cdd_Adc_ModuleEntry/Cdd_Adc_ClearPpbEvt</BSW-MODULE-ENTRY-REF>
            </BSW-MODULE-ENTRY-REF-CONDITIONAL>
            <BSW-MODULE-ENTRY-REF-CONDITIONAL>
              <BSW-MODULE-ENTRY-REF DEST="BSW-MODULE-ENTRY">/Cdd_Adc_TI_F29H85x/Cdd_Adc_ModuleEntry/Cdd_Adc_ReadPpbValue</BSW-MODULE-ENTRY-REF>
            </BSW-MODULE-ENTRY-REF-CONDITIONAL>
            <BSW-MODULE-ENTRY-REF-CONDITIONAL>
              <BSW-MODULE-ENTRY-REF DEST="BSW-MODULE-ENTRY">/Cdd_Adc_TI_F29H85x/Cdd_Adc_ModuleEntry/Cdd_Adc_ReadPartialPpbValue</BSW-MODULE-ENTRY-REF>
            </BSW-MODULE-ENTRY-REF-CONDITIONAL>
            <BSW-MODULE-ENTRY-REF-CONDITIONAL>
              <BSW-MODULE-ENTRY-REF DEST="BSW-MODULE-ENTRY">/Cdd_Adc_TI_F29H85x/Cdd_Adc_ModuleEntry/Cdd_Adc_ReadPpb</BSW-MODULE-ENTRY-REF>
            </BSW-MODULE-ENTRY-REF-CONDITIONAL>
            <BSW-MODULE-ENTRY-REF-CONDITIONAL>
              <BSW-MODULE-ENTRY-REF DEST="BSW-MODULE-ENTRY">/Cdd_Adc_TI_F29H85x/Cdd_Adc_ModuleEntry/Cdd_Adc_GetDelayStamp</BSW-MODULE-ENTRY-REF>
            </BSW-MODULE-ENTRY-REF-CONDITIONAL>
            [!IF "$PpbEvtNotification > 0"!]
            <BSW-MODULE-ENTRY-REF-CONDITIONAL>
              <BSW-MODULE-ENTRY-REF DEST="BSW-MODULE-ENTRY">/Cdd_Adc_TI_F29H85x/Cdd_Adc_ModuleEntry/Cdd_Adc_ConfigurePpbNotification</BSW-MODULE-ENTRY-REF>
            </BSW-MODULE-ENTRY-REF-CONDITIONAL>
            [!ENDIF!]
            [!ENDIF!]
            [!IF "CddAdcGeneral/CddAdcDeInitApi = 'true'"!]
            <BSW-MODULE-ENTRY-REF-CONDITIONAL>
              <BSW-MODULE-ENTRY-REF DEST="BSW-MODULE-ENTRY">/Cdd_Adc_TI_F29H85x/Cdd_Adc_ModuleEntry/Cdd_Adc_DeInit</BSW-MODULE-ENTRY-REF>
            </BSW-MODULE-ENTRY-REF-CONDITIONAL>
            [!ENDIF!]
            [!IF "CddAdcGeneral/CddAdcNotifCapability = 'true'"!]
            <BSW-MODULE-ENTRY-REF-CONDITIONAL>
              <BSW-MODULE-ENTRY-REF DEST="BSW-MODULE-ENTRY">/Cdd_Adc_TI_F29H85x/Cdd_Adc_ModuleEntry/Cdd_Adc_EnableGroupNotification</BSW-MODULE-ENTRY-REF>
            </BSW-MODULE-ENTRY-REF-CONDITIONAL>
            <BSW-MODULE-ENTRY-REF-CONDITIONAL>
              <BSW-MODULE-ENTRY-REF DEST="BSW-MODULE-ENTRY">/Cdd_Adc_TI_F29H85x/Cdd_Adc_ModuleEntry/Cdd_Adc_DisableGroupNotification</BSW-MODULE-ENTRY-REF>
            </BSW-MODULE-ENTRY-REF-CONDITIONAL>
            [!ENDIF!]
            [!IF "CddAdcGeneral/CddAdcHwTriggerApi = 'true'"!]
            <BSW-MODULE-ENTRY-REF-CONDITIONAL>
              <BSW-MODULE-ENTRY-REF DEST="BSW-MODULE-ENTRY">/Cdd_Adc_TI_F29H85x/Cdd_Adc_ModuleEntry/Cdd_Adc_DisableHardwareTrigger</BSW-MODULE-ENTRY-REF>
            </BSW-MODULE-ENTRY-REF-CONDITIONAL>
            <BSW-MODULE-ENTRY-REF-CONDITIONAL>
              <BSW-MODULE-ENTRY-REF DEST="BSW-MODULE-ENTRY">/Cdd_Adc_TI_F29H85x/Cdd_Adc_ModuleEntry/Cdd_Adc_EnableHardwareTrigger</BSW-MODULE-ENTRY-REF>
            </BSW-MODULE-ENTRY-REF-CONDITIONAL>
            [!ENDIF!]
            <BSW-MODULE-ENTRY-REF-CONDITIONAL>
              <BSW-MODULE-ENTRY-REF DEST="BSW-MODULE-ENTRY">/Cdd_Adc_TI_F29H85x/Cdd_Adc_ModuleEntry/Cdd_Adc_GetGroupStatus</BSW-MODULE-ENTRY-REF>
            </BSW-MODULE-ENTRY-REF-CONDITIONAL>
            <BSW-MODULE-ENTRY-REF-CONDITIONAL>
              <BSW-MODULE-ENTRY-REF DEST="BSW-MODULE-ENTRY">/Cdd_Adc_TI_F29H85x/Cdd_Adc_ModuleEntry/Cdd_Adc_GetStreamLastPointer</BSW-MODULE-ENTRY-REF>
            </BSW-MODULE-ENTRY-REF-CONDITIONAL>
            <BSW-MODULE-ENTRY-REF-CONDITIONAL>
              <BSW-MODULE-ENTRY-REF DEST="BSW-MODULE-ENTRY">/Cdd_Adc_TI_F29H85x/Cdd_Adc_ModuleEntry/Cdd_Adc_SetInternalTestNode</BSW-MODULE-ENTRY-REF>
            </BSW-MODULE-ENTRY-REF-CONDITIONAL>
            [!IF "CddAdcConfigSet/CddAdcEnableTemperatureSensor = 'true'"!]
            <BSW-MODULE-ENTRY-REF-CONDITIONAL>
              <BSW-MODULE-ENTRY-REF DEST="BSW-MODULE-ENTRY">/Cdd_Adc_TI_F29H85x/Cdd_Adc_ModuleEntry/Cdd_Adc_GetTemperatureC</BSW-MODULE-ENTRY-REF>
            </BSW-MODULE-ENTRY-REF-CONDITIONAL>
            <BSW-MODULE-ENTRY-REF-CONDITIONAL>
              <BSW-MODULE-ENTRY-REF DEST="BSW-MODULE-ENTRY">/Cdd_Adc_TI_F29H85x/Cdd_Adc_ModuleEntry/Cdd_Adc_GetTemperatureK</BSW-MODULE-ENTRY-REF>
            </BSW-MODULE-ENTRY-REF-CONDITIONAL>
            [!ENDIF!]
            [!IF "CddAdcGeneral/CddAdcVersionInfoApi = 'true'"!]
            <BSW-MODULE-ENTRY-REF-CONDITIONAL>
              <BSW-MODULE-ENTRY-REF DEST="BSW-MODULE-ENTRY">/Cdd_Adc_TI_F29H85x/Cdd_Adc_ModuleEntry/Cdd_Adc_GetVersionInfo</BSW-MODULE-ENTRY-REF>
            </BSW-MODULE-ENTRY-REF-CONDITIONAL>
            [!ENDIF!]
            <BSW-MODULE-ENTRY-REF-CONDITIONAL>
              <BSW-MODULE-ENTRY-REF DEST="BSW-MODULE-ENTRY">/Cdd_Adc_TI_F29H85x/Cdd_Adc_ModuleEntry/Cdd_Adc_Init</BSW-MODULE-ENTRY-REF>
            </BSW-MODULE-ENTRY-REF-CONDITIONAL>
            <BSW-MODULE-ENTRY-REF-CONDITIONAL>
              <BSW-MODULE-ENTRY-REF DEST="BSW-MODULE-ENTRY">/Cdd_Adc_TI_F29H85x/Cdd_Adc_ModuleEntry/Cdd_Adc_UpdateStatusThroughDma</BSW-MODULE-ENTRY-REF>
            </BSW-MODULE-ENTRY-REF-CONDITIONAL>
            [!IF "CddAdcGeneral/CddAdcReadGroupApi = 'true'"!]
            <BSW-MODULE-ENTRY-REF-CONDITIONAL>
              <BSW-MODULE-ENTRY-REF DEST="BSW-MODULE-ENTRY">/Cdd_Adc_TI_F29H85x/Cdd_Adc_ModuleEntry/Cdd_Adc_ReadGroup</BSW-MODULE-ENTRY-REF>
            </BSW-MODULE-ENTRY-REF-CONDITIONAL>
            [!ENDIF!]
            [!IF "CddAdcGeneral/CddAdcSetResolutionApi = 'true'"!]
            <BSW-MODULE-ENTRY-REF-CONDITIONAL>
              <BSW-MODULE-ENTRY-REF DEST="BSW-MODULE-ENTRY">/Cdd_Adc_TI_F29H85x/Cdd_Adc_ModuleEntry/Cdd_Adc_SetResolution</BSW-MODULE-ENTRY-REF>
            </BSW-MODULE-ENTRY-REF-CONDITIONAL>
            [!ENDIF!]
            [!IF "CddAdcGeneral/CddAdcEnableGlobalSoftwareTrigger = 'true'"!]
            <BSW-MODULE-ENTRY-REF-CONDITIONAL>
              <BSW-MODULE-ENTRY-REF DEST="BSW-MODULE-ENTRY">/Cdd_Adc_TI_F29H85x/Cdd_Adc_ModuleEntry/Cdd_Adc_StartGlobalSwTrig</BSW-MODULE-ENTRY-REF>
            </BSW-MODULE-ENTRY-REF-CONDITIONAL>
            <BSW-MODULE-ENTRY-REF-CONDITIONAL>
              <BSW-MODULE-ENTRY-REF DEST="BSW-MODULE-ENTRY">/Cdd_Adc_TI_F29H85x/Cdd_Adc_ModuleEntry/Cdd_Adc_StopGlobalSwTrig</BSW-MODULE-ENTRY-REF>
            </BSW-MODULE-ENTRY-REF-CONDITIONAL>
            [!ENDIF!]
            [!IF "CddAdcGeneral/CddAdcEnableStartStopGroupApi = 'true'"!]
            <BSW-MODULE-ENTRY-REF-CONDITIONAL>
              <BSW-MODULE-ENTRY-REF DEST="BSW-MODULE-ENTRY">/Cdd_Adc_TI_F29H85x/Cdd_Adc_ModuleEntry/Cdd_Adc_StartGroupConversion</BSW-MODULE-ENTRY-REF>
            </BSW-MODULE-ENTRY-REF-CONDITIONAL>
            <BSW-MODULE-ENTRY-REF-CONDITIONAL>
              <BSW-MODULE-ENTRY-REF DEST="BSW-MODULE-ENTRY">/Cdd_Adc_TI_F29H85x/Cdd_Adc_ModuleEntry/Cdd_Adc_StopGroupConversion</BSW-MODULE-ENTRY-REF>
            </BSW-MODULE-ENTRY-REF-CONDITIONAL>
            [!ENDIF!]
            <BSW-MODULE-ENTRY-REF-CONDITIONAL>
              <BSW-MODULE-ENTRY-REF DEST="BSW-MODULE-ENTRY">/Cdd_Adc_TI_F29H85x/Cdd_Adc_ModuleEntry/Cdd_Adc_SetupResultBuffer</BSW-MODULE-ENTRY-REF>
            </BSW-MODULE-ENTRY-REF-CONDITIONAL>            
          </IMPLEMENTED-ENTRYS>
          <MODULE-ID>255</MODULE-ID>
          <BSW-MODULE-DEPENDENCYS>        
            <BSW-MODULE-DEPENDENCY UUID="921299a5-07e4-4bc5-a5e0-695e1b1c1ba5">
              <SHORT-NAME>Det</SHORT-NAME>
              <TARGET-MODULE-ID>15</TARGET-MODULE-ID>
              <TARGET-MODULE-REFS>
                <BSW-MODULE-DESCRIPTION-REF-CONDITIONAL>
                  <BSW-MODULE-DESCRIPTION-REF DEST="BSW-MODULE-DESCRIPTION">/AUTOSAR_Det/Det</BSW-MODULE-DESCRIPTION-REF>
                </BSW-MODULE-DESCRIPTION-REF-CONDITIONAL>
              </TARGET-MODULE-REFS>
            </BSW-MODULE-DEPENDENCY>
          </BSW-MODULE-DEPENDENCYS>       
          <INTERNAL-BEHAVIORS>
            <BSW-INTERNAL-BEHAVIOR UUID="08c7871b-5e99-4611-9a00-06a369df7e86">
              <SHORT-NAME>Cdd_Adc_Behavior</SHORT-NAME>
              <EXCLUSIVE-AREAS>
                <EXCLUSIVE-AREA UUID="4fc38db4-f789-41ad-baac-f5c8fc007188">
                  <SHORT-NAME>CDD_ADC_EXCLUSIVE_AREA_0</SHORT-NAME>
                </EXCLUSIVE-AREA>
              </EXCLUSIVE-AREAS>
              <ENTITYS>
            [!LOOP "CddAdcConfigSet/CddAdcHwUnit/*"!]
            [!IF "node:value(CddAdcHwInstance) = 'CDD_ADCA'"!]
              [!LOOP ".//*[@name='CddAdcInterruptSelect']"!]
              [!IF "node:value(.) = 'CDD_ADC_INT1'"!]
                <BSW-INTERRUPT-ENTITY UUID="a8762bb5-9776-48e6-9f88-3f601435e284">
                  <SHORT-NAME>Cdd_Adc_ADCA_Int1Isr</SHORT-NAME>
                  <REENTRANCY-LEVEL>NON-REENTRANT</REENTRANCY-LEVEL>
                  <IMPLEMENTED-ENTRY-REF DEST="BSW-MODULE-ENTRY">/Cdd_Adc_TI_F29H85x/Cdd_Adc_ModuleEntry/Cdd_Adc_ADCA_Int1Isr</IMPLEMENTED-ENTRY-REF>
                  [!IF "node:value(../CddAdcInterruptCategory) = 'CDD_ADC_ISR_CAT2_INT'"!]
                  <INTERRUPT-CATEGORY>CAT-2</INTERRUPT-CATEGORY>
                  [!ELSE!]
                  <INTERRUPT-CATEGORY>CAT-1</INTERRUPT-CATEGORY>
                  [!ENDIF!]
                </BSW-INTERRUPT-ENTITY>
              [!ELSE!]
              [!ENDIF!]
              [!IF "node:value(.) = 'CDD_ADC_INT2'"!]
                <BSW-INTERRUPT-ENTITY UUID="6e81150d-4167-46a0-8ebe-3ae8210e9ba9">
                  <SHORT-NAME>Cdd_Adc_ADCA_Int2Isr</SHORT-NAME>
                  <REENTRANCY-LEVEL>NON-REENTRANT</REENTRANCY-LEVEL>
                  <IMPLEMENTED-ENTRY-REF DEST="BSW-MODULE-ENTRY">/Cdd_Adc_TI_F29H85x/Cdd_Adc_ModuleEntry/Cdd_Adc_ADCA_Int2Isr</IMPLEMENTED-ENTRY-REF>
                  [!IF "node:value(../CddAdcInterruptCategory) = 'CDD_ADC_ISR_CAT2_INT'"!]
                  <INTERRUPT-CATEGORY>CAT-2</INTERRUPT-CATEGORY>
                  [!ELSE!]
                  <INTERRUPT-CATEGORY>CAT-1</INTERRUPT-CATEGORY>
                  [!ENDIF!]
                </BSW-INTERRUPT-ENTITY>
              [!ELSE!]
              [!ENDIF!]
              [!IF "node:value(.) = 'CDD_ADC_INT3'"!]              
                <BSW-INTERRUPT-ENTITY UUID="cbe5f357-56e7-4c4a-8eec-53d85f185ae8">
                  <SHORT-NAME>Cdd_Adc_ADCA_Int3Isr</SHORT-NAME>
                  <REENTRANCY-LEVEL>NON-REENTRANT</REENTRANCY-LEVEL>
                  <IMPLEMENTED-ENTRY-REF DEST="BSW-MODULE-ENTRY">/Cdd_Adc_TI_F29H85x/Cdd_Adc_ModuleEntry/Cdd_Adc_ADCA_Int3Isr</IMPLEMENTED-ENTRY-REF>
                  [!IF "node:value(../CddAdcInterruptCategory) = 'CDD_ADC_ISR_CAT2_INT'"!]
                  <INTERRUPT-CATEGORY>CAT-2</INTERRUPT-CATEGORY>
                  [!ELSE!]
                  <INTERRUPT-CATEGORY>CAT-1</INTERRUPT-CATEGORY>
                  [!ENDIF!]                 
                </BSW-INTERRUPT-ENTITY>
              [!ELSE!]
              [!ENDIF!]
              [!IF "node:value(.) = 'CDD_ADC_INT4'"!] 
                <BSW-INTERRUPT-ENTITY UUID="ac14fa3b-a94f-4fcc-97ce-afe493122c22">
                  <SHORT-NAME>Cdd_Adc_ADCA_Int4Isr</SHORT-NAME>
                  <REENTRANCY-LEVEL>NON-REENTRANT</REENTRANCY-LEVEL>
                  <IMPLEMENTED-ENTRY-REF DEST="BSW-MODULE-ENTRY">/Cdd_Adc_TI_F29H85x/Cdd_Adc_ModuleEntry/Cdd_Adc_ADCA_Int4Isr</IMPLEMENTED-ENTRY-REF>
                  [!IF "node:value(../CddAdcInterruptCategory) = 'CDD_ADC_ISR_CAT2_INT'"!]
                  <INTERRUPT-CATEGORY>CAT-2</INTERRUPT-CATEGORY>
                  [!ELSE!]
                  <INTERRUPT-CATEGORY>CAT-1</INTERRUPT-CATEGORY>
                  [!ENDIF!]                   
                </BSW-INTERRUPT-ENTITY>
              [!ELSE!]
              [!ENDIF!]
              [!ENDLOOP!]               
              [!LOOP "CddAdcPpbConfig/*"!]
              [!IF "(CddAdcPpbTripHighInterruptEnable = 'true' or CddAdcPpbTripLowInterruptEnable = 'true' or CddAdcPpbZeroCrossingInterruptEnable = 'true')"!]
                <BSW-INTERRUPT-ENTITY UUID="89fcfccc-944e-4ba4-9da4-450dfef4124e">
                  <SHORT-NAME>Cdd_Adc_ADCA_PpbIntIsr</SHORT-NAME>
                  <REENTRANCY-LEVEL>NON-REENTRANT</REENTRANCY-LEVEL>
                  <IMPLEMENTED-ENTRY-REF DEST="BSW-MODULE-ENTRY">/Cdd_Adc_TI_F29H85x/Cdd_Adc_ModuleEntry/Cdd_Adc_ADCA_PpbIntIsr</IMPLEMENTED-ENTRY-REF>
                  [!IF "node:value(CddAdcEventInterruptCategory) = 'CDD_ADC_ISR_CAT2_INT'"!]
                  <INTERRUPT-CATEGORY>CAT-2</INTERRUPT-CATEGORY>
                  [!ELSE!]
                  <INTERRUPT-CATEGORY>CAT-1</INTERRUPT-CATEGORY>
                  [!ENDIF!]                
                </BSW-INTERRUPT-ENTITY>
              [!BREAK!]
              [!ELSE!]
              [!ENDIF!]
              [!ENDLOOP!]
            [!ENDIF!]
            [!IF "node:value(CddAdcHwInstance) = 'CDD_ADCB'"!]
              [!LOOP ".//*[@name='CddAdcInterruptSelect']"!]
              [!IF "node:value(.) = 'CDD_ADC_INT1'"!]
                <BSW-INTERRUPT-ENTITY UUID="2ff0c980-a3f2-4f17-95ac-3992e6021108">
                  <SHORT-NAME>Cdd_Adc_ADCB_Int1Isr</SHORT-NAME>
                  <REENTRANCY-LEVEL>NON-REENTRANT</REENTRANCY-LEVEL>
                  <IMPLEMENTED-ENTRY-REF DEST="BSW-MODULE-ENTRY">/Cdd_Adc_TI_F29H85x/Cdd_Adc_ModuleEntry/Cdd_Adc_ADCB_Int1Isr</IMPLEMENTED-ENTRY-REF>
                  [!IF "node:value(../CddAdcInterruptCategory) = 'CDD_ADC_ISR_CAT2_INT'"!]
                  <INTERRUPT-CATEGORY>CAT-2</INTERRUPT-CATEGORY>
                  [!ELSE!]
                  <INTERRUPT-CATEGORY>CAT-1</INTERRUPT-CATEGORY>
                  [!ENDIF!]                  
                </BSW-INTERRUPT-ENTITY>
              [!ELSE!]
              [!ENDIF!]
              [!IF "node:value(.) = 'CDD_ADC_INT2'"!]
                <BSW-INTERRUPT-ENTITY UUID="2acee50f-7807-4b03-962b-cc0edf025d51">
                  <SHORT-NAME>Cdd_Adc_ADCB_Int2Isr</SHORT-NAME>
                  <REENTRANCY-LEVEL>NON-REENTRANT</REENTRANCY-LEVEL>
                  <IMPLEMENTED-ENTRY-REF DEST="BSW-MODULE-ENTRY">/Cdd_Adc_TI_F29H85x/Cdd_Adc_ModuleEntry/Cdd_Adc_ADCB_Int2Isr</IMPLEMENTED-ENTRY-REF>
                  [!IF "node:value(../CddAdcInterruptCategory) = 'CDD_ADC_ISR_CAT2_INT'"!]
                  <INTERRUPT-CATEGORY>CAT-2</INTERRUPT-CATEGORY>
                  [!ELSE!]
                  <INTERRUPT-CATEGORY>CAT-1</INTERRUPT-CATEGORY>
                  [!ENDIF!]                   
                </BSW-INTERRUPT-ENTITY>
              [!ELSE!]
              [!ENDIF!]
              [!IF "node:value(.) = 'CDD_ADC_INT3'"!]
                <BSW-INTERRUPT-ENTITY UUID="a30e4ebc-738e-4389-a8b6-be20f0b9a16d">
                  <SHORT-NAME>Cdd_Adc_ADCB_Int3Isr</SHORT-NAME>
                  <REENTRANCY-LEVEL>NON-REENTRANT</REENTRANCY-LEVEL>
                  <IMPLEMENTED-ENTRY-REF DEST="BSW-MODULE-ENTRY">/Cdd_Adc_TI_F29H85x/Cdd_Adc_ModuleEntry/Cdd_Adc_ADCB_Int3Isr</IMPLEMENTED-ENTRY-REF>
                  [!IF "node:value(../CddAdcInterruptCategory) = 'CDD_ADC_ISR_CAT2_INT'"!]
                  <INTERRUPT-CATEGORY>CAT-2</INTERRUPT-CATEGORY>
                  [!ELSE!]
                  <INTERRUPT-CATEGORY>CAT-1</INTERRUPT-CATEGORY>
                  [!ENDIF!]                  
                </BSW-INTERRUPT-ENTITY>
              [!ELSE!]
              [!ENDIF!]
              [!IF "node:value(.) = 'CDD_ADC_INT4'"!]
                <BSW-INTERRUPT-ENTITY UUID="9550915e-7e6f-43a6-a6ec-84a99079b5cd">
                  <SHORT-NAME>Cdd_Adc_ADCB_Int4Isr</SHORT-NAME>
                  <REENTRANCY-LEVEL>NON-REENTRANT</REENTRANCY-LEVEL>
                  <IMPLEMENTED-ENTRY-REF DEST="BSW-MODULE-ENTRY">/Cdd_Adc_TI_F29H85x/Cdd_Adc_ModuleEntry/Cdd_Adc_ADCB_Int4Isr</IMPLEMENTED-ENTRY-REF>
                  [!IF "node:value(../CddAdcInterruptCategory) = 'CDD_ADC_ISR_CAT2_INT'"!]
                  <INTERRUPT-CATEGORY>CAT-2</INTERRUPT-CATEGORY>
                  [!ELSE!]
                  <INTERRUPT-CATEGORY>CAT-1</INTERRUPT-CATEGORY>
                  [!ENDIF!]                  
                </BSW-INTERRUPT-ENTITY>
              [!ELSE!]
              [!ENDIF!]
              [!ENDLOOP!]                 
              [!LOOP "CddAdcPpbConfig/*"!]
              [!IF "(CddAdcPpbTripHighInterruptEnable = 'true' or CddAdcPpbTripLowInterruptEnable = 'true' or CddAdcPpbZeroCrossingInterruptEnable = 'true')"!]               
                <BSW-INTERRUPT-ENTITY UUID="66c60be0-4913-42ef-9bce-cf63e0c794e9">
                  <SHORT-NAME>Cdd_Adc_ADCB_PpbIntIsr</SHORT-NAME>
                  <REENTRANCY-LEVEL>NON-REENTRANT</REENTRANCY-LEVEL>
                  <IMPLEMENTED-ENTRY-REF DEST="BSW-MODULE-ENTRY">/Cdd_Adc_TI_F29H85x/Cdd_Adc_ModuleEntry/Cdd_Adc_ADCB_PpbIntIsr</IMPLEMENTED-ENTRY-REF>
                  [!IF "node:value(CddAdcEventInterruptCategory) = 'CDD_ADC_ISR_CAT2_INT'"!]
                  <INTERRUPT-CATEGORY>CAT-2</INTERRUPT-CATEGORY>
                  [!ELSE!]
                  <INTERRUPT-CATEGORY>CAT-1</INTERRUPT-CATEGORY>
                  [!ENDIF!]                  
                </BSW-INTERRUPT-ENTITY>
              [!BREAK!]
              [!ELSE!]
              [!ENDIF!]
              [!ENDLOOP!]
            [!ENDIF!]
            [!IF "node:value(CddAdcHwInstance) = 'CDD_ADCC'"!]
              [!LOOP ".//*[@name='CddAdcInterruptSelect']"!]
              [!IF "node:value(.) = 'CDD_ADC_INT1'"!]
                <BSW-INTERRUPT-ENTITY UUID="1cdc02ab-0111-4578-b5b3-154ffc275aeb">
                  <SHORT-NAME>Cdd_Adc_ADCC_Int1Isr</SHORT-NAME>
                  <REENTRANCY-LEVEL>NON-REENTRANT</REENTRANCY-LEVEL>
                  <IMPLEMENTED-ENTRY-REF DEST="BSW-MODULE-ENTRY">/Cdd_Adc_TI_F29H85x/Cdd_Adc_ModuleEntry/Cdd_Adc_ADCC_Int1Isr</IMPLEMENTED-ENTRY-REF>
                  [!IF "node:value(../CddAdcInterruptCategory) = 'CDD_ADC_ISR_CAT2_INT'"!]
                  <INTERRUPT-CATEGORY>CAT-2</INTERRUPT-CATEGORY>
                  [!ELSE!]
                  <INTERRUPT-CATEGORY>CAT-1</INTERRUPT-CATEGORY>
                  [!ENDIF!]                  
                </BSW-INTERRUPT-ENTITY>
              [!ELSE!]
              [!ENDIF!]
              [!IF "node:value(.) = 'CDD_ADC_INT2'"!]
                <BSW-INTERRUPT-ENTITY UUID="5bb9fadc-1d19-490e-9d99-6a920a0458fd">
                  <SHORT-NAME>Cdd_Adc_ADCC_Int2Isr</SHORT-NAME>
                  <REENTRANCY-LEVEL>NON-REENTRANT</REENTRANCY-LEVEL>
                  <IMPLEMENTED-ENTRY-REF DEST="BSW-MODULE-ENTRY">/Cdd_Adc_TI_F29H85x/Cdd_Adc_ModuleEntry/Cdd_Adc_ADCC_Int2Isr</IMPLEMENTED-ENTRY-REF>
                  [!IF "node:value(../CddAdcInterruptCategory) = 'CDD_ADC_ISR_CAT2_INT'"!]
                  <INTERRUPT-CATEGORY>CAT-2</INTERRUPT-CATEGORY>
                  [!ELSE!]
                  <INTERRUPT-CATEGORY>CAT-1</INTERRUPT-CATEGORY>
                  [!ENDIF!]                    
                </BSW-INTERRUPT-ENTITY>
              [!ELSE!]
              [!ENDIF!]
              [!IF "node:value(.) = 'CDD_ADC_INT3'"!]              
                <BSW-INTERRUPT-ENTITY UUID="dd225526-6129-4c7b-a554-980a4e1be51f">
                  <SHORT-NAME>Cdd_Adc_ADCC_Int3Isr</SHORT-NAME>
                  <REENTRANCY-LEVEL>NON-REENTRANT</REENTRANCY-LEVEL>
                  <IMPLEMENTED-ENTRY-REF DEST="BSW-MODULE-ENTRY">/Cdd_Adc_TI_F29H85x/Cdd_Adc_ModuleEntry/Cdd_Adc_ADCC_Int3Isr</IMPLEMENTED-ENTRY-REF>
                  [!IF "node:value(../CddAdcInterruptCategory) = 'CDD_ADC_ISR_CAT2_INT'"!]
                  <INTERRUPT-CATEGORY>CAT-2</INTERRUPT-CATEGORY>
                  [!ELSE!]
                  <INTERRUPT-CATEGORY>CAT-1</INTERRUPT-CATEGORY>
                  [!ENDIF!]                    
                </BSW-INTERRUPT-ENTITY>
              [!ELSE!]
              [!ENDIF!]
              [!IF "node:value(.) = 'CDD_ADC_INT4'"!]
                <BSW-INTERRUPT-ENTITY UUID="e7fa20bc-3254-42b1-a35c-1e5e18a815ab">
                  <SHORT-NAME>Cdd_Adc_ADCC_Int4Isr</SHORT-NAME>
                  <REENTRANCY-LEVEL>NON-REENTRANT</REENTRANCY-LEVEL>
                  <IMPLEMENTED-ENTRY-REF DEST="BSW-MODULE-ENTRY">/Cdd_Adc_TI_F29H85x/Cdd_Adc_ModuleEntry/Cdd_Adc_ADCC_Int4Isr</IMPLEMENTED-ENTRY-REF>
                  [!IF "node:value(../CddAdcInterruptCategory) = 'CDD_ADC_ISR_CAT2_INT'"!]
                  <INTERRUPT-CATEGORY>CAT-2</INTERRUPT-CATEGORY>
                  [!ELSE!]
                  <INTERRUPT-CATEGORY>CAT-1</INTERRUPT-CATEGORY>
                  [!ENDIF!]
                </BSW-INTERRUPT-ENTITY>
              [!ELSE!]
              [!ENDIF!]
              [!ENDLOOP!]
              [!LOOP "CddAdcPpbConfig/*"!]
              [!IF "(CddAdcPpbTripHighInterruptEnable = 'true' or CddAdcPpbTripLowInterruptEnable = 'true' or CddAdcPpbZeroCrossingInterruptEnable = 'true')"!]
                <BSW-INTERRUPT-ENTITY UUID="03d2df30-54ca-43aa-9386-da3e99d350e9">
                  <SHORT-NAME>Cdd_Adc_ADCC_PpbIntIsr</SHORT-NAME>
                  <REENTRANCY-LEVEL>NON-REENTRANT</REENTRANCY-LEVEL>
                  <IMPLEMENTED-ENTRY-REF DEST="BSW-MODULE-ENTRY">/Cdd_Adc_TI_F29H85x/Cdd_Adc_ModuleEntry/Cdd_Adc_ADCC_PpbIntIsr</IMPLEMENTED-ENTRY-REF>
                  [!IF "node:value(CddAdcEventInterruptCategory) = 'CDD_ADC_ISR_CAT2_INT'"!]
                  <INTERRUPT-CATEGORY>CAT-2</INTERRUPT-CATEGORY>
                  [!ELSE!]
                  <INTERRUPT-CATEGORY>CAT-1</INTERRUPT-CATEGORY>
                  [!ENDIF!]
                </BSW-INTERRUPT-ENTITY>
              [!BREAK!]
              [!ELSE!]
              [!ENDIF!]
              [!ENDLOOP!]
            [!ENDIF!]
            [!IF "node:value(CddAdcHwInstance) = 'CDD_ADCD'"!]
              [!LOOP ".//*[@name='CddAdcInterruptSelect']"!]
              [!IF "node:value(.) = 'CDD_ADC_INT1'"!]
                <BSW-INTERRUPT-ENTITY UUID="3fa509e9-cad6-4e8c-8c35-9c63d26cc69e">
                  <SHORT-NAME>Cdd_Adc_ADCD_Int1Isr</SHORT-NAME>
                  <REENTRANCY-LEVEL>NON-REENTRANT</REENTRANCY-LEVEL>
                  <IMPLEMENTED-ENTRY-REF DEST="BSW-MODULE-ENTRY">/Cdd_Adc_TI_F29H85x/Cdd_Adc_ModuleEntry/Cdd_Adc_ADCD_Int1Isr</IMPLEMENTED-ENTRY-REF>
                  [!IF "node:value(../CddAdcInterruptCategory) = 'CDD_ADC_ISR_CAT2_INT'"!]
                  <INTERRUPT-CATEGORY>CAT-2</INTERRUPT-CATEGORY>
                  [!ELSE!]
                  <INTERRUPT-CATEGORY>CAT-1</INTERRUPT-CATEGORY>
                  [!ENDIF!]
                </BSW-INTERRUPT-ENTITY>
              [!ELSE!]
              [!ENDIF!]
              [!IF "node:value(.) = 'CDD_ADC_INT2'"!]
                <BSW-INTERRUPT-ENTITY UUID="10438c5a-858a-4f9d-8d10-d029ecf35865">
                  <SHORT-NAME>Cdd_Adc_ADCD_Int2Isr</SHORT-NAME>
                  <REENTRANCY-LEVEL>NON-REENTRANT</REENTRANCY-LEVEL>
                  <IMPLEMENTED-ENTRY-REF DEST="BSW-MODULE-ENTRY">/Cdd_Adc_TI_F29H85x/Cdd_Adc_ModuleEntry/Cdd_Adc_ADCD_Int2Isr</IMPLEMENTED-ENTRY-REF>
                  [!IF "node:value(../CddAdcInterruptCategory) = 'CDD_ADC_ISR_CAT2_INT'"!]
                  <INTERRUPT-CATEGORY>CAT-2</INTERRUPT-CATEGORY>
                  [!ELSE!]
                  <INTERRUPT-CATEGORY>CAT-1</INTERRUPT-CATEGORY>
                  [!ENDIF!]                  
                </BSW-INTERRUPT-ENTITY>
              [!ELSE!]
              [!ENDIF!]
              [!IF "node:value(.) = 'CDD_ADC_INT3'"!]
                <BSW-INTERRUPT-ENTITY UUID="89c7eb94-448c-49bb-ac83-49b843f21062">
                  <SHORT-NAME>Cdd_Adc_ADCD_Int3Isr</SHORT-NAME>
                  <REENTRANCY-LEVEL>NON-REENTRANT</REENTRANCY-LEVEL>
                  <IMPLEMENTED-ENTRY-REF DEST="BSW-MODULE-ENTRY">/Cdd_Adc_TI_F29H85x/Cdd_Adc_ModuleEntry/Cdd_Adc_ADCD_Int3Isr</IMPLEMENTED-ENTRY-REF>
                  [!IF "node:value(../CddAdcInterruptCategory) = 'CDD_ADC_ISR_CAT2_INT'"!]
                  <INTERRUPT-CATEGORY>CAT-2</INTERRUPT-CATEGORY>
                  [!ELSE!]
                  <INTERRUPT-CATEGORY>CAT-1</INTERRUPT-CATEGORY>
                  [!ENDIF!]                  
                </BSW-INTERRUPT-ENTITY>
              [!ELSE!]
              [!ENDIF!]
              [!IF "node:value(.) = 'CDD_ADC_INT4'"!]
                <BSW-INTERRUPT-ENTITY UUID="91a1da9f-d3a4-4f56-85bb-78792d4fa931">
                  <SHORT-NAME>Cdd_Adc_ADCD_Int4Isr</SHORT-NAME>
                  <REENTRANCY-LEVEL>NON-REENTRANT</REENTRANCY-LEVEL>
                  <IMPLEMENTED-ENTRY-REF DEST="BSW-MODULE-ENTRY">/Cdd_Adc_TI_F29H85x/Cdd_Adc_ModuleEntry/Cdd_Adc_ADCD_Int4Isr</IMPLEMENTED-ENTRY-REF>
                  [!IF "node:value(../CddAdcInterruptCategory) = 'CDD_ADC_ISR_CAT2_INT'"!]
                  <INTERRUPT-CATEGORY>CAT-2</INTERRUPT-CATEGORY>
                  [!ELSE!]
                  <INTERRUPT-CATEGORY>CAT-1</INTERRUPT-CATEGORY>
                  [!ENDIF!]                  
                </BSW-INTERRUPT-ENTITY>
              [!ELSE!]
              [!ENDIF!]
              [!ENDLOOP!]                              
              [!LOOP "CddAdcPpbConfig/*"!]
              [!IF "(CddAdcPpbTripHighInterruptEnable = 'true' or CddAdcPpbTripLowInterruptEnable = 'true' or CddAdcPpbZeroCrossingInterruptEnable = 'true')"!]
                <BSW-INTERRUPT-ENTITY UUID="4746aae8-3afc-47d3-abc1-d4d991273b3a">
                  <SHORT-NAME>Cdd_Adc_ADCD_PpbIntIsr</SHORT-NAME>
                  <REENTRANCY-LEVEL>NON-REENTRANT</REENTRANCY-LEVEL>
                  <IMPLEMENTED-ENTRY-REF DEST="BSW-MODULE-ENTRY">/Cdd_Adc_TI_F29H85x/Cdd_Adc_ModuleEntry/Cdd_Adc_ADCD_PpbIntIsr</IMPLEMENTED-ENTRY-REF>
                  [!IF "node:value(CddAdcEventInterruptCategory) = 'CDD_ADC_ISR_CAT2_INT'"!]
                  <INTERRUPT-CATEGORY>CAT-2</INTERRUPT-CATEGORY>
                  [!ELSE!]
                  <INTERRUPT-CATEGORY>CAT-1</INTERRUPT-CATEGORY>
                  [!ENDIF!]                  
                </BSW-INTERRUPT-ENTITY>
              [!BREAK!]
              [!ELSE!]
              [!ENDIF!]
              [!ENDLOOP!]
            [!ENDIF!]
            [!IF "node:value(CddAdcHwInstance) = 'CDD_ADCE'"!]
              [!LOOP ".//*[@name='CddAdcInterruptSelect']"!]
              [!IF "node:value(.) = 'CDD_ADC_INT1'"!]            
                <BSW-INTERRUPT-ENTITY UUID="e55444ba-338f-44c5-9eb2-8cb525997267">
                  <SHORT-NAME>Cdd_Adc_ADCE_Int1Isr</SHORT-NAME>
                  <REENTRANCY-LEVEL>NON-REENTRANT</REENTRANCY-LEVEL>
                  <IMPLEMENTED-ENTRY-REF DEST="BSW-MODULE-ENTRY">/Cdd_Adc_TI_F29H85x/Cdd_Adc_ModuleEntry/Cdd_Adc_ADCE_Int1Isr</IMPLEMENTED-ENTRY-REF>
                  [!IF "node:value(../CddAdcInterruptCategory) = 'CDD_ADC_ISR_CAT2_INT'"!]
                  <INTERRUPT-CATEGORY>CAT-2</INTERRUPT-CATEGORY>
                  [!ELSE!]
                  <INTERRUPT-CATEGORY>CAT-1</INTERRUPT-CATEGORY>
                  [!ENDIF!]                  
                </BSW-INTERRUPT-ENTITY>
              [!ELSE!]
              [!ENDIF!]
              [!IF "node:value(.) = 'CDD_ADC_INT2'"!]                
                <BSW-INTERRUPT-ENTITY UUID="ab0e5de2-8779-40c5-bfc3-8884a490179a">
                  <SHORT-NAME>Cdd_Adc_ADCE_Int2Isr</SHORT-NAME>
                  <REENTRANCY-LEVEL>NON-REENTRANT</REENTRANCY-LEVEL>
                  <IMPLEMENTED-ENTRY-REF DEST="BSW-MODULE-ENTRY">/Cdd_Adc_TI_F29H85x/Cdd_Adc_ModuleEntry/Cdd_Adc_ADCE_Int2Isr</IMPLEMENTED-ENTRY-REF>
                  [!IF "node:value(../CddAdcInterruptCategory) = 'CDD_ADC_ISR_CAT2_INT'"!]
                  <INTERRUPT-CATEGORY>CAT-2</INTERRUPT-CATEGORY>
                  [!ELSE!]
                  <INTERRUPT-CATEGORY>CAT-1</INTERRUPT-CATEGORY>
                  [!ENDIF!]                  
                </BSW-INTERRUPT-ENTITY>
              [!ELSE!]
              [!ENDIF!]
              [!IF "node:value(.) = 'CDD_ADC_INT3'"!]                
                <BSW-INTERRUPT-ENTITY UUID="57227650-9ab9-4283-b5de-dad731601884">
                  <SHORT-NAME>Cdd_Adc_ADCE_Int3Isr</SHORT-NAME>
                  <REENTRANCY-LEVEL>NON-REENTRANT</REENTRANCY-LEVEL>
                  <IMPLEMENTED-ENTRY-REF DEST="BSW-MODULE-ENTRY">/Cdd_Adc_TI_F29H85x/Cdd_Adc_ModuleEntry/Cdd_Adc_ADCE_Int3Isr</IMPLEMENTED-ENTRY-REF>
                  [!IF "node:value(../CddAdcInterruptCategory) = 'CDD_ADC_ISR_CAT2_INT'"!]
                  <INTERRUPT-CATEGORY>CAT-2</INTERRUPT-CATEGORY>
                  [!ELSE!]
                  <INTERRUPT-CATEGORY>CAT-1</INTERRUPT-CATEGORY>
                  [!ENDIF!]                  
                </BSW-INTERRUPT-ENTITY>
              [!ELSE!]
              [!ENDIF!]
              [!IF "node:value(.) = 'CDD_ADC_INT4'"!]                
                <BSW-INTERRUPT-ENTITY UUID="16337539-012d-4972-80a1-063311c6c4b6">
                  <SHORT-NAME>Cdd_Adc_ADCE_Int4Isr</SHORT-NAME>
                  <REENTRANCY-LEVEL>NON-REENTRANT</REENTRANCY-LEVEL>
                  <IMPLEMENTED-ENTRY-REF DEST="BSW-MODULE-ENTRY">/Cdd_Adc_TI_F29H85x/Cdd_Adc_ModuleEntry/Cdd_Adc_ADCE_Int4Isr</IMPLEMENTED-ENTRY-REF>
                  [!IF "node:value(../CddAdcInterruptCategory) = 'CDD_ADC_ISR_CAT2_INT'"!]
                  <INTERRUPT-CATEGORY>CAT-2</INTERRUPT-CATEGORY>
                  [!ELSE!]
                  <INTERRUPT-CATEGORY>CAT-1</INTERRUPT-CATEGORY>
                  [!ENDIF!]                  
                </BSW-INTERRUPT-ENTITY>
              [!ELSE!]
              [!ENDIF!]
              [!ENDLOOP!] 
              [!LOOP "CddAdcPpbConfig/*"!]
              [!IF "(CddAdcPpbTripHighInterruptEnable = 'true' or CddAdcPpbTripLowInterruptEnable = 'true' or CddAdcPpbZeroCrossingInterruptEnable = 'true')"!]                
                <BSW-INTERRUPT-ENTITY UUID="c08e3ab1-df36-46df-a860-e770c00d901a">
                  <SHORT-NAME>Cdd_Adc_ADCE_PpbIntIsr</SHORT-NAME>
                  <REENTRANCY-LEVEL>NON-REENTRANT</REENTRANCY-LEVEL>
                  <IMPLEMENTED-ENTRY-REF DEST="BSW-MODULE-ENTRY">/Cdd_Adc_TI_F29H85x/Cdd_Adc_ModuleEntry/Cdd_Adc_ADCE_PpbIntIsr</IMPLEMENTED-ENTRY-REF>
                  [!IF "node:value(CddAdcEventInterruptCategory) = 'CDD_ADC_ISR_CAT2_INT'"!]
                  <INTERRUPT-CATEGORY>CAT-2</INTERRUPT-CATEGORY>
                  [!ELSE!]
                  <INTERRUPT-CATEGORY>CAT-1</INTERRUPT-CATEGORY>  
                  [!ENDIF!]                
                </BSW-INTERRUPT-ENTITY>
              [!BREAK!]
              [!ELSE!]
              [!ENDIF!]
              [!ENDLOOP!]
            [!ENDIF!]
            [!ENDLOOP!]
                [!IF "CddAdcGeneral/CddAdcSafetyCheckerEnable = 'true'"!]
                <BSW-CALLED-ENTITY UUID="79ee34eb-e9fc-4d69-8e7d-cf268b448e91">
                  <SHORT-NAME>Cdd_Adc_ClearCheckerEvt</SHORT-NAME>
                  <CAN-ENTER-EXCLUSIVE-AREA-REFS>
                    <CAN-ENTER-EXCLUSIVE-AREA-REF DEST="EXCLUSIVE-AREA">/Cdd_Adc_TI_F29H85x/Cdd_Adc/Cdd_Adc_Behavior/CDD_ADC_EXCLUSIVE_AREA_0</CAN-ENTER-EXCLUSIVE-AREA-REF>
                  </CAN-ENTER-EXCLUSIVE-AREA-REFS>
                  <REENTRANCY-LEVEL>SINGLE-CORE-REENTRANT</REENTRANCY-LEVEL>
                [!IF "CddAdcGeneral/CddAdcDevErrorDetect  = 'true'"!]
                  <CALL-POINTS>
                    <BSW-DIRECT-CALL-POINT>
                      <SHORT-NAME>Det</SHORT-NAME>
                      <CALLED-ENTRY-REF DEST="BSW-MODULE-ENTRY">/AUTOSAR_Det/Det/Det_ReportError</CALLED-ENTRY-REF>
                    </BSW-DIRECT-CALL-POINT>                  
                  </CALL-POINTS>
                [!ENDIF!]
                  <IMPLEMENTED-ENTRY-REF DEST="BSW-MODULE-ENTRY">/Cdd_Adc_TI_F29H85x/Cdd_Adc_ModuleEntry/Cdd_Adc_ClearCheckerEvt</IMPLEMENTED-ENTRY-REF>
                </BSW-CALLED-ENTITY>
                <BSW-CALLED-ENTITY UUID="08bd6605-9162-4248-b0c7-bf7ddd98d4ed">
                  <SHORT-NAME>Cdd_Adc_ReadCheckerStatus</SHORT-NAME>
                  <REENTRANCY-LEVEL>NON-REENTRANT</REENTRANCY-LEVEL>
                [!IF "CddAdcGeneral/CddAdcDevErrorDetect  = 'true'"!]
                  <CALL-POINTS>
                    <BSW-DIRECT-CALL-POINT>
                      <SHORT-NAME>Det</SHORT-NAME>
                      <CALLED-ENTRY-REF DEST="BSW-MODULE-ENTRY">/AUTOSAR_Det/Det/Det_ReportError</CALLED-ENTRY-REF>
                    </BSW-DIRECT-CALL-POINT>
                  </CALL-POINTS>
                [!ENDIF!]
                  <IMPLEMENTED-ENTRY-REF DEST="BSW-MODULE-ENTRY">/Cdd_Adc_TI_F29H85x/Cdd_Adc_ModuleEntry/Cdd_Adc_ReadCheckerStatus</IMPLEMENTED-ENTRY-REF>
                </BSW-CALLED-ENTITY>
                <BSW-CALLED-ENTITY UUID="3873f566-1c9d-4c6e-9b24-21917f025112">
                  <SHORT-NAME>Cdd_Adc_StartResultChecker</SHORT-NAME>
                  <CAN-ENTER-EXCLUSIVE-AREA-REFS>
                    <CAN-ENTER-EXCLUSIVE-AREA-REF DEST="EXCLUSIVE-AREA">/Cdd_Adc_TI_F29H85x/Cdd_Adc/Cdd_Adc_Behavior/CDD_ADC_EXCLUSIVE_AREA_0</CAN-ENTER-EXCLUSIVE-AREA-REF>
                  </CAN-ENTER-EXCLUSIVE-AREA-REFS>
                  <REENTRANCY-LEVEL>SINGLE-CORE-REENTRANT</REENTRANCY-LEVEL>
                  <CALL-POINTS>
                  [!IF "CddAdcGeneral/CddAdcDevErrorDetect  = 'true'"!]
                    <BSW-DIRECT-CALL-POINT>
                      <SHORT-NAME>Det</SHORT-NAME>
                      <CALLED-ENTRY-REF DEST="BSW-MODULE-ENTRY">/AUTOSAR_Det/Det/Det_ReportError</CALLED-ENTRY-REF>
                    </BSW-DIRECT-CALL-POINT>
                  [!ENDIF!]
                    <BSW-DIRECT-CALL-POINT>
                      <SHORT-NAME>Det_Runtime</SHORT-NAME>
                      <CALLED-ENTRY-REF DEST="BSW-MODULE-ENTRY">/AUTOSAR_Det/Det/Det_ReportRuntimeError</CALLED-ENTRY-REF>
                    </BSW-DIRECT-CALL-POINT>  
                  </CALL-POINTS>
                  <IMPLEMENTED-ENTRY-REF DEST="BSW-MODULE-ENTRY">/Cdd_Adc_TI_F29H85x/Cdd_Adc_ModuleEntry/Cdd_Adc_StartResultChecker</IMPLEMENTED-ENTRY-REF>
                </BSW-CALLED-ENTITY>
                <BSW-CALLED-ENTITY UUID="ed26244d-90f5-48d6-8153-1fcabc0f8f56">
                  <SHORT-NAME>Cdd_Adc_StopResultChecker</SHORT-NAME>
                  <CAN-ENTER-EXCLUSIVE-AREA-REFS>
                    <CAN-ENTER-EXCLUSIVE-AREA-REF DEST="EXCLUSIVE-AREA">/Cdd_Adc_TI_F29H85x/Cdd_Adc/Cdd_Adc_Behavior/CDD_ADC_EXCLUSIVE_AREA_0</CAN-ENTER-EXCLUSIVE-AREA-REF>
                  </CAN-ENTER-EXCLUSIVE-AREA-REFS>
                  <REENTRANCY-LEVEL>SINGLE-CORE-REENTRANT</REENTRANCY-LEVEL>
                  <CALL-POINTS>
                  [!IF "CddAdcGeneral/CddAdcDevErrorDetect  = 'true'"!]
                    <BSW-DIRECT-CALL-POINT>
                      <SHORT-NAME>Det</SHORT-NAME>
                      <CALLED-ENTRY-REF DEST="BSW-MODULE-ENTRY">/AUTOSAR_Det/Det/Det_ReportError</CALLED-ENTRY-REF>
                    </BSW-DIRECT-CALL-POINT>
                  [!ENDIF!]
                    <BSW-DIRECT-CALL-POINT>
                      <SHORT-NAME>Det_Runtime</SHORT-NAME>
                      <CALLED-ENTRY-REF DEST="BSW-MODULE-ENTRY">/AUTOSAR_Det/Det/Det_ReportRuntimeError</CALLED-ENTRY-REF>
                    </BSW-DIRECT-CALL-POINT>  
                  </CALL-POINTS>
                  <IMPLEMENTED-ENTRY-REF DEST="BSW-MODULE-ENTRY">/Cdd_Adc_TI_F29H85x/Cdd_Adc_ModuleEntry/Cdd_Adc_StopResultChecker</IMPLEMENTED-ENTRY-REF>
                </BSW-CALLED-ENTITY>
                [!ENDIF!]
                [!IF "CddAdcGeneral/CddAdcPpbEnable = 'true'"!]
                <BSW-CALLED-ENTITY UUID="6ea07d2b-ad3f-48ca-8d79-e119f35e85c1">
                  <SHORT-NAME>Cdd_Adc_ClearPpbEvt</SHORT-NAME>
                  <CAN-ENTER-EXCLUSIVE-AREA-REFS>
                    <CAN-ENTER-EXCLUSIVE-AREA-REF DEST="EXCLUSIVE-AREA">/Cdd_Adc_TI_F29H85x/Cdd_Adc/Cdd_Adc_Behavior/CDD_ADC_EXCLUSIVE_AREA_0</CAN-ENTER-EXCLUSIVE-AREA-REF>
                  </CAN-ENTER-EXCLUSIVE-AREA-REFS>
                  <REENTRANCY-LEVEL>SINGLE-CORE-REENTRANT</REENTRANCY-LEVEL>
                  [!IF "CddAdcGeneral/CddAdcDevErrorDetect  = 'true'"!]
                  <CALL-POINTS>
                    <BSW-DIRECT-CALL-POINT>
                      <SHORT-NAME>Det</SHORT-NAME>
                      <CALLED-ENTRY-REF DEST="BSW-MODULE-ENTRY">/AUTOSAR_Det/Det/Det_ReportError</CALLED-ENTRY-REF>
                    </BSW-DIRECT-CALL-POINT>
                  </CALL-POINTS>
                  [!ENDIF!]
                  <IMPLEMENTED-ENTRY-REF DEST="BSW-MODULE-ENTRY">/Cdd_Adc_TI_F29H85x/Cdd_Adc_ModuleEntry/Cdd_Adc_ClearPpbEvt</IMPLEMENTED-ENTRY-REF>
                </BSW-CALLED-ENTITY>
                <BSW-CALLED-ENTITY UUID="22b574ad-51da-4567-bfe3-0639a985f25e">
                  <SHORT-NAME>Cdd_Adc_GetDelayStamp</SHORT-NAME>
                  <CAN-ENTER-EXCLUSIVE-AREA-REFS>
                    <CAN-ENTER-EXCLUSIVE-AREA-REF DEST="EXCLUSIVE-AREA">/Cdd_Adc_TI_F29H85x/Cdd_Adc/Cdd_Adc_Behavior/CDD_ADC_EXCLUSIVE_AREA_0</CAN-ENTER-EXCLUSIVE-AREA-REF>
                  </CAN-ENTER-EXCLUSIVE-AREA-REFS>
                  <REENTRANCY-LEVEL>SINGLE-CORE-REENTRANT</REENTRANCY-LEVEL>
                  [!IF "CddAdcGeneral/CddAdcDevErrorDetect  = 'true'"!]
                  <CALL-POINTS>
                    <BSW-DIRECT-CALL-POINT>
                      <SHORT-NAME>Det</SHORT-NAME>
                      <CALLED-ENTRY-REF DEST="BSW-MODULE-ENTRY">/AUTOSAR_Det/Det/Det_ReportError</CALLED-ENTRY-REF>
                    </BSW-DIRECT-CALL-POINT>
                  </CALL-POINTS>
                  [!ENDIF!]
                  <IMPLEMENTED-ENTRY-REF DEST="BSW-MODULE-ENTRY">/Cdd_Adc_TI_F29H85x/Cdd_Adc_ModuleEntry/Cdd_Adc_GetDelayStamp</IMPLEMENTED-ENTRY-REF>
                </BSW-CALLED-ENTITY>
                <BSW-CALLED-ENTITY UUID="ec11fd99-da4f-4dd9-ad0e-2d2b2562badb">
                  <SHORT-NAME>Cdd_Adc_ReadPartialPpbValue</SHORT-NAME>
                  <CAN-ENTER-EXCLUSIVE-AREA-REFS>
                    <CAN-ENTER-EXCLUSIVE-AREA-REF DEST="EXCLUSIVE-AREA">/Cdd_Adc_TI_F29H85x/Cdd_Adc/Cdd_Adc_Behavior/CDD_ADC_EXCLUSIVE_AREA_0</CAN-ENTER-EXCLUSIVE-AREA-REF>
                  </CAN-ENTER-EXCLUSIVE-AREA-REFS>
                  <REENTRANCY-LEVEL>SINGLE-CORE-REENTRANT</REENTRANCY-LEVEL>
                [!IF "CddAdcGeneral/CddAdcDevErrorDetect  = 'true'"!]
                  <CALL-POINTS>
                    <BSW-DIRECT-CALL-POINT>
                      <SHORT-NAME>Det</SHORT-NAME>
                      <CALLED-ENTRY-REF DEST="BSW-MODULE-ENTRY">/AUTOSAR_Det/Det/Det_ReportError</CALLED-ENTRY-REF>
                    </BSW-DIRECT-CALL-POINT>
                  </CALL-POINTS>
                [!ENDIF!]
                  <IMPLEMENTED-ENTRY-REF DEST="BSW-MODULE-ENTRY">/Cdd_Adc_TI_F29H85x/Cdd_Adc_ModuleEntry/Cdd_Adc_ReadPartialPpbValue</IMPLEMENTED-ENTRY-REF>
                </BSW-CALLED-ENTITY>
                <BSW-CALLED-ENTITY UUID="72400e2a-0ee7-46ee-9f55-15efd05b591b">
                  <SHORT-NAME>Cdd_Adc_ReadPpb</SHORT-NAME>
                  <CAN-ENTER-EXCLUSIVE-AREA-REFS>
                    <CAN-ENTER-EXCLUSIVE-AREA-REF DEST="EXCLUSIVE-AREA">/Cdd_Adc_TI_F29H85x/Cdd_Adc/Cdd_Adc_Behavior/CDD_ADC_EXCLUSIVE_AREA_0</CAN-ENTER-EXCLUSIVE-AREA-REF>
                  </CAN-ENTER-EXCLUSIVE-AREA-REFS>
                  <REENTRANCY-LEVEL>SINGLE-CORE-REENTRANT</REENTRANCY-LEVEL>
                  [!IF "CddAdcGeneral/CddAdcDevErrorDetect  = 'true'"!]
                  <CALL-POINTS>
                    <BSW-DIRECT-CALL-POINT>
                      <SHORT-NAME>Det</SHORT-NAME>
                      <CALLED-ENTRY-REF DEST="BSW-MODULE-ENTRY">/AUTOSAR_Det/Det/Det_ReportError</CALLED-ENTRY-REF>
                    </BSW-DIRECT-CALL-POINT>
                  </CALL-POINTS>
                  [!ENDIF!]
                  <IMPLEMENTED-ENTRY-REF DEST="BSW-MODULE-ENTRY">/Cdd_Adc_TI_F29H85x/Cdd_Adc_ModuleEntry/Cdd_Adc_ReadPpb</IMPLEMENTED-ENTRY-REF>
                </BSW-CALLED-ENTITY>
                [!IF "$PpbEvtNotification > 0"!]
                <BSW-CALLED-ENTITY UUID="21b574ad-51da-4567-bfe3-0639a985f25e">
                  <SHORT-NAME>Cdd_Adc_ConfigurePpbNotification</SHORT-NAME>
                  <CAN-ENTER-EXCLUSIVE-AREA-REFS>
                    <CAN-ENTER-EXCLUSIVE-AREA-REF DEST="EXCLUSIVE-AREA">/Cdd_Adc_TI_F29H85x/Cdd_Adc/Cdd_Adc_Behavior/CDD_ADC_EXCLUSIVE_AREA_0</CAN-ENTER-EXCLUSIVE-AREA-REF>
                  </CAN-ENTER-EXCLUSIVE-AREA-REFS>
                  <REENTRANCY-LEVEL>SINGLE-CORE-REENTRANT</REENTRANCY-LEVEL>
                  [!IF "CddAdcGeneral/CddAdcDevErrorDetect  = 'true'"!]
                  <CALL-POINTS>
                    <BSW-DIRECT-CALL-POINT>
                      <SHORT-NAME>Det</SHORT-NAME>
                      <CALLED-ENTRY-REF DEST="BSW-MODULE-ENTRY">/AUTOSAR_Det/Det/Det_ReportError</CALLED-ENTRY-REF>
                    </BSW-DIRECT-CALL-POINT>
                  </CALL-POINTS>
                  [!ENDIF!]
                  <IMPLEMENTED-ENTRY-REF DEST="BSW-MODULE-ENTRY">/Cdd_Adc_TI_F29H85x/Cdd_Adc_ModuleEntry/Cdd_Adc_ConfigurePpbNotification</IMPLEMENTED-ENTRY-REF>
                </BSW-CALLED-ENTITY>
                [!ENDIF!]
                <BSW-CALLED-ENTITY UUID="5afe7ff5-3d4d-47ec-8573-b381dfffeb57">
                  <SHORT-NAME>Cdd_Adc_ReadPpbValue</SHORT-NAME>
                  <CAN-ENTER-EXCLUSIVE-AREA-REFS>
                    <CAN-ENTER-EXCLUSIVE-AREA-REF DEST="EXCLUSIVE-AREA">/Cdd_Adc_TI_F29H85x/Cdd_Adc/Cdd_Adc_Behavior/CDD_ADC_EXCLUSIVE_AREA_0</CAN-ENTER-EXCLUSIVE-AREA-REF>
                  </CAN-ENTER-EXCLUSIVE-AREA-REFS>
                  <REENTRANCY-LEVEL>SINGLE-CORE-REENTRANT</REENTRANCY-LEVEL>
                [!IF "CddAdcGeneral/CddAdcDevErrorDetect  = 'true'"!]
                  <CALL-POINTS>
                    <BSW-DIRECT-CALL-POINT>
                      <SHORT-NAME>Det</SHORT-NAME>
                      <CALLED-ENTRY-REF DEST="BSW-MODULE-ENTRY">/AUTOSAR_Det/Det/Det_ReportError</CALLED-ENTRY-REF>
                    </BSW-DIRECT-CALL-POINT>
                  </CALL-POINTS>
                [!ENDIF!]
                  <IMPLEMENTED-ENTRY-REF DEST="BSW-MODULE-ENTRY">/Cdd_Adc_TI_F29H85x/Cdd_Adc_ModuleEntry/Cdd_Adc_ReadPpbValue</IMPLEMENTED-ENTRY-REF>
                </BSW-CALLED-ENTITY>
                [!ENDIF!]
                [!IF "CddAdcGeneral/CddAdcDeInitApi = 'true'"!]
                <BSW-CALLED-ENTITY UUID="651bbd50-7d63-4d59-965e-17dff3fd0f04">
                  <SHORT-NAME>Cdd_Adc_DeInit</SHORT-NAME>
                  <REENTRANCY-LEVEL>NON-REENTRANT</REENTRANCY-LEVEL>
                [!IF "CddAdcGeneral/CddAdcDevErrorDetect  = 'true'"!]
                  <CALL-POINTS>
                    <BSW-DIRECT-CALL-POINT>
                      <SHORT-NAME>Det</SHORT-NAME>
                      <CALLED-ENTRY-REF DEST="BSW-MODULE-ENTRY">/AUTOSAR_Det/Det/Det_ReportError</CALLED-ENTRY-REF>
                    </BSW-DIRECT-CALL-POINT>
                  </CALL-POINTS>
                [!ENDIF!]
                  <IMPLEMENTED-ENTRY-REF DEST="BSW-MODULE-ENTRY">/Cdd_Adc_TI_F29H85x/Cdd_Adc_ModuleEntry/Cdd_Adc_DeInit</IMPLEMENTED-ENTRY-REF>
                </BSW-CALLED-ENTITY>
                [!ENDIF!]
                [!IF "CddAdcGeneral/CddAdcNotifCapability = 'true'"!]
                <BSW-CALLED-ENTITY UUID="d8fc5289-1682-47a8-97fa-be6fbb3515ce">
                  <SHORT-NAME>Cdd_Adc_EnableGroupNotification</SHORT-NAME>
                  <CAN-ENTER-EXCLUSIVE-AREA-REFS>
                    <CAN-ENTER-EXCLUSIVE-AREA-REF DEST="EXCLUSIVE-AREA">/Cdd_Adc_TI_F29H85x/Cdd_Adc/Cdd_Adc_Behavior/CDD_ADC_EXCLUSIVE_AREA_0</CAN-ENTER-EXCLUSIVE-AREA-REF>
                  </CAN-ENTER-EXCLUSIVE-AREA-REFS>
                  <REENTRANCY-LEVEL>SINGLE-CORE-REENTRANT</REENTRANCY-LEVEL>
                  [!IF "CddAdcGeneral/CddAdcDevErrorDetect  = 'true'"!]
                  <CALL-POINTS>
                    <BSW-DIRECT-CALL-POINT>
                      <SHORT-NAME>Det</SHORT-NAME>
                      <CALLED-ENTRY-REF DEST="BSW-MODULE-ENTRY">/AUTOSAR_Det/Det/Det_ReportError</CALLED-ENTRY-REF>
                    </BSW-DIRECT-CALL-POINT>
                  </CALL-POINTS>
                [!ENDIF!]
                  <IMPLEMENTED-ENTRY-REF DEST="BSW-MODULE-ENTRY">/Cdd_Adc_TI_F29H85x/Cdd_Adc_ModuleEntry/Cdd_Adc_EnableGroupNotification</IMPLEMENTED-ENTRY-REF>
                </BSW-CALLED-ENTITY>
                <BSW-CALLED-ENTITY UUID="9d8c8d20-eda8-4c53-8ab5-ac8b80c04faa">
                  <SHORT-NAME>Cdd_Adc_DisableGroupNotification</SHORT-NAME>
                  <CAN-ENTER-EXCLUSIVE-AREA-REFS>
                    <CAN-ENTER-EXCLUSIVE-AREA-REF DEST="EXCLUSIVE-AREA">/Cdd_Adc_TI_F29H85x/Cdd_Adc/Cdd_Adc_Behavior/CDD_ADC_EXCLUSIVE_AREA_0</CAN-ENTER-EXCLUSIVE-AREA-REF>
                  </CAN-ENTER-EXCLUSIVE-AREA-REFS>
                  <REENTRANCY-LEVEL>SINGLE-CORE-REENTRANT</REENTRANCY-LEVEL>
                [!IF "CddAdcGeneral/CddAdcDevErrorDetect  = 'true'"!]
                  <CALL-POINTS>
                    <BSW-DIRECT-CALL-POINT>
                      <SHORT-NAME>Det</SHORT-NAME>
                      <CALLED-ENTRY-REF DEST="BSW-MODULE-ENTRY">/AUTOSAR_Det/Det/Det_ReportError</CALLED-ENTRY-REF>
                    </BSW-DIRECT-CALL-POINT>
                  </CALL-POINTS>
                [!ENDIF!]
                  <IMPLEMENTED-ENTRY-REF DEST="BSW-MODULE-ENTRY">/Cdd_Adc_TI_F29H85x/Cdd_Adc_ModuleEntry/Cdd_Adc_DisableGroupNotification</IMPLEMENTED-ENTRY-REF>
                </BSW-CALLED-ENTITY>
                [!ENDIF!]
                [!IF "CddAdcGeneral/CddAdcHwTriggerApi = 'true'"!]
                <BSW-CALLED-ENTITY UUID="5ecc9ae5-238e-4a6c-bfa1-6ee4bf44b997">
                  <SHORT-NAME>Cdd_Adc_DisableHardwareTrigger</SHORT-NAME>
                  <CAN-ENTER-EXCLUSIVE-AREA-REFS>
                    <CAN-ENTER-EXCLUSIVE-AREA-REF DEST="EXCLUSIVE-AREA">/Cdd_Adc_TI_F29H85x/Cdd_Adc/Cdd_Adc_Behavior/CDD_ADC_EXCLUSIVE_AREA_0</CAN-ENTER-EXCLUSIVE-AREA-REF>
                  </CAN-ENTER-EXCLUSIVE-AREA-REFS>
                  <REENTRANCY-LEVEL>SINGLE-CORE-REENTRANT</REENTRANCY-LEVEL>
                  <CALL-POINTS>
                  [!IF "CddAdcGeneral/CddAdcDevErrorDetect  = 'true'"!]
                    <BSW-DIRECT-CALL-POINT>
                      <SHORT-NAME>Det</SHORT-NAME>
                      <CALLED-ENTRY-REF DEST="BSW-MODULE-ENTRY">/AUTOSAR_Det/Det/Det_ReportError</CALLED-ENTRY-REF>
                    </BSW-DIRECT-CALL-POINT>
                  [!ENDIF!]
                    <BSW-DIRECT-CALL-POINT>
                      <SHORT-NAME>Det_Runtime</SHORT-NAME>
                      <CALLED-ENTRY-REF DEST="BSW-MODULE-ENTRY">/AUTOSAR_Det/Det/Det_ReportRuntimeError</CALLED-ENTRY-REF>
                    </BSW-DIRECT-CALL-POINT>
                  </CALL-POINTS>
                  <IMPLEMENTED-ENTRY-REF DEST="BSW-MODULE-ENTRY">/Cdd_Adc_TI_F29H85x/Cdd_Adc_ModuleEntry/Cdd_Adc_DisableHardwareTrigger</IMPLEMENTED-ENTRY-REF>
                </BSW-CALLED-ENTITY>
                <BSW-CALLED-ENTITY UUID="6240e756-c91d-4d38-8566-949c17afe46d">
                  <SHORT-NAME>Cdd_Adc_EnableHardwareTrigger</SHORT-NAME>
                  <CAN-ENTER-EXCLUSIVE-AREA-REFS>
                    <CAN-ENTER-EXCLUSIVE-AREA-REF DEST="EXCLUSIVE-AREA">/Cdd_Adc_TI_F29H85x/Cdd_Adc/Cdd_Adc_Behavior/CDD_ADC_EXCLUSIVE_AREA_0</CAN-ENTER-EXCLUSIVE-AREA-REF>
                  </CAN-ENTER-EXCLUSIVE-AREA-REFS>
                  <REENTRANCY-LEVEL>SINGLE-CORE-REENTRANT</REENTRANCY-LEVEL>
                  <CALL-POINTS>
                  [!IF "CddAdcGeneral/CddAdcDevErrorDetect  = 'true'"!]
                    <BSW-DIRECT-CALL-POINT>
                      <SHORT-NAME>Det</SHORT-NAME>
                      <CALLED-ENTRY-REF DEST="BSW-MODULE-ENTRY">/AUTOSAR_Det/Det/Det_ReportError</CALLED-ENTRY-REF>
                    </BSW-DIRECT-CALL-POINT>
                  [!ENDIF!]
                    <BSW-DIRECT-CALL-POINT>
                      <SHORT-NAME>Det_Runtime</SHORT-NAME>
                      <CALLED-ENTRY-REF DEST="BSW-MODULE-ENTRY">/AUTOSAR_Det/Det/Det_ReportRuntimeError</CALLED-ENTRY-REF>
                    </BSW-DIRECT-CALL-POINT>  
                  </CALL-POINTS>
                  <IMPLEMENTED-ENTRY-REF DEST="BSW-MODULE-ENTRY">/Cdd_Adc_TI_F29H85x/Cdd_Adc_ModuleEntry/Cdd_Adc_EnableHardwareTrigger</IMPLEMENTED-ENTRY-REF>
                </BSW-CALLED-ENTITY>
                [!ENDIF!]
                <BSW-CALLED-ENTITY UUID="0c03974a-1da2-404a-9e71-cd171747303d">
                  <SHORT-NAME>Cdd_Adc_GetGroupStatus</SHORT-NAME>
                  <CAN-ENTER-EXCLUSIVE-AREA-REFS>
                    <CAN-ENTER-EXCLUSIVE-AREA-REF DEST="EXCLUSIVE-AREA">/Cdd_Adc_TI_F29H85x/Cdd_Adc/Cdd_Adc_Behavior/CDD_ADC_EXCLUSIVE_AREA_0</CAN-ENTER-EXCLUSIVE-AREA-REF>
                  </CAN-ENTER-EXCLUSIVE-AREA-REFS>
                  <REENTRANCY-LEVEL>SINGLE-CORE-REENTRANT</REENTRANCY-LEVEL>
                [!IF "CddAdcGeneral/CddAdcDevErrorDetect  = 'true'"!]
                  <CALL-POINTS>
                    <BSW-DIRECT-CALL-POINT>
                      <SHORT-NAME>Det</SHORT-NAME>
                      <CALLED-ENTRY-REF DEST="BSW-MODULE-ENTRY">/AUTOSAR_Det/Det/Det_ReportError</CALLED-ENTRY-REF>
                    </BSW-DIRECT-CALL-POINT>
                  </CALL-POINTS>
                [!ENDIF!]
                  <IMPLEMENTED-ENTRY-REF DEST="BSW-MODULE-ENTRY">/Cdd_Adc_TI_F29H85x/Cdd_Adc_ModuleEntry/Cdd_Adc_GetGroupStatus</IMPLEMENTED-ENTRY-REF>
                </BSW-CALLED-ENTITY>
                <BSW-CALLED-ENTITY UUID="0c03984a-1da2-404a-9e71-cd171747303d">
                  <SHORT-NAME>Cdd_Adc_SetInternalTestNode</SHORT-NAME>
                  <CAN-ENTER-EXCLUSIVE-AREA-REFS>
                    <CAN-ENTER-EXCLUSIVE-AREA-REF DEST="EXCLUSIVE-AREA">/Cdd_Adc_TI_F29H85x/Cdd_Adc/Cdd_Adc_Behavior/CDD_ADC_EXCLUSIVE_AREA_0</CAN-ENTER-EXCLUSIVE-AREA-REF>
                  </CAN-ENTER-EXCLUSIVE-AREA-REFS>
                  <REENTRANCY-LEVEL>SINGLE-CORE-REENTRANT</REENTRANCY-LEVEL>
                [!IF "CddAdcGeneral/CddAdcDevErrorDetect  = 'true'"!]
                  <CALL-POINTS>
                    <BSW-DIRECT-CALL-POINT>
                      <SHORT-NAME>Det</SHORT-NAME>
                      <CALLED-ENTRY-REF DEST="BSW-MODULE-ENTRY">/AUTOSAR_Det/Det/Det_ReportError</CALLED-ENTRY-REF>
                    </BSW-DIRECT-CALL-POINT>
                  </CALL-POINTS>
                [!ENDIF!]
                  <IMPLEMENTED-ENTRY-REF DEST="BSW-MODULE-ENTRY">/Cdd_Adc_TI_F29H85x/Cdd_Adc_ModuleEntry/Cdd_Adc_SetInternalTestNode</IMPLEMENTED-ENTRY-REF>
                </BSW-CALLED-ENTITY>
                <BSW-CALLED-ENTITY UUID="ad08af1d-2dd8-4551-a036-3dd706a08933">
                  <SHORT-NAME>Cdd_Adc_GetStreamLastPointer</SHORT-NAME>
                  <CAN-ENTER-EXCLUSIVE-AREA-REFS>
                    <CAN-ENTER-EXCLUSIVE-AREA-REF DEST="EXCLUSIVE-AREA">/Cdd_Adc_TI_F29H85x/Cdd_Adc/Cdd_Adc_Behavior/CDD_ADC_EXCLUSIVE_AREA_0</CAN-ENTER-EXCLUSIVE-AREA-REF>
                  </CAN-ENTER-EXCLUSIVE-AREA-REFS>
                  <REENTRANCY-LEVEL>SINGLE-CORE-REENTRANT</REENTRANCY-LEVEL>
                  <CALL-POINTS>
                  [!IF "CddAdcGeneral/CddAdcDevErrorDetect  = 'true'"!]
                    <BSW-DIRECT-CALL-POINT>
                      <SHORT-NAME>Det</SHORT-NAME>
                      <CALLED-ENTRY-REF DEST="BSW-MODULE-ENTRY">/AUTOSAR_Det/Det/Det_ReportError</CALLED-ENTRY-REF>
                    </BSW-DIRECT-CALL-POINT>
                  [!ENDIF!]
                    <BSW-DIRECT-CALL-POINT>
                      <SHORT-NAME>Det_Runtime</SHORT-NAME>
                      <CALLED-ENTRY-REF DEST="BSW-MODULE-ENTRY">/AUTOSAR_Det/Det/Det_ReportRuntimeError</CALLED-ENTRY-REF>
                    </BSW-DIRECT-CALL-POINT>  
                  </CALL-POINTS>
                  <IMPLEMENTED-ENTRY-REF DEST="BSW-MODULE-ENTRY">/Cdd_Adc_TI_F29H85x/Cdd_Adc_ModuleEntry/Cdd_Adc_GetStreamLastPointer</IMPLEMENTED-ENTRY-REF>
                </BSW-CALLED-ENTITY>
                [!IF "CddAdcConfigSet/CddAdcEnableTemperatureSensor = 'true'"!]
                <BSW-CALLED-ENTITY UUID="2c4e81ea-0048-4fb7-a354-617150db19a6">
                  <SHORT-NAME>Cdd_Adc_GetTemperatureC</SHORT-NAME>
                  <CAN-ENTER-EXCLUSIVE-AREA-REFS>
                    <CAN-ENTER-EXCLUSIVE-AREA-REF DEST="EXCLUSIVE-AREA">/Cdd_Adc_TI_F29H85x/Cdd_Adc/Cdd_Adc_Behavior/CDD_ADC_EXCLUSIVE_AREA_0</CAN-ENTER-EXCLUSIVE-AREA-REF>
                  </CAN-ENTER-EXCLUSIVE-AREA-REFS>
                  <REENTRANCY-LEVEL>SINGLE-CORE-REENTRANT</REENTRANCY-LEVEL>
                [!IF "CddAdcGeneral/CddAdcDevErrorDetect  = 'true'"!]
                  <CALL-POINTS>
                    <BSW-DIRECT-CALL-POINT>
                      <SHORT-NAME>Det</SHORT-NAME>
                      <CALLED-ENTRY-REF DEST="BSW-MODULE-ENTRY">/AUTOSAR_Det/Det/Det_ReportError</CALLED-ENTRY-REF>
                    </BSW-DIRECT-CALL-POINT>
                  </CALL-POINTS>
                [!ENDIF!]
                  <IMPLEMENTED-ENTRY-REF DEST="BSW-MODULE-ENTRY">/Cdd_Adc_TI_F29H85x/Cdd_Adc_ModuleEntry/Cdd_Adc_GetTemperatureC</IMPLEMENTED-ENTRY-REF>
                </BSW-CALLED-ENTITY>
                <BSW-CALLED-ENTITY UUID="550faa6e-e80d-46fc-88c8-248636ac0d0d">
                  <SHORT-NAME>Cdd_Adc_GetTemperatureK</SHORT-NAME>
                  <CAN-ENTER-EXCLUSIVE-AREA-REFS>
                    <CAN-ENTER-EXCLUSIVE-AREA-REF DEST="EXCLUSIVE-AREA">/Cdd_Adc_TI_F29H85x/Cdd_Adc/Cdd_Adc_Behavior/CDD_ADC_EXCLUSIVE_AREA_0</CAN-ENTER-EXCLUSIVE-AREA-REF>
                  </CAN-ENTER-EXCLUSIVE-AREA-REFS>
                  <REENTRANCY-LEVEL>SINGLE-CORE-REENTRANT</REENTRANCY-LEVEL>
                [!IF "CddAdcGeneral/CddAdcDevErrorDetect  = 'true'"!]
                  <CALL-POINTS>
                    <BSW-DIRECT-CALL-POINT>
                      <SHORT-NAME>Det</SHORT-NAME>
                      <CALLED-ENTRY-REF DEST="BSW-MODULE-ENTRY">/AUTOSAR_Det/Det/Det_ReportError</CALLED-ENTRY-REF>
                    </BSW-DIRECT-CALL-POINT>
                  </CALL-POINTS>
                [!ENDIF!]
                  <IMPLEMENTED-ENTRY-REF DEST="BSW-MODULE-ENTRY">/Cdd_Adc_TI_F29H85x/Cdd_Adc_ModuleEntry/Cdd_Adc_GetTemperatureK</IMPLEMENTED-ENTRY-REF>
                </BSW-CALLED-ENTITY>
                [!ENDIF!]
                [!IF "CddAdcGeneral/CddAdcVersionInfoApi = 'true'"!]
                <BSW-CALLED-ENTITY UUID="ff8af45f-9327-43ec-a2c3-d836793c5dfa">
                  <SHORT-NAME>Cdd_Adc_GetVersionInfo</SHORT-NAME>
                  <REENTRANCY-LEVEL>SINGLE-CORE-REENTRANT</REENTRANCY-LEVEL>
                [!IF "CddAdcGeneral/CddAdcDevErrorDetect  = 'true'"!]
                  <CALL-POINTS>
                    <BSW-DIRECT-CALL-POINT>
                      <SHORT-NAME>Det</SHORT-NAME>
                      <CALLED-ENTRY-REF DEST="BSW-MODULE-ENTRY">/AUTOSAR_Det/Det/Det_ReportError</CALLED-ENTRY-REF>
                    </BSW-DIRECT-CALL-POINT>
                  </CALL-POINTS>
                [!ENDIF!]
                  <IMPLEMENTED-ENTRY-REF DEST="BSW-MODULE-ENTRY">/Cdd_Adc_TI_F29H85x/Cdd_Adc_ModuleEntry/Cdd_Adc_GetVersionInfo</IMPLEMENTED-ENTRY-REF>
                </BSW-CALLED-ENTITY>
                [!ENDIF!]
                <BSW-CALLED-ENTITY UUID="12cf18e0-9183-4e55-839b-57fe386a0627">
                  <SHORT-NAME>Cdd_Adc_Init</SHORT-NAME>
                  <REENTRANCY-LEVEL>NON-REENTRANT</REENTRANCY-LEVEL>
                [!IF "CddAdcGeneral/CddAdcDevErrorDetect  = 'true'"!]
                  <CALL-POINTS>
                    <BSW-DIRECT-CALL-POINT>
                      <SHORT-NAME>Det</SHORT-NAME>
                      <CALLED-ENTRY-REF DEST="BSW-MODULE-ENTRY">/AUTOSAR_Det/Det/Det_ReportError</CALLED-ENTRY-REF>
                    </BSW-DIRECT-CALL-POINT>
                  </CALL-POINTS>
                [!ENDIF!]
                  <IMPLEMENTED-ENTRY-REF DEST="BSW-MODULE-ENTRY">/Cdd_Adc_TI_F29H85x/Cdd_Adc_ModuleEntry/Cdd_Adc_Init</IMPLEMENTED-ENTRY-REF>
                </BSW-CALLED-ENTITY>
                <BSW-CALLED-ENTITY UUID="11cf18e0-9183-4e55-839b-57fe386a0627">
                  <SHORT-NAME>Cdd_Adc_UpdateStatusThroughDma</SHORT-NAME>
                  <REENTRANCY-LEVEL>NON-REENTRANT</REENTRANCY-LEVEL>
                  <CALL-POINTS>  
                    <BSW-DIRECT-CALL-POINT>
                      <SHORT-NAME>Det_Runtime</SHORT-NAME>
                      <CALLED-ENTRY-REF DEST="BSW-MODULE-ENTRY">/AUTOSAR_Det/Det/Det_ReportRuntimeError</CALLED-ENTRY-REF>
                    </BSW-DIRECT-CALL-POINT>  
                  </CALL-POINTS>
				          <IMPLEMENTED-ENTRY-REF DEST="BSW-MODULE-ENTRY">/Cdd_Adc_TI_F29H85x/Cdd_Adc_ModuleEntry/Cdd_Adc_UpdateStatusThroughDma</IMPLEMENTED-ENTRY-REF>
                </BSW-CALLED-ENTITY>
                [!IF "CddAdcGeneral/CddAdcReadGroupApi = 'true'"!]
                <BSW-CALLED-ENTITY UUID="e72f7886-1549-4bb6-b596-6aaf3e811fce">
                  <SHORT-NAME>Cdd_Adc_ReadGroup</SHORT-NAME>
                  <CAN-ENTER-EXCLUSIVE-AREA-REFS>
                    <CAN-ENTER-EXCLUSIVE-AREA-REF DEST="EXCLUSIVE-AREA">/Cdd_Adc_TI_F29H85x/Cdd_Adc/Cdd_Adc_Behavior/CDD_ADC_EXCLUSIVE_AREA_0</CAN-ENTER-EXCLUSIVE-AREA-REF>
                  </CAN-ENTER-EXCLUSIVE-AREA-REFS>
                  <REENTRANCY-LEVEL>SINGLE-CORE-REENTRANT</REENTRANCY-LEVEL>
                  <CALL-POINTS>
                  [!IF "CddAdcGeneral/CddAdcDevErrorDetect  = 'true'"!]
                    <BSW-DIRECT-CALL-POINT>
                      <SHORT-NAME>Det</SHORT-NAME>
                      <CALLED-ENTRY-REF DEST="BSW-MODULE-ENTRY">/AUTOSAR_Det/Det/Det_ReportError</CALLED-ENTRY-REF>
                    </BSW-DIRECT-CALL-POINT>
                  [!ENDIF!]
                    <BSW-DIRECT-CALL-POINT>
                      <SHORT-NAME>Det_Runtime</SHORT-NAME>
                      <CALLED-ENTRY-REF DEST="BSW-MODULE-ENTRY">/AUTOSAR_Det/Det/Det_ReportRuntimeError</CALLED-ENTRY-REF>
                    </BSW-DIRECT-CALL-POINT>  
                  </CALL-POINTS>
                  <IMPLEMENTED-ENTRY-REF DEST="BSW-MODULE-ENTRY">/Cdd_Adc_TI_F29H85x/Cdd_Adc_ModuleEntry/Cdd_Adc_ReadGroup</IMPLEMENTED-ENTRY-REF>
                </BSW-CALLED-ENTITY>
                [!ENDIF!]
                [!IF "CddAdcGeneral/CddAdcSetResolutionApi = 'true'"!]
                <BSW-CALLED-ENTITY UUID="46ea5dc8-db30-4557-a6ba-37df6db09c51">
                  <SHORT-NAME>Cdd_Adc_SetResolution</SHORT-NAME>
                  <CAN-ENTER-EXCLUSIVE-AREA-REFS>
                    <CAN-ENTER-EXCLUSIVE-AREA-REF DEST="EXCLUSIVE-AREA">/Cdd_Adc_TI_F29H85x/Cdd_Adc/Cdd_Adc_Behavior/CDD_ADC_EXCLUSIVE_AREA_0</CAN-ENTER-EXCLUSIVE-AREA-REF>
                  </CAN-ENTER-EXCLUSIVE-AREA-REFS>
                  <REENTRANCY-LEVEL>SINGLE-CORE-REENTRANT</REENTRANCY-LEVEL>
                  <CALL-POINTS>
                  [!IF "CddAdcGeneral/CddAdcDevErrorDetect  = 'true'"!]
                    <BSW-DIRECT-CALL-POINT>
                      <SHORT-NAME>Det</SHORT-NAME>
                      <CALLED-ENTRY-REF DEST="BSW-MODULE-ENTRY">/AUTOSAR_Det/Det/Det_ReportError</CALLED-ENTRY-REF>
                    </BSW-DIRECT-CALL-POINT>
                  [!ENDIF!]
                    <BSW-DIRECT-CALL-POINT>
                      <SHORT-NAME>Det_Runtime</SHORT-NAME>
                      <CALLED-ENTRY-REF DEST="BSW-MODULE-ENTRY">/AUTOSAR_Det/Det/Det_ReportRuntimeError</CALLED-ENTRY-REF>
                    </BSW-DIRECT-CALL-POINT>  
                  </CALL-POINTS>
                  <IMPLEMENTED-ENTRY-REF DEST="BSW-MODULE-ENTRY">/Cdd_Adc_TI_F29H85x/Cdd_Adc_ModuleEntry/Cdd_Adc_SetResolution</IMPLEMENTED-ENTRY-REF>
                </BSW-CALLED-ENTITY>
                [!ENDIF!]
                <BSW-CALLED-ENTITY UUID="6e74426b-8b78-4198-977c-d9ede8d0d44f">
                  <SHORT-NAME>Cdd_Adc_SetupResultBuffer</SHORT-NAME>
                  <CAN-ENTER-EXCLUSIVE-AREA-REFS>
                    <CAN-ENTER-EXCLUSIVE-AREA-REF DEST="EXCLUSIVE-AREA">/Cdd_Adc_TI_F29H85x/Cdd_Adc/Cdd_Adc_Behavior/CDD_ADC_EXCLUSIVE_AREA_0</CAN-ENTER-EXCLUSIVE-AREA-REF>
                  </CAN-ENTER-EXCLUSIVE-AREA-REFS>
                  <REENTRANCY-LEVEL>SINGLE-CORE-REENTRANT</REENTRANCY-LEVEL>
                  <CALL-POINTS>
                  [!IF "CddAdcGeneral/CddAdcDevErrorDetect  = 'true'"!]
                    <BSW-DIRECT-CALL-POINT>
                      <SHORT-NAME>Det</SHORT-NAME>
                      <CALLED-ENTRY-REF DEST="BSW-MODULE-ENTRY">/AUTOSAR_Det/Det/Det_ReportError</CALLED-ENTRY-REF>
                    </BSW-DIRECT-CALL-POINT>
                  [!ENDIF!]
                    <BSW-DIRECT-CALL-POINT>
                      <SHORT-NAME>Det_Runtime</SHORT-NAME>
                      <CALLED-ENTRY-REF DEST="BSW-MODULE-ENTRY">/AUTOSAR_Det/Det/Det_ReportRuntimeError</CALLED-ENTRY-REF>
                    </BSW-DIRECT-CALL-POINT>  
                  </CALL-POINTS>
                  <IMPLEMENTED-ENTRY-REF DEST="BSW-MODULE-ENTRY">/Cdd_Adc_TI_F29H85x/Cdd_Adc_ModuleEntry/Cdd_Adc_SetupResultBuffer</IMPLEMENTED-ENTRY-REF>
                </BSW-CALLED-ENTITY>
                [!IF "CddAdcGeneral/CddAdcEnableGlobalSoftwareTrigger = 'true'"!]
                <BSW-CALLED-ENTITY UUID="83f53b90-996d-4854-ac7f-de2f65096da0">
                  <SHORT-NAME>Cdd_Adc_StartGlobalSwTrig</SHORT-NAME>
                  <CAN-ENTER-EXCLUSIVE-AREA-REFS>
                    <CAN-ENTER-EXCLUSIVE-AREA-REF DEST="EXCLUSIVE-AREA">/Cdd_Adc_TI_F29H85x/Cdd_Adc/Cdd_Adc_Behavior/CDD_ADC_EXCLUSIVE_AREA_0</CAN-ENTER-EXCLUSIVE-AREA-REF>
                  </CAN-ENTER-EXCLUSIVE-AREA-REFS>
                  <REENTRANCY-LEVEL>SINGLE-CORE-REENTRANT</REENTRANCY-LEVEL>
                  <CALL-POINTS>
                  [!IF "CddAdcGeneral/CddAdcDevErrorDetect  = 'true'"!]
                    <BSW-DIRECT-CALL-POINT>
                      <SHORT-NAME>Det</SHORT-NAME>
                      <CALLED-ENTRY-REF DEST="BSW-MODULE-ENTRY">/AUTOSAR_Det/Det/Det_ReportError</CALLED-ENTRY-REF>
                    </BSW-DIRECT-CALL-POINT>
                  [!ENDIF!]
                    <BSW-DIRECT-CALL-POINT>
                      <SHORT-NAME>Det_Runtime</SHORT-NAME>
                      <CALLED-ENTRY-REF DEST="BSW-MODULE-ENTRY">/AUTOSAR_Det/Det/Det_ReportRuntimeError</CALLED-ENTRY-REF>
                    </BSW-DIRECT-CALL-POINT>  
                  </CALL-POINTS>
                  <IMPLEMENTED-ENTRY-REF DEST="BSW-MODULE-ENTRY">/Cdd_Adc_TI_F29H85x/Cdd_Adc_ModuleEntry/Cdd_Adc_StartGlobalSwTrig</IMPLEMENTED-ENTRY-REF>
                </BSW-CALLED-ENTITY>
                <BSW-CALLED-ENTITY UUID="83f53b90-996d-4854-ac7f-de2f65086da0">
                  <SHORT-NAME>Cdd_Adc_StopGlobalSwTrig</SHORT-NAME>
                  <CAN-ENTER-EXCLUSIVE-AREA-REFS>
                    <CAN-ENTER-EXCLUSIVE-AREA-REF DEST="EXCLUSIVE-AREA">/Cdd_Adc_TI_F29H85x/Cdd_Adc/Cdd_Adc_Behavior/CDD_ADC_EXCLUSIVE_AREA_0</CAN-ENTER-EXCLUSIVE-AREA-REF>
                  </CAN-ENTER-EXCLUSIVE-AREA-REFS>
                  <REENTRANCY-LEVEL>SINGLE-CORE-REENTRANT</REENTRANCY-LEVEL>
                  <CALL-POINTS>
                  [!IF "CddAdcGeneral/CddAdcDevErrorDetect  = 'true'"!]
                    <BSW-DIRECT-CALL-POINT>
                      <SHORT-NAME>Det</SHORT-NAME>
                      <CALLED-ENTRY-REF DEST="BSW-MODULE-ENTRY">/AUTOSAR_Det/Det/Det_ReportError</CALLED-ENTRY-REF>
                    </BSW-DIRECT-CALL-POINT>
                  [!ENDIF!]
                    <BSW-DIRECT-CALL-POINT>
                      <SHORT-NAME>Det_Runtime</SHORT-NAME>
                      <CALLED-ENTRY-REF DEST="BSW-MODULE-ENTRY">/AUTOSAR_Det/Det/Det_ReportRuntimeError</CALLED-ENTRY-REF>
                    </BSW-DIRECT-CALL-POINT>  
                  </CALL-POINTS>
                  <IMPLEMENTED-ENTRY-REF DEST="BSW-MODULE-ENTRY">/Cdd_Adc_TI_F29H85x/Cdd_Adc_ModuleEntry/Cdd_Adc_StopGlobalSwTrig</IMPLEMENTED-ENTRY-REF>
                </BSW-CALLED-ENTITY>
                [!ENDIF!]
                [!IF "CddAdcGeneral/CddAdcEnableStartStopGroupApi = 'true'"!]
                <BSW-CALLED-ENTITY UUID="2afa6fb0-4f02-4e6e-bc83-ef8a0eb72fe8">
                  <SHORT-NAME>Cdd_Adc_StartGroupConversion</SHORT-NAME>
                  <CAN-ENTER-EXCLUSIVE-AREA-REFS>
                    <CAN-ENTER-EXCLUSIVE-AREA-REF DEST="EXCLUSIVE-AREA">/Cdd_Adc_TI_F29H85x/Cdd_Adc/Cdd_Adc_Behavior/CDD_ADC_EXCLUSIVE_AREA_0</CAN-ENTER-EXCLUSIVE-AREA-REF>
                  </CAN-ENTER-EXCLUSIVE-AREA-REFS>
                  <REENTRANCY-LEVEL>SINGLE-CORE-REENTRANT</REENTRANCY-LEVEL>
                  <CALL-POINTS>
                  [!IF "CddAdcGeneral/CddAdcDevErrorDetect  = 'true'"!]
                    <BSW-DIRECT-CALL-POINT>
                      <SHORT-NAME>Det</SHORT-NAME>
                      <CALLED-ENTRY-REF DEST="BSW-MODULE-ENTRY">/AUTOSAR_Det/Det/Det_ReportError</CALLED-ENTRY-REF>
                    </BSW-DIRECT-CALL-POINT>
                  [!ENDIF!]
                    <BSW-DIRECT-CALL-POINT>
                      <SHORT-NAME>Det_Runtime</SHORT-NAME>
                      <CALLED-ENTRY-REF DEST="BSW-MODULE-ENTRY">/AUTOSAR_Det/Det/Det_ReportRuntimeError</CALLED-ENTRY-REF>
                    </BSW-DIRECT-CALL-POINT>  
                  </CALL-POINTS>
                  <IMPLEMENTED-ENTRY-REF DEST="BSW-MODULE-ENTRY">/Cdd_Adc_TI_F29H85x/Cdd_Adc_ModuleEntry/Cdd_Adc_StartGroupConversion</IMPLEMENTED-ENTRY-REF>
                </BSW-CALLED-ENTITY>
                <BSW-CALLED-ENTITY UUID="bb272a2a-6dce-4e25-994f-abcd07ae5e19">
                  <SHORT-NAME>Cdd_Adc_StopGroupConversion</SHORT-NAME>
                  <CAN-ENTER-EXCLUSIVE-AREA-REFS>
                    <CAN-ENTER-EXCLUSIVE-AREA-REF DEST="EXCLUSIVE-AREA">/Cdd_Adc_TI_F29H85x/Cdd_Adc/Cdd_Adc_Behavior/CDD_ADC_EXCLUSIVE_AREA_0</CAN-ENTER-EXCLUSIVE-AREA-REF>
                  </CAN-ENTER-EXCLUSIVE-AREA-REFS>
                  <REENTRANCY-LEVEL>SINGLE-CORE-REENTRANT</REENTRANCY-LEVEL>
                  <CALL-POINTS>
                  [!IF "CddAdcGeneral/CddAdcDevErrorDetect  = 'true'"!]
                    <BSW-DIRECT-CALL-POINT>
                      <SHORT-NAME>Det</SHORT-NAME>
                      <CALLED-ENTRY-REF DEST="BSW-MODULE-ENTRY">/AUTOSAR_Det/Det/Det_ReportError</CALLED-ENTRY-REF>
                    </BSW-DIRECT-CALL-POINT>
                  [!ENDIF!]
                    <BSW-DIRECT-CALL-POINT>
                      <SHORT-NAME>Det_Runtime</SHORT-NAME>
                      <CALLED-ENTRY-REF DEST="BSW-MODULE-ENTRY">/AUTOSAR_Det/Det/Det_ReportRuntimeError</CALLED-ENTRY-REF>
                    </BSW-DIRECT-CALL-POINT>  
                  </CALL-POINTS>
                  <IMPLEMENTED-ENTRY-REF DEST="BSW-MODULE-ENTRY">/Cdd_Adc_TI_F29H85x/Cdd_Adc_ModuleEntry/Cdd_Adc_StopGroupConversion</IMPLEMENTED-ENTRY-REF>
                </BSW-CALLED-ENTITY>
              [!ELSE!]
                [!ENDIF!]
              </ENTITYS>
            </BSW-INTERNAL-BEHAVIOR>
          </INTERNAL-BEHAVIORS>
        </BSW-MODULE-DESCRIPTION>
        <BSW-IMPLEMENTATION UUID="68fab167-6a0d-4a08-9015-4767e4cc68a5">
          <SHORT-NAME>Cdd_Adc_Impl</SHORT-NAME>
          <CODE-DESCRIPTORS>
            <CODE UUID="e4253ecc-4d3a-4d4c-a08b-835c4c19fb3a">
              <SHORT-NAME>Files</SHORT-NAME>
              <ARTIFACT-DESCRIPTORS>
                <AUTOSAR-ENGINEERING-OBJECT>
                  <SHORT-LABEL>include::Cdd_Adc.h</SHORT-LABEL>
                  <CATEGORY>SWHDR</CATEGORY>
                </AUTOSAR-ENGINEERING-OBJECT>
                <AUTOSAR-ENGINEERING-OBJECT>
                  <SHORT-LABEL>include::Cdd_Adc_Priv.h</SHORT-LABEL>
                  <CATEGORY>SWHDR</CATEGORY>
                </AUTOSAR-ENGINEERING-OBJECT>
                <AUTOSAR-ENGINEERING-OBJECT>
                  <SHORT-LABEL>src::Cdd_Adc.c</SHORT-LABEL>
                  <CATEGORY>SWSRC</CATEGORY>
                </AUTOSAR-ENGINEERING-OBJECT>
                <AUTOSAR-ENGINEERING-OBJECT>
                  <SHORT-LABEL>src::Cdd_Adc_Irq.c</SHORT-LABEL>
                  <CATEGORY>SWSRC</CATEGORY>
                </AUTOSAR-ENGINEERING-OBJECT>
                <AUTOSAR-ENGINEERING-OBJECT>
                  <SHORT-LABEL>src::Cdd_Adc_Priv.c</SHORT-LABEL>
                  <CATEGORY>SWSRC</CATEGORY>
                </AUTOSAR-ENGINEERING-OBJECT>
                <AUTOSAR-ENGINEERING-OBJECT>
                  <SHORT-LABEL>generate::src::Cdd_Adc_Cfg.c</SHORT-LABEL>
                  <CATEGORY>SWSRC</CATEGORY>
                </AUTOSAR-ENGINEERING-OBJECT>
                <AUTOSAR-ENGINEERING-OBJECT>
                  <SHORT-LABEL>generate::include::Cdd_Adc_Cfg.h</SHORT-LABEL>
                  <CATEGORY>SWHDR</CATEGORY>
                </AUTOSAR-ENGINEERING-OBJECT>                                
              </ARTIFACT-DESCRIPTORS>
            </CODE>
          </CODE-DESCRIPTORS>
          <COMPILERS>
            <COMPILER UUID="c5d2d554-cc7e-4353-aea6-d7e43bb88742">
              <SHORT-NAME>TI_C29Clang</SHORT-NAME>
              <NAME>TI_C29Clang</NAME>
              <VENDOR>Texas Instruments</VENDOR>
              <VERSION>2.2.0</VERSION>
            </COMPILER>
          </COMPILERS>
          <LINKERS>
            <LINKER UUID="8f77e550-8cb7-4e4b-bcd3-84ad14fa6d22">
              <SHORT-NAME>TI_C29Linker</SHORT-NAME>
              <NAME>TI_C29Linker</NAME>
              <VENDOR>Texas Instruments</VENDOR>
              <VERSION>2.2.0</VERSION>
            </LINKER>
          </LINKERS>
          <PROGRAMMING-LANGUAGE>C</PROGRAMMING-LANGUAGE>
          <RESOURCE-CONSUMPTION UUID="014cc1bb-df57-4463-ac65-9a6716333457">
            <SHORT-NAME>ResourceConsumption</SHORT-NAME>
            <MEMORY-SECTIONS>
              <MEMORY-SECTION UUID="46032e93-30dc-4f81-ba38-7f5f4ffabdb5">
                <SHORT-NAME>CDD_ADC_CODE</SHORT-NAME>
                <ALIGNMENT>UNSPECIFIED</ALIGNMENT>
                <SW-ADDRMETHOD-REF DEST="SW-ADDR-METHOD">/AUTOSAR_MemMap/SwAddrMethods/CODE</SW-ADDRMETHOD-REF>
                <SYMBOL>CODE</SYMBOL>
              </MEMORY-SECTION>
              <MEMORY-SECTION UUID="05762da2-dda0-4963-90d9-953f2fe0d600">
                <SHORT-NAME>CDD_ADC_CONFIG_DATA_UNSPECIFIED</SHORT-NAME>
                <ALIGNMENT>UNSPECIFIED</ALIGNMENT>
                <SW-ADDRMETHOD-REF DEST="SW-ADDR-METHOD">/AUTOSAR_MemMap/SwAddrMethods/CONST_PBCFG</SW-ADDRMETHOD-REF>
                <SYMBOL>CONFIG_DATA_UNSPECIFIED</SYMBOL>
              </MEMORY-SECTION>
              <MEMORY-SECTION UUID="d12e1a76-3729-4407-8207-1f405aeee785">
                <SHORT-NAME>CDD_ADC_VAR_INIT_PTR</SHORT-NAME>
                <ALIGNMENT>UNSPECIFIED</ALIGNMENT>
                <SW-ADDRMETHOD-REF DEST="SW-ADDR-METHOD">/AUTOSAR_MemMap/SwAddrMethods/VAR_INIT</SW-ADDRMETHOD-REF>
                <SYMBOL>VAR_INIT_PTR</SYMBOL>
              </MEMORY-SECTION>
              <MEMORY-SECTION UUID="543e36c8-40d7-43a3-b649-1accc3d62c50">
                <SHORT-NAME>CDD_ADC_ISR_CODE</SHORT-NAME>
                <ALIGNMENT>UNSPECIFIED</ALIGNMENT>
                <SW-ADDRMETHOD-REF DEST="SW-ADDR-METHOD">/AUTOSAR_MemMap/SwAddrMethods/CODE</SW-ADDRMETHOD-REF>
                <SYMBOL>ISR_CODE</SYMBOL>
              </MEMORY-SECTION>
              <MEMORY-SECTION UUID="b41d053a-ccf3-4af2-9a8b-613565486687">
                <SHORT-NAME>CDD_ADC_VAR_FAST_INIT_UNSPECIFIED</SHORT-NAME>
                <ALIGNMENT>UNSPECIFIED</ALIGNMENT>
                <SW-ADDRMETHOD-REF DEST="SW-ADDR-METHOD">/AUTOSAR_MemMap/SwAddrMethods/VAR_INIT</SW-ADDRMETHOD-REF>
                <SYMBOL>VAR_FAST_INIT_UNSPECIFIED</SYMBOL>
              </MEMORY-SECTION>
              <MEMORY-SECTION UUID="b41d052a-ccf3-4af2-9a8b-613565486687">
                <SHORT-NAME>CDD_ADC_VAR_INIT_BOOLEAN</SHORT-NAME>
                <ALIGNMENT>BOOLEAN</ALIGNMENT>
                <SW-ADDRMETHOD-REF DEST="SW-ADDR-METHOD">/AUTOSAR_MemMap/SwAddrMethods/VAR_INIT</SW-ADDRMETHOD-REF>
                <SYMBOL>VAR_INIT_BOOLEAN</SYMBOL>
              </MEMORY-SECTION>
            </MEMORY-SECTIONS>
          </RESOURCE-CONSUMPTION>
          <SW-VERSION>[!"$moduleSoftwareVer"!]</SW-VERSION>
          <VENDOR-ID>44</VENDOR-ID>
          <AR-RELEASE-VERSION>[!"substring-after($moduleReleaseVer, 'AUTOSAR ')"!]</AR-RELEASE-VERSION>
          <BEHAVIOR-REF DEST="BSW-INTERNAL-BEHAVIOR">/Cdd_Adc_TI_F29H85x/Cdd_Adc/Cdd_Adc_Behavior</BEHAVIOR-REF>
          <VENDOR-SPECIFIC-MODULE-DEF-REFS>
            <VENDOR-SPECIFIC-MODULE-DEF-REF DEST="ECUC-MODULE-DEF">/TI_F29H85x/Cdd_Adc/Cdd</VENDOR-SPECIFIC-MODULE-DEF-REF>
          </VENDOR-SPECIFIC-MODULE-DEF-REFS>
        </BSW-IMPLEMENTATION>
      </ELEMENTS>
      <AR-PACKAGES>
        <AR-PACKAGE UUID="1566c979-f45e-487c-bc3b-f53f40dd5feb">
          <SHORT-NAME>Cdd_Adc_ModuleEntry</SHORT-NAME>
          <ELEMENTS>
            <BSW-MODULE-ENTRY UUID="4e4e4b1e-5669-44c3-8985-65cde984c255">
              <SHORT-NAME>Cdd_Adc_ADCA_Int1Isr</SHORT-NAME>
              <IS-REENTRANT>false</IS-REENTRANT>
              <IS-SYNCHRONOUS>true</IS-SYNCHRONOUS>
              <CALL-TYPE>INTERRUPT</CALL-TYPE>
              [!LOOP "CddAdcConfigSet/CddAdcHwUnit/*/.//*[@name='CddAdcInterruptCategory']"!]
              [!IF "node:value(../../../CddAdcHwInstance) = 'CDD_ADCA' and node:value(../CddAdcInterruptSelect) = 'CDD_ADC_INT1'"!]
              [!IF "node:value(.) = 'CDD_ADC_ISR_CAT2_INT'"!]
              <EXECUTION-CONTEXT>INTERRUPT-CAT-2</EXECUTION-CONTEXT>
              [!ELSE!]
              <EXECUTION-CONTEXT>INTERRUPT-CAT-1</EXECUTION-CONTEXT>
              [!ENDIF!]
              [!ENDIF!]
              [!ENDLOOP!]
              <SW-SERVICE-IMPL-POLICY>STANDARD</SW-SERVICE-IMPL-POLICY>
              <BSW-ENTRY-KIND>CONCRETE</BSW-ENTRY-KIND>
            </BSW-MODULE-ENTRY>
            <BSW-MODULE-ENTRY UUID="d62326a2-76d7-4b5f-a48a-868d01e75cd8">
              <SHORT-NAME>Cdd_Adc_ADCA_Int2Isr</SHORT-NAME>
              <IS-REENTRANT>false</IS-REENTRANT>
              <IS-SYNCHRONOUS>true</IS-SYNCHRONOUS>
              <CALL-TYPE>INTERRUPT</CALL-TYPE>
              [!LOOP "CddAdcConfigSet/CddAdcHwUnit/*/.//*[@name='CddAdcInterruptCategory']"!]
              [!IF "node:value(../../../CddAdcHwInstance) = 'CDD_ADCA' and node:value(../CddAdcInterruptSelect) = 'CDD_ADC_INT2'"!]
              [!IF "node:value(.) = 'CDD_ADC_ISR_CAT2_INT'"!]
              <EXECUTION-CONTEXT>INTERRUPT-CAT-2</EXECUTION-CONTEXT>
              [!ELSE!]
              <EXECUTION-CONTEXT>INTERRUPT-CAT-1</EXECUTION-CONTEXT>
              [!ENDIF!]
              [!ENDIF!]
              [!ENDLOOP!]             
              <SW-SERVICE-IMPL-POLICY>STANDARD</SW-SERVICE-IMPL-POLICY>
              <BSW-ENTRY-KIND>CONCRETE</BSW-ENTRY-KIND>
            </BSW-MODULE-ENTRY>
            <BSW-MODULE-ENTRY UUID="ca89f437-c077-4a7e-bad5-d93046f6ff2c">
              <SHORT-NAME>Cdd_Adc_ADCA_Int3Isr</SHORT-NAME>
              <IS-REENTRANT>false</IS-REENTRANT>
              <IS-SYNCHRONOUS>true</IS-SYNCHRONOUS>
              <CALL-TYPE>INTERRUPT</CALL-TYPE>
              [!LOOP "CddAdcConfigSet/CddAdcHwUnit/*/.//*[@name='CddAdcInterruptCategory']"!]
              [!IF "node:value(../../../CddAdcHwInstance) = 'CDD_ADCA' and node:value(../CddAdcInterruptSelect) = 'CDD_ADC_INT3'"!]
              [!IF "node:value(.) = 'CDD_ADC_ISR_CAT2_INT'"!]
              <EXECUTION-CONTEXT>INTERRUPT-CAT-2</EXECUTION-CONTEXT>
              [!ELSE!]
              <EXECUTION-CONTEXT>INTERRUPT-CAT-1</EXECUTION-CONTEXT>
              [!ENDIF!]
              [!ENDIF!]
              [!ENDLOOP!]             
              <SW-SERVICE-IMPL-POLICY>STANDARD</SW-SERVICE-IMPL-POLICY>
              <BSW-ENTRY-KIND>CONCRETE</BSW-ENTRY-KIND>
            </BSW-MODULE-ENTRY>
            <BSW-MODULE-ENTRY UUID="b20afe28-0f59-416b-82d2-560f57357573">
              <SHORT-NAME>Cdd_Adc_ADCA_Int4Isr</SHORT-NAME>
              <IS-REENTRANT>false</IS-REENTRANT>
              <IS-SYNCHRONOUS>true</IS-SYNCHRONOUS>
              <CALL-TYPE>INTERRUPT</CALL-TYPE>
              [!LOOP "CddAdcConfigSet/CddAdcHwUnit/*/.//*[@name='CddAdcInterruptCategory']"!]
              [!IF "node:value(../../../CddAdcHwInstance) = 'CDD_ADCA' and node:value(../CddAdcInterruptSelect) = 'CDD_ADC_INT4'"!]
              [!IF "node:value(.) = 'CDD_ADC_ISR_CAT2_INT'"!]
              <EXECUTION-CONTEXT>INTERRUPT-CAT-2</EXECUTION-CONTEXT>
              [!ELSE!]
              <EXECUTION-CONTEXT>INTERRUPT-CAT-1</EXECUTION-CONTEXT>
              [!ENDIF!]
              [!ENDIF!]
              [!ENDLOOP!]              
              <SW-SERVICE-IMPL-POLICY>STANDARD</SW-SERVICE-IMPL-POLICY>
              <BSW-ENTRY-KIND>CONCRETE</BSW-ENTRY-KIND>
            </BSW-MODULE-ENTRY>
            <BSW-MODULE-ENTRY UUID="a25a642c-438b-4256-9dbd-2662d2175044">
              <SHORT-NAME>Cdd_Adc_ADCA_PpbIntIsr</SHORT-NAME>
              <IS-REENTRANT>false</IS-REENTRANT>
              <IS-SYNCHRONOUS>true</IS-SYNCHRONOUS>
              <CALL-TYPE>INTERRUPT</CALL-TYPE>
              [!LOOP "CddAdcConfigSet/CddAdcHwUnit/*/.//*[@name='CddAdcEventInterruptCategory']"!]
              [!IF "node:value(../../../CddAdcHwInstance) = 'CDD_ADCA'"!]
              [!IF "node:value(.) = 'CDD_ADC_ISR_CAT2_INT'"!]
              <EXECUTION-CONTEXT>INTERRUPT-CAT-2</EXECUTION-CONTEXT>
              [!ELSE!]
              <EXECUTION-CONTEXT>INTERRUPT-CAT-1</EXECUTION-CONTEXT>
              [!ENDIF!]
              [!BREAK!]
              [!ENDIF!]
              [!ENDLOOP!]
              <SW-SERVICE-IMPL-POLICY>STANDARD</SW-SERVICE-IMPL-POLICY>
              <BSW-ENTRY-KIND>CONCRETE</BSW-ENTRY-KIND>
            </BSW-MODULE-ENTRY>
            <BSW-MODULE-ENTRY UUID="1d97bed1-0ab4-4928-82fa-b02fa6d4757a">
              <SHORT-NAME>Cdd_Adc_ADCB_Int1Isr</SHORT-NAME>
              <IS-REENTRANT>false</IS-REENTRANT>
              <IS-SYNCHRONOUS>true</IS-SYNCHRONOUS>
              <CALL-TYPE>INTERRUPT</CALL-TYPE>
              [!LOOP "CddAdcConfigSet/CddAdcHwUnit/*/.//*[@name='CddAdcInterruptCategory']"!]
              [!IF "node:value(../../../CddAdcHwInstance) = 'CDD_ADCB' and node:value(../CddAdcInterruptSelect) = 'CDD_ADC_INT1'"!]
              [!IF "node:value(.) = 'CDD_ADC_ISR_CAT2_INT'"!]
              <EXECUTION-CONTEXT>INTERRUPT-CAT-2</EXECUTION-CONTEXT>
              [!ELSE!]
              <EXECUTION-CONTEXT>INTERRUPT-CAT-1</EXECUTION-CONTEXT>
              [!ENDIF!]
              [!BREAK!]
              [!ENDIF!]
              [!ENDLOOP!]               
              <SW-SERVICE-IMPL-POLICY>STANDARD</SW-SERVICE-IMPL-POLICY>
              <BSW-ENTRY-KIND>CONCRETE</BSW-ENTRY-KIND>
            </BSW-MODULE-ENTRY>
            <BSW-MODULE-ENTRY UUID="0c16dfc7-8957-4508-9120-00506f632384">
              <SHORT-NAME>Cdd_Adc_ADCB_Int2Isr</SHORT-NAME>
              <IS-REENTRANT>false</IS-REENTRANT>
              <IS-SYNCHRONOUS>true</IS-SYNCHRONOUS>
              <CALL-TYPE>INTERRUPT</CALL-TYPE>
              [!LOOP "CddAdcConfigSet/CddAdcHwUnit/*/.//*[@name='CddAdcInterruptCategory']"!]
              [!IF "node:value(../../../CddAdcHwInstance) = 'CDD_ADCB' and node:value(../CddAdcInterruptSelect) = 'CDD_ADC_INT2'"!]
              [!IF "node:value(.) = 'CDD_ADC_ISR_CAT2_INT'"!]
              <EXECUTION-CONTEXT>INTERRUPT-CAT-2</EXECUTION-CONTEXT>
              [!ELSE!]
              <EXECUTION-CONTEXT>INTERRUPT-CAT-1</EXECUTION-CONTEXT>
              [!ENDIF!]
              [!BREAK!]
              [!ENDIF!]
              [!ENDLOOP!]                
              <SW-SERVICE-IMPL-POLICY>STANDARD</SW-SERVICE-IMPL-POLICY>
              <BSW-ENTRY-KIND>CONCRETE</BSW-ENTRY-KIND>
            </BSW-MODULE-ENTRY>
            <BSW-MODULE-ENTRY UUID="769f837d-a184-4930-8b69-2b65fafde7b4">
              <SHORT-NAME>Cdd_Adc_ADCB_Int3Isr</SHORT-NAME>
              <IS-REENTRANT>false</IS-REENTRANT>
              <IS-SYNCHRONOUS>true</IS-SYNCHRONOUS>
              <CALL-TYPE>INTERRUPT</CALL-TYPE>
              [!LOOP "CddAdcConfigSet/CddAdcHwUnit/*/.//*[@name='CddAdcInterruptCategory']"!]
              [!IF "node:value(../../../CddAdcHwInstance) = 'CDD_ADCB' and node:value(../CddAdcInterruptSelect) = 'CDD_ADC_INT3'"!]
              [!IF "node:value(.) = 'CDD_ADC_ISR_CAT2_INT'"!]
              <EXECUTION-CONTEXT>INTERRUPT-CAT-2</EXECUTION-CONTEXT>
              [!ELSE!]
              <EXECUTION-CONTEXT>INTERRUPT-CAT-1</EXECUTION-CONTEXT>
              [!ENDIF!]
              [!BREAK!]
              [!ENDIF!]
              [!ENDLOOP!]
              <SW-SERVICE-IMPL-POLICY>STANDARD</SW-SERVICE-IMPL-POLICY>
              <BSW-ENTRY-KIND>CONCRETE</BSW-ENTRY-KIND>
            </BSW-MODULE-ENTRY>
            <BSW-MODULE-ENTRY UUID="263e8733-692d-45c2-88c5-9720c97ecab8">
              <SHORT-NAME>Cdd_Adc_ADCB_Int4Isr</SHORT-NAME>
              <IS-REENTRANT>false</IS-REENTRANT>
              <IS-SYNCHRONOUS>true</IS-SYNCHRONOUS>
              <CALL-TYPE>INTERRUPT</CALL-TYPE>
              [!LOOP "CddAdcConfigSet/CddAdcHwUnit/*/.//*[@name='CddAdcInterruptCategory']"!]
              [!IF "node:value(../../../CddAdcHwInstance) = 'CDD_ADCB' and node:value(../CddAdcInterruptSelect) = 'CDD_ADC_INT4'"!]
              [!IF "node:value(.) = 'CDD_ADC_ISR_CAT2_INT'"!]
              <EXECUTION-CONTEXT>INTERRUPT-CAT-2</EXECUTION-CONTEXT>
              [!ELSE!]
              <EXECUTION-CONTEXT>INTERRUPT-CAT-1</EXECUTION-CONTEXT>
              [!ENDIF!]
              [!BREAK!]
              [!ENDIF!]
              [!ENDLOOP!]
              <SW-SERVICE-IMPL-POLICY>STANDARD</SW-SERVICE-IMPL-POLICY>
              <BSW-ENTRY-KIND>CONCRETE</BSW-ENTRY-KIND>
            </BSW-MODULE-ENTRY>
            <BSW-MODULE-ENTRY UUID="ade5c3fe-e1fd-4d5e-9794-82d911e23422">
              <SHORT-NAME>Cdd_Adc_ADCB_PpbIntIsr</SHORT-NAME>
              <IS-REENTRANT>false</IS-REENTRANT>
              <IS-SYNCHRONOUS>true</IS-SYNCHRONOUS>
              <CALL-TYPE>INTERRUPT</CALL-TYPE>
              [!LOOP "CddAdcConfigSet/CddAdcHwUnit/*/.//*[@name='CddAdcEventInterruptCategory']"!]
              [!IF "node:value(../../../CddAdcHwInstance) = 'CDD_ADCB'"!]
              [!IF "node:value(.) = 'CDD_ADC_ISR_CAT2_INT'"!]
              <EXECUTION-CONTEXT>INTERRUPT-CAT-2</EXECUTION-CONTEXT>
              [!ELSE!]
              <EXECUTION-CONTEXT>INTERRUPT-CAT-1</EXECUTION-CONTEXT>
              [!ENDIF!]
              [!BREAK!]
              [!ENDIF!]
              [!ENDLOOP!]              
              <SW-SERVICE-IMPL-POLICY>STANDARD</SW-SERVICE-IMPL-POLICY>
              <BSW-ENTRY-KIND>CONCRETE</BSW-ENTRY-KIND>
            </BSW-MODULE-ENTRY>
            <BSW-MODULE-ENTRY UUID="417fc517-e8b1-42e8-abeb-b0a7da40f6fd">
              <SHORT-NAME>Cdd_Adc_ADCC_Int1Isr</SHORT-NAME>
              <IS-REENTRANT>false</IS-REENTRANT>
              <IS-SYNCHRONOUS>true</IS-SYNCHRONOUS>
              <CALL-TYPE>INTERRUPT</CALL-TYPE>
              [!LOOP "CddAdcConfigSet/CddAdcHwUnit/*/.//*[@name='CddAdcInterruptCategory']"!]
              [!IF "node:value(../../../CddAdcHwInstance) = 'CDD_ADCC' and node:value(../CddAdcInterruptSelect) = 'CDD_ADC_INT1'"!]
              [!IF "node:value(.) = 'CDD_ADC_ISR_CAT2_INT'"!]
              <EXECUTION-CONTEXT>INTERRUPT-CAT-2</EXECUTION-CONTEXT>
              [!ELSE!]
              <EXECUTION-CONTEXT>INTERRUPT-CAT-1</EXECUTION-CONTEXT>
              [!ENDIF!]
              [!BREAK!]
              [!ENDIF!]
              [!ENDLOOP!]             
              <SW-SERVICE-IMPL-POLICY>STANDARD</SW-SERVICE-IMPL-POLICY>
              <BSW-ENTRY-KIND>CONCRETE</BSW-ENTRY-KIND>
            </BSW-MODULE-ENTRY>
            <BSW-MODULE-ENTRY UUID="ac821010-b730-41b5-812e-f4637c2bf573">
              <SHORT-NAME>Cdd_Adc_ADCC_Int2Isr</SHORT-NAME>
              <IS-REENTRANT>false</IS-REENTRANT>
              <IS-SYNCHRONOUS>true</IS-SYNCHRONOUS>
              <CALL-TYPE>INTERRUPT</CALL-TYPE>
              [!LOOP "CddAdcConfigSet/CddAdcHwUnit/*/.//*[@name='CddAdcInterruptCategory']"!]
              [!IF "node:value(../../../CddAdcHwInstance) = 'CDD_ADCC' and node:value(../CddAdcInterruptSelect) = 'CDD_ADC_INT2'"!]
              [!IF "node:value(.) = 'CDD_ADC_ISR_CAT2_INT'"!]
              <EXECUTION-CONTEXT>INTERRUPT-CAT-2</EXECUTION-CONTEXT>
              [!ELSE!]
              <EXECUTION-CONTEXT>INTERRUPT-CAT-1</EXECUTION-CONTEXT>
              [!ENDIF!]
              [!BREAK!]
              [!ENDIF!]
              [!ENDLOOP!]
              <SW-SERVICE-IMPL-POLICY>STANDARD</SW-SERVICE-IMPL-POLICY>
              <BSW-ENTRY-KIND>CONCRETE</BSW-ENTRY-KIND>
            </BSW-MODULE-ENTRY>
            <BSW-MODULE-ENTRY UUID="cc8e2957-a70e-4a45-8b54-8a3b10b4b550">
              <SHORT-NAME>Cdd_Adc_ADCC_Int3Isr</SHORT-NAME>
              <IS-REENTRANT>false</IS-REENTRANT>
              <IS-SYNCHRONOUS>true</IS-SYNCHRONOUS>
              <CALL-TYPE>INTERRUPT</CALL-TYPE>
              [!LOOP "CddAdcConfigSet/CddAdcHwUnit/*/.//*[@name='CddAdcInterruptCategory']"!]
              [!IF "node:value(../../../CddAdcHwInstance) = 'CDD_ADCC' and node:value(../CddAdcInterruptSelect) = 'CDD_ADC_INT3'"!]
              [!IF "node:value(.) = 'CDD_ADC_ISR_CAT2_INT'"!]
              <EXECUTION-CONTEXT>INTERRUPT-CAT-2</EXECUTION-CONTEXT>
              [!ELSE!]
              <EXECUTION-CONTEXT>INTERRUPT-CAT-1</EXECUTION-CONTEXT>
              [!ENDIF!]
              [!BREAK!]
              [!ENDIF!]
              [!ENDLOOP!]             
              <SW-SERVICE-IMPL-POLICY>STANDARD</SW-SERVICE-IMPL-POLICY>
              <BSW-ENTRY-KIND>CONCRETE</BSW-ENTRY-KIND>
            </BSW-MODULE-ENTRY>
            <BSW-MODULE-ENTRY UUID="da623ccd-d640-4f55-a819-789361f5b0eb">
              <SHORT-NAME>Cdd_Adc_ADCC_Int4Isr</SHORT-NAME>
              <IS-REENTRANT>false</IS-REENTRANT>
              <IS-SYNCHRONOUS>true</IS-SYNCHRONOUS>
              <CALL-TYPE>INTERRUPT</CALL-TYPE>
              [!LOOP "CddAdcConfigSet/CddAdcHwUnit/*/.//*[@name='CddAdcInterruptCategory']"!]
              [!IF "node:value(../../../CddAdcHwInstance) = 'CDD_ADCC' and node:value(../CddAdcInterruptSelect) = 'CDD_ADC_INT4'"!]
              [!IF "node:value(.) = 'CDD_ADC_ISR_CAT2_INT'"!]
              <EXECUTION-CONTEXT>INTERRUPT-CAT-2</EXECUTION-CONTEXT>
              [!ELSE!]
              <EXECUTION-CONTEXT>INTERRUPT-CAT-1</EXECUTION-CONTEXT>
              [!ENDIF!]
              [!BREAK!]
              [!ENDIF!]
              [!ENDLOOP!]
              <SW-SERVICE-IMPL-POLICY>STANDARD</SW-SERVICE-IMPL-POLICY>
              <BSW-ENTRY-KIND>CONCRETE</BSW-ENTRY-KIND>
            </BSW-MODULE-ENTRY>
            <BSW-MODULE-ENTRY UUID="5ab06ae6-baaf-4aa4-bab7-fe071c779565">
              <SHORT-NAME>Cdd_Adc_ADCC_PpbIntIsr</SHORT-NAME>
              <IS-REENTRANT>false</IS-REENTRANT>
              <IS-SYNCHRONOUS>true</IS-SYNCHRONOUS>
              <CALL-TYPE>INTERRUPT</CALL-TYPE>
              [!LOOP "CddAdcConfigSet/CddAdcHwUnit/*/.//*[@name='CddAdcEventInterruptCategory']"!]
              [!IF "node:value(../../../CddAdcHwInstance) = 'CDD_ADCC'"!]
              [!IF "node:value(.) = 'CDD_ADC_ISR_CAT2_INT'"!]
              <EXECUTION-CONTEXT>INTERRUPT-CAT-2</EXECUTION-CONTEXT>
              [!ELSE!]
              <EXECUTION-CONTEXT>INTERRUPT-CAT-1</EXECUTION-CONTEXT>
              [!ENDIF!]
              [!BREAK!]
              [!ENDIF!]
              [!ENDLOOP!]              
              <SW-SERVICE-IMPL-POLICY>STANDARD</SW-SERVICE-IMPL-POLICY>
              <BSW-ENTRY-KIND>CONCRETE</BSW-ENTRY-KIND>
            </BSW-MODULE-ENTRY>
            <BSW-MODULE-ENTRY UUID="192e7af4-8dcd-412c-aa9b-eb297ec48025">
              <SHORT-NAME>Cdd_Adc_ADCD_Int1Isr</SHORT-NAME>
              <IS-REENTRANT>false</IS-REENTRANT>
              <IS-SYNCHRONOUS>true</IS-SYNCHRONOUS>
              <CALL-TYPE>INTERRUPT</CALL-TYPE>
              [!LOOP "CddAdcConfigSet/CddAdcHwUnit/*/.//*[@name='CddAdcInterruptCategory']"!]
              [!IF "node:value(../../../CddAdcHwInstance) = 'CDD_ADCD' and node:value(../CddAdcInterruptSelect) = 'CDD_ADC_INT1'"!]
              [!IF "node:value(.) = 'CDD_ADC_ISR_CAT2_INT'"!]
              <EXECUTION-CONTEXT>INTERRUPT-CAT-2</EXECUTION-CONTEXT>
              [!ELSE!]
              <EXECUTION-CONTEXT>INTERRUPT-CAT-1</EXECUTION-CONTEXT>
              [!ENDIF!]
              [!BREAK!]
              [!ENDIF!]
              [!ENDLOOP!]
              <SW-SERVICE-IMPL-POLICY>STANDARD</SW-SERVICE-IMPL-POLICY>
              <BSW-ENTRY-KIND>CONCRETE</BSW-ENTRY-KIND>
            </BSW-MODULE-ENTRY>
            <BSW-MODULE-ENTRY UUID="ce8e3624-1f48-4342-ad11-41adb2423d0b">
              <SHORT-NAME>Cdd_Adc_ADCD_Int2Isr</SHORT-NAME>
              <IS-REENTRANT>false</IS-REENTRANT>
              <IS-SYNCHRONOUS>true</IS-SYNCHRONOUS>
              <CALL-TYPE>INTERRUPT</CALL-TYPE>
              [!LOOP "CddAdcConfigSet/CddAdcHwUnit/*/.//*[@name='CddAdcInterruptCategory']"!]
              [!IF "node:value(../../../CddAdcHwInstance) = 'CDD_ADCD' and node:value(../CddAdcInterruptSelect) = 'CDD_ADC_INT2'"!]
              [!IF "node:value(.) = 'CDD_ADC_ISR_CAT2_INT'"!]
              <EXECUTION-CONTEXT>INTERRUPT-CAT-2</EXECUTION-CONTEXT>
              [!ELSE!]
              <EXECUTION-CONTEXT>INTERRUPT-CAT-1</EXECUTION-CONTEXT>
              [!ENDIF!]
              [!BREAK!]
              [!ENDIF!]
              [!ENDLOOP!]              
              <SW-SERVICE-IMPL-POLICY>STANDARD</SW-SERVICE-IMPL-POLICY>
              <BSW-ENTRY-KIND>CONCRETE</BSW-ENTRY-KIND>
            </BSW-MODULE-ENTRY>
            <BSW-MODULE-ENTRY UUID="7315dede-eca9-453e-b48b-4a87af9ba5c7">
              <SHORT-NAME>Cdd_Adc_ADCD_Int3Isr</SHORT-NAME>
              <IS-REENTRANT>false</IS-REENTRANT>
              <IS-SYNCHRONOUS>true</IS-SYNCHRONOUS>
              <CALL-TYPE>INTERRUPT</CALL-TYPE>
              [!LOOP "CddAdcConfigSet/CddAdcHwUnit/*/.//*[@name='CddAdcInterruptCategory']"!]
              [!IF "node:value(../../../CddAdcHwInstance) = 'CDD_ADCD' and node:value(../CddAdcInterruptSelect) = 'CDD_ADC_INT3'"!]
              [!IF "node:value(.) = 'CDD_ADC_ISR_CAT2_INT'"!]
              <EXECUTION-CONTEXT>INTERRUPT-CAT-2</EXECUTION-CONTEXT>
              [!ELSE!]
              <EXECUTION-CONTEXT>INTERRUPT-CAT-1</EXECUTION-CONTEXT>
              [!ENDIF!]
              [!BREAK!]
              [!ENDIF!]
              [!ENDLOOP!]             
              <SW-SERVICE-IMPL-POLICY>STANDARD</SW-SERVICE-IMPL-POLICY>
              <BSW-ENTRY-KIND>CONCRETE</BSW-ENTRY-KIND>
            </BSW-MODULE-ENTRY>
            <BSW-MODULE-ENTRY UUID="28529850-8547-4739-8ac4-ee3dd899a27f">
              <SHORT-NAME>Cdd_Adc_ADCD_Int4Isr</SHORT-NAME>
              <IS-REENTRANT>false</IS-REENTRANT>
              <IS-SYNCHRONOUS>true</IS-SYNCHRONOUS>
              <CALL-TYPE>INTERRUPT</CALL-TYPE>
              [!LOOP "CddAdcConfigSet/CddAdcHwUnit/*/.//*[@name='CddAdcInterruptCategory']"!]
              [!IF "node:value(../../../CddAdcHwInstance) = 'CDD_ADCD' and node:value(../CddAdcInterruptSelect) = 'CDD_ADC_INT4'"!]
              [!IF "node:value(.) = 'CDD_ADC_ISR_CAT2_INT'"!]
              <EXECUTION-CONTEXT>INTERRUPT-CAT-2</EXECUTION-CONTEXT>
              [!ELSE!]
              <EXECUTION-CONTEXT>INTERRUPT-CAT-1</EXECUTION-CONTEXT>
              [!ENDIF!]
              [!BREAK!]
              [!ENDIF!]
              [!ENDLOOP!]               
              <SW-SERVICE-IMPL-POLICY>STANDARD</SW-SERVICE-IMPL-POLICY>
              <BSW-ENTRY-KIND>CONCRETE</BSW-ENTRY-KIND>
            </BSW-MODULE-ENTRY>
            <BSW-MODULE-ENTRY UUID="52f2f1e7-b1e5-45ef-8e63-1d7174df0334">
              <SHORT-NAME>Cdd_Adc_ADCD_PpbIntIsr</SHORT-NAME>
              <IS-REENTRANT>false</IS-REENTRANT>
              <IS-SYNCHRONOUS>true</IS-SYNCHRONOUS>
              <CALL-TYPE>INTERRUPT</CALL-TYPE>
              [!LOOP "CddAdcConfigSet/CddAdcHwUnit/*/.//*[@name='CddAdcEventInterruptCategory']"!]
              [!IF "node:value(../../../CddAdcHwInstance) = 'CDD_ADCD'"!]
              [!IF "node:value(.) = 'CDD_ADC_ISR_CAT2_INT'"!]
              <EXECUTION-CONTEXT>INTERRUPT-CAT-2</EXECUTION-CONTEXT>
              [!ELSE!]
              <EXECUTION-CONTEXT>INTERRUPT-CAT-1</EXECUTION-CONTEXT>
              [!ENDIF!]
              [!BREAK!]
              [!ENDIF!]
              [!ENDLOOP!]               
              <SW-SERVICE-IMPL-POLICY>STANDARD</SW-SERVICE-IMPL-POLICY>
              <BSW-ENTRY-KIND>CONCRETE</BSW-ENTRY-KIND>
            </BSW-MODULE-ENTRY>
            <BSW-MODULE-ENTRY UUID="d0a4632e-6cf0-4971-b37c-a678f6089521">
              <SHORT-NAME>Cdd_Adc_ADCE_Int1Isr</SHORT-NAME>
              <IS-REENTRANT>false</IS-REENTRANT>
              <IS-SYNCHRONOUS>true</IS-SYNCHRONOUS>
              <CALL-TYPE>INTERRUPT</CALL-TYPE>
              [!LOOP "CddAdcConfigSet/CddAdcHwUnit/*/.//*[@name='CddAdcInterruptCategory']"!]
              [!IF "node:value(../../../CddAdcHwInstance) = 'CDD_ADCE' and node:value(../CddAdcInterruptSelect) = 'CDD_ADC_INT1'"!]
              [!IF "node:value(.) = 'CDD_ADC_ISR_CAT2_INT'"!]
              <EXECUTION-CONTEXT>INTERRUPT-CAT-2</EXECUTION-CONTEXT>
              [!ELSE!]
              <EXECUTION-CONTEXT>INTERRUPT-CAT-1</EXECUTION-CONTEXT>
              [!ENDIF!]
              [!BREAK!]
              [!ENDIF!]
              [!ENDLOOP!]             
              <SW-SERVICE-IMPL-POLICY>STANDARD</SW-SERVICE-IMPL-POLICY>
              <BSW-ENTRY-KIND>CONCRETE</BSW-ENTRY-KIND>
            </BSW-MODULE-ENTRY>
            <BSW-MODULE-ENTRY UUID="f8d41547-9e80-4c5a-81cd-c9df493e41f2">
              <SHORT-NAME>Cdd_Adc_ADCE_Int2Isr</SHORT-NAME>
              <IS-REENTRANT>false</IS-REENTRANT>
              <IS-SYNCHRONOUS>true</IS-SYNCHRONOUS>
              <CALL-TYPE>INTERRUPT</CALL-TYPE>
              [!LOOP "CddAdcConfigSet/CddAdcHwUnit/*/.//*[@name='CddAdcInterruptCategory']"!]
              [!IF "node:value(../../../CddAdcHwInstance) = 'CDD_ADCE' and node:value(../CddAdcInterruptSelect) = 'CDD_ADC_INT2'"!]
              [!IF "node:value(.) = 'CDD_ADC_ISR_CAT2_INT'"!]
              <EXECUTION-CONTEXT>INTERRUPT-CAT-2</EXECUTION-CONTEXT>
              [!ELSE!]
              <EXECUTION-CONTEXT>INTERRUPT-CAT-1</EXECUTION-CONTEXT>
              [!ENDIF!]
              [!BREAK!]
              [!ENDIF!]
              [!ENDLOOP!]            
              <SW-SERVICE-IMPL-POLICY>STANDARD</SW-SERVICE-IMPL-POLICY>
              <BSW-ENTRY-KIND>CONCRETE</BSW-ENTRY-KIND>
            </BSW-MODULE-ENTRY>
            <BSW-MODULE-ENTRY UUID="bfbd37ca-e8bb-4d27-9793-e38722735aea">
              <SHORT-NAME>Cdd_Adc_ADCE_Int3Isr</SHORT-NAME>
              <IS-REENTRANT>false</IS-REENTRANT>
              <IS-SYNCHRONOUS>true</IS-SYNCHRONOUS>
              <CALL-TYPE>INTERRUPT</CALL-TYPE>
              [!LOOP "CddAdcConfigSet/CddAdcHwUnit/*/.//*[@name='CddAdcInterruptCategory']"!]
              [!IF "node:value(../../../CddAdcHwInstance) = 'CDD_ADCE' and node:value(../CddAdcInterruptSelect) = 'CDD_ADC_INT3'"!]
              [!IF "node:value(.) = 'CDD_ADC_ISR_CAT2_INT'"!]
              <EXECUTION-CONTEXT>INTERRUPT-CAT-2</EXECUTION-CONTEXT>
              [!ELSE!]
              <EXECUTION-CONTEXT>INTERRUPT-CAT-1</EXECUTION-CONTEXT>
              [!ENDIF!]
              [!BREAK!]
              [!ENDIF!]
              [!ENDLOOP!]              
              <SW-SERVICE-IMPL-POLICY>STANDARD</SW-SERVICE-IMPL-POLICY>
              <BSW-ENTRY-KIND>CONCRETE</BSW-ENTRY-KIND>
            </BSW-MODULE-ENTRY>
            <BSW-MODULE-ENTRY UUID="89903f4e-4a3b-4fb2-bf14-4a5ac3b49daf">
              <SHORT-NAME>Cdd_Adc_ADCE_Int4Isr</SHORT-NAME>
              <IS-REENTRANT>false</IS-REENTRANT>
              <IS-SYNCHRONOUS>true</IS-SYNCHRONOUS>
              <CALL-TYPE>INTERRUPT</CALL-TYPE>
              [!LOOP "CddAdcConfigSet/CddAdcHwUnit/*/.//*[@name='CddAdcInterruptCategory']"!]
              [!IF "node:value(../../../CddAdcHwInstance) = 'CDD_ADCE' and node:value(../CddAdcInterruptSelect) = 'CDD_ADC_INT4'"!]
              [!IF "node:value(.) = 'CDD_ADC_ISR_CAT2_INT'"!]
              <EXECUTION-CONTEXT>INTERRUPT-CAT-2</EXECUTION-CONTEXT>
              [!ELSE!]
              <EXECUTION-CONTEXT>INTERRUPT-CAT-1</EXECUTION-CONTEXT>
              [!ENDIF!]
              [!BREAK!]
              [!ENDIF!]
              [!ENDLOOP!]             
              <SW-SERVICE-IMPL-POLICY>STANDARD</SW-SERVICE-IMPL-POLICY>
              <BSW-ENTRY-KIND>CONCRETE</BSW-ENTRY-KIND>
            </BSW-MODULE-ENTRY>
            <BSW-MODULE-ENTRY UUID="284f72d6-56a1-41ca-8dbf-f31326fe0508">
              <SHORT-NAME>Cdd_Adc_ADCE_PpbIntIsr</SHORT-NAME>
              <IS-REENTRANT>false</IS-REENTRANT>
              <IS-SYNCHRONOUS>true</IS-SYNCHRONOUS>
              <CALL-TYPE>INTERRUPT</CALL-TYPE>
              [!LOOP "CddAdcConfigSet/CddAdcHwUnit/*/.//*[@name='CddAdcEventInterruptCategory']"!]
              [!IF "node:value(../../../CddAdcHwInstance) = 'CDD_ADCE'"!]
              [!IF "node:value(.) = 'CDD_ADC_ISR_CAT2_INT'"!]
              <EXECUTION-CONTEXT>INTERRUPT-CAT-2</EXECUTION-CONTEXT>
              [!ELSE!]
              <EXECUTION-CONTEXT>INTERRUPT-CAT-1</EXECUTION-CONTEXT>
              [!ENDIF!]
              [!BREAK!]
              [!ENDIF!]
              [!ENDLOOP!]               
              <SW-SERVICE-IMPL-POLICY>STANDARD</SW-SERVICE-IMPL-POLICY>
              <BSW-ENTRY-KIND>CONCRETE</BSW-ENTRY-KIND>
            </BSW-MODULE-ENTRY>
            <BSW-MODULE-ENTRY UUID="3831ae35-06d0-4dd0-b81d-df5877491b55">
              <SHORT-NAME>Cdd_Adc_ClearCheckerEvt</SHORT-NAME>
              <SERVICE-ID>16</SERVICE-ID>
              <IS-REENTRANT>true</IS-REENTRANT>
              <IS-SYNCHRONOUS>true</IS-SYNCHRONOUS>
              <CALL-TYPE>REGULAR</CALL-TYPE>
              <EXECUTION-CONTEXT>UNSPECIFIED</EXECUTION-CONTEXT>
              <SW-SERVICE-IMPL-POLICY>STANDARD</SW-SERVICE-IMPL-POLICY>
              <BSW-ENTRY-KIND>CONCRETE</BSW-ENTRY-KIND>
            </BSW-MODULE-ENTRY>
            <BSW-MODULE-ENTRY UUID="aa15e1b4-9d57-432b-9a97-47e11a58beda">
              <SHORT-NAME>Cdd_Adc_ClearPpbEvt</SHORT-NAME>
              <SERVICE-ID>23</SERVICE-ID>
              <IS-REENTRANT>true</IS-REENTRANT>
              <IS-SYNCHRONOUS>true</IS-SYNCHRONOUS>
              <CALL-TYPE>REGULAR</CALL-TYPE>
              <EXECUTION-CONTEXT>UNSPECIFIED</EXECUTION-CONTEXT>
              <SW-SERVICE-IMPL-POLICY>STANDARD</SW-SERVICE-IMPL-POLICY>
              <BSW-ENTRY-KIND>CONCRETE</BSW-ENTRY-KIND>
            </BSW-MODULE-ENTRY>
            <BSW-MODULE-ENTRY UUID="ad2befa7-4cd5-4c70-966c-2dfa1ae6bbda">
              <SHORT-NAME>Cdd_Adc_DeInit</SHORT-NAME>
              <SERVICE-ID>1</SERVICE-ID>
              <IS-REENTRANT>false</IS-REENTRANT>
              <IS-SYNCHRONOUS>true</IS-SYNCHRONOUS>
              <CALL-TYPE>REGULAR</CALL-TYPE>
              <EXECUTION-CONTEXT>UNSPECIFIED</EXECUTION-CONTEXT>
              <SW-SERVICE-IMPL-POLICY>STANDARD</SW-SERVICE-IMPL-POLICY>
              <BSW-ENTRY-KIND>CONCRETE</BSW-ENTRY-KIND>
            </BSW-MODULE-ENTRY>
            <BSW-MODULE-ENTRY UUID="dcd07f7b-51d5-42b6-9dca-909c2aff0bb9">
              <SHORT-NAME>Cdd_Adc_DisableGroupNotification</SHORT-NAME>
              <SERVICE-ID>8</SERVICE-ID>
              <IS-REENTRANT>true</IS-REENTRANT>
              <IS-SYNCHRONOUS>true</IS-SYNCHRONOUS>
              <CALL-TYPE>REGULAR</CALL-TYPE>
              <EXECUTION-CONTEXT>UNSPECIFIED</EXECUTION-CONTEXT>
              <SW-SERVICE-IMPL-POLICY>STANDARD</SW-SERVICE-IMPL-POLICY>
              <BSW-ENTRY-KIND>CONCRETE</BSW-ENTRY-KIND>
            </BSW-MODULE-ENTRY>
            <BSW-MODULE-ENTRY UUID="e5aa82bb-2440-41bb-b8a8-79333947d692">
              <SHORT-NAME>Cdd_Adc_DisableHardwareTrigger</SHORT-NAME>
              <SERVICE-ID>6</SERVICE-ID>
              <IS-REENTRANT>true</IS-REENTRANT>
              <IS-SYNCHRONOUS>true</IS-SYNCHRONOUS>
              <CALL-TYPE>REGULAR</CALL-TYPE>
              <EXECUTION-CONTEXT>UNSPECIFIED</EXECUTION-CONTEXT>
              <SW-SERVICE-IMPL-POLICY>STANDARD</SW-SERVICE-IMPL-POLICY>
              <BSW-ENTRY-KIND>CONCRETE</BSW-ENTRY-KIND>
            </BSW-MODULE-ENTRY>
            <BSW-MODULE-ENTRY UUID="7f808ba2-63db-46f4-8000-d8d86708c8b8">
              <SHORT-NAME>Cdd_Adc_EnableGroupNotification</SHORT-NAME>
              <SERVICE-ID>7</SERVICE-ID>
              <IS-REENTRANT>true</IS-REENTRANT>
              <IS-SYNCHRONOUS>true</IS-SYNCHRONOUS>
              <CALL-TYPE>REGULAR</CALL-TYPE>
              <EXECUTION-CONTEXT>UNSPECIFIED</EXECUTION-CONTEXT>
              <SW-SERVICE-IMPL-POLICY>STANDARD</SW-SERVICE-IMPL-POLICY>
              <BSW-ENTRY-KIND>CONCRETE</BSW-ENTRY-KIND>
            </BSW-MODULE-ENTRY>
            <BSW-MODULE-ENTRY UUID="345d7384-bb06-4329-b7bd-0317e342d81f">
              <SHORT-NAME>Cdd_Adc_EnableHardwareTrigger</SHORT-NAME>
              <SERVICE-ID>5</SERVICE-ID>
              <IS-REENTRANT>true</IS-REENTRANT>
              <IS-SYNCHRONOUS>true</IS-SYNCHRONOUS>
              <CALL-TYPE>REGULAR</CALL-TYPE>
              <EXECUTION-CONTEXT>UNSPECIFIED</EXECUTION-CONTEXT>
              <SW-SERVICE-IMPL-POLICY>STANDARD</SW-SERVICE-IMPL-POLICY>
              <BSW-ENTRY-KIND>CONCRETE</BSW-ENTRY-KIND>
            </BSW-MODULE-ENTRY>
            <BSW-MODULE-ENTRY UUID="bd391b06-dbed-4563-b245-1aa30491ae18">
              <SHORT-NAME>Cdd_Adc_GetDelayStamp</SHORT-NAME>
              <SERVICE-ID>24</SERVICE-ID>
              <IS-REENTRANT>true</IS-REENTRANT>
              <IS-SYNCHRONOUS>true</IS-SYNCHRONOUS>
              <CALL-TYPE>REGULAR</CALL-TYPE>
              <EXECUTION-CONTEXT>UNSPECIFIED</EXECUTION-CONTEXT>
              <SW-SERVICE-IMPL-POLICY>STANDARD</SW-SERVICE-IMPL-POLICY>
              <BSW-ENTRY-KIND>CONCRETE</BSW-ENTRY-KIND>
            </BSW-MODULE-ENTRY>
            <BSW-MODULE-ENTRY UUID="08839271-b4b5-4df5-9258-1c17684c055f">
              <SHORT-NAME>Cdd_Adc_GetGroupStatus</SHORT-NAME>
              <SERVICE-ID>9</SERVICE-ID>
              <IS-REENTRANT>true</IS-REENTRANT>
              <IS-SYNCHRONOUS>true</IS-SYNCHRONOUS>
              <CALL-TYPE>REGULAR</CALL-TYPE>
              <EXECUTION-CONTEXT>UNSPECIFIED</EXECUTION-CONTEXT>
              <SW-SERVICE-IMPL-POLICY>STANDARD</SW-SERVICE-IMPL-POLICY>
              <BSW-ENTRY-KIND>CONCRETE</BSW-ENTRY-KIND>
            </BSW-MODULE-ENTRY>
            <BSW-MODULE-ENTRY UUID="88c4b6d9-89ae-47d1-89e2-7b65de198119">
              <SHORT-NAME>Cdd_Adc_GetStreamLastPointer</SHORT-NAME>
              <SERVICE-ID>11</SERVICE-ID>
              <IS-REENTRANT>true</IS-REENTRANT>
              <IS-SYNCHRONOUS>true</IS-SYNCHRONOUS>
              <CALL-TYPE>REGULAR</CALL-TYPE>
              <EXECUTION-CONTEXT>UNSPECIFIED</EXECUTION-CONTEXT>
              <SW-SERVICE-IMPL-POLICY>STANDARD</SW-SERVICE-IMPL-POLICY>
              <BSW-ENTRY-KIND>CONCRETE</BSW-ENTRY-KIND>
            </BSW-MODULE-ENTRY>
            <BSW-MODULE-ENTRY UUID="283993a0-04bf-419a-baf8-c22327e41534">
              <SHORT-NAME>Cdd_Adc_GetTemperatureC</SHORT-NAME>
              <SERVICE-ID>25</SERVICE-ID>
              <IS-REENTRANT>true</IS-REENTRANT>
              <IS-SYNCHRONOUS>true</IS-SYNCHRONOUS>
              <CALL-TYPE>REGULAR</CALL-TYPE>
              <EXECUTION-CONTEXT>UNSPECIFIED</EXECUTION-CONTEXT>
              <SW-SERVICE-IMPL-POLICY>STANDARD</SW-SERVICE-IMPL-POLICY>
              <BSW-ENTRY-KIND>CONCRETE</BSW-ENTRY-KIND>
            </BSW-MODULE-ENTRY>
            <BSW-MODULE-ENTRY UUID="aa23fe2a-c7a9-41e9-94d5-a10254587d34">
              <SHORT-NAME>Cdd_Adc_GetTemperatureK</SHORT-NAME>
              <SERVICE-ID>26</SERVICE-ID>
              <IS-REENTRANT>true</IS-REENTRANT>
              <IS-SYNCHRONOUS>true</IS-SYNCHRONOUS>
              <CALL-TYPE>REGULAR</CALL-TYPE>
              <EXECUTION-CONTEXT>UNSPECIFIED</EXECUTION-CONTEXT>
              <SW-SERVICE-IMPL-POLICY>STANDARD</SW-SERVICE-IMPL-POLICY>
              <BSW-ENTRY-KIND>CONCRETE</BSW-ENTRY-KIND>
            </BSW-MODULE-ENTRY>
            <BSW-MODULE-ENTRY UUID="ced45391-39d8-4fcc-bd87-f4b48777093d">
              <SHORT-NAME>Cdd_Adc_GetVersionInfo</SHORT-NAME>
              <SERVICE-ID>10</SERVICE-ID>
              <IS-REENTRANT>true</IS-REENTRANT>
              <IS-SYNCHRONOUS>true</IS-SYNCHRONOUS>
              <CALL-TYPE>REGULAR</CALL-TYPE>
              <EXECUTION-CONTEXT>UNSPECIFIED</EXECUTION-CONTEXT>
              <SW-SERVICE-IMPL-POLICY>STANDARD</SW-SERVICE-IMPL-POLICY>
              <BSW-ENTRY-KIND>CONCRETE</BSW-ENTRY-KIND>
            </BSW-MODULE-ENTRY>
            <BSW-MODULE-ENTRY UUID="74e9925f-06c4-4a36-a512-6ce2f23bbc28">
              <SHORT-NAME>Cdd_Adc_Init</SHORT-NAME>
              <SERVICE-ID>0</SERVICE-ID>
              <IS-REENTRANT>false</IS-REENTRANT>
              <IS-SYNCHRONOUS>true</IS-SYNCHRONOUS>
              <CALL-TYPE>REGULAR</CALL-TYPE>
              <EXECUTION-CONTEXT>UNSPECIFIED</EXECUTION-CONTEXT>
              <SW-SERVICE-IMPL-POLICY>STANDARD</SW-SERVICE-IMPL-POLICY>
              <BSW-ENTRY-KIND>CONCRETE</BSW-ENTRY-KIND>
            </BSW-MODULE-ENTRY>
            <BSW-MODULE-ENTRY UUID="71e9925f-06c4-4a36-a512-6ce2f23bbc28">
              <SHORT-NAME>Cdd_Adc_UpdateStatusThroughDma</SHORT-NAME>
              <SERVICE-ID>28</SERVICE-ID>
              <IS-REENTRANT>false</IS-REENTRANT>
              <IS-SYNCHRONOUS>true</IS-SYNCHRONOUS>
              <CALL-TYPE>REGULAR</CALL-TYPE>
              <EXECUTION-CONTEXT>INTERRUPT-CAT-1</EXECUTION-CONTEXT>
              <SW-SERVICE-IMPL-POLICY>STANDARD</SW-SERVICE-IMPL-POLICY>
              <BSW-ENTRY-KIND>CONCRETE</BSW-ENTRY-KIND>
            </BSW-MODULE-ENTRY>
            <BSW-MODULE-ENTRY UUID="410173d9-6d41-4c6d-8fe7-ea29f9732b9a">
              <SHORT-NAME>Cdd_Adc_ReadCheckerStatus</SHORT-NAME>
              <SERVICE-ID>15</SERVICE-ID>
              <IS-REENTRANT>false</IS-REENTRANT>
              <IS-SYNCHRONOUS>true</IS-SYNCHRONOUS>
              <CALL-TYPE>REGULAR</CALL-TYPE>
              <EXECUTION-CONTEXT>INTERRUPT-CAT-1</EXECUTION-CONTEXT>
              <SW-SERVICE-IMPL-POLICY>STANDARD</SW-SERVICE-IMPL-POLICY>
              <BSW-ENTRY-KIND>CONCRETE</BSW-ENTRY-KIND>
            </BSW-MODULE-ENTRY>
            <BSW-MODULE-ENTRY UUID="2de664e0-eb6d-4395-99fb-a792c65a859a">
              <SHORT-NAME>Cdd_Adc_ReadGroup</SHORT-NAME>
              <SERVICE-ID>4</SERVICE-ID>
              <IS-REENTRANT>true</IS-REENTRANT>
              <IS-SYNCHRONOUS>true</IS-SYNCHRONOUS>
              <CALL-TYPE>REGULAR</CALL-TYPE>
              <EXECUTION-CONTEXT>UNSPECIFIED</EXECUTION-CONTEXT>
              <SW-SERVICE-IMPL-POLICY>STANDARD</SW-SERVICE-IMPL-POLICY>
              <BSW-ENTRY-KIND>CONCRETE</BSW-ENTRY-KIND>
            </BSW-MODULE-ENTRY>
            <BSW-MODULE-ENTRY UUID="cb3bb749-1cae-44d8-b58e-705e4d1b189c">
              <SHORT-NAME>Cdd_Adc_ReadPartialPpbValue</SHORT-NAME>
              <SERVICE-ID>20</SERVICE-ID>
              <IS-REENTRANT>true</IS-REENTRANT>
              <IS-SYNCHRONOUS>true</IS-SYNCHRONOUS>
              <CALL-TYPE>REGULAR</CALL-TYPE>
              <EXECUTION-CONTEXT>UNSPECIFIED</EXECUTION-CONTEXT>
              <SW-SERVICE-IMPL-POLICY>STANDARD</SW-SERVICE-IMPL-POLICY>
              <BSW-ENTRY-KIND>CONCRETE</BSW-ENTRY-KIND>
              <ARGUMENTS>
              </ARGUMENTS>
            </BSW-MODULE-ENTRY>
            <BSW-MODULE-ENTRY UUID="0b433164-b308-4899-ad67-a71aba3440ca">
              <SHORT-NAME>Cdd_Adc_ReadPpb</SHORT-NAME>
              <SERVICE-ID>22</SERVICE-ID>
              <IS-REENTRANT>true</IS-REENTRANT>
              <IS-SYNCHRONOUS>true</IS-SYNCHRONOUS>
              <CALL-TYPE>REGULAR</CALL-TYPE>
              <EXECUTION-CONTEXT>UNSPECIFIED</EXECUTION-CONTEXT>
              <SW-SERVICE-IMPL-POLICY>STANDARD</SW-SERVICE-IMPL-POLICY>
              <BSW-ENTRY-KIND>CONCRETE</BSW-ENTRY-KIND>
            </BSW-MODULE-ENTRY>
            <BSW-MODULE-ENTRY UUID="0b133164-b308-4899-ad67-a71aba3440ca">
              <SHORT-NAME>Cdd_Adc_ConfigurePpbNotification</SHORT-NAME>
              <SERVICE-ID>29</SERVICE-ID>
              <IS-REENTRANT>true</IS-REENTRANT>
              <IS-SYNCHRONOUS>true</IS-SYNCHRONOUS>
              <CALL-TYPE>REGULAR</CALL-TYPE>
              <EXECUTION-CONTEXT>UNSPECIFIED</EXECUTION-CONTEXT>
              <SW-SERVICE-IMPL-POLICY>STANDARD</SW-SERVICE-IMPL-POLICY>
              <BSW-ENTRY-KIND>CONCRETE</BSW-ENTRY-KIND>
            </BSW-MODULE-ENTRY>
            <BSW-MODULE-ENTRY UUID="82034007-6c51-4632-8111-91c5b5b3f84e">
              <SHORT-NAME>Cdd_Adc_ReadPpbValue</SHORT-NAME>
              <SERVICE-ID>21</SERVICE-ID>
              <IS-REENTRANT>true</IS-REENTRANT>
              <IS-SYNCHRONOUS>true</IS-SYNCHRONOUS>
              <CALL-TYPE>REGULAR</CALL-TYPE>
              <EXECUTION-CONTEXT>UNSPECIFIED</EXECUTION-CONTEXT>
              <SW-SERVICE-IMPL-POLICY>STANDARD</SW-SERVICE-IMPL-POLICY>
              <BSW-ENTRY-KIND>CONCRETE</BSW-ENTRY-KIND>
            </BSW-MODULE-ENTRY>
            <BSW-MODULE-ENTRY UUID="0ca9282e-79e2-4d3a-a158-8e6bd8f1f407">
              <SHORT-NAME>Cdd_Adc_SetResolution</SHORT-NAME>
              <SERVICE-ID>19</SERVICE-ID>
              <IS-REENTRANT>true</IS-REENTRANT>
              <IS-SYNCHRONOUS>true</IS-SYNCHRONOUS>
              <CALL-TYPE>REGULAR</CALL-TYPE>
              <EXECUTION-CONTEXT>UNSPECIFIED</EXECUTION-CONTEXT>
              <SW-SERVICE-IMPL-POLICY>STANDARD</SW-SERVICE-IMPL-POLICY>
              <BSW-ENTRY-KIND>CONCRETE</BSW-ENTRY-KIND>
            </BSW-MODULE-ENTRY>
            <BSW-MODULE-ENTRY UUID="ce068c6d-0c7f-4ac5-aab5-10bd63b136c3">
              <SHORT-NAME>Cdd_Adc_SetupResultBuffer</SHORT-NAME>
              <SERVICE-ID>12</SERVICE-ID>
              <IS-REENTRANT>true</IS-REENTRANT>
              <IS-SYNCHRONOUS>true</IS-SYNCHRONOUS>
              <CALL-TYPE>REGULAR</CALL-TYPE>
              <EXECUTION-CONTEXT>UNSPECIFIED</EXECUTION-CONTEXT>
              <SW-SERVICE-IMPL-POLICY>STANDARD</SW-SERVICE-IMPL-POLICY>
              <BSW-ENTRY-KIND>CONCRETE</BSW-ENTRY-KIND>              
            </BSW-MODULE-ENTRY>
            <BSW-MODULE-ENTRY UUID="bb9dfdc9-7a46-4856-8b80-1895d91c2278">
              <SHORT-NAME>Cdd_Adc_StartGlobalSwTrig</SHORT-NAME>
              <SERVICE-ID>17</SERVICE-ID>
              <IS-REENTRANT>true</IS-REENTRANT>
              <IS-SYNCHRONOUS>true</IS-SYNCHRONOUS>
              <CALL-TYPE>REGULAR</CALL-TYPE>
              <EXECUTION-CONTEXT>UNSPECIFIED</EXECUTION-CONTEXT>
              <SW-SERVICE-IMPL-POLICY>STANDARD</SW-SERVICE-IMPL-POLICY>
              <BSW-ENTRY-KIND>CONCRETE</BSW-ENTRY-KIND>            
            </BSW-MODULE-ENTRY>
            <BSW-MODULE-ENTRY UUID="bb9dfdc9-7a46-4856-8b80-1895d93c2278">
              <SHORT-NAME>Cdd_Adc_StopGlobalSwTrig</SHORT-NAME>
              <SERVICE-ID>18</SERVICE-ID>
              <IS-REENTRANT>true</IS-REENTRANT>
              <IS-SYNCHRONOUS>true</IS-SYNCHRONOUS>
              <CALL-TYPE>REGULAR</CALL-TYPE>
              <EXECUTION-CONTEXT>UNSPECIFIED</EXECUTION-CONTEXT>
              <SW-SERVICE-IMPL-POLICY>STANDARD</SW-SERVICE-IMPL-POLICY>
              <BSW-ENTRY-KIND>CONCRETE</BSW-ENTRY-KIND>            
            </BSW-MODULE-ENTRY>
            <BSW-MODULE-ENTRY UUID="c1af6de3-e9fe-4249-993d-b24091614c84">
              <SHORT-NAME>Cdd_Adc_StartGroupConversion</SHORT-NAME>
              <SERVICE-ID>2</SERVICE-ID>
              <IS-REENTRANT>true</IS-REENTRANT>
              <IS-SYNCHRONOUS>true</IS-SYNCHRONOUS>
              <CALL-TYPE>REGULAR</CALL-TYPE>
              <EXECUTION-CONTEXT>UNSPECIFIED</EXECUTION-CONTEXT>
              <SW-SERVICE-IMPL-POLICY>STANDARD</SW-SERVICE-IMPL-POLICY>
              <BSW-ENTRY-KIND>CONCRETE</BSW-ENTRY-KIND>
            </BSW-MODULE-ENTRY>
            <BSW-MODULE-ENTRY UUID="59658057-2d13-456b-bbb1-aad86bd65ac6">
              <SHORT-NAME>Cdd_Adc_StartResultChecker</SHORT-NAME>
              <SERVICE-ID>13</SERVICE-ID>
              <IS-REENTRANT>true</IS-REENTRANT>
              <IS-SYNCHRONOUS>true</IS-SYNCHRONOUS>
              <CALL-TYPE>REGULAR</CALL-TYPE>
              <EXECUTION-CONTEXT>UNSPECIFIED</EXECUTION-CONTEXT>
              <SW-SERVICE-IMPL-POLICY>STANDARD</SW-SERVICE-IMPL-POLICY>
              <BSW-ENTRY-KIND>CONCRETE</BSW-ENTRY-KIND>
            </BSW-MODULE-ENTRY>
            <BSW-MODULE-ENTRY UUID="0e013ca2-a25a-4aef-8c31-dc60c733d41c">
              <SHORT-NAME>Cdd_Adc_StopGroupConversion</SHORT-NAME>
              <SERVICE-ID>3</SERVICE-ID>
              <IS-REENTRANT>true</IS-REENTRANT>
              <IS-SYNCHRONOUS>true</IS-SYNCHRONOUS>
              <CALL-TYPE>REGULAR</CALL-TYPE>
              <EXECUTION-CONTEXT>UNSPECIFIED</EXECUTION-CONTEXT>
              <SW-SERVICE-IMPL-POLICY>STANDARD</SW-SERVICE-IMPL-POLICY>
              <BSW-ENTRY-KIND>CONCRETE</BSW-ENTRY-KIND>
            </BSW-MODULE-ENTRY>
            <BSW-MODULE-ENTRY UUID="e9ed452c-a9f0-445a-ba2b-754c20213717">
              <SHORT-NAME>Cdd_Adc_StopResultChecker</SHORT-NAME>
              <SERVICE-ID>14</SERVICE-ID>
              <IS-REENTRANT>true</IS-REENTRANT>
              <IS-SYNCHRONOUS>true</IS-SYNCHRONOUS>
              <CALL-TYPE>REGULAR</CALL-TYPE>
              <EXECUTION-CONTEXT>UNSPECIFIED</EXECUTION-CONTEXT>
              <SW-SERVICE-IMPL-POLICY>STANDARD</SW-SERVICE-IMPL-POLICY>
              <BSW-ENTRY-KIND>CONCRETE</BSW-ENTRY-KIND>
            </BSW-MODULE-ENTRY>
            <BSW-MODULE-ENTRY UUID="e9edd52c-a9f0-445a-ba2b-754c20213717">
              <SHORT-NAME>Cdd_Adc_SetInternalTestNode</SHORT-NAME>
              <SERVICE-ID>27</SERVICE-ID>
              <IS-REENTRANT>true</IS-REENTRANT>
              <IS-SYNCHRONOUS>true</IS-SYNCHRONOUS>
              <CALL-TYPE>REGULAR</CALL-TYPE>
              <EXECUTION-CONTEXT>UNSPECIFIED</EXECUTION-CONTEXT>
              <SW-SERVICE-IMPL-POLICY>STANDARD</SW-SERVICE-IMPL-POLICY>
              <BSW-ENTRY-KIND>CONCRETE</BSW-ENTRY-KIND>
            </BSW-MODULE-ENTRY>
          </ELEMENTS>
        </AR-PACKAGE>
      </AR-PACKAGES>
    </AR-PACKAGE>
  </AR-PACKAGES>
</AUTOSAR>
[!ENDSELECT!]
