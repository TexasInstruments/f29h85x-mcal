AUTOSAR XML (schema 00044)
package /TI_F29H85x/Cdd_Adc
  ecuc definition collection ecuParameterDefinition: module=Cdd
  module definition Cdd [0..1]: api-service-prefix=Cdd_Adc, refined-module-def=Cdd, variants pre-compile  # Configuration of the CDD(Complex Device Driver) Adc(Analog Digital Conversion) module.
    container CddAdcConfigSet  # This container contains the configuration parameters and sub containers of the Cdd Adc module.
      boolean CddAdcEnableTemperatureSensor: origin=Texas Instruments, set at pre-compile, default-value=false  # Enables/Disables the temperature sensor.
      boolean CddAdcLockTemperatureSensor: origin=Texas Instruments, set at pre-compile, default-value=false  # Locks the temperature sensor configuration register When enabled .This is editable only when the temperature sensor is enabled.
      enumeration CddAdcInternalTestInput: {CDD_ADC_TEST_NODE_NO_CONN, CDD_ADC_TEST_NODE_VDDCORE, CDD_ADC_TEST_NODE_VDDA, CDD_ADC_TEST_NODE_VSSA, CDD_ADC_TEST_NODE_VREFLOA, CDD_ADC_TEST_NODE_VREFLOB, CDD_ADC_TEST_NODE_CDAC1H, CDD_ADC_TEST_NODE_CDAC1L, CDD_ADC_TEST_NODE_CDAC2H, CDD_ADC_TEST_NODE_CDAC2L, CDD_ADC_TEST_NODE_CDAC3H, CDD_ADC_TEST_NODE_CDAC3L, CDD_ADC_TEST_NODE_CDAC4H, CDD_ADC_TEST_NODE_CDAC4L, CDD_ADC_TEST_NODE_CDAC5H, CDD_ADC_TEST_NODE_CDAC5L, CDD_ADC_TEST_NODE_CDAC6H, CDD_ADC_TEST_NODE_CDAC6L, CDD_ADC_TEST_NODE_CDAC7H, CDD_ADC_TEST_NODE_CDAC7L, CDD_ADC_TEST_NODE_CDAC8H, CDD_ADC_TEST_NODE_CDAC8L, CDD_ADC_TEST_NODE_CDAC9H, CDD_ADC_TEST_NODE_CDAC9L, CDD_ADC_TEST_NODE_CDAC10H, CDD_ADC_TEST_NODE_CDAC10L, CDD_ADC_TEST_NODE_CDAC11H, CDD_ADC_TEST_NODE_CDAC11L, CDD_ADC_TEST_NODE_ENZ_CALIB_GAIN_3P3}, origin=Texas Instruments, set at pre-compile, default-value=CDD_ADC_TEST_NODE_NO_CONN  # Selects the input source for the internal test nodes for the ADC hardware unit.
      enumeration CddAdcHwUnitAnalogRefABVoltageMode: {CDD_ADC_REFERENCE_INTERNAL, CDD_ADC_REFERENCE_EXTERNAL}, origin=Texas Instruments, set at pre-compile, default-value=CDD_ADC_REFERENCE_INTERNAL  # This parameter defines the voltage reference mode for ADC A and B hardware instances.
      enumeration CddAdcHwUnitAnalogRefABVoltage: {CDD_ADC_REFERENCE_3_3V, CDD_ADC_REFERENCE_2_5V}, origin=Texas Instruments, set at pre-compile, default-value=CDD_ADC_REFERENCE_2_5V  # This parameter defines the reference voltage for A and B instances of the ADC. This paramter is applicable only when the voltage reference mode is INTERNAL.
      enumeration CddAdcHwUnitAnalogRefCDEVoltageMode: {CDD_ADC_REFERENCE_INTERNAL, CDD_ADC_REFERENCE_EXTERNAL}, origin=Texas Instruments, set at pre-compile, default-value=CDD_ADC_REFERENCE_INTERNAL  # This parameter defines the voltage reference mode for C,D and E instances of the ADC.
      enumeration CddAdcHwUnitAnalogRefCDEVoltage: {CDD_ADC_REFERENCE_3_3V, CDD_ADC_REFERENCE_2_5V}, origin=Texas Instruments, set at pre-compile, default-value=CDD_ADC_REFERENCE_3_3V  # This parameter defines the reference voltage for C,D and E instances of the ADC.This paramter is applicable only when the voltage reference mode is INTERNAL.
      container CddAdcHwUnit [1..5]: multiplicity set at pre-compile  # This container contains the driver configuration (parameters) for the ADC Hardware Unit
        string CddAdcHwInstance: origin=Texas Instruments, set at pre-compile, default-value=CDD_ADCA  # This parameter describes the ADC HW Unit instance.
        string CddAdcHwUnitId: origin=Texas Instruments, set at pre-compile, symbolic-name-value=true, default-value=0  # This parameter indicates harware unit index among all the configured hardware units.
        integer CddAdcSocPriorityMode: 0..32, origin=Texas Instruments, set at pre-compile, default-value=0  # This parameter defines the SOC priority of the ADC hardware unit. If the selected priority is 0 then all SOCs are handled in round robin mode,for any other value channels with SOC number below the Priority value are handled in high priority mode and the rest of the SOCs will be handled in round robin mode. By default round robin mode is configured.
        enumeration CddAdcHwUnitResolution: {CDD_ADC_RESOLUTION_12BIT, CDD_ADC_RESOLUTION_16BIT}, origin=Texas Instruments, set at pre-compile, default-value=CDD_ADC_RESOLUTION_12BIT  # This parameter defines the resolution of the hardware unit assigned to the group(in bits).
        enumeration CddAdcHwUnitSignalMode: {CDD_ADC_MODE_SINGLE_ENDED, CDD_ADC_MODE_DIFFERENTIAL}, origin=Texas Instruments, set at pre-compile, default-value=CDD_ADC_MODE_SINGLE_ENDED  # This parameter defines the signal mode of the group.Differential mode is supported only for ADC instances A and B.
        enumeration CddAdcHwUnitClockPrescale: {CDD_ADC_CLK_DIV_1_0, CDD_ADC_CLK_DIV_2_0, CDD_ADC_CLK_DIV_2_5, CDD_ADC_CLK_DIV_3_0, CDD_ADC_CLK_DIV_3_5, CDD_ADC_CLK_DIV_4_0, CDD_ADC_CLK_DIV_4_5, CDD_ADC_CLK_DIV_5_0, CDD_ADC_CLK_DIV_5_5, CDD_ADC_CLK_DIV_6_0, CDD_ADC_CLK_DIV_6_5, CDD_ADC_CLK_DIV_7_0, CDD_ADC_CLK_DIV_7_5, CDD_ADC_CLK_DIV_8_0, CDD_ADC_CLK_DIV_8_5}, origin=Texas Instruments, set at pre-compile, default-value=CDD_ADC_CLK_DIV_3_5  # This enum describes the clock prescale factor for the ADC Hardware unit.
        float CddAdcClock: 5000000.0..6.0E7, origin=Texas Instruments, set at pre-compile, default-value=5.714285714285714E7  # This parameter describes the ADC clock after the clock prescale factor for the ADC Hardware unit.
        boolean CddAdcHwExternalMuxSelect: origin=Texas Instruments, set at pre-compile, default-value=false  # This parameter determines whether the external mux channel is enabled for the ADC hardware unit.
        boolean CddAdcHwExternalMuxPreselectEnable [0..1]: multiplicity set at pre-compile, origin=Texas Instruments, set at pre-compile, default-value=false  # This parameter determines whether the external mux preset is enabled for the ADC hardware unit.
        enumeration CddAdcInterruptPulseMode: {CDD_ADC_PULSE_END_OF_ACQ_WIN, CDD_ADC_PULSE_END_OF_CONV}, origin=Texas Instruments, set at pre-compile, default-value=CDD_ADC_PULSE_END_OF_CONV  # This enumeration defines the interrupt pulse mode of the ADc hardware unit.
        integer CddAdcInterruptCycleoffset: 0..65535, origin=Texas Instruments, set at pre-compile, default-value=0  # This parameter defines the delay from the fall edge of the SOC and the interrupt to be generated in SYSCLK cycles .
        enumeration CddAdcOpenShortDetectMode: {CDD_ADC_OSDETECT_MODE_DISABLED, CDD_ADC_OSDETECT_MODE_VSSA, CDD_ADC_OSDETECT_MODE_VDDA, CDD_ADC_OSDETECT_MODE_5BY12_VDDA, CDD_ADC_OSDETECT_MODE_7BY12_VDDA, CDD_ADC_OSDETECT_MODE_5K_PULLDOWN_TO_VSSA, CDD_ADC_OSDETECT_MODE_5K_PULLUP_TO_VDDA, CDD_ADC_OSDETECT_MODE_7K_PULLDOWN_TO_VSSA}, origin=Texas Instruments, set at pre-compile, default-value=CDD_ADC_OSDETECT_MODE_DISABLED  # This parameter defines the opens/shorts detection circuit mode .
        reference CddAdcHwInstanceRef: origin=Texas Instruments, set at pre-compile, destination=Cdd_AdcAllocatedInstance  # This parameter refers to the ADC HW Unit instance.
        reference CddAdcClockReference: origin=Texas Instruments, set at pre-compile, destination=McuClockReferencePoint  # Reference to a container of the type McuClockReferencePoint, to select an input clock.
        container CddAdcGroup [1..4]: multiplicity set at pre-compile  # This container contains the Group configuration (parameters).
          enumeration CddAdcGroupPriority: {CDD_ADC_HIGH_PRIORITY, CDD_ADC_ROUND_ROBIN}, origin=Texas Instruments, set at pre-compile, default-value=CDD_ADC_ROUND_ROBIN  # Priority of the group.
          integer CddAdcGroupSocMask: 0..4294967295, origin=Texas Instruments, set at pre-compile, default-value=0  # SOC mask of the Adc hardware unit of the group.
          enumeration CddAdcGroupConversionMode: {CDD_ADC_CONV_MODE_CONTINUOUS, CDD_ADC_CONV_MODE_ONESHOT}, origin=Texas Instruments, set at pre-compile, default-value=CDD_ADC_CONV_MODE_ONESHOT  # This parameter defines the type of conversion mode for the group.
          enumeration CddAdcGroupTrigSrcType: {CDD_ADC_TRIGG_SRC_HW, CDD_ADC_TRIGG_SRC_SW}, origin=Texas Instruments, set at pre-compile, default-value=CDD_ADC_TRIGG_SRC_SW  # Type of source event that starts a group conversion.
          enumeration CddAdcGroupTrigSrc: {CDD_ADC_TRIGGER_SW_ONLY}, origin=Texas Instruments, set at pre-compile, default-value=CDD_ADC_TRIGGER_SW_ONLY  # Source of the trigger that triggers the start of the conversion of all the channels in the group.
          enumeration CddAdcGroupAccessMode: {CDD_ADC_ACCESS_MODE_SINGLE, CDD_ADC_ACCESS_MODE_STREAMING}, origin=Texas Instruments, set at pre-compile, default-value=CDD_ADC_ACCESS_MODE_SINGLE  # This parameter defines the access mode of thegroup conversion results.
          enumeration CddAdcGroupHwTrigSignal: {CDD_ADC_HW_TRIG_BOTH_EDGES, CDD_ADC_HW_TRIG_FALLING_EDGE, CDD_ADC_HW_TRIG_RISING_EDGE}, origin=Texas Instruments, set at pre-compile, default-value=CDD_ADC_HW_TRIG_RISING_EDGE  # Configures on which edge of the hardware trigger signal the driver should react, i.e. start the conversion (only if supported by the ADC hardware).
          enumeration CddAdcGroupStreamingBufferMode: {CDD_ADC_STREAM_BUFFER_CIRCULAR, CDD_ADC_STREAM_BUFFER_LINEAR}, origin=Texas Instruments, set at pre-compile, default-value=CDD_ADC_STREAM_BUFFER_LINEAR  # Configure streaming buffer as "linear buffer" (i.e. the ADC Driver stops the conversion as soon as the stream buffer is full) or as "ring buffer" (wraps around if the end of the stream buffer is reached).
          integer CddAdcGroupStreamingNumSamples: 1..255, origin=Texas Instruments, set at pre-compile, default-value=1  # Number of ADC values to be acquired per channel in streaming access mode.
          boolean CddAdcEnableDma: origin=Texas Instruments, set at pre-compile, default-value=false  # This parameter enables/disables DMA for the group.
          enumeration CddAdcInterruptCategory: {ISR_CAT1_INT, ISR_CAT1_RTINT, ISR_CAT2_INT}, origin=Texas Instruments, set at pre-compile, default-value=ISR_CAT1_RTINT  # This parameters defines the category of the interrupt.
          function name CddAdcGroupNotification [0..1]: multiplicity set at pre-compile, origin=Texas Instruments, set at pre-compile, default-value=NULL_PTR  # Callback function for each group
          enumeration CddAdcInterruptSelect: {CDD_ADC_INT1, CDD_ADC_INT2, CDD_ADC_INT3, CDD_ADC_INT4}, origin=Texas Instruments, set at pre-compile, default-value=CDD_ADC_INT1  # This parameter defines to which interrupt the group is linked.
          enumeration CddAdcInterruptSocSelect: {CDD_ADC_INT_SOC_TRIGGER_NONE, CDD_ADC_INT_SOC_TRIGGER_ADCINT1, CDD_ADC_INT_SOC_TRIGGER_ADCINT2}, origin=Texas Instruments, set at pre-compile, default-value=CDD_ADC_INT_SOC_TRIGGER_NONE  # This parameter allows interrupt as the trigger source of the group in addition to trigger select. This is applicable only for the interrupts CDD_ADC_INT1 and CDD_ADC_INT2.
          boolean CddAdcContinueToInterruptMode: origin=Texas Instruments, set at pre-compile, default-value=false  # This parameters enables/disables the continue to interrupt mode for the specified interrupt.When this mode is enabled then interrupt is generated irrespective of whether the flag bit is cleared or not else No further ADCINT pulses are generated until ADCINT flag is cleared.
          reference CddAdcTrigRepeaterReference [0..1]: multiplicity set at pre-compile, origin=Texas Instruments, set at pre-compile, destination=CddAdcTriggerRepeater  # Reference to the trigger repeater.
          container CddAdcChannel [1..32]: multiplicity set at pre-compile  # This container contains the channel configuration (parameters) depending on the hardware capability.
            integer CddAdcChannelId: 0..31, origin=Texas Instruments, set at pre-compile, default-value=0  # This parameter defines to the numeric ID of the channel on the ADC hardware unit. Only some channels are brought out on the device. Some of the channels are connected internally. So,while confguring the channel IDs make sure the channels have pin out on the deivce and are configured in Port. A particular channel is reserved for temperature sensor in every device. For example, in F29H85x device channel 20 is reserved for temperature sensor.
            integer CddAdcSocNumber: 0..31, origin=Texas Instruments, set at pre-compile, default-value=0  # This parameter defines the assignment of the channel to the physical ADC hardware channel.
            integer CddAdcSocExternalChannelSelect: 0..15, origin=Texas Instruments, set at pre-compile, default-value=0  # This parameter defines the assignment of the external channel based on the digital output pins.
            integer CddAdcChannelSampleWindow: 15..511, origin=Texas Instruments, set at pre-compile, default-value=15  # Configuration of sampling time, i.e. the time during which the value is sampled, (in SYSCLK cycles) for each channel, if supported by hardware. Minimum value should be 15 to meet the minimum acquistsition window duration.
        container CddAdcTriggerRepeater [0..2]: multiplicity set at pre-compile  # This container contains the trigger repeater configuration (parameters) depending on the hardware capability. To have this container enabled trigger source type should be hardware, trigger source should be one of the repeaters and trigger repeater should be enabled in the CddAdcGeneral container.
          integer CddAdcRepeaterInstance: 0..1, origin=Texas Instruments, set at pre-compile, default-value=0  # Numeric ID of the trigger repeater instance.
          enumeration CddAdcRepeaterTriggerSrc: {CDD_ADC_TRIGGER_CPU1INT0, CDD_ADC_TRIGGER_CPU1INT1, CDD_ADC_TRIGGER_CPU1INT2, CDD_ADC_TRIGGER_GPIO, CDD_ADC_TRIGGER_EPWM1_SOCA, CDD_ADC_TRIGGER_EPWM1_SOCB, CDD_ADC_TRIGGER_EPWM2_SOCA, CDD_ADC_TRIGGER_EPWM2_SOCB, CDD_ADC_TRIGGER_EPWM3_SOCA, CDD_ADC_TRIGGER_EPWM3_SOCB, CDD_ADC_TRIGGER_EPWM4_SOCA, CDD_ADC_TRIGGER_EPWM4_SOCB, CDD_ADC_TRIGGER_EPWM5_SOCA, CDD_ADC_TRIGGER_EPWM5_SOCB, CDD_ADC_TRIGGER_EPWM6_SOCA, CDD_ADC_TRIGGER_EPWM6_SOCB, CDD_ADC_TRIGGER_EPWM7_SOCA, CDD_ADC_TRIGGER_EPWM7_SOCB, CDD_ADC_TRIGGER_EPWM8_SOCA, CDD_ADC_TRIGGER_EPWM8_SOCB, CDD_ADC_TRIGGER_EPWM9_SOCA, CDD_ADC_TRIGGER_EPWM9_SOCB, CDD_ADC_TRIGGER_EPWM10_SOCA, CDD_ADC_TRIGGER_EPWM10_SOCB, CDD_ADC_TRIGGER_EPWM11_SOCA, CDD_ADC_TRIGGER_EPWM11_SOCB, CDD_ADC_TRIGGER_EPWM12_SOCA, CDD_ADC_TRIGGER_EPWM12_SOCB, CDD_ADC_TRIGGER_CPU2INT0, CDD_ADC_TRIGGER_CPU2INT1, CDD_ADC_TRIGGER_CPU2INT2, CDD_ADC_TRIGGER_ECAP1, CDD_ADC_TRIGGER_ECAP2, CDD_ADC_TRIGGER_ECAP3, CDD_ADC_TRIGGER_ECAP4, CDD_ADC_TRIGGER_ECAP5, CDD_ADC_TRIGGER_ECAP6, CDD_ADC_TRIGGER_EPWM13_SOCA, CDD_ADC_TRIGGER_EPWM13_SOCB, CDD_ADC_TRIGGER_EPWM14_SOCA, CDD_ADC_TRIGGER_EPWM14_SOCB, CDD_ADC_TRIGGER_EPWM15_SOCA, CDD_ADC_TRIGGER_EPWM15_SOCB, CDD_ADC_TRIGGER_EPWM16_SOCA, CDD_ADC_TRIGGER_EPWM16_SOCB, CDD_ADC_TRIGGER_EPWM17_SOCA, CDD_ADC_TRIGGER_EPWM17_SOCB, CDD_ADC_TRIGGER_EPWM18_SOCA, CDD_ADC_TRIGGER_EPWM18_SOCB, CDD_ADC_TRIGGER_CPU3INT0, CDD_ADC_TRIGGER_CPU3INT1, CDD_ADC_TRIGGER_CPU3INT2}, origin=Texas Instruments, set at pre-compile, default-value=CDD_ADC_TRIGGER_CPU1INT0  # Trigger source of the trigger repeater.
          enumeration CddAdcRepeaterMode: {OVERSAMPLING_MODE, UNDERSAMPLING_MODE}, origin=Texas Instruments, set at pre-compile, default-value=OVERSAMPLING_MODE  # This parameter configures the trigger repeater mode. In oversampling mode (CddAdcTriggerCount+1) triggers are generated and in undersampling mode (CddAdcTriggerCount+1) triggers are suppressed.
          integer CddAdcTriggerCount: 0..127, origin=Texas Instruments, set at pre-compile, default-value=0  # This parameter selects the number of triggers. When 0 is selected 1 trigger is generated (pass-through).
          integer CddAdcTriggerPhaseDelay: 0..65535, origin=Texas Instruments, set at pre-compile, default-value=0  # This parameter defines the number of SYSCLKs to delay the selected trigger before passing it onto the re-triggering logic.
          integer CddAdcTriggerSpreadDelay: 0..65535, origin=Texas Instruments, set at pre-compile, default-value=0  # This parameter defines the minimum number of SYSCLKs to wait before creating the next repeated trigger to the ADC. This parameter has no effect in undersampling mode or when the TriggerCount is set to 0
        container CddAdcPpbConfig [0..4]: multiplicity set at pre-compile  # This container contains the PPB configuration (parameters) of the PPB.
          integer CddAdcPpbInstance: 0..3, origin=Texas Instruments, set at pre-compile, default-value=0  # Numeric ID of the PPB number assigned to the channel.
          integer CddAdcPpbSocNumber: 0..31, origin=Texas Instruments, set at pre-compile, default-value=0  # Soc number of the selected channel. This is a calculated value, it can't be edited.
          integer CddAdcPpbCalibrationOffset: 0..1024, origin=Texas Instruments, set at pre-compile, default-value=0  # This parameters configures the offset calibration for the ADC channel.For values from 0 to 511,the configured value will be subtracted from the PPB result. For values from 512,(1024 - CddAdcPpbCalibrationOffset) value will be added to the PPB result. In case multiple PPBs point to the same SOC, only the OFFCAL of the lowest PPB ID will be applied. This offset value will be subtracted from the raw conversion result and stores the value in the ADC result register. The addition/subtraction satureated at o on the low ed and either 4095/65536 on the high end for 12-bit and 16-bit respectively.
          integer CddAdcPpbReferenceOffset: 0..65535, origin=Texas Instruments, set at pre-compile, default-value=0  # This parameters configures the reference offset value for the ADC channel.In 12-bit mode the reference offset shouldn't exceed 4095 in 12-bit and 65535 in 16-bit mode.
          boolean CddAdcPpbDeltaEnable: origin=Texas Instruments, set at pre-compile, default-value=false  # This parameters configures the bit to enable/disable delta enable.
          boolean CddAdcPpbEnableTwosComplement: origin=Texas Instruments, set at pre-compile, default-value=false  # This parameters configures the bit to enable/disable two's complement.
          boolean CddAdcPpbAbsoluteEnable: origin=Texas Instruments, set at pre-compile, default-value=false  # This parameters configures the bit to enable/disable absolute value calculation. This is done before the two's complement logic, so enabling both CddAdcPpbEnableTwosComplement and CddAdcPpbAbsoluteEnable will always result in a negative PPB value.
          boolean CddAdcPpbCyclebyCycleEnable: origin=Texas Instruments, set at pre-compile, default-value=false  # This parameters configures the bit to enable/disable cycle by cycle enable.
          enumeration CddAdcPpbCompareSource: {CDD_ADC_COMPARE_PPBRESULT, CDD_ADC_COMPARE_PPBPSUM, CDD_ADC_COMPARE_PPBSUM}, origin=Texas Instruments, set at pre-compile, default-value=CDD_ADC_COMPARE_PPBRESULT  # This parameters configures the PPB result type used for the zero-crossing detect logic and threshold compare.
          integer CddAdcPpbTripHighLimit: -8388608..8388607, origin=Texas Instruments, set at pre-compile, default-value=0  # High limit - used for limit checking for all types of PB results. When comparing to an ADCPPBxRESULT register, the upper bits will be ignored:TRIPHI[23:17] will be ignored in 16 bit mode and TRIPHI[23:13] will be ignored in 12 bit mode
          boolean CddAdcPpbExtendedTripLowEnable: origin=Texas Instruments, set at pre-compile, default-value=true  # This parameters configures the extended trip limit low.This value can be used to compare any PPBRESULT. This is non-editable It is always enabled
          integer CddAdcPpbTripLowLimit: -8388608..8388607, origin=Texas Instruments, set at pre-compile, default-value=0  # Extended trip low limit - used for limit checking.When comparing to an ADCPPBxRESULT register, the upper bits will be ignored: TRIPLO2[23:17] will be ignored in 16 bit mode and TRIPLO2[23:13] will be ignored in 12 bit mode
          boolean CddAdcPpbTripHighEventEnable: origin=Texas Instruments, set at pre-compile, default-value=false  # Enabling this allows the corresponding rising trip high flag in the PPB to activate the event signal to the PWM blocks.
          boolean CddAdcPpbTripLowEventEnable: origin=Texas Instruments, set at pre-compile, default-value=false  # Enabling this allows the corresponding rising trip low flag in the PPB to activate the event signal to the PWM blocks.
          boolean CddAdcPpbZeroCrossingEventEnable: origin=Texas Instruments, set at pre-compile, default-value=false  # Enabling this allows the corresponding rising zero crossing flag in the PPB to activate the event signal to the PWM blocks.
          boolean CddAdcPpbTripHighInterruptEnable: origin=Texas Instruments, set at pre-compile, default-value=false  # Enabling this allows the corresponding rising trip high flag in the PPB to activate the event signal to the PIE.
          boolean CddAdcPpbTripLowInterruptEnable: origin=Texas Instruments, set at pre-compile, default-value=false  # Enabling this allows the corresponding rising trip low flag in the PPB to activate the event signal to the PIE.
          boolean CddAdcPpbZeroCrossingInterruptEnable: origin=Texas Instruments, set at pre-compile, default-value=false  # Enabling this allows the corresponding rising zero crossing flag in the PPB to activate the event signal to the PIE.
          enumeration CddAdcEventInterruptCategory [0..1]: {ISR_CAT1_INT, ISR_CAT1_RTINT, ISR_CAT2_INT}, multiplicity set at pre-compile, origin=Texas Instruments, set at pre-compile, default-value=ISR_CAT1_RTINT  # This parameters defines the category of the interrupt.
          function name CddAdcPpbEventInterruptNotification [0..1]: multiplicity set at pre-compile, origin=Texas Instruments, set at pre-compile, default-value=NULL_PTR  # Callback function for each PPB that generaterd the event interrupt
          integer CddAdcPpbAccumulationCountLimit: 0..1024, origin=Texas Instruments, set at pre-compile, default-value=0  # This parameters defines the oversampling limit Defines the number of conversion to accumulate before PSUM is automatically loaded into SUM. The minimum allowed value is zero. The maximum value allowed is the StreamingSamples value of the corresonding channel group. If the hardware unit is configured in 16-bit resolution mode with CddAdcPpbAccumulationCountLimit exceeding 128, it results in overflow in PPB partial sum register
          integer CddAdcPpbRightShift: 0..10, origin=Texas Instruments, set at pre-compile, default-value=0  # The parameter defines the number of bits to right shift partial ppb result(PSUM) before writing to the final PPB result register(SUM). For 0, no right shit.
          boolean CddAdcPpbTripFilterEnable: origin=Texas Instruments, set at pre-compile, default-value=false  # This parameters configures the bit to enable/disable trip filter.
          reference CddAdcPpbChannel: origin=Texas Instruments, set at pre-compile, destination=CddAdcChannel  # Numeric ID of the channel whose result is to be compared.
          container CddAdcTripFilterConfig [0..1]: multiplicity set at pre-compile  # This container contains the channel configuration (parameters) depending on the hardware capability.
            integer CddAdcTripFilterClk: 0..65535, origin=Texas Instruments, set at pre-compile, default-value=0  # This parameters configures the bit to enable/disable trip filter.The effective prescale value is (CddAdcTripFilterClk + 1). This applies to the filter on both the high and low trips.
            integer CddAdcTripFilterTreshold: 0..63, origin=Texas Instruments, set at pre-compile, default-value=0  # This parameters configures the trip filter.
            integer CddAdcTripFilterSampleWindow: 0..63, origin=Texas Instruments, set at pre-compile, default-value=0  # This parameters configures the sample window for the digital trip filter.
            boolean CddAdcTripFilterLowEnable: origin=Texas Instruments, set at pre-compile, default-value=false  # This parameters configures the bit to enable/disable trip filter.
            boolean CddAdcTripFilterHighEnable: origin=Texas Instruments, set at pre-compile, default-value=false  # This parameters configures the bit to enable/disable trip filter.
      container CddAdcGlobalSwTrigger [0..255]: multiplicity set at pre-compile  # This container configures the global software trigger.When configured Soc mask of all added ADC instances should match.
        integer CddAdcGlbSwTrigId: 0..255, origin=Texas Instruments, set at pre-compile, symbolic-name-value=true, default-value=0  # Numeric ID of global software trigger.This parameter is used for symbolic name generation.
        container CddAdcHwGroup [0..*]: multiplicity set at pre-compile  # This container contains the parameter for configuring the hardware for the global software trigger feature.
          string CddAdcHwUnit: origin=Texas Instruments, set at pre-compile, default-value=CDD_ADCA  # This parameter refers to the hardware unit to which the group belongs.
          integer CddAdcSocMask: 0..4294967295, origin=Texas Instruments, set at pre-compile, default-value=0  # This parameter refers to the hardware unit to which the group belongs.
          reference CddAdcHwGroupRef: origin=Texas Instruments, set at pre-compile, destination=CddAdcGroup  # This paramter refers to the group to select the SOC numners for the global software trigger.
      container CddAdcResultCheckerUnit [0..10]: multiplicity set at pre-compile  # This container contains the safety result checker configuration (parameters).
        string CddAdcCheckerId: origin=Texas Instruments, set at pre-compile, symbolic-name-value=true, default-value=0  # Symbolic ID for a safety result checker instance.This ID should be unique.
        integer CddAdcCheckerTolerance: 0..167777216, origin=Texas Instruments, set at pre-compile, default-value=0  # This paramter configures the tolerance for the difference between CHECKRESULT1 and CHECKRESULT2.
        reference CddAdcCheckerInstanceRef: origin=Texas Instruments, set at pre-compile, destination=CddAdcSafetyCheckerInstance  # This parameter refers to the ADC safety checker instances.
        container CddAdcSelResConfig1  # This container contains the checker result1 configuration (parameters) whose results will be compared.
          enumeration CddAdcCheckerResultType: {CDD_ADC_SAFETY_CHECKER_INPUT_SOC, CDD_ADC_SAFETY_CHECKER_INPUT_PPB, CDD_ADC_SAFETY_CHECKER_INPUT_PPBSUM}, origin=Texas Instruments, set at pre-compile, default-value=CDD_ADC_SAFETY_CHECKER_INPUT_SOC  # This parameter defines thw type of result that is being accessed - a raw result or a processed result.
          reference CddAdcChannelReference [0..1]: multiplicity set at pre-compile, origin=Texas Instruments, set at pre-compile, destination=CddAdcChannel  # Numeric ID of the channel whose result is to be compared.
          reference CddAdcPpbReference [0..1]: multiplicity set at pre-compile, origin=Texas Instruments, set at pre-compile, destination=CddAdcPpbConfig  # Numeric ID of the channel whose result is to be compared.
        container CddAdcSelResConfig2  # This container contains the checker result2 configuration (parameters) whose results will be compared.
          enumeration CddAdcCheckerResultType: {CDD_ADC_SAFETY_CHECKER_INPUT_SOC, CDD_ADC_SAFETY_CHECKER_INPUT_PPB, CDD_ADC_SAFETY_CHECKER_INPUT_PPBSUM}, origin=Texas Instruments, set at pre-compile, default-value=CDD_ADC_SAFETY_CHECKER_INPUT_SOC  # This parameter defines thw type of result that is being accessed - a raw result or a processed result.
          reference CddAdcChannelReference [0..1]: multiplicity set at pre-compile, origin=Texas Instruments, set at pre-compile, destination=CddAdcChannel  # Reference to the channel whose result is to be compared.
          reference CddAdcPpbReference [0..1]: multiplicity set at pre-compile, origin=Texas Instruments, set at pre-compile, destination=CddAdcPpbConfig  # Reference to the PPB unit whose result is to be compared.
      container CddAdcCheckerIntEvtConfig [0..1]: multiplicity set at pre-compile  # This container configures the triggers for interrupts and events from the safety checker units.
        string CddAdcIntEvtId: origin=Texas Instruments, set at pre-compile, symbolic-name-value=true, default-value=0  # Symbolic ID for safety checker interrupt event instance.This ID should be unique.
        reference CddAdcCheckerIntEvtInstanceRef: origin=Texas Instruments, set at pre-compile, destination=CddAdcCheckerInterruptEvtInstance  # This parameter refers to the ADC HW Unit instance.
        container CddAdcCheckerIntEvtConfiguration [0..10]: multiplicity set at pre-compile  # Configure interrupts and events for the safety checker instance for the specified interrupt event block.
          reference CddAdcSafetyCheckerInstance: origin=Texas Instruments, set at pre-compile, destination=CddAdcResultCheckerUnit  # Reference to the safety checker instance.
          container CddAdcCheckerIntSource  # This container selects the source of the safety checker interrupt.
            boolean CddAdcCheckerRes1Ovf: origin=Texas Instruments, set at pre-compile, default-value=false  # This paramter enables the result1 overflow as the source of the safety checker interrupt.
            boolean CddAdcCheckerRes2Ovf: origin=Texas Instruments, set at pre-compile, default-value=false  # This paramter enables the result2 overflow as the source of the safety checker interrupt.
            boolean CddAdcCheckerOot: origin=Texas Instruments, set at pre-compile, default-value=false  # This paramter enables the out-of-tolerance as the source of the safety checker interrupt.
          container CddAdcCheckerEvt1Source  # This container selects the source of the safety checker event signal.
            boolean CddAdcCheckerRes1Ovf: origin=Texas Instruments, set at pre-compile, default-value=false  # This paramter enables the result1 overflow as the source of the safety checker event signal.
            boolean CddAdcCheckerRes2Ovf: origin=Texas Instruments, set at pre-compile, default-value=false  # This paramter enables the result2 overflow as the source of the safety checker event signal.
            boolean CddAdcCheckerOot: origin=Texas Instruments, set at pre-compile, default-value=false  # This paramter enables the out-of-tolerance as the source of the safety checker event signal.
          container CddAdcCheckerEvt2Source  # This container selects the source of the safety checker event signal.
            boolean CddAdcCheckerRes1Ovf: origin=Texas Instruments, set at pre-compile, default-value=false  # This paramter enables the result1 overflow as the source of the safety checker event signal.
            boolean CddAdcCheckerRes2Ovf: origin=Texas Instruments, set at pre-compile, default-value=false  # This paramter enables the result2 overflow as the source of the safety checker event signal.
            boolean CddAdcCheckerOot: origin=Texas Instruments, set at pre-compile, default-value=false  # This paramter enables the out-of-tolerance as the source of the safety checker event signal.
          container CddAdcCheckerEvt3Source  # This container selects the source of the safety checker event signal.
            boolean CddAdcCheckerRes1Ovf: origin=Texas Instruments, set at pre-compile, default-value=false  # This paramter enables the result1 overflow as the source of the safety checker event signal.
            boolean CddAdcCheckerRes2Ovf: origin=Texas Instruments, set at pre-compile, default-value=false  # This paramter enables the result2 overflow as the source of the safety checker event signal.
            boolean CddAdcCheckerOot: origin=Texas Instruments, set at pre-compile, default-value=false  # This paramter enables the out-of-tolerance as the source of the safety checker event signal.
          container CddAdcCheckerEvt4Source  # This container selects the source of the safety checker event signal.
            boolean CddAdcCheckerRes1Ovf: origin=Texas Instruments, set at pre-compile, default-value=false  # This paramter enables the result1 overflow as the source of the safety checker event signal.
            boolean CddAdcCheckerRes2Ovf: origin=Texas Instruments, set at pre-compile, default-value=false  # This paramter enables the result2 overflow as the source of the safety checker event signal.
            boolean CddAdcCheckerOot: origin=Texas Instruments, set at pre-compile, default-value=false  # This paramter enables the out-of-tolerance as the source of the safety checker event signal.
    container CddAdcGeneral  # General configuration (parameters) of the ADC Driver software module.
      boolean CddAdcDeInitApi: origin=Texas Instruments, set at pre-compile, default-value=true  # Adds / removes the service Cdd_Adc_DeInit() from the code.
      boolean CddAdcDevErrorDetect: origin=Texas Instruments, set at pre-compile, default-value=false  # Switches the development error detection and notification on or off.
      boolean CddAdcEnableStartStopGroupApi: origin=Texas Instruments, set at pre-compile, default-value=true  # Adds / removes the services Cdd_Adc_StartGroupConversion() and Cdd_Adc_StopGroupConversion() from the code.
      boolean CddAdcEnableGlobalSoftwareTrigger: origin=Texas Instruments, set at pre-compile, default-value=false  # Adds / removes the services Cdd_Adc_StartGlobalSwTrig() and Cdd_Adc_StopGlobalSwTrig() from the code.
      boolean CddAdcNotifCapability: origin=Texas Instruments, set at pre-compile, default-value=false  # Determines, if the group notification mechanism (the functions to enable and disable the notifications) is available at runtime.
      boolean CddAdcHwTriggerApi: origin=Texas Instruments, set at pre-compile, default-value=true  # Adds / removes the services Cdd_Adc_EnableHardwareTrigger() and Cdd_Adc_DisableHardwareTrigger() from the code.
      boolean CddAdcPpbEnable: origin=Texas Instruments, set at pre-compile, default-value=false  # This parameter enables safety checker capability for the module.
      boolean CddAdcReadGroupApi: origin=Texas Instruments, set at pre-compile, default-value=true  # Adds / removes the service Cdd_Adc_ReadGroup() and from the code.
      boolean CddAdcSafetyCheckerEnable: origin=Texas Instruments, set at pre-compile, default-value=false  # This parameter enables safety checker capability for the module.
      boolean CddAdcSetResolutionApi: origin=Texas Instruments, set at pre-compile, default-value=false  # Adds / removes the service Cdd_Adc_SetResolution() from the code.
      boolean CddAdcVersionInfoApi: origin=Texas Instruments, set at pre-compile, default-value=false  # Adds / removes the service Cdd_Adc_GetVersionInfo() from the code.
