[part 3 of 3]
<AUTOSAR xmlns="http://autosar.org/schema/r4.0" xmlns:xsi="http://www.w3.org/2001/XMLSchema-instance" xsi:schemaLocation="http://autosar.org/schema/r4.0 AUTOSAR_00044.xsd">  (continued)
  <AR-PACKAGES>  (continued)
    <AR-PACKAGE UUID="367937c5-f61a-496f-8737-ac11c6ac205a">  (continued)
      <AR-PACKAGES>
        <AR-PACKAGE UUID="1f41b693-5c43-49dd-85df-dfb5c345a15b">
          <SHORT-NAME>Cdd_Pwm_ModuleEntry</SHORT-NAME>
          <ELEMENTS>
            <BSW-MODULE-ENTRY UUID="f971b6c5-964a-40ad-a836-66cf7f7523c7">
              <SHORT-NAME>Cdd_Pwm_Epwm1_IntIsr</SHORT-NAME>
              <IS-REENTRANT>false</IS-REENTRANT>
              <IS-SYNCHRONOUS>true</IS-SYNCHRONOUS>
              <CALL-TYPE>INTERRUPT</CALL-TYPE>
              [!LOOP "as:modconf('Cdd_Pwm/Cdd')[as:path(node:dtos(.))='/TI_F29H85x/Cdd_Pwm/Cdd']/CddPwmConfigSet/CddPwmHwUnitConfig/*/.//*[@name='CddPwmInterruptEnable']"!]
              [!IF "num:i(node:value(../CddPwmInstance)) = num:i(1)"!]
              [!IF "(node:value(../CddPwmInterruptCategory)='ISR_CAT2_INT')"!]
              <EXECUTION-CONTEXT>INTERRUPT-CAT-2</EXECUTION-CONTEXT>
              [!ELSE!]
              <EXECUTION-CONTEXT>INTERRUPT-CAT-1</EXECUTION-CONTEXT>
              [!ENDIF!]
              [!BREAK!]
              [!ENDIF!]
              [!ENDLOOP!]
              <SW-SERVICE-IMPL-POLICY>STANDARD</SW-SERVICE-IMPL-POLICY>
              <BSW-ENTRY-KIND>CONCRETE</BSW-ENTRY-KIND>
            </BSW-MODULE-ENTRY>
            <BSW-MODULE-ENTRY UUID="41c93848-1e12-4fde-b670-b84d0d87096b">
              <SHORT-NAME>Cdd_Pwm_Epwm2_IntIsr</SHORT-NAME>
              <IS-REENTRANT>false</IS-REENTRANT>
              <IS-SYNCHRONOUS>true</IS-SYNCHRONOUS>
              <CALL-TYPE>INTERRUPT</CALL-TYPE>
              [!LOOP "as:modconf('Cdd_Pwm/Cdd')[as:path(node:dtos(.))='/TI_F29H85x/Cdd_Pwm/Cdd']/CddPwmConfigSet/CddPwmHwUnitConfig/*/.//*[@name='CddPwmInterruptEnable']"!]
              [!IF "num:i(node:value(../CddPwmInstance)) = num:i(2)"!]
              [!IF "(node:value(../CddPwmInterruptCategory)='ISR_CAT2_INT')"!]
              <EXECUTION-CONTEXT>INTERRUPT-CAT-2</EXECUTION-CONTEXT>
              [!ELSE!]
              <EXECUTION-CONTEXT>INTERRUPT-CAT-1</EXECUTION-CONTEXT>
              [!ENDIF!]
              [!BREAK!]
              [!ENDIF!]
              [!ENDLOOP!]
              <SW-SERVICE-IMPL-POLICY>STANDARD</SW-SERVICE-IMPL-POLICY>
              <BSW-ENTRY-KIND>CONCRETE</BSW-ENTRY-KIND>
            </BSW-MODULE-ENTRY>
            <BSW-MODULE-ENTRY UUID="05bfec66-5e55-4510-bcc7-51aaa56389d1">
              <SHORT-NAME>Cdd_Pwm_Epwm3_IntIsr</SHORT-NAME>
              <IS-REENTRANT>false</IS-REENTRANT>
              <IS-SYNCHRONOUS>true</IS-SYNCHRONOUS>
              <CALL-TYPE>INTERRUPT</CALL-TYPE>
              [!LOOP "as:modconf('Cdd_Pwm/Cdd')[as:path(node:dtos(.))='/TI_F29H85x/Cdd_Pwm/Cdd']/CddPwmConfigSet/CddPwmHwUnitConfig/*/.//*[@name='CddPwmInterruptEnable']"!]
              [!IF "num:i(node:value(../CddPwmInstance)) = num:i(3)"!]
              [!IF "(node:value(../CddPwmInterruptCategory)='ISR_CAT2_INT')"!]
              <EXECUTION-CONTEXT>INTERRUPT-CAT-2</EXECUTION-CONTEXT>
              [!ELSE!]
              <EXECUTION-CONTEXT>INTERRUPT-CAT-1</EXECUTION-CONTEXT>
              [!ENDIF!]
              [!BREAK!]
              [!ENDIF!]
              [!ENDLOOP!]
              <SW-SERVICE-IMPL-POLICY>STANDARD</SW-SERVICE-IMPL-POLICY>
              <BSW-ENTRY-KIND>CONCRETE</BSW-ENTRY-KIND>
            </BSW-MODULE-ENTRY>
            <BSW-MODULE-ENTRY UUID="c4c5eda0-4f89-4502-b42b-466477eedec1">
              <SHORT-NAME>Cdd_Pwm_Epwm4_IntIsr</SHORT-NAME>
              <IS-REENTRANT>false</IS-REENTRANT>
              <IS-SYNCHRONOUS>true</IS-SYNCHRONOUS>
              <CALL-TYPE>INTERRUPT</CALL-TYPE>
              [!LOOP "as:modconf('Cdd_Pwm/Cdd')[as:path(node:dtos(.))='/TI_F29H85x/Cdd_Pwm/Cdd']/CddPwmConfigSet/CddPwmHwUnitConfig/*/.//*[@name='CddPwmInterruptEnable']"!]
              [!IF "num:i(node:value(../CddPwmInstance)) = num:i(4)"!]
              [!IF "(node:value(../CddPwmInterruptCategory)='ISR_CAT2_INT')"!]
              <EXECUTION-CONTEXT>INTERRUPT-CAT-2</EXECUTION-CONTEXT>
              [!ELSE!]
              <EXECUTION-CONTEXT>INTERRUPT-CAT-1</EXECUTION-CONTEXT>
              [!ENDIF!]
              [!BREAK!]
              [!ENDIF!]
              [!ENDLOOP!]
              <SW-SERVICE-IMPL-POLICY>STANDARD</SW-SERVICE-IMPL-POLICY>
              <BSW-ENTRY-KIND>CONCRETE</BSW-ENTRY-KIND>
            </BSW-MODULE-ENTRY>
            <BSW-MODULE-ENTRY UUID="817714e7-688d-4d70-a031-d60ec5c7869c">
              <SHORT-NAME>Cdd_Pwm_Epwm5_IntIsr</SHORT-NAME>
              <IS-REENTRANT>false</IS-REENTRANT>
              <IS-SYNCHRONOUS>true</IS-SYNCHRONOUS>
              <CALL-TYPE>INTERRUPT</CALL-TYPE>
              [!LOOP "as:modconf('Cdd_Pwm/Cdd')[as:path(node:dtos(.))='/TI_F29H85x/Cdd_Pwm/Cdd']/CddPwmConfigSet/CddPwmHwUnitConfig/*/.//*[@name='CddPwmInterruptEnable']"!]
              [!IF "num:i(node:value(../CddPwmInstance)) = num:i(5)"!]
              [!IF "(node:value(../CddPwmInterruptCategory)='ISR_CAT2_INT')"!]
              <EXECUTION-CONTEXT>INTERRUPT-CAT-2</EXECUTION-CONTEXT>
              [!ELSE!]
              <EXECUTION-CONTEXT>INTERRUPT-CAT-1</EXECUTION-CONTEXT>
              [!ENDIF!]
              [!BREAK!]
              [!ENDIF!]
              [!ENDLOOP!]
              <SW-SERVICE-IMPL-POLICY>STANDARD</SW-SERVICE-IMPL-POLICY>
              <BSW-ENTRY-KIND>CONCRETE</BSW-ENTRY-KIND>
            </BSW-MODULE-ENTRY>
            <BSW-MODULE-ENTRY UUID="0a32eec9-cdb8-484f-b05a-0136eaf33d8c">
              <SHORT-NAME>Cdd_Pwm_Epwm6_IntIsr</SHORT-NAME>
              <IS-REENTRANT>false</IS-REENTRANT>
              <IS-SYNCHRONOUS>true</IS-SYNCHRONOUS>
              <CALL-TYPE>INTERRUPT</CALL-TYPE>
              [!LOOP "as:modconf('Cdd_Pwm/Cdd')[as:path(node:dtos(.))='/TI_F29H85x/Cdd_Pwm/Cdd']/CddPwmConfigSet/CddPwmHwUnitConfig/*/.//*[@name='CddPwmInterruptEnable']"!]
              [!IF "num:i(node:value(../CddPwmInstance)) = num:i(6)"!]
              [!IF "(node:value(../CddPwmInterruptCategory)='ISR_CAT2_INT')"!]
              <EXECUTION-CONTEXT>INTERRUPT-CAT-2</EXECUTION-CONTEXT>
              [!ELSE!]
              <EXECUTION-CONTEXT>INTERRUPT-CAT-1</EXECUTION-CONTEXT>
              [!ENDIF!]
              [!BREAK!]
              [!ENDIF!]
              [!ENDLOOP!]
              <SW-SERVICE-IMPL-POLICY>STANDARD</SW-SERVICE-IMPL-POLICY>
              <BSW-ENTRY-KIND>CONCRETE</BSW-ENTRY-KIND>
            </BSW-MODULE-ENTRY>
            <BSW-MODULE-ENTRY UUID="f9f5097a-4ff2-4f59-ac70-afbaeade1ae5">
              <SHORT-NAME>Cdd_Pwm_Epwm7_IntIsr</SHORT-NAME>
              <IS-REENTRANT>false</IS-REENTRANT>
              <IS-SYNCHRONOUS>true</IS-SYNCHRONOUS>
              <CALL-TYPE>INTERRUPT</CALL-TYPE>
              [!LOOP "as:modconf('Cdd_Pwm/Cdd')[as:path(node:dtos(.))='/TI_F29H85x/Cdd_Pwm/Cdd']/CddPwmConfigSet/CddPwmHwUnitConfig/*/.//*[@name='CddPwmInterruptEnable']"!]
              [!IF "num:i(node:value(../CddPwmInstance)) = num:i(7)"!]
              [!IF "(node:value(../CddPwmInterruptCategory)='ISR_CAT2_INT')"!]
              <EXECUTION-CONTEXT>INTERRUPT-CAT-2</EXECUTION-CONTEXT>
              [!ELSE!]
              <EXECUTION-CONTEXT>INTERRUPT-CAT-1</EXECUTION-CONTEXT>
              [!ENDIF!]
              [!BREAK!]
              [!ENDIF!]
              [!ENDLOOP!]
              <SW-SERVICE-IMPL-POLICY>STANDARD</SW-SERVICE-IMPL-POLICY>
              <BSW-ENTRY-KIND>CONCRETE</BSW-ENTRY-KIND>
            </BSW-MODULE-ENTRY>
            <BSW-MODULE-ENTRY UUID="a0f64028-8582-4d14-862e-fa1a66389e73">
              <SHORT-NAME>Cdd_Pwm_Epwm8_IntIsr</SHORT-NAME>
              <IS-REENTRANT>false</IS-REENTRANT>
              <IS-SYNCHRONOUS>true</IS-SYNCHRONOUS>
              <CALL-TYPE>INTERRUPT</CALL-TYPE>
              [!LOOP "as:modconf('Cdd_Pwm/Cdd')[as:path(node:dtos(.))='/TI_F29H85x/Cdd_Pwm/Cdd']/CddPwmConfigSet/CddPwmHwUnitConfig/*/.//*[@name='CddPwmInterruptEnable']"!]
              [!IF "num:i(node:value(../CddPwmInstance)) = num:i(8)"!]
              [!IF "(node:value(../CddPwmInterruptCategory)='ISR_CAT2_INT')"!]
              <EXECUTION-CONTEXT>INTERRUPT-CAT-2</EXECUTION-CONTEXT>
              [!ELSE!]
              <EXECUTION-CONTEXT>INTERRUPT-CAT-1</EXECUTION-CONTEXT>
              [!ENDIF!]
              [!BREAK!]
              [!ENDIF!]
              [!ENDLOOP!]
              <SW-SERVICE-IMPL-POLICY>STANDARD</SW-SERVICE-IMPL-POLICY>
              <BSW-ENTRY-KIND>CONCRETE</BSW-ENTRY-KIND>
            </BSW-MODULE-ENTRY>
            <BSW-MODULE-ENTRY UUID="ac24d043-f63b-442c-b2cc-74572b20d0b2">
              <SHORT-NAME>Cdd_Pwm_Epwm9_IntIsr</SHORT-NAME>
              <IS-REENTRANT>false</IS-REENTRANT>
              <IS-SYNCHRONOUS>true</IS-SYNCHRONOUS>
              <CALL-TYPE>INTERRUPT</CALL-TYPE>
              [!LOOP "as:modconf('Cdd_Pwm/Cdd')[as:path(node:dtos(.))='/TI_F29H85x/Cdd_Pwm/Cdd']/CddPwmConfigSet/CddPwmHwUnitConfig/*/.//*[@name='CddPwmInterruptEnable']"!]
              [!IF "num:i(node:value(../CddPwmInstance)) = num:i(9)"!]
              [!IF "(node:value(../CddPwmInterruptCategory)='ISR_CAT2_INT')"!]
              <EXECUTION-CONTEXT>INTERRUPT-CAT-2</EXECUTION-CONTEXT>
              [!ELSE!]
              <EXECUTION-CONTEXT>INTERRUPT-CAT-1</EXECUTION-CONTEXT>
              [!ENDIF!]
              [!BREAK!]
              [!ENDIF!]
              [!ENDLOOP!]
              <SW-SERVICE-IMPL-POLICY>STANDARD</SW-SERVICE-IMPL-POLICY>
              <BSW-ENTRY-KIND>CONCRETE</BSW-ENTRY-KIND>
            </BSW-MODULE-ENTRY>
            <BSW-MODULE-ENTRY UUID="62f1345f-2ddf-49c0-a7cf-d5f74b99e4b7">
              <SHORT-NAME>Cdd_Pwm_Epwm10_IntIsr</SHORT-NAME>
              <IS-REENTRANT>false</IS-REENTRANT>
              <IS-SYNCHRONOUS>true</IS-SYNCHRONOUS>
              <CALL-TYPE>INTERRUPT</CALL-TYPE>
              [!LOOP "as:modconf('Cdd_Pwm/Cdd')[as:path(node:dtos(.))='/TI_F29H85x/Cdd_Pwm/Cdd']/CddPwmConfigSet/CddPwmHwUnitConfig/*/.//*[@name='CddPwmInterruptEnable']"!]
              [!IF "num:i(node:value(../CddPwmInstance)) = num:i(10)"!]
              [!IF "(node:value(../CddPwmInterruptCategory)='ISR_CAT2_INT')"!]
              <EXECUTION-CONTEXT>INTERRUPT-CAT-2</EXECUTION-CONTEXT>
              [!ELSE!]
              <EXECUTION-CONTEXT>INTERRUPT-CAT-1</EXECUTION-CONTEXT>
              [!ENDIF!]
              [!BREAK!]
              [!ENDIF!]
              [!ENDLOOP!]
              <SW-SERVICE-IMPL-POLICY>STANDARD</SW-SERVICE-IMPL-POLICY>
              <BSW-ENTRY-KIND>CONCRETE</BSW-ENTRY-KIND>
            </BSW-MODULE-ENTRY>
            <BSW-MODULE-ENTRY UUID="436577ac-39a7-44ca-aa12-52827056e2a0">
              <SHORT-NAME>Cdd_Pwm_Epwm11_IntIsr</SHORT-NAME>
              <IS-REENTRANT>false</IS-REENTRANT>
              <IS-SYNCHRONOUS>true</IS-SYNCHRONOUS>
              <CALL-TYPE>INTERRUPT</CALL-TYPE>
              [!LOOP "as:modconf('Cdd_Pwm/Cdd')[as:path(node:dtos(.))='/TI_F29H85x/Cdd_Pwm/Cdd']/CddPwmConfigSet/CddPwmHwUnitConfig/*/.//*[@name='CddPwmInterruptEnable']"!]
              [!IF "num:i(node:value(../CddPwmInstance)) = num:i(11)"!]
              [!IF "(node:value(../CddPwmInterruptCategory)='ISR_CAT2_INT')"!]
              <EXECUTION-CONTEXT>INTERRUPT-CAT-2</EXECUTION-CONTEXT>
              [!ELSE!]
              <EXECUTION-CONTEXT>INTERRUPT-CAT-1</EXECUTION-CONTEXT>
              [!ENDIF!]
              [!BREAK!]
              [!ENDIF!]
              [!ENDLOOP!]
              <SW-SERVICE-IMPL-POLICY>STANDARD</SW-SERVICE-IMPL-POLICY>
              <BSW-ENTRY-KIND>CONCRETE</BSW-ENTRY-KIND>
            </BSW-MODULE-ENTRY>
            <BSW-MODULE-ENTRY UUID="92973244-84e2-4760-8bb4-cde2e5788540">
              <SHORT-NAME>Cdd_Pwm_Epwm12_IntIsr</SHORT-NAME>
              <IS-REENTRANT>false</IS-REENTRANT>
              <IS-SYNCHRONOUS>true</IS-SYNCHRONOUS>
              <CALL-TYPE>INTERRUPT</CALL-TYPE>
              [!LOOP "as:modconf('Cdd_Pwm/Cdd')[as:path(node:dtos(.))='/TI_F29H85x/Cdd_Pwm/Cdd']/CddPwmConfigSet/CddPwmHwUnitConfig/*/.//*[@name='CddPwmInterruptEnable']"!]
              [!IF "num:i(node:value(../CddPwmInstance)) = num:i(12)"!]
              [!IF "(node:value(../CddPwmInterruptCategory)='ISR_CAT2_INT')"!]
              <EXECUTION-CONTEXT>INTERRUPT-CAT-2</EXECUTION-CONTEXT>
              [!ELSE!]
              <EXECUTION-CONTEXT>INTERRUPT-CAT-1</EXECUTION-CONTEXT>
              [!ENDIF!]
              [!BREAK!]
              [!ENDIF!]
              [!ENDLOOP!]
              <SW-SERVICE-IMPL-POLICY>STANDARD</SW-SERVICE-IMPL-POLICY>
              <BSW-ENTRY-KIND>CONCRETE</BSW-ENTRY-KIND>
            </BSW-MODULE-ENTRY>
            <BSW-MODULE-ENTRY UUID="8ce8587d-2ab9-4bef-a93f-a8b7dd5f5f5e">
              <SHORT-NAME>Cdd_Pwm_Epwm13_IntIsr</SHORT-NAME>
              <IS-REENTRANT>false</IS-REENTRANT>
              <IS-SYNCHRONOUS>true</IS-SYNCHRONOUS>
              <CALL-TYPE>INTERRUPT</CALL-TYPE>
              [!LOOP "as:modconf('Cdd_Pwm/Cdd')[as:path(node:dtos(.))='/TI_F29H85x/Cdd_Pwm/Cdd']/CddPwmConfigSet/CddPwmHwUnitConfig/*/.//*[@name='CddPwmInterruptEnable']"!]
              [!IF "num:i(node:value(../CddPwmInstance)) = num:i(13)"!]
              [!IF "(node:value(../CddPwmInterruptCategory)='ISR_CAT2_INT')"!]
              <EXECUTION-CONTEXT>INTERRUPT-CAT-2</EXECUTION-CONTEXT>
              [!ELSE!]
              <EXECUTION-CONTEXT>INTERRUPT-CAT-1</EXECUTION-CONTEXT>
              [!ENDIF!]
              [!BREAK!]
              [!ENDIF!]
              [!ENDLOOP!]
              <SW-SERVICE-IMPL-POLICY>STANDARD</SW-SERVICE-IMPL-POLICY>
              <BSW-ENTRY-KIND>CONCRETE</BSW-ENTRY-KIND>
            </BSW-MODULE-ENTRY>
            <BSW-MODULE-ENTRY UUID="5d83d20e-007c-4c2a-b20a-e7a0f50c5ec8">
              <SHORT-NAME>Cdd_Pwm_Epwm14_IntIsr</SHORT-NAME>
              <IS-REENTRANT>false</IS-REENTRANT>
              <IS-SYNCHRONOUS>true</IS-SYNCHRONOUS>
              <CALL-TYPE>INTERRUPT</CALL-TYPE>
              [!LOOP "as:modconf('Cdd_Pwm/Cdd')[as:path(node:dtos(.))='/TI_F29H85x/Cdd_Pwm/Cdd']/CddPwmConfigSet/CddPwmHwUnitConfig/*/.//*[@name='CddPwmInterruptEnable']"!]
              [!IF "num:i(node:value(../CddPwmInstance)) = num:i(14)"!]
              [!IF "(node:value(../CddPwmInterruptCategory)='ISR_CAT2_INT')"!]
              <EXECUTION-CONTEXT>INTERRUPT-CAT-2</EXECUTION-CONTEXT>
              [!ELSE!]
              <EXECUTION-CONTEXT>INTERRUPT-CAT-1</EXECUTION-CONTEXT>
              [!ENDIF!]
              [!BREAK!]
              [!ENDIF!]
              [!ENDLOOP!]
              <SW-SERVICE-IMPL-POLICY>STANDARD</SW-SERVICE-IMPL-POLICY>
              <BSW-ENTRY-KIND>CONCRETE</BSW-ENTRY-KIND>
            </BSW-MODULE-ENTRY>
            <BSW-MODULE-ENTRY UUID="673885cc-5139-4c86-b5d5-70945bdcdbb2">
              <SHORT-NAME>Cdd_Pwm_Epwm15_IntIsr</SHORT-NAME>
              <IS-REENTRANT>false</IS-REENTRANT>
              <IS-SYNCHRONOUS>true</IS-SYNCHRONOUS>
              <CALL-TYPE>INTERRUPT</CALL-TYPE>
              [!LOOP "as:modconf('Cdd_Pwm/Cdd')[as:path(node:dtos(.))='/TI_F29H85x/Cdd_Pwm/Cdd']/CddPwmConfigSet/CddPwmHwUnitConfig/*/.//*[@name='CddPwmInterruptEnable']"!]
              [!IF "num:i(node:value(../CddPwmInstance)) = num:i(15)"!]
              [!IF "(node:value(../CddPwmInterruptCategory)='ISR_CAT2_INT')"!]
              <EXECUTION-CONTEXT>INTERRUPT-CAT-2</EXECUTION-CONTEXT>
              [!ELSE!]
              <EXECUTION-CONTEXT>INTERRUPT-CAT-1</EXECUTION-CONTEXT>
              [!ENDIF!]
              [!BREAK!]
              [!ENDIF!]
              [!ENDLOOP!]
              <SW-SERVICE-IMPL-POLICY>STANDARD</SW-SERVICE-IMPL-POLICY>
              <BSW-ENTRY-KIND>CONCRETE</BSW-ENTRY-KIND>
            </BSW-MODULE-ENTRY>
            <BSW-MODULE-ENTRY UUID="69287660-0a8a-47b5-b92b-4dbd3a30a3ef">
              <SHORT-NAME>Cdd_Pwm_Epwm16_IntIsr</SHORT-NAME>
              <IS-REENTRANT>false</IS-REENTRANT>
              <IS-SYNCHRONOUS>true</IS-SYNCHRONOUS>
              <CALL-TYPE>INTERRUPT</CALL-TYPE>
              [!LOOP "as:modconf('Cdd_Pwm/Cdd')[as:path(node:dtos(.))='/TI_F29H85x/Cdd_Pwm/Cdd']/CddPwmConfigSet/CddPwmHwUnitConfig/*/.//*[@name='CddPwmInterruptEnable']"!]
              [!IF "num:i(node:value(../CddPwmInstance)) = num:i(16)"!]
              [!IF "(node:value(../CddPwmInterruptCategory)='ISR_CAT2_INT')"!]
              <EXECUTION-CONTEXT>INTERRUPT-CAT-2</EXECUTION-CONTEXT>
              [!ELSE!]
              <EXECUTION-CONTEXT>INTERRUPT-CAT-1</EXECUTION-CONTEXT>
              [!ENDIF!]
              [!BREAK!]
              [!ENDIF!]
              [!ENDLOOP!]
              <SW-SERVICE-IMPL-POLICY>STANDARD</SW-SERVICE-IMPL-POLICY>
              <BSW-ENTRY-KIND>CONCRETE</BSW-ENTRY-KIND>
            </BSW-MODULE-ENTRY>
            <BSW-MODULE-ENTRY UUID="8831babf-5fc6-441c-847f-5b4c42a55522">
              <SHORT-NAME>Cdd_Pwm_Epwm17_IntIsr</SHORT-NAME>
              <IS-REENTRANT>false</IS-REENTRANT>
              <IS-SYNCHRONOUS>true</IS-SYNCHRONOUS>
              <CALL-TYPE>INTERRUPT</CALL-TYPE>
              [!LOOP "as:modconf('Cdd_Pwm/Cdd')[as:path(node:dtos(.))='/TI_F29H85x/Cdd_Pwm/Cdd']/CddPwmConfigSet/CddPwmHwUnitConfig/*/.//*[@name='CddPwmInterruptEnable']"!]
              [!IF "num:i(node:value(../CddPwmInstance)) = num:i(17)"!]
              [!IF "(node:value(../CddPwmInterruptCategory)='ISR_CAT2_INT')"!]
              <EXECUTION-CONTEXT>INTERRUPT-CAT-2</EXECUTION-CONTEXT>
              [!ELSE!]
              <EXECUTION-CONTEXT>INTERRUPT-CAT-1</EXECUTION-CONTEXT>
              [!ENDIF!]
              [!BREAK!]
              [!ENDIF!]
              [!ENDLOOP!]
              <SW-SERVICE-IMPL-POLICY>STANDARD</SW-SERVICE-IMPL-POLICY>
              <BSW-ENTRY-KIND>CONCRETE</BSW-ENTRY-KIND>
            </BSW-MODULE-ENTRY>
            <BSW-MODULE-ENTRY UUID="0864ada0-b406-4497-8031-bcabd115b1fd">
              <SHORT-NAME>Cdd_Pwm_Epwm18_IntIsr</SHORT-NAME>
              <IS-REENTRANT>false</IS-REENTRANT>
              <IS-SYNCHRONOUS>true</IS-SYNCHRONOUS>
              <CALL-TYPE>INTERRUPT</CALL-TYPE>
              [!LOOP "as:modconf('Cdd_Pwm/Cdd')[as:path(node:dtos(.))='/TI_F29H85x/Cdd_Pwm/Cdd']/CddPwmConfigSet/CddPwmHwUnitConfig/*/.//*[@name='CddPwmInterruptEnable']"!]
              [!IF "num:i(node:value(../CddPwmInstance)) = num:i(18)"!]
              [!IF "(node:value(../CddPwmInterruptCategory)='ISR_CAT2_INT')"!]
              <EXECUTION-CONTEXT>INTERRUPT-CAT-2</EXECUTION-CONTEXT>
              [!ELSE!]
              <EXECUTION-CONTEXT>INTERRUPT-CAT-1</EXECUTION-CONTEXT>
              [!ENDIF!]
              [!BREAK!]
              [!ENDIF!]
              [!ENDLOOP!]
              <SW-SERVICE-IMPL-POLICY>STANDARD</SW-SERVICE-IMPL-POLICY>
              <BSW-ENTRY-KIND>CONCRETE</BSW-ENTRY-KIND>
            </BSW-MODULE-ENTRY>
            <BSW-MODULE-ENTRY UUID="d9bffa22-8052-4207-a458-fca851b138f0">
              <SHORT-NAME>Cdd_Pwm_EnableNotification</SHORT-NAME>
              <SERVICE-ID>221</SERVICE-ID>
              <IS-REENTRANT>true</IS-REENTRANT>
              <IS-SYNCHRONOUS>true</IS-SYNCHRONOUS>
              <CALL-TYPE>REGULAR</CALL-TYPE>
              <EXECUTION-CONTEXT>UNSPECIFIED</EXECUTION-CONTEXT>
              <SW-SERVICE-IMPL-POLICY>STANDARD</SW-SERVICE-IMPL-POLICY>
              <BSW-ENTRY-KIND>CONCRETE</BSW-ENTRY-KIND>
            </BSW-MODULE-ENTRY>
            <BSW-MODULE-ENTRY UUID="d7fc520e-66b9-4048-951d-a28f37296627">
              <SHORT-NAME>Cdd_Pwm_DisableNotification</SHORT-NAME>
              <SERVICE-ID>222</SERVICE-ID>
              <IS-REENTRANT>true</IS-REENTRANT>
              <IS-SYNCHRONOUS>true</IS-SYNCHRONOUS>
              <CALL-TYPE>REGULAR</CALL-TYPE>
              <EXECUTION-CONTEXT>UNSPECIFIED</EXECUTION-CONTEXT>
              <SW-SERVICE-IMPL-POLICY>STANDARD</SW-SERVICE-IMPL-POLICY>
              <BSW-ENTRY-KIND>CONCRETE</BSW-ENTRY-KIND>
            </BSW-MODULE-ENTRY>
            <BSW-MODULE-ENTRY UUID="726b47fb-75a5-471e-b5db-da1fc491cc02">
              <SHORT-NAME>Cdd_Pwm_Init</SHORT-NAME>
              <SERVICE-ID>0</SERVICE-ID>
              <IS-REENTRANT>false</IS-REENTRANT>
              <IS-SYNCHRONOUS>true</IS-SYNCHRONOUS>
              <CALL-TYPE>REGULAR</CALL-TYPE>
              <EXECUTION-CONTEXT>UNSPECIFIED</EXECUTION-CONTEXT>
              <SW-SERVICE-IMPL-POLICY>STANDARD</SW-SERVICE-IMPL-POLICY>
              <BSW-ENTRY-KIND>CONCRETE</BSW-ENTRY-KIND>
            </BSW-MODULE-ENTRY>
            <BSW-MODULE-ENTRY UUID="f9ba4bbe-49e4-4c0d-a1a6-530c7186ff4b">
              <SHORT-NAME>Cdd_Pwm_GetVersionInfo</SHORT-NAME>
              <SERVICE-ID>7</SERVICE-ID>
              <IS-REENTRANT>true</IS-REENTRANT>
              <IS-SYNCHRONOUS>false</IS-SYNCHRONOUS>
              <CALL-TYPE>REGULAR</CALL-TYPE>
              <EXECUTION-CONTEXT>UNSPECIFIED</EXECUTION-CONTEXT>
              <SW-SERVICE-IMPL-POLICY>STANDARD</SW-SERVICE-IMPL-POLICY>
              <BSW-ENTRY-KIND>CONCRETE</BSW-ENTRY-KIND>
            </BSW-MODULE-ENTRY>
            <BSW-MODULE-ENTRY UUID="55ade7bb-a222-4869-b7d6-815e2b48229a">
              <SHORT-NAME>Cdd_Pwm_SetInterruptEventCount</SHORT-NAME>
              <SERVICE-ID>220</SERVICE-ID>
              <IS-REENTRANT>true</IS-REENTRANT>
              <IS-SYNCHRONOUS>false</IS-SYNCHRONOUS>
              <CALL-TYPE>REGULAR</CALL-TYPE>
              <EXECUTION-CONTEXT>UNSPECIFIED</EXECUTION-CONTEXT>
              <SW-SERVICE-IMPL-POLICY>STANDARD</SW-SERVICE-IMPL-POLICY>
              <BSW-ENTRY-KIND>CONCRETE</BSW-ENTRY-KIND>
            </BSW-MODULE-ENTRY>
          [!IF "node:value(as:modconf('Cdd_Pwm/Cdd')[as:path(node:dtos(.))='/TI_F29H85x/Cdd_Pwm/Cdd']/CddPwmConfigSet/CddPwmAdvancedMode) = 'false'"!]
            <BSW-MODULE-ENTRY UUID="4c6c4e11-d2ca-432b-8d6b-fbf3276fd688">
              <SHORT-NAME>Cdd_Pwm_DeInit</SHORT-NAME>
              <SERVICE-ID>1</SERVICE-ID>
              <IS-REENTRANT>false</IS-REENTRANT>
              <IS-SYNCHRONOUS>true</IS-SYNCHRONOUS>
              <CALL-TYPE>REGULAR</CALL-TYPE>
              <EXECUTION-CONTEXT>UNSPECIFIED</EXECUTION-CONTEXT>
              <SW-SERVICE-IMPL-POLICY>STANDARD</SW-SERVICE-IMPL-POLICY>
              <BSW-ENTRY-KIND>CONCRETE</BSW-ENTRY-KIND>
            </BSW-MODULE-ENTRY>
            <BSW-MODULE-ENTRY UUID="85c4ee0e-4bf4-4d95-a300-8e5bd0cc76a2">
              <SHORT-NAME>Cdd_Pwm_SetOutputToIdle</SHORT-NAME>
              <SERVICE-ID>4</SERVICE-ID>
              <IS-REENTRANT>true</IS-REENTRANT>
              <IS-SYNCHRONOUS>true</IS-SYNCHRONOUS>
              <CALL-TYPE>REGULAR</CALL-TYPE>
              <EXECUTION-CONTEXT>UNSPECIFIED</EXECUTION-CONTEXT>
              <SW-SERVICE-IMPL-POLICY>STANDARD</SW-SERVICE-IMPL-POLICY>
              <BSW-ENTRY-KIND>CONCRETE</BSW-ENTRY-KIND>
            </BSW-MODULE-ENTRY>
            <BSW-MODULE-ENTRY UUID="9774502f-8a4c-44eb-bcec-059b656e4a02">
              <SHORT-NAME>Cdd_Pwm_SetPeriod</SHORT-NAME>
              <SERVICE-ID>3</SERVICE-ID>
              <IS-REENTRANT>true</IS-REENTRANT>
              <IS-SYNCHRONOUS>true</IS-SYNCHRONOUS>
              <CALL-TYPE>REGULAR</CALL-TYPE>
              <EXECUTION-CONTEXT>UNSPECIFIED</EXECUTION-CONTEXT>
              <SW-SERVICE-IMPL-POLICY>STANDARD</SW-SERVICE-IMPL-POLICY>
              <BSW-ENTRY-KIND>CONCRETE</BSW-ENTRY-KIND>
            </BSW-MODULE-ENTRY>
            <BSW-MODULE-ENTRY UUID="0991deed-261b-410b-ae9b-c34a58a0e489">
              <SHORT-NAME>Cdd_Pwm_SetDutyCycle</SHORT-NAME>
              <SERVICE-ID>2</SERVICE-ID>
              <IS-REENTRANT>true</IS-REENTRANT>
              <IS-SYNCHRONOUS>true</IS-SYNCHRONOUS>
              <CALL-TYPE>REGULAR</CALL-TYPE>
              <EXECUTION-CONTEXT>UNSPECIFIED</EXECUTION-CONTEXT>
              <SW-SERVICE-IMPL-POLICY>STANDARD</SW-SERVICE-IMPL-POLICY>
              <BSW-ENTRY-KIND>CONCRETE</BSW-ENTRY-KIND>
              <ARGUMENTS>
              </ARGUMENTS>
            </BSW-MODULE-ENTRY>
          [!ELSE!]
            <BSW-MODULE-ENTRY UUID="607572ec-44a6-4300-8070-a183e1e8f63f">
              <SHORT-NAME>Cdd_Pwm_Epwm1_TzIntIsr</SHORT-NAME>
              <IS-REENTRANT>false</IS-REENTRANT>
              <IS-SYNCHRONOUS>true</IS-SYNCHRONOUS>
              <CALL-TYPE>INTERRUPT</CALL-TYPE>
              [!LOOP "as:modconf('Cdd_Pwm/Cdd')[as:path(node:dtos(.))='/TI_F29H85x/Cdd_Pwm/Cdd']/CddPwmConfigSet/CddPwmHwUnitConfig/*/.//*[@name='CddPwmInterruptEnable']"!]
              [!IF "num:i(node:value(../CddPwmInstance)) = num:i(1)"!]
              [!IF "(node:value(../CddPwmInterruptCategory)='ISR_CAT2_INT')"!]
              <EXECUTION-CONTEXT>INTERRUPT-CAT-2</EXECUTION-CONTEXT>
              [!ELSE!]
              <EXECUTION-CONTEXT>INTERRUPT-CAT-1</EXECUTION-CONTEXT>
              [!ENDIF!]
              [!BREAK!]
              [!ENDIF!]
              [!ENDLOOP!]
              <SW-SERVICE-IMPL-POLICY>STANDARD</SW-SERVICE-IMPL-POLICY>
              <BSW-ENTRY-KIND>CONCRETE</BSW-ENTRY-KIND>
            </BSW-MODULE-ENTRY>
            <BSW-MODULE-ENTRY UUID="bab17bb0-1979-48ae-b5ae-a9db792f0dd8">
              <SHORT-NAME>Cdd_Pwm_Epwm2_TzIntIsr</SHORT-NAME>
              <IS-REENTRANT>false</IS-REENTRANT>
              <IS-SYNCHRONOUS>true</IS-SYNCHRONOUS>
              <CALL-TYPE>INTERRUPT</CALL-TYPE>
              [!LOOP "as:modconf('Cdd_Pwm/Cdd')[as:path(node:dtos(.))='/TI_F29H85x/Cdd_Pwm/Cdd']/CddPwmConfigSet/CddPwmHwUnitConfig/*/.//*[@name='CddPwmInterruptEnable']"!]
              [!IF "num:i(node:value(../CddPwmInstance)) = num:i(2)"!]
              [!IF "(node:value(../CddPwmInterruptCategory)='ISR_CAT2_INT')"!]
              <EXECUTION-CONTEXT>INTERRUPT-CAT-2</EXECUTION-CONTEXT>
              [!ELSE!]
              <EXECUTION-CONTEXT>INTERRUPT-CAT-1</EXECUTION-CONTEXT>
              [!ENDIF!]
              [!BREAK!]
              [!ENDIF!]
              [!ENDLOOP!]
              <SW-SERVICE-IMPL-POLICY>STANDARD</SW-SERVICE-IMPL-POLICY>
              <BSW-ENTRY-KIND>CONCRETE</BSW-ENTRY-KIND>
            </BSW-MODULE-ENTRY>
            <BSW-MODULE-ENTRY UUID="c4544b89-8a17-4ffc-a06b-f8b86bd09081">
              <SHORT-NAME>Cdd_Pwm_Epwm3_TzIntIsr</SHORT-NAME>
              <IS-REENTRANT>false</IS-REENTRANT>
              <IS-SYNCHRONOUS>true</IS-SYNCHRONOUS>
              <CALL-TYPE>INTERRUPT</CALL-TYPE>
              [!LOOP "as:modconf('Cdd_Pwm/Cdd')[as:path(node:dtos(.))='/TI_F29H85x/Cdd_Pwm/Cdd']/CddPwmConfigSet/CddPwmHwUnitConfig/*/.//*[@name='CddPwmInterruptEnable']"!]
              [!IF "num:i(node:value(../CddPwmInstance)) = num:i(3)"!]
              [!IF "(node:value(../CddPwmInterruptCategory)='ISR_CAT2_INT')"!]
              <EXECUTION-CONTEXT>INTERRUPT-CAT-2</EXECUTION-CONTEXT>
              [!ELSE!]
              <EXECUTION-CONTEXT>INTERRUPT-CAT-1</EXECUTION-CONTEXT>
              [!ENDIF!]
              [!BREAK!]
              [!ENDIF!]
              [!ENDLOOP!]
              <SW-SERVICE-IMPL-POLICY>STANDARD</SW-SERVICE-IMPL-POLICY>
              <BSW-ENTRY-KIND>CONCRETE</BSW-ENTRY-KIND>
            </BSW-MODULE-ENTRY>
            <BSW-MODULE-ENTRY UUID="980bcc5d-cb0d-4f7a-8373-e8605264062b">
              <SHORT-NAME>Cdd_Pwm_Epwm4_TzIntIsr</SHORT-NAME>
              <IS-REENTRANT>false</IS-REENTRANT>
              <IS-SYNCHRONOUS>true</IS-SYNCHRONOUS>
              <CALL-TYPE>INTERRUPT</CALL-TYPE>
              [!LOOP "as:modconf('Cdd_Pwm/Cdd')[as:path(node:dtos(.))='/TI_F29H85x/Cdd_Pwm/Cdd']/CddPwmConfigSet/CddPwmHwUnitConfig/*/.//*[@name='CddPwmInterruptEnable']"!]
              [!IF "num:i(node:value(../CddPwmInstance)) = num:i(4)"!]
              [!IF "(node:value(../CddPwmInterruptCategory)='ISR_CAT2_INT')"!]
              <EXECUTION-CONTEXT>INTERRUPT-CAT-2</EXECUTION-CONTEXT>
              [!ELSE!]
              <EXECUTION-CONTEXT>INTERRUPT-CAT-1</EXECUTION-CONTEXT>
              [!ENDIF!]
              [!BREAK!]
              [!ENDIF!]
              [!ENDLOOP!]
              <SW-SERVICE-IMPL-POLICY>STANDARD</SW-SERVICE-IMPL-POLICY>
              <BSW-ENTRY-KIND>CONCRETE</BSW-ENTRY-KIND>
            </BSW-MODULE-ENTRY>
            <BSW-MODULE-ENTRY UUID="b417d8fb-13b5-4f6c-9949-83ead01d6baa">
              <SHORT-NAME>Cdd_Pwm_Epwm5_TzIntIsr</SHORT-NAME>
              <IS-REENTRANT>false</IS-REENTRANT>
              <IS-SYNCHRONOUS>true</IS-SYNCHRONOUS>
              <CALL-TYPE>INTERRUPT</CALL-TYPE>
              [!LOOP "as:modconf('Cdd_Pwm/Cdd')[as:path(node:dtos(.))='/TI_F29H85x/Cdd_Pwm/Cdd']/CddPwmConfigSet/CddPwmHwUnitConfig/*/.//*[@name='CddPwmInterruptEnable']"!]
              [!IF "num:i(node:value(../CddPwmInstance)) = num:i(5)"!]
              [!IF "(node:value(../CddPwmInterruptCategory)='ISR_CAT2_INT')"!]
              <EXECUTION-CONTEXT>INTERRUPT-CAT-2</EXECUTION-CONTEXT>
              [!ELSE!]
              <EXECUTION-CONTEXT>INTERRUPT-CAT-1</EXECUTION-CONTEXT>
              [!ENDIF!]
              [!BREAK!]
              [!ENDIF!]
              [!ENDLOOP!]
              <SW-SERVICE-IMPL-POLICY>STANDARD</SW-SERVICE-IMPL-POLICY>
              <BSW-ENTRY-KIND>CONCRETE</BSW-ENTRY-KIND>
            </BSW-MODULE-ENTRY>
            <BSW-MODULE-ENTRY UUID="221243cd-146e-4485-9831-6bc9c0eb27aa">
              <SHORT-NAME>Cdd_Pwm_Epwm6_TzIntIsr</SHORT-NAME>
              <IS-REENTRANT>false</IS-REENTRANT>
              <IS-SYNCHRONOUS>true</IS-SYNCHRONOUS>
              <CALL-TYPE>INTERRUPT</CALL-TYPE>
              [!LOOP "as:modconf('Cdd_Pwm/Cdd')[as:path(node:dtos(.))='/TI_F29H85x/Cdd_Pwm/Cdd']/CddPwmConfigSet/CddPwmHwUnitConfig/*/.//*[@name='CddPwmInterruptEnable']"!]
              [!IF "num:i(node:value(../CddPwmInstance)) = num:i(6)"!]
              [!IF "(node:value(../CddPwmInterruptCategory)='ISR_CAT2_INT')"!]
              <EXECUTION-CONTEXT>INTERRUPT-CAT-2</EXECUTION-CONTEXT>
              [!ELSE!]
              <EXECUTION-CONTEXT>INTERRUPT-CAT-1</EXECUTION-CONTEXT>
              [!ENDIF!]
              [!BREAK!]
              [!ENDIF!]
              [!ENDLOOP!]
              <SW-SERVICE-IMPL-POLICY>STANDARD</SW-SERVICE-IMPL-POLICY>
              <BSW-ENTRY-KIND>CONCRETE</BSW-ENTRY-KIND>
            </BSW-MODULE-ENTRY>
            <BSW-MODULE-ENTRY UUID="456fd4d0-57b7-4f65-a00a-dfff9b543730">
              <SHORT-NAME>Cdd_Pwm_Epwm7_TzIntIsr</SHORT-NAME>
              <IS-REENTRANT>false</IS-REENTRANT>
              <IS-SYNCHRONOUS>true</IS-SYNCHRONOUS>
              <CALL-TYPE>INTERRUPT</CALL-TYPE>
              [!LOOP "as:modconf('Cdd_Pwm/Cdd')[as:path(node:dtos(.))='/TI_F29H85x/Cdd_Pwm/Cdd']/CddPwmConfigSet/CddPwmHwUnitConfig/*/.//*[@name='CddPwmInterruptEnable']"!]
              [!IF "num:i(node:value(../CddPwmInstance)) = num:i(7)"!]
              [!IF "(node:value(../CddPwmInterruptCategory)='ISR_CAT2_INT')"!]
              <EXECUTION-CONTEXT>INTERRUPT-CAT-2</EXECUTION-CONTEXT>
              [!ELSE!]
              <EXECUTION-CONTEXT>INTERRUPT-CAT-1</EXECUTION-CONTEXT>
              [!ENDIF!]
              [!BREAK!]
              [!ENDIF!]
              [!ENDLOOP!]
              <SW-SERVICE-IMPL-POLICY>STANDARD</SW-SERVICE-IMPL-POLICY>
              <BSW-ENTRY-KIND>CONCRETE</BSW-ENTRY-KIND>
            </BSW-MODULE-ENTRY>
            <BSW-MODULE-ENTRY UUID="f6f7cd0a-08f7-4989-a41f-b23fb71b677c">
              <SHORT-NAME>Cdd_Pwm_Epwm8_TzIntIsr</SHORT-NAME>
              <IS-REENTRANT>false</IS-REENTRANT>
              <IS-SYNCHRONOUS>true</IS-SYNCHRONOUS>
              <CALL-TYPE>INTERRUPT</CALL-TYPE>
              [!LOOP "as:modconf('Cdd_Pwm/Cdd')[as:path(node:dtos(.))='/TI_F29H85x/Cdd_Pwm/Cdd']/CddPwmConfigSet/CddPwmHwUnitConfig/*/.//*[@name='CddPwmInterruptEnable']"!]
              [!IF "num:i(node:value(../CddPwmInstance)) = num:i(8)"!]
              [!IF "(node:value(../CddPwmInterruptCategory)='ISR_CAT2_INT')"!]
              <EXECUTION-CONTEXT>INTERRUPT-CAT-2</EXECUTION-CONTEXT>
              [!ELSE!]
              <EXECUTION-CONTEXT>INTERRUPT-CAT-1</EXECUTION-CONTEXT>
              [!ENDIF!]
              [!BREAK!]
              [!ENDIF!]
              [!ENDLOOP!]
              <SW-SERVICE-IMPL-POLICY>STANDARD</SW-SERVICE-IMPL-POLICY>
              <BSW-ENTRY-KIND>CONCRETE</BSW-ENTRY-KIND>
            </BSW-MODULE-ENTRY>
            <BSW-MODULE-ENTRY UUID="41982e0f-2535-4cdb-bd28-283fd8bc9032">
              <SHORT-NAME>Cdd_Pwm_Epwm9_TzIntIsr</SHORT-NAME>
              <IS-REENTRANT>false</IS-REENTRANT>
              <IS-SYNCHRONOUS>true</IS-SYNCHRONOUS>
              <CALL-TYPE>INTERRUPT</CALL-TYPE>
              [!LOOP "as:modconf('Cdd_Pwm/Cdd')[as:path(node:dtos(.))='/TI_F29H85x/Cdd_Pwm/Cdd']/CddPwmConfigSet/CddPwmHwUnitConfig/*/.//*[@name='CddPwmInterruptEnable']"!]
              [!IF "num:i(node:value(../CddPwmInstance)) = num:i(9)"!]
              [!IF "(node:value(../CddPwmInterruptCategory)='ISR_CAT2_INT')"!]
              <EXECUTION-CONTEXT>INTERRUPT-CAT-2</EXECUTION-CONTEXT>
              [!ELSE!]
              <EXECUTION-CONTEXT>INTERRUPT-CAT-1</EXECUTION-CONTEXT>
              [!ENDIF!]
              [!BREAK!]
              [!ENDIF!]
              [!ENDLOOP!]
              <SW-SERVICE-IMPL-POLICY>STANDARD</SW-SERVICE-IMPL-POLICY>
              <BSW-ENTRY-KIND>CONCRETE</BSW-ENTRY-KIND>
            </BSW-MODULE-ENTRY>
            <BSW-MODULE-ENTRY UUID="2658a788-b20c-45b9-a151-e1764bc0af74">
              <SHORT-NAME>Cdd_Pwm_Epwm10_TzIntIsr</SHORT-NAME>
              <IS-REENTRANT>false</IS-REENTRANT>
              <IS-SYNCHRONOUS>true</IS-SYNCHRONOUS>
              <CALL-TYPE>INTERRUPT</CALL-TYPE>
              [!LOOP "as:modconf('Cdd_Pwm/Cdd')[as:path(node:dtos(.))='/TI_F29H85x/Cdd_Pwm/Cdd']/CddPwmConfigSet/CddPwmHwUnitConfig/*/.//*[@name='CddPwmInterruptEnable']"!]
              [!IF "num:i(node:value(../CddPwmInstance)) = num:i(10)"!]
              [!IF "(node:value(../CddPwmInterruptCategory)='ISR_CAT2_INT')"!]
              <EXECUTION-CONTEXT>INTERRUPT-CAT-2</EXECUTION-CONTEXT>
              [!ELSE!]
              <EXECUTION-CONTEXT>INTERRUPT-CAT-1</EXECUTION-CONTEXT>
              [!ENDIF!]
              [!BREAK!]
              [!ENDIF!]
              [!ENDLOOP!]
              <SW-SERVICE-IMPL-POLICY>STANDARD</SW-SERVICE-IMPL-POLICY>
              <BSW-ENTRY-KIND>CONCRETE</BSW-ENTRY-KIND>
            </BSW-MODULE-ENTRY>
            <BSW-MODULE-ENTRY UUID="4e415802-4b4a-4635-a954-1e8f061f4319">
              <SHORT-NAME>Cdd_Pwm_Epwm11_TzIntIsr</SHORT-NAME>
              <IS-REENTRANT>false</IS-REENTRANT>
              <IS-SYNCHRONOUS>true</IS-SYNCHRONOUS>
              <CALL-TYPE>INTERRUPT</CALL-TYPE>
              [!LOOP "as:modconf('Cdd_Pwm/Cdd')[as:path(node:dtos(.))='/TI_F29H85x/Cdd_Pwm/Cdd']/CddPwmConfigSet/CddPwmHwUnitConfig/*/.//*[@name='CddPwmInterruptEnable']"!]
              [!IF "num:i(node:value(../CddPwmInstance)) = num:i(11)"!]
              [!IF "(node:value(../CddPwmInterruptCategory)='ISR_CAT2_INT')"!]
              <EXECUTION-CONTEXT>INTERRUPT-CAT-2</EXECUTION-CONTEXT>
              [!ELSE!]
              <EXECUTION-CONTEXT>INTERRUPT-CAT-1</EXECUTION-CONTEXT>
              [!ENDIF!]
              [!BREAK!]
              [!ENDIF!]
              [!ENDLOOP!]
              <SW-SERVICE-IMPL-POLICY>STANDARD</SW-SERVICE-IMPL-POLICY>
              <BSW-ENTRY-KIND>CONCRETE</BSW-ENTRY-KIND>
            </BSW-MODULE-ENTRY>
            <BSW-MODULE-ENTRY UUID="b62169c2-a259-4a17-b77f-c9146048853e">
              <SHORT-NAME>Cdd_Pwm_Epwm12_TzIntIsr</SHORT-NAME>
              <IS-REENTRANT>false</IS-REENTRANT>
              <IS-SYNCHRONOUS>true</IS-SYNCHRONOUS>
              <CALL-TYPE>INTERRUPT</CALL-TYPE>
              [!LOOP "as:modconf('Cdd_Pwm/Cdd')[as:path(node:dtos(.))='/TI_F29H85x/Cdd_Pwm/Cdd']/CddPwmConfigSet/CddPwmHwUnitConfig/*/.//*[@name='CddPwmInterruptEnable']"!]
              [!IF "num:i(node:value(../CddPwmInstance)) = num:i(12)"!]
              [!IF "(node:value(../CddPwmInterruptCategory)='ISR_CAT2_INT')"!]
              <EXECUTION-CONTEXT>INTERRUPT-CAT-2</EXECUTION-CONTEXT>
              [!ELSE!]
              <EXECUTION-CONTEXT>INTERRUPT-CAT-1</EXECUTION-CONTEXT>
              [!ENDIF!]
              [!BREAK!]
              [!ENDIF!]
              [!ENDLOOP!]
              <SW-SERVICE-IMPL-POLICY>STANDARD</SW-SERVICE-IMPL-POLICY>
              <BSW-ENTRY-KIND>CONCRETE</BSW-ENTRY-KIND>
            </BSW-MODULE-ENTRY>
            <BSW-MODULE-ENTRY UUID="1f1bda14-2b01-4daf-9ed1-5f9f760a4575">
              <SHORT-NAME>Cdd_Pwm_Epwm13_TzIntIsr</SHORT-NAME>
              <IS-REENTRANT>false</IS-REENTRANT>
              <IS-SYNCHRONOUS>true</IS-SYNCHRONOUS>
              <CALL-TYPE>INTERRUPT</CALL-TYPE>
              [!LOOP "as:modconf('Cdd_Pwm/Cdd')[as:path(node:dtos(.))='/TI_F29H85x/Cdd_Pwm/Cdd']/CddPwmConfigSet/CddPwmHwUnitConfig/*/.//*[@name='CddPwmInterruptEnable']"!]
              [!IF "num:i(node:value(../CddPwmInstance)) = num:i(13)"!]
              [!IF "(node:value(../CddPwmInterruptCategory)='ISR_CAT2_INT')"!]
              <EXECUTION-CONTEXT>INTERRUPT-CAT-2</EXECUTION-CONTEXT>
              [!ELSE!]
              <EXECUTION-CONTEXT>INTERRUPT-CAT-1</EXECUTION-CONTEXT>
              [!ENDIF!]
              [!BREAK!]
              [!ENDIF!]
              [!ENDLOOP!]
              <SW-SERVICE-IMPL-POLICY>STANDARD</SW-SERVICE-IMPL-POLICY>
              <BSW-ENTRY-KIND>CONCRETE</BSW-ENTRY-KIND>
            </BSW-MODULE-ENTRY>
            <BSW-MODULE-ENTRY UUID="f378500a-28ab-4dfd-bdc3-09a0903e537c">
              <SHORT-NAME>Cdd_Pwm_Epwm14_TzIntIsr</SHORT-NAME>
              <IS-REENTRANT>false</IS-REENTRANT>
              <IS-SYNCHRONOUS>true</IS-SYNCHRONOUS>
              <CALL-TYPE>INTERRUPT</CALL-TYPE>
              [!LOOP "as:modconf('Cdd_Pwm/Cdd')[as:path(node:dtos(.))='/TI_F29H85x/Cdd_Pwm/Cdd']/CddPwmConfigSet/CddPwmHwUnitConfig/*/.//*[@name='CddPwmInterruptEnable']"!]
              [!IF "num:i(node:value(../CddPwmInstance)) = num:i(14)"!]
              [!IF "(node:value(../CddPwmInterruptCategory)='ISR_CAT2_INT')"!]
              <EXECUTION-CONTEXT>INTERRUPT-CAT-2</EXECUTION-CONTEXT>
              [!ELSE!]
              <EXECUTION-CONTEXT>INTERRUPT-CAT-1</EXECUTION-CONTEXT>
              [!ENDIF!]
              [!BREAK!]
              [!ENDIF!]
              [!ENDLOOP!]
              <SW-SERVICE-IMPL-POLICY>STANDARD</SW-SERVICE-IMPL-POLICY>
              <BSW-ENTRY-KIND>CONCRETE</BSW-ENTRY-KIND>
            </BSW-MODULE-ENTRY>
            <BSW-MODULE-ENTRY UUID="393a5a27-e204-4e9a-9f34-a4c0022a6991">
              <SHORT-NAME>Cdd_Pwm_Epwm15_TzIntIsr</SHORT-NAME>
              <IS-REENTRANT>false</IS-REENTRANT>
              <IS-SYNCHRONOUS>true</IS-SYNCHRONOUS>
              <CALL-TYPE>INTERRUPT</CALL-TYPE>
              [!LOOP "as:modconf('Cdd_Pwm/Cdd')[as:path(node:dtos(.))='/TI_F29H85x/Cdd_Pwm/Cdd']/CddPwmConfigSet/CddPwmHwUnitConfig/*/.//*[@name='CddPwmInterruptEnable']"!]
              [!IF "num:i(node:value(../CddPwmInstance)) = num:i(15)"!]
              [!IF "(node:value(../CddPwmInterruptCategory)='ISR_CAT2_INT')"!]
              <EXECUTION-CONTEXT>INTERRUPT-CAT-2</EXECUTION-CONTEXT>
              [!ELSE!]
              <EXECUTION-CONTEXT>INTERRUPT-CAT-1</EXECUTION-CONTEXT>
              [!ENDIF!]
              [!BREAK!]
              [!ENDIF!]
              [!ENDLOOP!]
              <SW-SERVICE-IMPL-POLICY>STANDARD</SW-SERVICE-IMPL-POLICY>
              <BSW-ENTRY-KIND>CONCRETE</BSW-ENTRY-KIND>
            </BSW-MODULE-ENTRY>
            <BSW-MODULE-ENTRY UUID="8defb77e-e50c-4777-9d3d-81f67d784d9d">
              <SHORT-NAME>Cdd_Pwm_Epwm16_TzIntIsr</SHORT-NAME>
              <IS-REENTRANT>false</IS-REENTRANT>
              <IS-SYNCHRONOUS>true</IS-SYNCHRONOUS>
              <CALL-TYPE>INTERRUPT</CALL-TYPE>
              [!LOOP "as:modconf('Cdd_Pwm/Cdd')[as:path(node:dtos(.))='/TI_F29H85x/Cdd_Pwm/Cdd']/CddPwmConfigSet/CddPwmHwUnitConfig/*/.//*[@name='CddPwmInterruptEnable']"!]
              [!IF "num:i(node:value(../CddPwmInstance)) = num:i(16)"!]
              [!IF "(node:value(../CddPwmInterruptCategory)='ISR_CAT2_INT')"!]
              <EXECUTION-CONTEXT>INTERRUPT-CAT-2</EXECUTION-CONTEXT>
              [!ELSE!]
              <EXECUTION-CONTEXT>INTERRUPT-CAT-1</EXECUTION-CONTEXT>
              [!ENDIF!]
              [!BREAK!]
              [!ENDIF!]
              [!ENDLOOP!]
              <SW-SERVICE-IMPL-POLICY>STANDARD</SW-SERVICE-IMPL-POLICY>
              <BSW-ENTRY-KIND>CONCRETE</BSW-ENTRY-KIND>
            </BSW-MODULE-ENTRY>
            <BSW-MODULE-ENTRY UUID="6f8e43c5-5062-4df0-a0bb-aafe5c9b8124">
              <SHORT-NAME>Cdd_Pwm_Epwm17_TzIntIsr</SHORT-NAME>
              <IS-REENTRANT>false</IS-REENTRANT>
              <IS-SYNCHRONOUS>true</IS-SYNCHRONOUS>
              <CALL-TYPE>INTERRUPT</CALL-TYPE>
              [!LOOP "as:modconf('Cdd_Pwm/Cdd')[as:path(node:dtos(.))='/TI_F29H85x/Cdd_Pwm/Cdd']/CddPwmConfigSet/CddPwmHwUnitConfig/*/.//*[@name='CddPwmInterruptEnable']"!]
              [!IF "num:i(node:value(../CddPwmInstance)) = num:i(17)"!]
              [!IF "(node:value(../CddPwmInterruptCategory)='ISR_CAT2_INT')"!]
              <EXECUTION-CONTEXT>INTERRUPT-CAT-2</EXECUTION-CONTEXT>
              [!ELSE!]
              <EXECUTION-CONTEXT>INTERRUPT-CAT-1</EXECUTION-CONTEXT>
              [!ENDIF!]
              [!BREAK!]
              [!ENDIF!]
              [!ENDLOOP!]
              <SW-SERVICE-IMPL-POLICY>STANDARD</SW-SERVICE-IMPL-POLICY>
              <BSW-ENTRY-KIND>CONCRETE</BSW-ENTRY-KIND>
            </BSW-MODULE-ENTRY>
            <BSW-MODULE-ENTRY UUID="275d3319-8f25-4b5c-a39d-b2fe78121e18">
              <SHORT-NAME>Cdd_Pwm_Epwm18_TzIntIsr</SHORT-NAME>
              <IS-REENTRANT>false</IS-REENTRANT>
              <IS-SYNCHRONOUS>true</IS-SYNCHRONOUS>
              <CALL-TYPE>INTERRUPT</CALL-TYPE>
              [!LOOP "as:modconf('Cdd_Pwm/Cdd')[as:path(node:dtos(.))='/TI_F29H85x/Cdd_Pwm/Cdd']/CddPwmConfigSet/CddPwmHwUnitConfig/*/.//*[@name='CddPwmInterruptEnable']"!]
              [!IF "num:i(node:value(../CddPwmInstance)) = num:i(18)"!]
              [!IF "(node:value(../CddPwmInterruptCategory)='ISR_CAT2_INT')"!]
              <EXECUTION-CONTEXT>INTERRUPT-CAT-2</EXECUTION-CONTEXT>
              [!ELSE!]
              <EXECUTION-CONTEXT>INTERRUPT-CAT-1</EXECUTION-CONTEXT>
              [!ENDIF!]
              [!BREAK!]
              [!ENDIF!]
              [!ENDLOOP!]
              <SW-SERVICE-IMPL-POLICY>STANDARD</SW-SERVICE-IMPL-POLICY>
              <BSW-ENTRY-KIND>CONCRETE</BSW-ENTRY-KIND>
            </BSW-MODULE-ENTRY>
            <BSW-MODULE-ENTRY UUID="ef8ea7a9-87f2-4b68-baa2-d5ef985cb1fb">
              <SHORT-NAME>Cdd_Pwm_SetEmulationMode</SHORT-NAME>
              <SERVICE-ID>226</SERVICE-ID>
              <IS-REENTRANT>false</IS-REENTRANT>
              <IS-SYNCHRONOUS>true</IS-SYNCHRONOUS>
              <CALL-TYPE>REGULAR</CALL-TYPE>
              <EXECUTION-CONTEXT>UNSPECIFIED</EXECUTION-CONTEXT>
              <SW-SERVICE-IMPL-POLICY>STANDARD</SW-SERVICE-IMPL-POLICY>
              <BSW-ENTRY-KIND>CONCRETE</BSW-ENTRY-KIND>
            </BSW-MODULE-ENTRY>  
            <BSW-MODULE-ENTRY UUID="19a1a82e-cb60-4fa8-8ec6-1ce75161ded7">
              <SHORT-NAME>Cdd_Pwm_ConfigureTripZoneNotification</SHORT-NAME>
              <SERVICE-ID>227</SERVICE-ID>
              <IS-REENTRANT>false</IS-REENTRANT>
              <IS-SYNCHRONOUS>true</IS-SYNCHRONOUS>
              <CALL-TYPE>REGULAR</CALL-TYPE>
              <EXECUTION-CONTEXT>UNSPECIFIED</EXECUTION-CONTEXT>
              <SW-SERVICE-IMPL-POLICY>STANDARD</SW-SERVICE-IMPL-POLICY>
              <BSW-ENTRY-KIND>CONCRETE</BSW-ENTRY-KIND>
            </BSW-MODULE-ENTRY>  
            <BSW-MODULE-ENTRY UUID="a450d15d-6cd3-47df-be23-25ae4438202b">
              <SHORT-NAME>Cdd_Pwm_SetTimeBaseCounter</SHORT-NAME>
              <SERVICE-ID>228</SERVICE-ID>
              <IS-REENTRANT>false</IS-REENTRANT>
              <IS-SYNCHRONOUS>true</IS-SYNCHRONOUS>
              <CALL-TYPE>REGULAR</CALL-TYPE>
              <EXECUTION-CONTEXT>UNSPECIFIED</EXECUTION-CONTEXT>
              <SW-SERVICE-IMPL-POLICY>STANDARD</SW-SERVICE-IMPL-POLICY>
              <BSW-ENTRY-KIND>CONCRETE</BSW-ENTRY-KIND>
            </BSW-MODULE-ENTRY>  
            <BSW-MODULE-ENTRY UUID="678f4f42-e8d6-40f7-a546-54b96c40bf93">
              <SHORT-NAME>Cdd_Pwm_SetCountModeAfterSync</SHORT-NAME>
              <SERVICE-ID>229</SERVICE-ID>
              <IS-REENTRANT>false</IS-REENTRANT>
              <IS-SYNCHRONOUS>true</IS-SYNCHRONOUS>
              <CALL-TYPE>REGULAR</CALL-TYPE>
              <EXECUTION-CONTEXT>UNSPECIFIED</EXECUTION-CONTEXT>
              <SW-SERVICE-IMPL-POLICY>STANDARD</SW-SERVICE-IMPL-POLICY>
              <BSW-ENTRY-KIND>CONCRETE</BSW-ENTRY-KIND>
            </BSW-MODULE-ENTRY>  
            <BSW-MODULE-ENTRY UUID="95dcfe33-c1e6-47ce-9672-a0e5a8111758">
              <SHORT-NAME>Cdd_Pwm_SetClockPrescaler</SHORT-NAME>
              <SERVICE-ID>5</SERVICE-ID>
              <IS-REENTRANT>false</IS-REENTRANT>
              <IS-SYNCHRONOUS>true</IS-SYNCHRONOUS>
              <CALL-TYPE>REGULAR</CALL-TYPE>
              <EXECUTION-CONTEXT>UNSPECIFIED</EXECUTION-CONTEXT>
              <SW-SERVICE-IMPL-POLICY>STANDARD</SW-SERVICE-IMPL-POLICY>
              <BSW-ENTRY-KIND>CONCRETE</BSW-ENTRY-KIND>
            </BSW-MODULE-ENTRY>  
            <BSW-MODULE-ENTRY UUID="ecd9824d-fcfa-4c0a-8589-b4cfe594389c">
              <SHORT-NAME>Cdd_Pwm_ForceSyncPulse</SHORT-NAME>
              <SERVICE-ID>6</SERVICE-ID>
              <IS-REENTRANT>false</IS-REENTRANT>
              <IS-SYNCHRONOUS>true</IS-SYNCHRONOUS>
              <CALL-TYPE>REGULAR</CALL-TYPE>
              <EXECUTION-CONTEXT>UNSPECIFIED</EXECUTION-CONTEXT>
              <SW-SERVICE-IMPL-POLICY>STANDARD</SW-SERVICE-IMPL-POLICY>
              <BSW-ENTRY-KIND>CONCRETE</BSW-ENTRY-KIND>
            </BSW-MODULE-ENTRY>  
            <BSW-MODULE-ENTRY UUID="85f68125-85ff-44c6-b411-22d101b37ecf">
              <SHORT-NAME>Cdd_Pwm_SetSyncInPulseSource</SHORT-NAME>
              <SERVICE-ID>225</SERVICE-ID>
              <IS-REENTRANT>false</IS-REENTRANT>
              <IS-SYNCHRONOUS>true</IS-SYNCHRONOUS>
              <CALL-TYPE>REGULAR</CALL-TYPE>
              <EXECUTION-CONTEXT>UNSPECIFIED</EXECUTION-CONTEXT>
              <SW-SERVICE-IMPL-POLICY>STANDARD</SW-SERVICE-IMPL-POLICY>
              <BSW-ENTRY-KIND>CONCRETE</BSW-ENTRY-KIND>
            </BSW-MODULE-ENTRY>  
            <BSW-MODULE-ENTRY UUID="25dc4244-42ba-4d2f-b731-42b6fae6ef59">
              <SHORT-NAME>Cdd_Pwm_ConfigureSyncOutPulseSource</SHORT-NAME>
              <SERVICE-ID>8</SERVICE-ID>
              <IS-REENTRANT>false</IS-REENTRANT>
              <IS-SYNCHRONOUS>true</IS-SYNCHRONOUS>
              <CALL-TYPE>REGULAR</CALL-TYPE>
              <EXECUTION-CONTEXT>UNSPECIFIED</EXECUTION-CONTEXT>
              <SW-SERVICE-IMPL-POLICY>STANDARD</SW-SERVICE-IMPL-POLICY>
              <BSW-ENTRY-KIND>CONCRETE</BSW-ENTRY-KIND>
            </BSW-MODULE-ENTRY>  
            <BSW-MODULE-ENTRY UUID="bcd819e8-6447-4592-9fe1-c1079d4fbacd">
              <SHORT-NAME>Cdd_Pwm_SetOneShotSyncOutTrigger</SHORT-NAME>
              <SERVICE-ID>9</SERVICE-ID>
              <IS-REENTRANT>false</IS-REENTRANT>
              <IS-SYNCHRONOUS>true</IS-SYNCHRONOUS>
              <CALL-TYPE>REGULAR</CALL-TYPE>
              <EXECUTION-CONTEXT>UNSPECIFIED</EXECUTION-CONTEXT>
              <SW-SERVICE-IMPL-POLICY>STANDARD</SW-SERVICE-IMPL-POLICY>
              <BSW-ENTRY-KIND>CONCRETE</BSW-ENTRY-KIND>
            </BSW-MODULE-ENTRY>  
            <BSW-MODULE-ENTRY UUID="71903e16-5c22-499a-a6b9-b83974253f26">
              <SHORT-NAME>Cdd_Pwm_SetPeriodLoadMode</SHORT-NAME>
              <SERVICE-ID>79</SERVICE-ID>
              <IS-REENTRANT>false</IS-REENTRANT>
              <IS-SYNCHRONOUS>true</IS-SYNCHRONOUS>
              <CALL-TYPE>REGULAR</CALL-TYPE>
              <EXECUTION-CONTEXT>UNSPECIFIED</EXECUTION-CONTEXT>
              <SW-SERVICE-IMPL-POLICY>STANDARD</SW-SERVICE-IMPL-POLICY>
              <BSW-ENTRY-KIND>CONCRETE</BSW-ENTRY-KIND>
            </BSW-MODULE-ENTRY>  
            <BSW-MODULE-ENTRY UUID="137746f4-5cb1-4a60-8c97-3cfea48d0b86">
              <SHORT-NAME>Cdd_Pwm_ConfigurePhaseShiftLoad</SHORT-NAME>
              <SERVICE-ID>10</SERVICE-ID>
              <IS-REENTRANT>false</IS-REENTRANT>
              <IS-SYNCHRONOUS>true</IS-SYNCHRONOUS>
              <CALL-TYPE>REGULAR</CALL-TYPE>
              <EXECUTION-CONTEXT>UNSPECIFIED</EXECUTION-CONTEXT>
              <SW-SERVICE-IMPL-POLICY>STANDARD</SW-SERVICE-IMPL-POLICY>
              <BSW-ENTRY-KIND>CONCRETE</BSW-ENTRY-KIND>
            </BSW-MODULE-ENTRY>  
            <BSW-MODULE-ENTRY UUID="424ce76f-5564-46e9-ac5b-a3d07f835406">
              <SHORT-NAME>Cdd_Pwm_SetTimeBaseCounterMode</SHORT-NAME>
              <SERVICE-ID>11</SERVICE-ID>
              <IS-REENTRANT>false</IS-REENTRANT>
              <IS-SYNCHRONOUS>true</IS-SYNCHRONOUS>
              <CALL-TYPE>REGULAR</CALL-TYPE>
              <EXECUTION-CONTEXT>UNSPECIFIED</EXECUTION-CONTEXT>
              <SW-SERVICE-IMPL-POLICY>STANDARD</SW-SERVICE-IMPL-POLICY>
              <BSW-ENTRY-KIND>CONCRETE</BSW-ENTRY-KIND>
            </BSW-MODULE-ENTRY>  
            <BSW-MODULE-ENTRY UUID="cfd1d6ef-79c3-48d6-be12-9e42ac000de4">
              <SHORT-NAME>Cdd_Pwm_SelectPeriodLoadEvent</SHORT-NAME>
              <SERVICE-ID>12</SERVICE-ID>
              <IS-REENTRANT>false</IS-REENTRANT>
              <IS-SYNCHRONOUS>true</IS-SYNCHRONOUS>
              <CALL-TYPE>REGULAR</CALL-TYPE>
              <EXECUTION-CONTEXT>UNSPECIFIED</EXECUTION-CONTEXT>
              <SW-SERVICE-IMPL-POLICY>STANDARD</SW-SERVICE-IMPL-POLICY>
              <BSW-ENTRY-KIND>CONCRETE</BSW-ENTRY-KIND>
            </BSW-MODULE-ENTRY>  
            <BSW-MODULE-ENTRY UUID="0dd4d903-46fb-4f44-a186-b5f4954b19bf">
              <SHORT-NAME>Cdd_Pwm_ConfigureOneShotSync</SHORT-NAME>
              <SERVICE-ID>13</SERVICE-ID>
              <IS-REENTRANT>false</IS-REENTRANT>
              <IS-SYNCHRONOUS>true</IS-SYNCHRONOUS>
              <CALL-TYPE>REGULAR</CALL-TYPE>
              <EXECUTION-CONTEXT>UNSPECIFIED</EXECUTION-CONTEXT>
              <SW-SERVICE-IMPL-POLICY>STANDARD</SW-SERVICE-IMPL-POLICY>
              <BSW-ENTRY-KIND>CONCRETE</BSW-ENTRY-KIND>
            </BSW-MODULE-ENTRY>  
            <BSW-MODULE-ENTRY UUID="666305e7-c1ad-41db-9252-435cc0d205e0">
              <SHORT-NAME>Cdd_Pwm_StartOneShotSync</SHORT-NAME>
              <SERVICE-ID>14</SERVICE-ID>
              <IS-REENTRANT>false</IS-REENTRANT>
              <IS-SYNCHRONOUS>true</IS-SYNCHRONOUS>
              <CALL-TYPE>REGULAR</CALL-TYPE>
              <EXECUTION-CONTEXT>UNSPECIFIED</EXECUTION-CONTEXT>
              <SW-SERVICE-IMPL-POLICY>STANDARD</SW-SERVICE-IMPL-POLICY>
              <BSW-ENTRY-KIND>CONCRETE</BSW-ENTRY-KIND>
            </BSW-MODULE-ENTRY>  
            <BSW-MODULE-ENTRY UUID="105ff7cf-72dd-49db-b519-53c26c7d2e91">
              <SHORT-NAME>Cdd_Pwm_GetTimeBaseCounterValue</SHORT-NAME>
              <SERVICE-ID>15</SERVICE-ID>
              <IS-REENTRANT>false</IS-REENTRANT>
              <IS-SYNCHRONOUS>true</IS-SYNCHRONOUS>
              <CALL-TYPE>REGULAR</CALL-TYPE>
              <EXECUTION-CONTEXT>UNSPECIFIED</EXECUTION-CONTEXT>
              <SW-SERVICE-IMPL-POLICY>STANDARD</SW-SERVICE-IMPL-POLICY>
              <BSW-ENTRY-KIND>CONCRETE</BSW-ENTRY-KIND>
            </BSW-MODULE-ENTRY>  
            <BSW-MODULE-ENTRY UUID="d14b4d7b-919d-40ed-80f4-3190e7e6ffa4">
              <SHORT-NAME>Cdd_Pwm_GetTimeBaseCounterOverflowStatus</SHORT-NAME>
              <SERVICE-ID>16</SERVICE-ID>
              <IS-REENTRANT>false</IS-REENTRANT>
              <IS-SYNCHRONOUS>true</IS-SYNCHRONOUS>
              <CALL-TYPE>REGULAR</CALL-TYPE>
              <EXECUTION-CONTEXT>UNSPECIFIED</EXECUTION-CONTEXT>
              <SW-SERVICE-IMPL-POLICY>STANDARD</SW-SERVICE-IMPL-POLICY>
              <BSW-ENTRY-KIND>CONCRETE</BSW-ENTRY-KIND>
            </BSW-MODULE-ENTRY>  
            <BSW-MODULE-ENTRY UUID="a4d8fd82-a85c-4349-b4f2-b3be48a82608">
              <SHORT-NAME>Cdd_Pwm_ClearTimeBaseCounterOverflowEvent</SHORT-NAME>
              <SERVICE-ID>17</SERVICE-ID>
              <IS-REENTRANT>false</IS-REENTRANT>
              <IS-SYNCHRONOUS>true</IS-SYNCHRONOUS>
              <CALL-TYPE>REGULAR</CALL-TYPE>
              <EXECUTION-CONTEXT>UNSPECIFIED</EXECUTION-CONTEXT>
              <SW-SERVICE-IMPL-POLICY>STANDARD</SW-SERVICE-IMPL-POLICY>
              <BSW-ENTRY-KIND>CONCRETE</BSW-ENTRY-KIND>
            </BSW-MODULE-ENTRY>  
            <BSW-MODULE-ENTRY UUID="2ccfdfc0-bf42-4f99-83b2-81b6b7a7cb92">
              <SHORT-NAME>Cdd_Pwm_GetSyncStatus</SHORT-NAME>
              <SERVICE-ID>18</SERVICE-ID>
              <IS-REENTRANT>false</IS-REENTRANT>
              <IS-SYNCHRONOUS>true</IS-SYNCHRONOUS>
              <CALL-TYPE>REGULAR</CALL-TYPE>
              <EXECUTION-CONTEXT>UNSPECIFIED</EXECUTION-CONTEXT>
              <SW-SERVICE-IMPL-POLICY>STANDARD</SW-SERVICE-IMPL-POLICY>
              <BSW-ENTRY-KIND>CONCRETE</BSW-ENTRY-KIND>
            </BSW-MODULE-ENTRY>  
            <BSW-MODULE-ENTRY UUID="a0960125-ac3b-427e-a9d2-d832cbf61347">
              <SHORT-NAME>Cdd_Pwm_ClearSyncEvent</SHORT-NAME>
              <SERVICE-ID>19</SERVICE-ID>
              <IS-REENTRANT>false</IS-REENTRANT>
              <IS-SYNCHRONOUS>true</IS-SYNCHRONOUS>
              <CALL-TYPE>REGULAR</CALL-TYPE>
              <EXECUTION-CONTEXT>UNSPECIFIED</EXECUTION-CONTEXT>
              <SW-SERVICE-IMPL-POLICY>STANDARD</SW-SERVICE-IMPL-POLICY>
              <BSW-ENTRY-KIND>CONCRETE</BSW-ENTRY-KIND>
            </BSW-MODULE-ENTRY>  
            <BSW-MODULE-ENTRY UUID="dfd6cdca-c17c-4de2-96a5-b3b30db423e9">
              <SHORT-NAME>Cdd_Pwm_GetTimeBaseCounterDirection</SHORT-NAME>
              <SERVICE-ID>20</SERVICE-ID>
              <IS-REENTRANT>false</IS-REENTRANT>
              <IS-SYNCHRONOUS>true</IS-SYNCHRONOUS>
              <CALL-TYPE>REGULAR</CALL-TYPE>
              <EXECUTION-CONTEXT>UNSPECIFIED</EXECUTION-CONTEXT>
              <SW-SERVICE-IMPL-POLICY>STANDARD</SW-SERVICE-IMPL-POLICY>
              <BSW-ENTRY-KIND>CONCRETE</BSW-ENTRY-KIND>
            </BSW-MODULE-ENTRY>  
            <BSW-MODULE-ENTRY UUID="30ca7cfc-2cc6-47a0-986f-6d57bb1c5bb0">
              <SHORT-NAME>Cdd_Pwm_SetPhaseShift</SHORT-NAME>
              <SERVICE-ID>21</SERVICE-ID>
              <IS-REENTRANT>false</IS-REENTRANT>
              <IS-SYNCHRONOUS>true</IS-SYNCHRONOUS>
              <CALL-TYPE>REGULAR</CALL-TYPE>
              <EXECUTION-CONTEXT>UNSPECIFIED</EXECUTION-CONTEXT>
              <SW-SERVICE-IMPL-POLICY>STANDARD</SW-SERVICE-IMPL-POLICY>
              <BSW-ENTRY-KIND>CONCRETE</BSW-ENTRY-KIND>
            </BSW-MODULE-ENTRY>  
            <BSW-MODULE-ENTRY UUID="04d6e09c-ac9c-44f2-8cd3-1ceead9b85a2">
              <SHORT-NAME>Cdd_Pwm_SetTimeBasePeriod</SHORT-NAME>
              <SERVICE-ID>22</SERVICE-ID>
              <IS-REENTRANT>false</IS-REENTRANT>
              <IS-SYNCHRONOUS>true</IS-SYNCHRONOUS>
              <CALL-TYPE>REGULAR</CALL-TYPE>
              <EXECUTION-CONTEXT>UNSPECIFIED</EXECUTION-CONTEXT>
              <SW-SERVICE-IMPL-POLICY>STANDARD</SW-SERVICE-IMPL-POLICY>
              <BSW-ENTRY-KIND>CONCRETE</BSW-ENTRY-KIND>
            </BSW-MODULE-ENTRY>  
            <BSW-MODULE-ENTRY UUID="ebfeadcf-b9ba-47d7-a935-e24e21a3f85a">
              <SHORT-NAME>Cdd_Pwm_GetTimeBasePeriod</SHORT-NAME>
              <SERVICE-ID>23</SERVICE-ID>
              <IS-REENTRANT>false</IS-REENTRANT>
              <IS-SYNCHRONOUS>true</IS-SYNCHRONOUS>
              <CALL-TYPE>REGULAR</CALL-TYPE>
              <EXECUTION-CONTEXT>UNSPECIFIED</EXECUTION-CONTEXT>
              <SW-SERVICE-IMPL-POLICY>STANDARD</SW-SERVICE-IMPL-POLICY>
              <BSW-ENTRY-KIND>CONCRETE</BSW-ENTRY-KIND>
            </BSW-MODULE-ENTRY>
            <BSW-MODULE-ENTRY UUID="7393f059-928b-4713-b5d1-713743057cca">
              <SHORT-NAME>Cdd_Pwm_SetCounterCompareShadowLoadMode</SHORT-NAME>
              <SERVICE-ID>25</SERVICE-ID>
              <IS-REENTRANT>false</IS-REENTRANT>
              <IS-SYNCHRONOUS>true</IS-SYNCHRONOUS>
              <CALL-TYPE>REGULAR</CALL-TYPE>
              <EXECUTION-CONTEXT>UNSPECIFIED</EXECUTION-CONTEXT>
              <SW-SERVICE-IMPL-POLICY>STANDARD</SW-SERVICE-IMPL-POLICY>
              <BSW-ENTRY-KIND>CONCRETE</BSW-ENTRY-KIND>
            </BSW-MODULE-ENTRY>  
            <BSW-MODULE-ENTRY UUID="547686fb-1f62-4939-99f8-a0c48c375eb8">
              <SHORT-NAME>Cdd_Pwm_DisableCounterCompareShadowLoadMode</SHORT-NAME>
              <SERVICE-ID>26</SERVICE-ID>
              <IS-REENTRANT>false</IS-REENTRANT>
              <IS-SYNCHRONOUS>true</IS-SYNCHRONOUS>
              <CALL-TYPE>REGULAR</CALL-TYPE>
              <EXECUTION-CONTEXT>UNSPECIFIED</EXECUTION-CONTEXT>
              <SW-SERVICE-IMPL-POLICY>STANDARD</SW-SERVICE-IMPL-POLICY>
              <BSW-ENTRY-KIND>CONCRETE</BSW-ENTRY-KIND>
            </BSW-MODULE-ENTRY>  
            <BSW-MODULE-ENTRY UUID="4c8c65f1-9654-4eeb-a88c-ebf01408b2c5">
              <SHORT-NAME>Cdd_Pwm_SetCounterCompareValue</SHORT-NAME>
              <SERVICE-ID>27</SERVICE-ID>
              <IS-REENTRANT>false</IS-REENTRANT>
              <IS-SYNCHRONOUS>true</IS-SYNCHRONOUS>
              <CALL-TYPE>REGULAR</CALL-TYPE>
              <EXECUTION-CONTEXT>UNSPECIFIED</EXECUTION-CONTEXT>
              <SW-SERVICE-IMPL-POLICY>STANDARD</SW-SERVICE-IMPL-POLICY>
              <BSW-ENTRY-KIND>CONCRETE</BSW-ENTRY-KIND>
            </BSW-MODULE-ENTRY>  
            <BSW-MODULE-ENTRY UUID="189921cb-4dac-4113-ad77-55092ec8270e">
              <SHORT-NAME>Cdd_Pwm_GetCounterCompareValue</SHORT-NAME>
              <SERVICE-ID>28</SERVICE-ID>
              <IS-REENTRANT>false</IS-REENTRANT>
              <IS-SYNCHRONOUS>true</IS-SYNCHRONOUS>
              <CALL-TYPE>REGULAR</CALL-TYPE>
              <EXECUTION-CONTEXT>UNSPECIFIED</EXECUTION-CONTEXT>
              <SW-SERVICE-IMPL-POLICY>STANDARD</SW-SERVICE-IMPL-POLICY>
              <BSW-ENTRY-KIND>CONCRETE</BSW-ENTRY-KIND>
            </BSW-MODULE-ENTRY>  
            <BSW-MODULE-ENTRY UUID="8c9e304d-d107-4998-86de-89b63c923739">
              <SHORT-NAME>Cdd_Pwm_GetCounterCompareShadowStatus</SHORT-NAME>
              <SERVICE-ID>29</SERVICE-ID>
              <IS-REENTRANT>false</IS-REENTRANT>
              <IS-SYNCHRONOUS>true</IS-SYNCHRONOUS>
              <CALL-TYPE>REGULAR</CALL-TYPE>
              <EXECUTION-CONTEXT>UNSPECIFIED</EXECUTION-CONTEXT>
              <SW-SERVICE-IMPL-POLICY>STANDARD</SW-SERVICE-IMPL-POLICY>
              <BSW-ENTRY-KIND>CONCRETE</BSW-ENTRY-KIND>
            </BSW-MODULE-ENTRY>  
            <BSW-MODULE-ENTRY UUID="ee2ffcda-b223-47fb-9872-4625a69ca310">
              <SHORT-NAME>Cdd_Pwm_ConfigureLinkDutyHR</SHORT-NAME>
              <SERVICE-ID>30</SERVICE-ID>
              <IS-REENTRANT>false</IS-REENTRANT>
              <IS-SYNCHRONOUS>true</IS-SYNCHRONOUS>
              <CALL-TYPE>REGULAR</CALL-TYPE>
              <EXECUTION-CONTEXT>UNSPECIFIED</EXECUTION-CONTEXT>
              <SW-SERVICE-IMPL-POLICY>STANDARD</SW-SERVICE-IMPL-POLICY>
              <BSW-ENTRY-KIND>CONCRETE</BSW-ENTRY-KIND>
            </BSW-MODULE-ENTRY>  
            <BSW-MODULE-ENTRY UUID="7475becf-c512-419b-99a5-c5d213945b02">
              <SHORT-NAME>Cdd_Pwm_SetActionQualifierShadowLoadMode</SHORT-NAME>
              <SERVICE-ID>31</SERVICE-ID>
              <IS-REENTRANT>false</IS-REENTRANT>
              <IS-SYNCHRONOUS>true</IS-SYNCHRONOUS>
              <CALL-TYPE>REGULAR</CALL-TYPE>
              <EXECUTION-CONTEXT>UNSPECIFIED</EXECUTION-CONTEXT>
              <SW-SERVICE-IMPL-POLICY>STANDARD</SW-SERVICE-IMPL-POLICY>
              <BSW-ENTRY-KIND>CONCRETE</BSW-ENTRY-KIND>
            </BSW-MODULE-ENTRY>  
            <BSW-MODULE-ENTRY UUID="43480cdb-5216-43e4-988a-4d32b12e464a">
              <SHORT-NAME>Cdd_Pwm_DisableActionQualifierShadowLoadMode</SHORT-NAME>
              <SERVICE-ID>32</SERVICE-ID>
              <IS-REENTRANT>false</IS-REENTRANT>
              <IS-SYNCHRONOUS>true</IS-SYNCHRONOUS>
              <CALL-TYPE>REGULAR</CALL-TYPE>
              <EXECUTION-CONTEXT>UNSPECIFIED</EXECUTION-CONTEXT>
              <SW-SERVICE-IMPL-POLICY>STANDARD</SW-SERVICE-IMPL-POLICY>
              <BSW-ENTRY-KIND>CONCRETE</BSW-ENTRY-KIND>
            </BSW-MODULE-ENTRY>  
            <BSW-MODULE-ENTRY UUID="d420547a-7b16-40e1-8ec6-1ac7322a19d4">
              <SHORT-NAME>Cdd_Pwm_SetActionQualifierT1TriggerSource</SHORT-NAME>
              <SERVICE-ID>33</SERVICE-ID>
              <IS-REENTRANT>false</IS-REENTRANT>
              <IS-SYNCHRONOUS>true</IS-SYNCHRONOUS>
              <CALL-TYPE>REGULAR</CALL-TYPE>
              <EXECUTION-CONTEXT>UNSPECIFIED</EXECUTION-CONTEXT>
              <SW-SERVICE-IMPL-POLICY>STANDARD</SW-SERVICE-IMPL-POLICY>
              <BSW-ENTRY-KIND>CONCRETE</BSW-ENTRY-KIND>
            </BSW-MODULE-ENTRY>  
            <BSW-MODULE-ENTRY UUID="22e72bd4-1213-47d3-8849-a2b50f16acf1">
              <SHORT-NAME>Cdd_Pwm_SetActionQualifierT2TriggerSource</SHORT-NAME>
              <SERVICE-ID>34</SERVICE-ID>
              <IS-REENTRANT>false</IS-REENTRANT>
              <IS-SYNCHRONOUS>true</IS-SYNCHRONOUS>
              <CALL-TYPE>REGULAR</CALL-TYPE>
              <EXECUTION-CONTEXT>UNSPECIFIED</EXECUTION-CONTEXT>
              <SW-SERVICE-IMPL-POLICY>STANDARD</SW-SERVICE-IMPL-POLICY>
              <BSW-ENTRY-KIND>CONCRETE</BSW-ENTRY-KIND>
            </BSW-MODULE-ENTRY>  
            <BSW-MODULE-ENTRY UUID="f8e42205-f95a-4e45-b534-208f32f94f4b">
              <SHORT-NAME>Cdd_Pwm_SetActionQualifierAction</SHORT-NAME>
              <SERVICE-ID>35</SERVICE-ID>
              <IS-REENTRANT>false</IS-REENTRANT>
              <IS-SYNCHRONOUS>true</IS-SYNCHRONOUS>
              <CALL-TYPE>REGULAR</CALL-TYPE>
              <EXECUTION-CONTEXT>UNSPECIFIED</EXECUTION-CONTEXT>
              <SW-SERVICE-IMPL-POLICY>STANDARD</SW-SERVICE-IMPL-POLICY>
              <BSW-ENTRY-KIND>CONCRETE</BSW-ENTRY-KIND>
            </BSW-MODULE-ENTRY>  
            <BSW-MODULE-ENTRY UUID="7c70e0ef-9149-4da9-a411-a421c1c45dcb">
              <SHORT-NAME>Cdd_Pwm_SetActionQualifierActionComplete</SHORT-NAME>
              <SERVICE-ID>36</SERVICE-ID>
              <IS-REENTRANT>false</IS-REENTRANT>
              <IS-SYNCHRONOUS>true</IS-SYNCHRONOUS>
              <CALL-TYPE>REGULAR</CALL-TYPE>
              <EXECUTION-CONTEXT>UNSPECIFIED</EXECUTION-CONTEXT>
              <SW-SERVICE-IMPL-POLICY>STANDARD</SW-SERVICE-IMPL-POLICY>
              <BSW-ENTRY-KIND>CONCRETE</BSW-ENTRY-KIND>
            </BSW-MODULE-ENTRY>
            <BSW-MODULE-ENTRY UUID="b662600f-0501-4965-808f-0e6ca6185506">
              <SHORT-NAME>Cdd_Pwm_SetAdditionalActionQualifierActionComplete</SHORT-NAME>
              <SERVICE-ID>37</SERVICE-ID>
              <IS-REENTRANT>false</IS-REENTRANT>
              <IS-SYNCHRONOUS>true</IS-SYNCHRONOUS>
              <CALL-TYPE>REGULAR</CALL-TYPE>
              <EXECUTION-CONTEXT>UNSPECIFIED</EXECUTION-CONTEXT>
              <SW-SERVICE-IMPL-POLICY>STANDARD</SW-SERVICE-IMPL-POLICY>
              <BSW-ENTRY-KIND>CONCRETE</BSW-ENTRY-KIND>
            </BSW-MODULE-ENTRY>  
            <BSW-MODULE-ENTRY UUID="057c08cb-3cde-4c20-9bfd-3d0a98baa226">
              <SHORT-NAME>Cdd_Pwm_SetActionQualifierContSwForceShadowMode</SHORT-NAME>
              <SERVICE-ID>38</SERVICE-ID>
              <IS-REENTRANT>false</IS-REENTRANT>
              <IS-SYNCHRONOUS>true</IS-SYNCHRONOUS>
              <CALL-TYPE>REGULAR</CALL-TYPE>
              <EXECUTION-CONTEXT>UNSPECIFIED</EXECUTION-CONTEXT>
              <SW-SERVICE-IMPL-POLICY>STANDARD</SW-SERVICE-IMPL-POLICY>
              <BSW-ENTRY-KIND>CONCRETE</BSW-ENTRY-KIND>
            </BSW-MODULE-ENTRY>  
            <BSW-MODULE-ENTRY UUID="6a535992-5683-4c91-b682-e355e9461d98">
              <SHORT-NAME>Cdd_Pwm_SetActionQualifierContSwForceAction</SHORT-NAME>
              <SERVICE-ID>39</SERVICE-ID>
              <IS-REENTRANT>false</IS-REENTRANT>
              <IS-SYNCHRONOUS>true</IS-SYNCHRONOUS>
              <CALL-TYPE>REGULAR</CALL-TYPE>
              <EXECUTION-CONTEXT>UNSPECIFIED</EXECUTION-CONTEXT>
              <SW-SERVICE-IMPL-POLICY>STANDARD</SW-SERVICE-IMPL-POLICY>
              <BSW-ENTRY-KIND>CONCRETE</BSW-ENTRY-KIND>
            </BSW-MODULE-ENTRY>  
            <BSW-MODULE-ENTRY UUID="1900f00a-fd77-4882-9b0b-18098c6ae4c4">
              <SHORT-NAME>Cdd_Pwm_SetActionQualifierSwAction</SHORT-NAME>
              <SERVICE-ID>40</SERVICE-ID>
              <IS-REENTRANT>false</IS-REENTRANT>
              <IS-SYNCHRONOUS>true</IS-SYNCHRONOUS>
              <CALL-TYPE>REGULAR</CALL-TYPE>
              <EXECUTION-CONTEXT>UNSPECIFIED</EXECUTION-CONTEXT>
              <SW-SERVICE-IMPL-POLICY>STANDARD</SW-SERVICE-IMPL-POLICY>
              <BSW-ENTRY-KIND>CONCRETE</BSW-ENTRY-KIND>
            </BSW-MODULE-ENTRY>  
            <BSW-MODULE-ENTRY UUID="56852f90-3a2b-460c-a287-ef98c4b8e3a2">
              <SHORT-NAME>Cdd_Pwm_ForceActionQualifierSwAction</SHORT-NAME>
              <SERVICE-ID>41</SERVICE-ID>
              <IS-REENTRANT>false</IS-REENTRANT>
              <IS-SYNCHRONOUS>true</IS-SYNCHRONOUS>
              <CALL-TYPE>REGULAR</CALL-TYPE>
              <EXECUTION-CONTEXT>UNSPECIFIED</EXECUTION-CONTEXT>
              <SW-SERVICE-IMPL-POLICY>STANDARD</SW-SERVICE-IMPL-POLICY>
              <BSW-ENTRY-KIND>CONCRETE</BSW-ENTRY-KIND>
            </BSW-MODULE-ENTRY>  
            <BSW-MODULE-ENTRY UUID="6d94eca7-63fe-492d-a0c3-21dd17e9b1c0">
              <SHORT-NAME>Cdd_Pwm_SetDeadBandOutputSwapMode</SHORT-NAME>
              <SERVICE-ID>42</SERVICE-ID>
              <IS-REENTRANT>false</IS-REENTRANT>
              <IS-SYNCHRONOUS>true</IS-SYNCHRONOUS>
              <CALL-TYPE>REGULAR</CALL-TYPE>
              <EXECUTION-CONTEXT>UNSPECIFIED</EXECUTION-CONTEXT>
              <SW-SERVICE-IMPL-POLICY>STANDARD</SW-SERVICE-IMPL-POLICY>
              <BSW-ENTRY-KIND>CONCRETE</BSW-ENTRY-KIND>
            </BSW-MODULE-ENTRY>  
            <BSW-MODULE-ENTRY UUID="309743db-13f8-4bac-9673-0c3f60ecff62">
              <SHORT-NAME>Cdd_Pwm_SetDeadBandDelayMode</SHORT-NAME>
              <SERVICE-ID>43</SERVICE-ID>
              <IS-REENTRANT>false</IS-REENTRANT>
              <IS-SYNCHRONOUS>true</IS-SYNCHRONOUS>
              <CALL-TYPE>REGULAR</CALL-TYPE>
              <EXECUTION-CONTEXT>UNSPECIFIED</EXECUTION-CONTEXT>
              <SW-SERVICE-IMPL-POLICY>STANDARD</SW-SERVICE-IMPL-POLICY>
              <BSW-ENTRY-KIND>CONCRETE</BSW-ENTRY-KIND>
            </BSW-MODULE-ENTRY>  
            <BSW-MODULE-ENTRY UUID="6e653073-b939-4fc1-a948-689079b66b3e">
              <SHORT-NAME>Cdd_Pwm_SetDeadBandDelayPolarity</SHORT-NAME>
              <SERVICE-ID>44</SERVICE-ID>
              <IS-REENTRANT>false</IS-REENTRANT>
              <IS-SYNCHRONOUS>true</IS-SYNCHRONOUS>
              <CALL-TYPE>REGULAR</CALL-TYPE>
              <EXECUTION-CONTEXT>UNSPECIFIED</EXECUTION-CONTEXT>
              <SW-SERVICE-IMPL-POLICY>STANDARD</SW-SERVICE-IMPL-POLICY>
              <BSW-ENTRY-KIND>CONCRETE</BSW-ENTRY-KIND>
            </BSW-MODULE-ENTRY>  
            <BSW-MODULE-ENTRY UUID="882983d7-b07e-4995-b5f4-c345c17de949">
              <SHORT-NAME>Cdd_Pwm_SetRisingEdgeDeadBandDelayInput</SHORT-NAME>
              <SERVICE-ID>45</SERVICE-ID>
              <IS-REENTRANT>false</IS-REENTRANT>
              <IS-SYNCHRONOUS>true</IS-SYNCHRONOUS>
              <CALL-TYPE>REGULAR</CALL-TYPE>
              <EXECUTION-CONTEXT>UNSPECIFIED</EXECUTION-CONTEXT>
              <SW-SERVICE-IMPL-POLICY>STANDARD</SW-SERVICE-IMPL-POLICY>
              <BSW-ENTRY-KIND>CONCRETE</BSW-ENTRY-KIND>
            </BSW-MODULE-ENTRY>  
            <BSW-MODULE-ENTRY UUID="94c4802f-88f1-4668-a823-1721935b62dd">
              <SHORT-NAME>Cdd_Pwm_SetFallingEdgeDeadBandDelayInput</SHORT-NAME>
              <SERVICE-ID>46</SERVICE-ID>
              <IS-REENTRANT>false</IS-REENTRANT>
              <IS-SYNCHRONOUS>true</IS-SYNCHRONOUS>
              <CALL-TYPE>REGULAR</CALL-TYPE>
              <EXECUTION-CONTEXT>UNSPECIFIED</EXECUTION-CONTEXT>
              <SW-SERVICE-IMPL-POLICY>STANDARD</SW-SERVICE-IMPL-POLICY>
              <BSW-ENTRY-KIND>CONCRETE</BSW-ENTRY-KIND>
            </BSW-MODULE-ENTRY>  
            <BSW-MODULE-ENTRY UUID="7d815183-f9c5-4ed8-9787-7da4a35f1e57">
              <SHORT-NAME>Cdd_Pwm_SetDeadBandControlShadowLoadMode</SHORT-NAME>
              <SERVICE-ID>47</SERVICE-ID>
              <IS-REENTRANT>false</IS-REENTRANT>
              <IS-SYNCHRONOUS>true</IS-SYNCHRONOUS>
              <CALL-TYPE>REGULAR</CALL-TYPE>
              <EXECUTION-CONTEXT>UNSPECIFIED</EXECUTION-CONTEXT>
              <SW-SERVICE-IMPL-POLICY>STANDARD</SW-SERVICE-IMPL-POLICY>
              <BSW-ENTRY-KIND>CONCRETE</BSW-ENTRY-KIND>
            </BSW-MODULE-ENTRY> 
            <BSW-MODULE-ENTRY UUID="7f2770f5-2aba-4cc3-ad1f-4cdac18baadd">
              <SHORT-NAME>Cdd_Pwm_SetRisingEdgeDelayCountShadowLoadMode</SHORT-NAME>
              <SERVICE-ID>48</SERVICE-ID>
              <IS-REENTRANT>false</IS-REENTRANT>
              <IS-SYNCHRONOUS>true</IS-SYNCHRONOUS>
              <CALL-TYPE>REGULAR</CALL-TYPE>
              <EXECUTION-CONTEXT>UNSPECIFIED</EXECUTION-CONTEXT>
              <SW-SERVICE-IMPL-POLICY>STANDARD</SW-SERVICE-IMPL-POLICY>
              <BSW-ENTRY-KIND>CONCRETE</BSW-ENTRY-KIND>
            </BSW-MODULE-ENTRY>  
            <BSW-MODULE-ENTRY UUID="06cff2ec-32b5-4513-90a9-77d90f4f5445">
              <SHORT-NAME>Cdd_Pwm_DisableRisingEdgeDelayCountShadowLoadMode</SHORT-NAME>
              <SERVICE-ID>49</SERVICE-ID>
              <IS-REENTRANT>false</IS-REENTRANT>
              <IS-SYNCHRONOUS>true</IS-SYNCHRONOUS>
              <CALL-TYPE>REGULAR</CALL-TYPE>
              <EXECUTION-CONTEXT>UNSPECIFIED</EXECUTION-CONTEXT>
              <SW-SERVICE-IMPL-POLICY>STANDARD</SW-SERVICE-IMPL-POLICY>
              <BSW-ENTRY-KIND>CONCRETE</BSW-ENTRY-KIND>
            </BSW-MODULE-ENTRY>  
            <BSW-MODULE-ENTRY UUID="114bad1a-343e-4297-a7bb-9a5cc30e99ce">
              <SHORT-NAME>Cdd_Pwm_SetFallingEdgeDelayCountShadowLoadMode</SHORT-NAME>
              <SERVICE-ID>50</SERVICE-ID>
              <IS-REENTRANT>false</IS-REENTRANT>
              <IS-SYNCHRONOUS>true</IS-SYNCHRONOUS>
              <CALL-TYPE>REGULAR</CALL-TYPE>
              <EXECUTION-CONTEXT>UNSPECIFIED</EXECUTION-CONTEXT>
              <SW-SERVICE-IMPL-POLICY>STANDARD</SW-SERVICE-IMPL-POLICY>
              <BSW-ENTRY-KIND>CONCRETE</BSW-ENTRY-KIND>
            </BSW-MODULE-ENTRY>  
            <BSW-MODULE-ENTRY UUID="1ea75c97-44e8-4180-a96a-a33992450083">
              <SHORT-NAME>Cdd_Pwm_DisableFallingEdgeDelayCountShadowLoadMode</SHORT-NAME>
              <SERVICE-ID>51</SERVICE-ID>
              <IS-REENTRANT>false</IS-REENTRANT>
              <IS-SYNCHRONOUS>true</IS-SYNCHRONOUS>
              <CALL-TYPE>REGULAR</CALL-TYPE>
              <EXECUTION-CONTEXT>UNSPECIFIED</EXECUTION-CONTEXT>
              <SW-SERVICE-IMPL-POLICY>STANDARD</SW-SERVICE-IMPL-POLICY>
              <BSW-ENTRY-KIND>CONCRETE</BSW-ENTRY-KIND>
            </BSW-MODULE-ENTRY>  
            <BSW-MODULE-ENTRY UUID="c51c0d7a-5bc0-437a-9f21-1f5517b6ca43">
              <SHORT-NAME>Cdd_Pwm_SetDeadBandCounterClock</SHORT-NAME>
              <SERVICE-ID>52</SERVICE-ID>
              <IS-REENTRANT>false</IS-REENTRANT>
              <IS-SYNCHRONOUS>true</IS-SYNCHRONOUS>
              <CALL-TYPE>REGULAR</CALL-TYPE>
              <EXECUTION-CONTEXT>UNSPECIFIED</EXECUTION-CONTEXT>
              <SW-SERVICE-IMPL-POLICY>STANDARD</SW-SERVICE-IMPL-POLICY>
              <BSW-ENTRY-KIND>CONCRETE</BSW-ENTRY-KIND>
            </BSW-MODULE-ENTRY>  
            <BSW-MODULE-ENTRY UUID="e3dd9371-ebbf-4d24-9c9d-39f9f17bf36b">
              <SHORT-NAME>Cdd_Pwm_SetRisingEdgeDelayCount</SHORT-NAME>
              <SERVICE-ID>53</SERVICE-ID>
              <IS-REENTRANT>false</IS-REENTRANT>
              <IS-SYNCHRONOUS>true</IS-SYNCHRONOUS>
              <CALL-TYPE>REGULAR</CALL-TYPE>
              <EXECUTION-CONTEXT>UNSPECIFIED</EXECUTION-CONTEXT>
              <SW-SERVICE-IMPL-POLICY>STANDARD</SW-SERVICE-IMPL-POLICY>
              <BSW-ENTRY-KIND>CONCRETE</BSW-ENTRY-KIND>
            </BSW-MODULE-ENTRY>  
            <BSW-MODULE-ENTRY UUID="0e63ec81-1cb6-4fbe-ba66-e540dc1599ea">
              <SHORT-NAME>Cdd_Pwm_SetFallingEdgeDelayCount</SHORT-NAME>
              <SERVICE-ID>54</SERVICE-ID>
              <IS-REENTRANT>false</IS-REENTRANT>
              <IS-SYNCHRONOUS>true</IS-SYNCHRONOUS>
              <CALL-TYPE>REGULAR</CALL-TYPE>
              <EXECUTION-CONTEXT>UNSPECIFIED</EXECUTION-CONTEXT>
              <SW-SERVICE-IMPL-POLICY>STANDARD</SW-SERVICE-IMPL-POLICY>
              <BSW-ENTRY-KIND>CONCRETE</BSW-ENTRY-KIND>
            </BSW-MODULE-ENTRY>  
            <BSW-MODULE-ENTRY UUID="d78c273c-5d0c-4a59-80b9-c1d055a46549">
              <SHORT-NAME>Cdd_Pwm_ConfigureChopper</SHORT-NAME>
              <SERVICE-ID>55</SERVICE-ID>
              <IS-REENTRANT>false</IS-REENTRANT>
              <IS-SYNCHRONOUS>true</IS-SYNCHRONOUS>
              <CALL-TYPE>REGULAR</CALL-TYPE>
              <EXECUTION-CONTEXT>UNSPECIFIED</EXECUTION-CONTEXT>
              <SW-SERVICE-IMPL-POLICY>STANDARD</SW-SERVICE-IMPL-POLICY>
              <BSW-ENTRY-KIND>CONCRETE</BSW-ENTRY-KIND>
            </BSW-MODULE-ENTRY>  
            <BSW-MODULE-ENTRY UUID="377d4958-2c0e-4a66-bcbf-ab3c80fff3b9">
              <SHORT-NAME>Cdd_Pwm_SetChopperDutyCycle</SHORT-NAME>
              <SERVICE-ID>56</SERVICE-ID>
              <IS-REENTRANT>false</IS-REENTRANT>
              <IS-SYNCHRONOUS>true</IS-SYNCHRONOUS>
              <CALL-TYPE>REGULAR</CALL-TYPE>
              <EXECUTION-CONTEXT>UNSPECIFIED</EXECUTION-CONTEXT>
              <SW-SERVICE-IMPL-POLICY>STANDARD</SW-SERVICE-IMPL-POLICY>
              <BSW-ENTRY-KIND>CONCRETE</BSW-ENTRY-KIND>
            </BSW-MODULE-ENTRY>  
            <BSW-MODULE-ENTRY UUID="fbf6babb-0ad1-48c3-95ce-165edea9bf9f">
              <SHORT-NAME>Cdd_Pwm_SetChopperFreq</SHORT-NAME>
              <SERVICE-ID>57</SERVICE-ID>
              <IS-REENTRANT>false</IS-REENTRANT>
              <IS-SYNCHRONOUS>true</IS-SYNCHRONOUS>
              <CALL-TYPE>REGULAR</CALL-TYPE>
              <EXECUTION-CONTEXT>UNSPECIFIED</EXECUTION-CONTEXT>
              <SW-SERVICE-IMPL-POLICY>STANDARD</SW-SERVICE-IMPL-POLICY>
              <BSW-ENTRY-KIND>CONCRETE</BSW-ENTRY-KIND>
            </BSW-MODULE-ENTRY>  
            <BSW-MODULE-ENTRY UUID="2673ba87-dbb5-4e7e-83a2-5dd83045e724">
              <SHORT-NAME>Cdd_Pwm_SetChopperFirstPulseWidth</SHORT-NAME>
              <SERVICE-ID>58</SERVICE-ID>
              <IS-REENTRANT>false</IS-REENTRANT>
              <IS-SYNCHRONOUS>true</IS-SYNCHRONOUS>
              <CALL-TYPE>REGULAR</CALL-TYPE>
              <EXECUTION-CONTEXT>UNSPECIFIED</EXECUTION-CONTEXT>
              <SW-SERVICE-IMPL-POLICY>STANDARD</SW-SERVICE-IMPL-POLICY>
              <BSW-ENTRY-KIND>CONCRETE</BSW-ENTRY-KIND>
            </BSW-MODULE-ENTRY>  
            <BSW-MODULE-ENTRY UUID="ade445d7-3652-4756-938b-d6c1f8915b3a">
              <SHORT-NAME>Cdd_Pwm_ConfigureTripZoneSignals</SHORT-NAME>
              <SERVICE-ID>59</SERVICE-ID>
              <IS-REENTRANT>false</IS-REENTRANT>
              <IS-SYNCHRONOUS>true</IS-SYNCHRONOUS>
              <CALL-TYPE>REGULAR</CALL-TYPE>
              <EXECUTION-CONTEXT>UNSPECIFIED</EXECUTION-CONTEXT>
              <SW-SERVICE-IMPL-POLICY>STANDARD</SW-SERVICE-IMPL-POLICY>
              <BSW-ENTRY-KIND>CONCRETE</BSW-ENTRY-KIND>
            </BSW-MODULE-ENTRY>  
            <BSW-MODULE-ENTRY UUID="f60fd3de-673d-40e8-9c26-e404a73197e9">
              <SHORT-NAME>Cdd_Pwm_SetTripZoneDigitalCompareEventCondition</SHORT-NAME>
              <SERVICE-ID>60</SERVICE-ID>
              <IS-REENTRANT>false</IS-REENTRANT>
              <IS-SYNCHRONOUS>true</IS-SYNCHRONOUS>
              <CALL-TYPE>REGULAR</CALL-TYPE>
              <EXECUTION-CONTEXT>UNSPECIFIED</EXECUTION-CONTEXT>
              <SW-SERVICE-IMPL-POLICY>STANDARD</SW-SERVICE-IMPL-POLICY>
              <BSW-ENTRY-KIND>CONCRETE</BSW-ENTRY-KIND>
            </BSW-MODULE-ENTRY>  
            <BSW-MODULE-ENTRY UUID="83665b76-5970-4046-a329-d5c130eb3cf4">
              <SHORT-NAME>Cdd_Pwm_ConfigureTripZoneAdvAction</SHORT-NAME>
              <SERVICE-ID>61</SERVICE-ID>
              <IS-REENTRANT>false</IS-REENTRANT>
              <IS-SYNCHRONOUS>true</IS-SYNCHRONOUS>
              <CALL-TYPE>REGULAR</CALL-TYPE>
              <EXECUTION-CONTEXT>UNSPECIFIED</EXECUTION-CONTEXT>
              <SW-SERVICE-IMPL-POLICY>STANDARD</SW-SERVICE-IMPL-POLICY>
              <BSW-ENTRY-KIND>CONCRETE</BSW-ENTRY-KIND>
            </BSW-MODULE-ENTRY>  
            <BSW-MODULE-ENTRY UUID="f2b9f75c-8e87-47a6-8ed4-95a79843dc27">
              <SHORT-NAME>Cdd_Pwm_SetTripZoneAction</SHORT-NAME>
              <SERVICE-ID>62</SERVICE-ID>
              <IS-REENTRANT>false</IS-REENTRANT>
              <IS-SYNCHRONOUS>true</IS-SYNCHRONOUS>
              <CALL-TYPE>REGULAR</CALL-TYPE>
              <EXECUTION-CONTEXT>UNSPECIFIED</EXECUTION-CONTEXT>
              <SW-SERVICE-IMPL-POLICY>STANDARD</SW-SERVICE-IMPL-POLICY>
              <BSW-ENTRY-KIND>CONCRETE</BSW-ENTRY-KIND>
            </BSW-MODULE-ENTRY>  
            <BSW-MODULE-ENTRY UUID="90d6d5ab-9500-4420-b665-7f27b5610488">
              <SHORT-NAME>Cdd_Pwm_SetTripZoneAdvAction</SHORT-NAME>
              <SERVICE-ID>63</SERVICE-ID>
              <IS-REENTRANT>false</IS-REENTRANT>
              <IS-SYNCHRONOUS>true</IS-SYNCHRONOUS>
              <CALL-TYPE>REGULAR</CALL-TYPE>
              <EXECUTION-CONTEXT>UNSPECIFIED</EXECUTION-CONTEXT>
              <SW-SERVICE-IMPL-POLICY>STANDARD</SW-SERVICE-IMPL-POLICY>
              <BSW-ENTRY-KIND>CONCRETE</BSW-ENTRY-KIND>
            </BSW-MODULE-ENTRY>  
            <BSW-MODULE-ENTRY UUID="7864ae22-012d-408c-a3ef-2c158989ce14">
              <SHORT-NAME>Cdd_Pwm_SetTripZoneAdvDigitalCompareAction</SHORT-NAME>
              <SERVICE-ID>64</SERVICE-ID>
              <IS-REENTRANT>false</IS-REENTRANT>
              <IS-SYNCHRONOUS>true</IS-SYNCHRONOUS>
              <CALL-TYPE>REGULAR</CALL-TYPE>
              <EXECUTION-CONTEXT>UNSPECIFIED</EXECUTION-CONTEXT>
              <SW-SERVICE-IMPL-POLICY>STANDARD</SW-SERVICE-IMPL-POLICY>
              <BSW-ENTRY-KIND>CONCRETE</BSW-ENTRY-KIND>
            </BSW-MODULE-ENTRY>  
            <BSW-MODULE-ENTRY UUID="e5b8caec-ce6f-4341-959f-3fb8aca6de77">
              <SHORT-NAME>Cdd_Pwm_ConfigureTripZoneInterrupt</SHORT-NAME>
              <SERVICE-ID>65</SERVICE-ID>
              <IS-REENTRANT>false</IS-REENTRANT>
              <IS-SYNCHRONOUS>true</IS-SYNCHRONOUS>
              <CALL-TYPE>REGULAR</CALL-TYPE>
              <EXECUTION-CONTEXT>UNSPECIFIED</EXECUTION-CONTEXT>
              <SW-SERVICE-IMPL-POLICY>STANDARD</SW-SERVICE-IMPL-POLICY>
              <BSW-ENTRY-KIND>CONCRETE</BSW-ENTRY-KIND>
            </BSW-MODULE-ENTRY>  
            <BSW-MODULE-ENTRY UUID="5e075042-c3d1-4ba9-855e-b4dbd5fda3ac">
              <SHORT-NAME>Cdd_Pwm_GetTripZoneFlagStatus</SHORT-NAME>
              <SERVICE-ID>66</SERVICE-ID>
              <IS-REENTRANT>false</IS-REENTRANT>
              <IS-SYNCHRONOUS>true</IS-SYNCHRONOUS>
              <CALL-TYPE>REGULAR</CALL-TYPE>
              <EXECUTION-CONTEXT>UNSPECIFIED</EXECUTION-CONTEXT>
              <SW-SERVICE-IMPL-POLICY>STANDARD</SW-SERVICE-IMPL-POLICY>
              <BSW-ENTRY-KIND>CONCRETE</BSW-ENTRY-KIND>
            </BSW-MODULE-ENTRY>  
            <BSW-MODULE-ENTRY UUID="5e301f93-d205-4e4c-8098-f97a9e48bf6c">
              <SHORT-NAME>Cdd_Pwm_GetCycleByCycleTripZoneFlagStatus</SHORT-NAME>
              <SERVICE-ID>67</SERVICE-ID>
              <IS-REENTRANT>false</IS-REENTRANT>
              <IS-SYNCHRONOUS>true</IS-SYNCHRONOUS>
              <CALL-TYPE>REGULAR</CALL-TYPE>
              <EXECUTION-CONTEXT>UNSPECIFIED</EXECUTION-CONTEXT>
              <SW-SERVICE-IMPL-POLICY>STANDARD</SW-SERVICE-IMPL-POLICY>
              <BSW-ENTRY-KIND>CONCRETE</BSW-ENTRY-KIND>
            </BSW-MODULE-ENTRY>  
            <BSW-MODULE-ENTRY UUID="c128b3ae-fa7d-4905-a452-41d60dab1c6c">
              <SHORT-NAME>Cdd_Pwm_GetOneShotTripZoneFlagStatus</SHORT-NAME>
              <SERVICE-ID>68</SERVICE-ID>
              <IS-REENTRANT>false</IS-REENTRANT>
              <IS-SYNCHRONOUS>true</IS-SYNCHRONOUS>
              <CALL-TYPE>REGULAR</CALL-TYPE>
              <EXECUTION-CONTEXT>UNSPECIFIED</EXECUTION-CONTEXT>
              <SW-SERVICE-IMPL-POLICY>STANDARD</SW-SERVICE-IMPL-POLICY>
              <BSW-ENTRY-KIND>CONCRETE</BSW-ENTRY-KIND>
            </BSW-MODULE-ENTRY>  
            <BSW-MODULE-ENTRY UUID="eb5d7c21-3938-470c-b71a-e13b451523c0">
              <SHORT-NAME>Cdd_Pwm_SelectCycleByCycleTripZoneClearEvent</SHORT-NAME>
              <SERVICE-ID>69</SERVICE-ID>
              <IS-REENTRANT>false</IS-REENTRANT>
              <IS-SYNCHRONOUS>true</IS-SYNCHRONOUS>
              <CALL-TYPE>REGULAR</CALL-TYPE>
              <EXECUTION-CONTEXT>UNSPECIFIED</EXECUTION-CONTEXT>
              <SW-SERVICE-IMPL-POLICY>STANDARD</SW-SERVICE-IMPL-POLICY>
              <BSW-ENTRY-KIND>CONCRETE</BSW-ENTRY-KIND>
            </BSW-MODULE-ENTRY>  
            <BSW-MODULE-ENTRY UUID="193181b1-b631-4e6c-a255-24e01556bb77">
              <SHORT-NAME>Cdd_Pwm_ClearTripZoneFlag</SHORT-NAME>
              <SERVICE-ID>70</SERVICE-ID>
              <IS-REENTRANT>false</IS-REENTRANT>
              <IS-SYNCHRONOUS>true</IS-SYNCHRONOUS>
              <CALL-TYPE>REGULAR</CALL-TYPE>
              <EXECUTION-CONTEXT>UNSPECIFIED</EXECUTION-CONTEXT>
              <SW-SERVICE-IMPL-POLICY>STANDARD</SW-SERVICE-IMPL-POLICY>
              <BSW-ENTRY-KIND>CONCRETE</BSW-ENTRY-KIND>
            </BSW-MODULE-ENTRY>  
            <BSW-MODULE-ENTRY UUID="f5f1dd9f-feaf-41c2-8c9e-882c72986cff">
              <SHORT-NAME>Cdd_Pwm_ClearCycleByCycleTripZoneFlag</SHORT-NAME>
              <SERVICE-ID>71</SERVICE-ID>
              <IS-REENTRANT>false</IS-REENTRANT>
              <IS-SYNCHRONOUS>true</IS-SYNCHRONOUS>
              <CALL-TYPE>REGULAR</CALL-TYPE>
              <EXECUTION-CONTEXT>UNSPECIFIED</EXECUTION-CONTEXT>
              <SW-SERVICE-IMPL-POLICY>STANDARD</SW-SERVICE-IMPL-POLICY>
              <BSW-ENTRY-KIND>CONCRETE</BSW-ENTRY-KIND>
            </BSW-MODULE-ENTRY>  
            <BSW-MODULE-ENTRY UUID="89e66849-a4f4-4a6a-877f-d877f5292147">
              <SHORT-NAME>Cdd_Pwm_ClearOneShotTripZoneFlag</SHORT-NAME>
              <SERVICE-ID>72</SERVICE-ID>
              <IS-REENTRANT>false</IS-REENTRANT>
              <IS-SYNCHRONOUS>true</IS-SYNCHRONOUS>
              <CALL-TYPE>REGULAR</CALL-TYPE>
              <EXECUTION-CONTEXT>UNSPECIFIED</EXECUTION-CONTEXT>
              <SW-SERVICE-IMPL-POLICY>STANDARD</SW-SERVICE-IMPL-POLICY>
              <BSW-ENTRY-KIND>CONCRETE</BSW-ENTRY-KIND>
            </BSW-MODULE-ENTRY>  
            <BSW-MODULE-ENTRY UUID="f49276c0-c31e-4df1-9f5d-98d495166e90">
              <SHORT-NAME>Cdd_Pwm_ForceTripZoneEvent</SHORT-NAME>
              <SERVICE-ID>73</SERVICE-ID>
              <IS-REENTRANT>false</IS-REENTRANT>
              <IS-SYNCHRONOUS>true</IS-SYNCHRONOUS>
              <CALL-TYPE>REGULAR</CALL-TYPE>
              <EXECUTION-CONTEXT>UNSPECIFIED</EXECUTION-CONTEXT>
              <SW-SERVICE-IMPL-POLICY>STANDARD</SW-SERVICE-IMPL-POLICY>
              <BSW-ENTRY-KIND>CONCRETE</BSW-ENTRY-KIND>
            </BSW-MODULE-ENTRY>  
            <BSW-MODULE-ENTRY UUID="bb737fd5-46f2-497b-a334-d760c224c1e4">
              <SHORT-NAME>Cdd_Pwm_ConfigureTripOutSource</SHORT-NAME>
              <SERVICE-ID>74</SERVICE-ID>
              <IS-REENTRANT>false</IS-REENTRANT>
              <IS-SYNCHRONOUS>true</IS-SYNCHRONOUS>
              <CALL-TYPE>REGULAR</CALL-TYPE>
              <EXECUTION-CONTEXT>UNSPECIFIED</EXECUTION-CONTEXT>
              <SW-SERVICE-IMPL-POLICY>STANDARD</SW-SERVICE-IMPL-POLICY>
              <BSW-ENTRY-KIND>CONCRETE</BSW-ENTRY-KIND>
            </BSW-MODULE-ENTRY>  
            <BSW-MODULE-ENTRY UUID="1de724f0-5de4-42f0-b35f-77af40ed8db6">
              <SHORT-NAME>Cdd_Pwm_ConfigureInterrupt</SHORT-NAME>
              <SERVICE-ID>75</SERVICE-ID>
              <IS-REENTRANT>false</IS-REENTRANT>
              <IS-SYNCHRONOUS>true</IS-SYNCHRONOUS>
              <CALL-TYPE>REGULAR</CALL-TYPE>
              <EXECUTION-CONTEXT>UNSPECIFIED</EXECUTION-CONTEXT>
              <SW-SERVICE-IMPL-POLICY>STANDARD</SW-SERVICE-IMPL-POLICY>
              <BSW-ENTRY-KIND>CONCRETE</BSW-ENTRY-KIND>
            </BSW-MODULE-ENTRY>  
            <BSW-MODULE-ENTRY UUID="c00154f2-3901-4bfa-af5a-704facf46a93">
              <SHORT-NAME>Cdd_Pwm_SetInterruptSource</SHORT-NAME>
              <SERVICE-ID>76</SERVICE-ID>
              <IS-REENTRANT>false</IS-REENTRANT>
              <IS-SYNCHRONOUS>true</IS-SYNCHRONOUS>
              <CALL-TYPE>REGULAR</CALL-TYPE>
              <EXECUTION-CONTEXT>UNSPECIFIED</EXECUTION-CONTEXT>
              <SW-SERVICE-IMPL-POLICY>STANDARD</SW-SERVICE-IMPL-POLICY>
              <BSW-ENTRY-KIND>CONCRETE</BSW-ENTRY-KIND>
            </BSW-MODULE-ENTRY>  
            <BSW-MODULE-ENTRY UUID="9dffe879-89b0-4f1b-9450-2995a7179423">
              <SHORT-NAME>Cdd_Pwm_GetEventTriggerInterruptStatus</SHORT-NAME>
              <SERVICE-ID>77</SERVICE-ID>
              <IS-REENTRANT>false</IS-REENTRANT>
              <IS-SYNCHRONOUS>true</IS-SYNCHRONOUS>
              <CALL-TYPE>REGULAR</CALL-TYPE>
              <EXECUTION-CONTEXT>UNSPECIFIED</EXECUTION-CONTEXT>
              <SW-SERVICE-IMPL-POLICY>STANDARD</SW-SERVICE-IMPL-POLICY>
              <BSW-ENTRY-KIND>CONCRETE</BSW-ENTRY-KIND>
            </BSW-MODULE-ENTRY>  
            <BSW-MODULE-ENTRY UUID="e470cea8-a814-40b0-bd78-478d6a20fdf5">
              <SHORT-NAME>Cdd_Pwm_ClearEventTriggerInterruptFlag</SHORT-NAME>
              <SERVICE-ID>78</SERVICE-ID>
              <IS-REENTRANT>false</IS-REENTRANT>
              <IS-SYNCHRONOUS>true</IS-SYNCHRONOUS>
              <CALL-TYPE>REGULAR</CALL-TYPE>
              <EXECUTION-CONTEXT>UNSPECIFIED</EXECUTION-CONTEXT>
              <SW-SERVICE-IMPL-POLICY>STANDARD</SW-SERVICE-IMPL-POLICY>
              <BSW-ENTRY-KIND>CONCRETE</BSW-ENTRY-KIND>
            </BSW-MODULE-ENTRY>  
             <BSW-MODULE-ENTRY UUID="90a6fb44-7c0d-43e8-9ca0-a2fe485177c7">
              <SHORT-NAME>Cdd_Pwm_ConfigureInterruptEventCountInit</SHORT-NAME>
              <SERVICE-ID>80</SERVICE-ID>
              <IS-REENTRANT>false</IS-REENTRANT>
              <IS-SYNCHRONOUS>true</IS-SYNCHRONOUS>
              <CALL-TYPE>REGULAR</CALL-TYPE>
              <EXECUTION-CONTEXT>UNSPECIFIED</EXECUTION-CONTEXT>
              <SW-SERVICE-IMPL-POLICY>STANDARD</SW-SERVICE-IMPL-POLICY>
              <BSW-ENTRY-KIND>CONCRETE</BSW-ENTRY-KIND>
            </BSW-MODULE-ENTRY>  
            <BSW-MODULE-ENTRY UUID="ba339d5f-6bb5-42eb-97f2-13d0376c24d6">
              <SHORT-NAME>Cdd_Pwm_ForceInterruptEventCountInit</SHORT-NAME>
              <SERVICE-ID>81</SERVICE-ID>
              <IS-REENTRANT>false</IS-REENTRANT>
              <IS-SYNCHRONOUS>true</IS-SYNCHRONOUS>
              <CALL-TYPE>REGULAR</CALL-TYPE>
              <EXECUTION-CONTEXT>UNSPECIFIED</EXECUTION-CONTEXT>
              <SW-SERVICE-IMPL-POLICY>STANDARD</SW-SERVICE-IMPL-POLICY>
              <BSW-ENTRY-KIND>CONCRETE</BSW-ENTRY-KIND>
            </BSW-MODULE-ENTRY>  
            <BSW-MODULE-ENTRY UUID="c7bb8402-df4f-4125-b6ea-ddf0575fd92a">
              <SHORT-NAME>Cdd_Pwm_SetInterruptEventCountInitValue</SHORT-NAME>
              <SERVICE-ID>82</SERVICE-ID>
              <IS-REENTRANT>false</IS-REENTRANT>
              <IS-SYNCHRONOUS>true</IS-SYNCHRONOUS>
              <CALL-TYPE>REGULAR</CALL-TYPE>
              <EXECUTION-CONTEXT>UNSPECIFIED</EXECUTION-CONTEXT>
              <SW-SERVICE-IMPL-POLICY>STANDARD</SW-SERVICE-IMPL-POLICY>
              <BSW-ENTRY-KIND>CONCRETE</BSW-ENTRY-KIND>
            </BSW-MODULE-ENTRY>  
            <BSW-MODULE-ENTRY UUID="7bf6d935-5258-4cb4-ab4e-82f963e08dcb">
              <SHORT-NAME>Cdd_Pwm_GetInterruptEventCount</SHORT-NAME>
              <SERVICE-ID>83</SERVICE-ID>
              <IS-REENTRANT>false</IS-REENTRANT>
              <IS-SYNCHRONOUS>true</IS-SYNCHRONOUS>
              <CALL-TYPE>REGULAR</CALL-TYPE>
              <EXECUTION-CONTEXT>UNSPECIFIED</EXECUTION-CONTEXT>
              <SW-SERVICE-IMPL-POLICY>STANDARD</SW-SERVICE-IMPL-POLICY>
              <BSW-ENTRY-KIND>CONCRETE</BSW-ENTRY-KIND>
            </BSW-MODULE-ENTRY>  
            <BSW-MODULE-ENTRY UUID="6da684d9-e962-4654-8ef4-db283ff824f3">
              <SHORT-NAME>Cdd_Pwm_ForceEventTriggerInterrupt</SHORT-NAME>
              <SERVICE-ID>84</SERVICE-ID>
              <IS-REENTRANT>false</IS-REENTRANT>
              <IS-SYNCHRONOUS>true</IS-SYNCHRONOUS>
              <CALL-TYPE>REGULAR</CALL-TYPE>
              <EXECUTION-CONTEXT>UNSPECIFIED</EXECUTION-CONTEXT>
              <SW-SERVICE-IMPL-POLICY>STANDARD</SW-SERVICE-IMPL-POLICY>
              <BSW-ENTRY-KIND>CONCRETE</BSW-ENTRY-KIND>
            </BSW-MODULE-ENTRY>  
            <BSW-MODULE-ENTRY UUID="a756a376-de6e-4a86-8b35-c4debf14f0f5">
              <SHORT-NAME>Cdd_Pwm_SetMixEvtTriggerSource</SHORT-NAME>
              <SERVICE-ID>85</SERVICE-ID>
              <IS-REENTRANT>false</IS-REENTRANT>
              <IS-SYNCHRONOUS>true</IS-SYNCHRONOUS>
              <CALL-TYPE>REGULAR</CALL-TYPE>
              <EXECUTION-CONTEXT>UNSPECIFIED</EXECUTION-CONTEXT>
              <SW-SERVICE-IMPL-POLICY>STANDARD</SW-SERVICE-IMPL-POLICY>
              <BSW-ENTRY-KIND>CONCRETE</BSW-ENTRY-KIND>
            </BSW-MODULE-ENTRY>  
            <BSW-MODULE-ENTRY UUID="e55e6609-f2eb-4e87-a209-1effb1eaebd0">
              <SHORT-NAME>Cdd_Pwm_ConfigureAdcTrigger</SHORT-NAME>
              <SERVICE-ID>86</SERVICE-ID>
              <IS-REENTRANT>false</IS-REENTRANT>
              <IS-SYNCHRONOUS>true</IS-SYNCHRONOUS>
              <CALL-TYPE>REGULAR</CALL-TYPE>
              <EXECUTION-CONTEXT>UNSPECIFIED</EXECUTION-CONTEXT>
              <SW-SERVICE-IMPL-POLICY>STANDARD</SW-SERVICE-IMPL-POLICY>
              <BSW-ENTRY-KIND>CONCRETE</BSW-ENTRY-KIND>
            </BSW-MODULE-ENTRY>  
            <BSW-MODULE-ENTRY UUID="e154641f-5165-41cd-b324-98f05bc45fab">
              <SHORT-NAME>Cdd_Pwm_SetAdcTriggerSource</SHORT-NAME>
              <SERVICE-ID>87</SERVICE-ID>
              <IS-REENTRANT>false</IS-REENTRANT>
              <IS-SYNCHRONOUS>true</IS-SYNCHRONOUS>
              <CALL-TYPE>REGULAR</CALL-TYPE>
              <EXECUTION-CONTEXT>UNSPECIFIED</EXECUTION-CONTEXT>
              <SW-SERVICE-IMPL-POLICY>STANDARD</SW-SERVICE-IMPL-POLICY>
              <BSW-ENTRY-KIND>CONCRETE</BSW-ENTRY-KIND>
            </BSW-MODULE-ENTRY>  
            <BSW-MODULE-ENTRY UUID="0283b107-e331-453a-bd71-486a45b39fdf">
              <SHORT-NAME>Cdd_Pwm_SetAdcTriggerEventPrescale</SHORT-NAME>
              <SERVICE-ID>88</SERVICE-ID>
              <IS-REENTRANT>false</IS-REENTRANT>
              <IS-SYNCHRONOUS>true</IS-SYNCHRONOUS>
              <CALL-TYPE>REGULAR</CALL-TYPE>
              <EXECUTION-CONTEXT>UNSPECIFIED</EXECUTION-CONTEXT>
              <SW-SERVICE-IMPL-POLICY>STANDARD</SW-SERVICE-IMPL-POLICY>
              <BSW-ENTRY-KIND>CONCRETE</BSW-ENTRY-KIND>
            </BSW-MODULE-ENTRY>  
            <BSW-MODULE-ENTRY UUID="fddd35fb-f958-485c-8711-c79268563613">
              <SHORT-NAME>Cdd_Pwm_GetAdcTriggerFlagStatus</SHORT-NAME>
              <SERVICE-ID>89</SERVICE-ID>
              <IS-REENTRANT>false</IS-REENTRANT>
              <IS-SYNCHRONOUS>true</IS-SYNCHRONOUS>
              <CALL-TYPE>REGULAR</CALL-TYPE>
              <EXECUTION-CONTEXT>UNSPECIFIED</EXECUTION-CONTEXT>
              <SW-SERVICE-IMPL-POLICY>STANDARD</SW-SERVICE-IMPL-POLICY>
              <BSW-ENTRY-KIND>CONCRETE</BSW-ENTRY-KIND>
            </BSW-MODULE-ENTRY>  
            <BSW-MODULE-ENTRY UUID="992b0b70-7e6c-4293-ab14-dd3b30f7b0e8">
              <SHORT-NAME>Cdd_Pwm_ClearAdcTriggerFlag</SHORT-NAME>
              <SERVICE-ID>90</SERVICE-ID>
              <IS-REENTRANT>false</IS-REENTRANT>
              <IS-SYNCHRONOUS>true</IS-SYNCHRONOUS>
              <CALL-TYPE>REGULAR</CALL-TYPE>
              <EXECUTION-CONTEXT>UNSPECIFIED</EXECUTION-CONTEXT>
              <SW-SERVICE-IMPL-POLICY>STANDARD</SW-SERVICE-IMPL-POLICY>
              <BSW-ENTRY-KIND>CONCRETE</BSW-ENTRY-KIND>
            </BSW-MODULE-ENTRY>  
            <BSW-MODULE-ENTRY UUID="137c4b5d-041a-45d5-99e6-68fbb399903e">
              <SHORT-NAME>Cdd_Pwm_ConfigureAdcTriggerEventCountInit</SHORT-NAME>
              <SERVICE-ID>91</SERVICE-ID>
              <IS-REENTRANT>false</IS-REENTRANT>
              <IS-SYNCHRONOUS>true</IS-SYNCHRONOUS>
              <CALL-TYPE>REGULAR</CALL-TYPE>
              <EXECUTION-CONTEXT>UNSPECIFIED</EXECUTION-CONTEXT>
              <SW-SERVICE-IMPL-POLICY>STANDARD</SW-SERVICE-IMPL-POLICY>
              <BSW-ENTRY-KIND>CONCRETE</BSW-ENTRY-KIND>
            </BSW-MODULE-ENTRY>  
            <BSW-MODULE-ENTRY UUID="5bd7d77d-8507-4e54-957c-855e122d02ca">
              <SHORT-NAME>Cdd_Pwm_ForceAdcTriggerEventCountInit</SHORT-NAME>
              <SERVICE-ID>92</SERVICE-ID>
              <IS-REENTRANT>false</IS-REENTRANT>
              <IS-SYNCHRONOUS>true</IS-SYNCHRONOUS>
              <CALL-TYPE>REGULAR</CALL-TYPE>
              <EXECUTION-CONTEXT>UNSPECIFIED</EXECUTION-CONTEXT>
              <SW-SERVICE-IMPL-POLICY>STANDARD</SW-SERVICE-IMPL-POLICY>
              <BSW-ENTRY-KIND>CONCRETE</BSW-ENTRY-KIND>
            </BSW-MODULE-ENTRY>  
            <BSW-MODULE-ENTRY UUID="f1da8b70-c179-4ae4-8770-b970339c1a5c">
              <SHORT-NAME>Cdd_Pwm_SetAdcTriggerEventCountInitValue</SHORT-NAME>
              <SERVICE-ID>93</SERVICE-ID>
              <IS-REENTRANT>false</IS-REENTRANT>
              <IS-SYNCHRONOUS>true</IS-SYNCHRONOUS>
              <CALL-TYPE>REGULAR</CALL-TYPE>
              <EXECUTION-CONTEXT>UNSPECIFIED</EXECUTION-CONTEXT>
              <SW-SERVICE-IMPL-POLICY>STANDARD</SW-SERVICE-IMPL-POLICY>
              <BSW-ENTRY-KIND>CONCRETE</BSW-ENTRY-KIND>
            </BSW-MODULE-ENTRY>  
            <BSW-MODULE-ENTRY UUID="a340477a-0b1c-4f55-9d4a-c97c65458995">
              <SHORT-NAME>Cdd_Pwm_GetAdcTriggerEventCount</SHORT-NAME>
              <SERVICE-ID>94</SERVICE-ID>
              <IS-REENTRANT>false</IS-REENTRANT>
              <IS-SYNCHRONOUS>true</IS-SYNCHRONOUS>
              <CALL-TYPE>REGULAR</CALL-TYPE>
              <EXECUTION-CONTEXT>UNSPECIFIED</EXECUTION-CONTEXT>
              <SW-SERVICE-IMPL-POLICY>STANDARD</SW-SERVICE-IMPL-POLICY>
              <BSW-ENTRY-KIND>CONCRETE</BSW-ENTRY-KIND>
            </BSW-MODULE-ENTRY>  
            <BSW-MODULE-ENTRY UUID="0aed0e7d-f6b1-4feb-97c3-9357d28d72f3">
              <SHORT-NAME>Cdd_Pwm_ForceAdcTrigger</SHORT-NAME>
              <SERVICE-ID>95</SERVICE-ID>
              <IS-REENTRANT>false</IS-REENTRANT>
              <IS-SYNCHRONOUS>true</IS-SYNCHRONOUS>
              <CALL-TYPE>REGULAR</CALL-TYPE>
              <EXECUTION-CONTEXT>UNSPECIFIED</EXECUTION-CONTEXT>
              <SW-SERVICE-IMPL-POLICY>STANDARD</SW-SERVICE-IMPL-POLICY>
              <BSW-ENTRY-KIND>CONCRETE</BSW-ENTRY-KIND>
            </BSW-MODULE-ENTRY>  
            <BSW-MODULE-ENTRY UUID="3f36ae04-ef6e-4a80-bc7a-7cb22ab56074">
              <SHORT-NAME>Cdd_Pwm_ConfigureDigitalCompareBlankingWindow</SHORT-NAME>
              <SERVICE-ID>96</SERVICE-ID>
              <IS-REENTRANT>false</IS-REENTRANT>
              <IS-SYNCHRONOUS>true</IS-SYNCHRONOUS>
              <CALL-TYPE>REGULAR</CALL-TYPE>
              <EXECUTION-CONTEXT>UNSPECIFIED</EXECUTION-CONTEXT>
              <SW-SERVICE-IMPL-POLICY>STANDARD</SW-SERVICE-IMPL-POLICY>
              <BSW-ENTRY-KIND>CONCRETE</BSW-ENTRY-KIND>
            </BSW-MODULE-ENTRY>  
            <BSW-MODULE-ENTRY UUID="ffaeb8fa-06c5-4b4e-8be2-953968bbe060">
              <SHORT-NAME>Cdd_Pwm_ConfigureDigitalCompareWindowInverseMode</SHORT-NAME>
              <SERVICE-ID>97</SERVICE-ID>
              <IS-REENTRANT>false</IS-REENTRANT>
              <IS-SYNCHRONOUS>true</IS-SYNCHRONOUS>
              <CALL-TYPE>REGULAR</CALL-TYPE>
              <EXECUTION-CONTEXT>UNSPECIFIED</EXECUTION-CONTEXT>
              <SW-SERVICE-IMPL-POLICY>STANDARD</SW-SERVICE-IMPL-POLICY>
              <BSW-ENTRY-KIND>CONCRETE</BSW-ENTRY-KIND>
            </BSW-MODULE-ENTRY>  
            <BSW-MODULE-ENTRY UUID="39c96591-bf9d-46ed-8472-7b555f0a0cf5">
              <SHORT-NAME>Cdd_Pwm_SetDigitalCompareBlankingEvent</SHORT-NAME>
              <SERVICE-ID>98</SERVICE-ID>
              <IS-REENTRANT>false</IS-REENTRANT>
              <IS-SYNCHRONOUS>true</IS-SYNCHRONOUS>
              <CALL-TYPE>REGULAR</CALL-TYPE>
              <EXECUTION-CONTEXT>UNSPECIFIED</EXECUTION-CONTEXT>
              <SW-SERVICE-IMPL-POLICY>STANDARD</SW-SERVICE-IMPL-POLICY>
              <BSW-ENTRY-KIND>CONCRETE</BSW-ENTRY-KIND>
            </BSW-MODULE-ENTRY>  
            <BSW-MODULE-ENTRY UUID="9302fb50-11c8-4262-aeab-9035d1836ee1">
              <SHORT-NAME>Cdd_Pwm_SetDigitalCompareFilterInput</SHORT-NAME>
              <SERVICE-ID>99</SERVICE-ID>
              <IS-REENTRANT>false</IS-REENTRANT>
              <IS-SYNCHRONOUS>true</IS-SYNCHRONOUS>
              <CALL-TYPE>REGULAR</CALL-TYPE>
              <EXECUTION-CONTEXT>UNSPECIFIED</EXECUTION-CONTEXT>
              <SW-SERVICE-IMPL-POLICY>STANDARD</SW-SERVICE-IMPL-POLICY>
              <BSW-ENTRY-KIND>CONCRETE</BSW-ENTRY-KIND>
            </BSW-MODULE-ENTRY>  
            <BSW-MODULE-ENTRY UUID="394e0d6a-0d5f-46f7-8d63-bd4727c353ce">
              <SHORT-NAME>Cdd_Pwm_ConfigureDigitalCompareEdgeFilter</SHORT-NAME>
              <SERVICE-ID>100</SERVICE-ID>
              <IS-REENTRANT>false</IS-REENTRANT>
              <IS-SYNCHRONOUS>true</IS-SYNCHRONOUS>
              <CALL-TYPE>REGULAR</CALL-TYPE>
              <EXECUTION-CONTEXT>UNSPECIFIED</EXECUTION-CONTEXT>
              <SW-SERVICE-IMPL-POLICY>STANDARD</SW-SERVICE-IMPL-POLICY>
              <BSW-ENTRY-KIND>CONCRETE</BSW-ENTRY-KIND>
            </BSW-MODULE-ENTRY>  
            <BSW-MODULE-ENTRY UUID="0a4dfde1-529e-4805-9cca-07fc8b837125">
              <SHORT-NAME>Cdd_Pwm_SetDigitalCompareEdgeFilterMode</SHORT-NAME>
              <SERVICE-ID>101</SERVICE-ID>
              <IS-REENTRANT>false</IS-REENTRANT>
              <IS-SYNCHRONOUS>true</IS-SYNCHRONOUS>
              <CALL-TYPE>REGULAR</CALL-TYPE>
              <EXECUTION-CONTEXT>UNSPECIFIED</EXECUTION-CONTEXT>
              <SW-SERVICE-IMPL-POLICY>STANDARD</SW-SERVICE-IMPL-POLICY>
              <BSW-ENTRY-KIND>CONCRETE</BSW-ENTRY-KIND>
            </BSW-MODULE-ENTRY>  
            <BSW-MODULE-ENTRY UUID="107c1643-acaf-4b8f-8c17-56d1067b5d08">
              <SHORT-NAME>Cdd_Pwm_SetDigitalCompareEdgeFilterEdgeCount</SHORT-NAME>
              <SERVICE-ID>102</SERVICE-ID>
              <IS-REENTRANT>false</IS-REENTRANT>
              <IS-SYNCHRONOUS>true</IS-SYNCHRONOUS>
              <CALL-TYPE>REGULAR</CALL-TYPE>
              <EXECUTION-CONTEXT>UNSPECIFIED</EXECUTION-CONTEXT>
              <SW-SERVICE-IMPL-POLICY>STANDARD</SW-SERVICE-IMPL-POLICY>
              <BSW-ENTRY-KIND>CONCRETE</BSW-ENTRY-KIND>
            </BSW-MODULE-ENTRY>  
            <BSW-MODULE-ENTRY UUID="02dc8820-f325-4122-a499-bb119ff9a055">
              <SHORT-NAME>Cdd_Pwm_GetDigitalCompareEdgeFilterEdgeCount</SHORT-NAME>
              <SERVICE-ID>103</SERVICE-ID>
              <IS-REENTRANT>false</IS-REENTRANT>
              <IS-SYNCHRONOUS>true</IS-SYNCHRONOUS>
              <CALL-TYPE>REGULAR</CALL-TYPE>
              <EXECUTION-CONTEXT>UNSPECIFIED</EXECUTION-CONTEXT>
              <SW-SERVICE-IMPL-POLICY>STANDARD</SW-SERVICE-IMPL-POLICY>
              <BSW-ENTRY-KIND>CONCRETE</BSW-ENTRY-KIND>
            </BSW-MODULE-ENTRY>  
            <BSW-MODULE-ENTRY UUID="0d0bd947-51ce-4ba2-8e82-1897f5477329">
              <SHORT-NAME>Cdd_Pwm_GetDigitalCompareEdgeFilterEdgeStatus</SHORT-NAME>
              <SERVICE-ID>104</SERVICE-ID>
              <IS-REENTRANT>false</IS-REENTRANT>
              <IS-SYNCHRONOUS>true</IS-SYNCHRONOUS>
              <CALL-TYPE>REGULAR</CALL-TYPE>
              <EXECUTION-CONTEXT>UNSPECIFIED</EXECUTION-CONTEXT>
              <SW-SERVICE-IMPL-POLICY>STANDARD</SW-SERVICE-IMPL-POLICY>
              <BSW-ENTRY-KIND>CONCRETE</BSW-ENTRY-KIND>
            </BSW-MODULE-ENTRY>  
            <BSW-MODULE-ENTRY UUID="7bdc57f0-c7e1-4d3e-b1b9-5c85438eb682">
              <SHORT-NAME>Cdd_Pwm_SetDigitalCompareWindowOffset</SHORT-NAME>
              <SERVICE-ID>105</SERVICE-ID>
              <IS-REENTRANT>false</IS-REENTRANT>
              <IS-SYNCHRONOUS>true</IS-SYNCHRONOUS>
              <CALL-TYPE>REGULAR</CALL-TYPE>
              <EXECUTION-CONTEXT>UNSPECIFIED</EXECUTION-CONTEXT>
              <SW-SERVICE-IMPL-POLICY>STANDARD</SW-SERVICE-IMPL-POLICY>
              <BSW-ENTRY-KIND>CONCRETE</BSW-ENTRY-KIND>
            </BSW-MODULE-ENTRY>  
            <BSW-MODULE-ENTRY UUID="723426e6-d7f2-4d3c-a4de-975754b8137c">
              <SHORT-NAME>Cdd_Pwm_SetDigitalCompareWindowLength</SHORT-NAME>
              <SERVICE-ID>106</SERVICE-ID>
              <IS-REENTRANT>false</IS-REENTRANT>
              <IS-SYNCHRONOUS>true</IS-SYNCHRONOUS>
              <CALL-TYPE>REGULAR</CALL-TYPE>
              <EXECUTION-CONTEXT>UNSPECIFIED</EXECUTION-CONTEXT>
              <SW-SERVICE-IMPL-POLICY>STANDARD</SW-SERVICE-IMPL-POLICY>
              <BSW-ENTRY-KIND>CONCRETE</BSW-ENTRY-KIND>
            </BSW-MODULE-ENTRY>  
            <BSW-MODULE-ENTRY UUID="ee7df723-d449-4d99-9174-752651f24aa3">
              <SHORT-NAME>Cdd_Pwm_GetDigitalCompareBlankingWindowOffsetCount</SHORT-NAME>
              <SERVICE-ID>107</SERVICE-ID>
              <IS-REENTRANT>false</IS-REENTRANT>
              <IS-SYNCHRONOUS>true</IS-SYNCHRONOUS>
              <CALL-TYPE>REGULAR</CALL-TYPE>
              <EXECUTION-CONTEXT>UNSPECIFIED</EXECUTION-CONTEXT>
              <SW-SERVICE-IMPL-POLICY>STANDARD</SW-SERVICE-IMPL-POLICY>
              <BSW-ENTRY-KIND>CONCRETE</BSW-ENTRY-KIND>
            </BSW-MODULE-ENTRY>  
            <BSW-MODULE-ENTRY UUID="464f6da5-2d13-400d-b6de-b9c7e6b8409b">
              <SHORT-NAME>Cdd_Pwm_GetDigitalCompareBlankingWindowLengthCount</SHORT-NAME>
              <SERVICE-ID>108</SERVICE-ID>
              <IS-REENTRANT>false</IS-REENTRANT>
              <IS-SYNCHRONOUS>true</IS-SYNCHRONOUS>
              <CALL-TYPE>REGULAR</CALL-TYPE>
              <EXECUTION-CONTEXT>UNSPECIFIED</EXECUTION-CONTEXT>
              <SW-SERVICE-IMPL-POLICY>STANDARD</SW-SERVICE-IMPL-POLICY>
              <BSW-ENTRY-KIND>CONCRETE</BSW-ENTRY-KIND>
            </BSW-MODULE-ENTRY>  
            <BSW-MODULE-ENTRY UUID="afca6318-d2b1-404e-9189-74f4d7d9309f">
              <SHORT-NAME>Cdd_Pwm_SetDigitalCompareEventSource</SHORT-NAME>
              <SERVICE-ID>109</SERVICE-ID>
              <IS-REENTRANT>false</IS-REENTRANT>
              <IS-SYNCHRONOUS>true</IS-SYNCHRONOUS>
              <CALL-TYPE>REGULAR</CALL-TYPE>
              <EXECUTION-CONTEXT>UNSPECIFIED</EXECUTION-CONTEXT>
              <SW-SERVICE-IMPL-POLICY>STANDARD</SW-SERVICE-IMPL-POLICY>
              <BSW-ENTRY-KIND>CONCRETE</BSW-ENTRY-KIND>
            </BSW-MODULE-ENTRY>  
            <BSW-MODULE-ENTRY UUID="7d69ce15-ba70-4912-aa22-d1da773228d8">
              <SHORT-NAME>Cdd_Pwm_SetDigitalCompareEventSyncMode</SHORT-NAME>
              <SERVICE-ID>110</SERVICE-ID>
              <IS-REENTRANT>false</IS-REENTRANT>
              <IS-SYNCHRONOUS>true</IS-SYNCHRONOUS>
              <CALL-TYPE>REGULAR</CALL-TYPE>
              <EXECUTION-CONTEXT>UNSPECIFIED</EXECUTION-CONTEXT>
              <SW-SERVICE-IMPL-POLICY>STANDARD</SW-SERVICE-IMPL-POLICY>
              <BSW-ENTRY-KIND>CONCRETE</BSW-ENTRY-KIND>
            </BSW-MODULE-ENTRY>  
            <BSW-MODULE-ENTRY UUID="8ed51864-6e5f-46c8-ad33-6b303e4783e5">
              <SHORT-NAME>Cdd_Pwm_ConfigureDigitalCompareAdcTrigger</SHORT-NAME>
              <SERVICE-ID>111</SERVICE-ID>
              <IS-REENTRANT>false</IS-REENTRANT>
              <IS-SYNCHRONOUS>true</IS-SYNCHRONOUS>
              <CALL-TYPE>REGULAR</CALL-TYPE>
              <EXECUTION-CONTEXT>UNSPECIFIED</EXECUTION-CONTEXT>
              <SW-SERVICE-IMPL-POLICY>STANDARD</SW-SERVICE-IMPL-POLICY>
              <BSW-ENTRY-KIND>CONCRETE</BSW-ENTRY-KIND>
            </BSW-MODULE-ENTRY>  
            <BSW-MODULE-ENTRY UUID="c14b5e4c-13dc-4fcf-b120-b9b0cb9fcc54">
              <SHORT-NAME>Cdd_Pwm_ConfigureDigitalCompareSyncEvent</SHORT-NAME>
              <SERVICE-ID>112</SERVICE-ID>
              <IS-REENTRANT>false</IS-REENTRANT>
              <IS-SYNCHRONOUS>true</IS-SYNCHRONOUS>
              <CALL-TYPE>REGULAR</CALL-TYPE>
              <EXECUTION-CONTEXT>UNSPECIFIED</EXECUTION-CONTEXT>
              <SW-SERVICE-IMPL-POLICY>STANDARD</SW-SERVICE-IMPL-POLICY>
              <BSW-ENTRY-KIND>CONCRETE</BSW-ENTRY-KIND>
            </BSW-MODULE-ENTRY>  
            <BSW-MODULE-ENTRY UUID="a1364cf6-82d6-491a-a3d3-6ea576ac0e1e">
              <SHORT-NAME>Cdd_Pwm_SetDigitalCompareCBCLatchMode</SHORT-NAME>
              <SERVICE-ID>113</SERVICE-ID>
              <IS-REENTRANT>false</IS-REENTRANT>
              <IS-SYNCHRONOUS>true</IS-SYNCHRONOUS>
              <CALL-TYPE>REGULAR</CALL-TYPE>
              <EXECUTION-CONTEXT>UNSPECIFIED</EXECUTION-CONTEXT>
              <SW-SERVICE-IMPL-POLICY>STANDARD</SW-SERVICE-IMPL-POLICY>
              <BSW-ENTRY-KIND>CONCRETE</BSW-ENTRY-KIND>
            </BSW-MODULE-ENTRY>  
            <BSW-MODULE-ENTRY UUID="af33673a-61fc-4a43-aa5b-80dcf520d416">
              <SHORT-NAME>Cdd_Pwm_SelectDigitalCompareCBCLatchClearEvent</SHORT-NAME>
              <SERVICE-ID>114</SERVICE-ID>
              <IS-REENTRANT>false</IS-REENTRANT>
              <IS-SYNCHRONOUS>true</IS-SYNCHRONOUS>
              <CALL-TYPE>REGULAR</CALL-TYPE>
              <EXECUTION-CONTEXT>UNSPECIFIED</EXECUTION-CONTEXT>
              <SW-SERVICE-IMPL-POLICY>STANDARD</SW-SERVICE-IMPL-POLICY>
              <BSW-ENTRY-KIND>CONCRETE</BSW-ENTRY-KIND>
            </BSW-MODULE-ENTRY>  
            <BSW-MODULE-ENTRY UUID="a4efaf5f-2acb-4706-b8d5-7629d1a6c7ee">
              <SHORT-NAME>Cdd_Pwm_GetDigitalCompareCBCLatchStatus</SHORT-NAME>
              <SERVICE-ID>115</SERVICE-ID>
              <IS-REENTRANT>false</IS-REENTRANT>
              <IS-SYNCHRONOUS>true</IS-SYNCHRONOUS>
              <CALL-TYPE>REGULAR</CALL-TYPE>
              <EXECUTION-CONTEXT>UNSPECIFIED</EXECUTION-CONTEXT>
              <SW-SERVICE-IMPL-POLICY>STANDARD</SW-SERVICE-IMPL-POLICY>
              <BSW-ENTRY-KIND>CONCRETE</BSW-ENTRY-KIND>
            </BSW-MODULE-ENTRY>  
            <BSW-MODULE-ENTRY UUID="44db5c56-da68-443a-ad40-f4cf68e8305d">
              <SHORT-NAME>Cdd_Pwm_ConfigureDigitalCompareCounterCapture</SHORT-NAME>
              <SERVICE-ID>116</SERVICE-ID>
              <IS-REENTRANT>false</IS-REENTRANT>
              <IS-SYNCHRONOUS>true</IS-SYNCHRONOUS>
              <CALL-TYPE>REGULAR</CALL-TYPE>
              <EXECUTION-CONTEXT>UNSPECIFIED</EXECUTION-CONTEXT>
              <SW-SERVICE-IMPL-POLICY>STANDARD</SW-SERVICE-IMPL-POLICY>
              <BSW-ENTRY-KIND>CONCRETE</BSW-ENTRY-KIND>
            </BSW-MODULE-ENTRY>  
            <BSW-MODULE-ENTRY UUID="3ec25edf-9457-42e8-95d0-54403ad7a04c">
              <SHORT-NAME>Cdd_Pwm_SetDigitalCompareCounterShadowMode</SHORT-NAME>
              <SERVICE-ID>117</SERVICE-ID>
              <IS-REENTRANT>false</IS-REENTRANT>
              <IS-SYNCHRONOUS>true</IS-SYNCHRONOUS>
              <CALL-TYPE>REGULAR</CALL-TYPE>
              <EXECUTION-CONTEXT>UNSPECIFIED</EXECUTION-CONTEXT>
              <SW-SERVICE-IMPL-POLICY>STANDARD</SW-SERVICE-IMPL-POLICY>
              <BSW-ENTRY-KIND>CONCRETE</BSW-ENTRY-KIND>
            </BSW-MODULE-ENTRY>  
            <BSW-MODULE-ENTRY UUID="9f0a7522-d2ef-4e28-a14c-afe6380d07b9">
              <SHORT-NAME>Cdd_Pwm_GetDigitalCompareCaptureStatus</SHORT-NAME>
              <SERVICE-ID>118</SERVICE-ID>
              <IS-REENTRANT>false</IS-REENTRANT>
              <IS-SYNCHRONOUS>true</IS-SYNCHRONOUS>
              <CALL-TYPE>REGULAR</CALL-TYPE>
              <EXECUTION-CONTEXT>UNSPECIFIED</EXECUTION-CONTEXT>
              <SW-SERVICE-IMPL-POLICY>STANDARD</SW-SERVICE-IMPL-POLICY>
              <BSW-ENTRY-KIND>CONCRETE</BSW-ENTRY-KIND>
            </BSW-MODULE-ENTRY>  
            <BSW-MODULE-ENTRY UUID="58c32b8a-eedb-406e-81f8-6d4094f95757">
              <SHORT-NAME>Cdd_Pwm_ConfigureDigitalCompareCounterCaptureMode</SHORT-NAME>
              <SERVICE-ID>119</SERVICE-ID>
              <IS-REENTRANT>false</IS-REENTRANT>
              <IS-SYNCHRONOUS>true</IS-SYNCHRONOUS>
              <CALL-TYPE>REGULAR</CALL-TYPE>
              <EXECUTION-CONTEXT>UNSPECIFIED</EXECUTION-CONTEXT>
              <SW-SERVICE-IMPL-POLICY>STANDARD</SW-SERVICE-IMPL-POLICY>
              <BSW-ENTRY-KIND>CONCRETE</BSW-ENTRY-KIND>
            </BSW-MODULE-ENTRY>  
            <BSW-MODULE-ENTRY UUID="92937902-49a5-48c3-99c0-5f2cd36c0c26">
              <SHORT-NAME>Cdd_Pwm_ClearDigitalCompareCaptureStatusFlag</SHORT-NAME>
              <SERVICE-ID>120</SERVICE-ID>
              <IS-REENTRANT>false</IS-REENTRANT>
              <IS-SYNCHRONOUS>true</IS-SYNCHRONOUS>
              <CALL-TYPE>REGULAR</CALL-TYPE>
              <EXECUTION-CONTEXT>UNSPECIFIED</EXECUTION-CONTEXT>
              <SW-SERVICE-IMPL-POLICY>STANDARD</SW-SERVICE-IMPL-POLICY>
              <BSW-ENTRY-KIND>CONCRETE</BSW-ENTRY-KIND>
            </BSW-MODULE-ENTRY>  
            <BSW-MODULE-ENTRY UUID="dc207e90-178a-4eec-834d-983c5aa3d8a5">
              <SHORT-NAME>Cdd_Pwm_GetDigitalCompareCaptureCount</SHORT-NAME>
              <SERVICE-ID>121</SERVICE-ID>
              <IS-REENTRANT>false</IS-REENTRANT>
              <IS-SYNCHRONOUS>true</IS-SYNCHRONOUS>
              <CALL-TYPE>REGULAR</CALL-TYPE>
              <EXECUTION-CONTEXT>UNSPECIFIED</EXECUTION-CONTEXT>
              <SW-SERVICE-IMPL-POLICY>STANDARD</SW-SERVICE-IMPL-POLICY>
              <BSW-ENTRY-KIND>CONCRETE</BSW-ENTRY-KIND>
            </BSW-MODULE-ENTRY>  
            <BSW-MODULE-ENTRY UUID="31aa5df6-db08-4e32-a561-e5a8fa67b00c">
              <SHORT-NAME>Cdd_Pwm_ConfigureDigitalCompareTripCombinationInput</SHORT-NAME>
              <SERVICE-ID>122</SERVICE-ID>
              <IS-REENTRANT>false</IS-REENTRANT>
              <IS-SYNCHRONOUS>true</IS-SYNCHRONOUS>
              <CALL-TYPE>REGULAR</CALL-TYPE>
              <EXECUTION-CONTEXT>UNSPECIFIED</EXECUTION-CONTEXT>
              <SW-SERVICE-IMPL-POLICY>STANDARD</SW-SERVICE-IMPL-POLICY>
              <BSW-ENTRY-KIND>CONCRETE</BSW-ENTRY-KIND>
            </BSW-MODULE-ENTRY>  
            <BSW-MODULE-ENTRY UUID="6241df0a-50d5-44c3-8310-fe4f98a494d2">
              <SHORT-NAME>Cdd_Pwm_ConfigureCaptureInEvent</SHORT-NAME>
              <SERVICE-ID>123</SERVICE-ID>
              <IS-REENTRANT>false</IS-REENTRANT>
              <IS-SYNCHRONOUS>true</IS-SYNCHRONOUS>
              <CALL-TYPE>REGULAR</CALL-TYPE>
              <EXECUTION-CONTEXT>UNSPECIFIED</EXECUTION-CONTEXT>
              <SW-SERVICE-IMPL-POLICY>STANDARD</SW-SERVICE-IMPL-POLICY>
              <BSW-ENTRY-KIND>CONCRETE</BSW-ENTRY-KIND>
            </BSW-MODULE-ENTRY>  
            <BSW-MODULE-ENTRY UUID="fcc656da-b362-447b-9498-38f811558130">
              <SHORT-NAME>Cdd_Pwm_ConfigCaptureGateInputPolarity</SHORT-NAME>
              <SERVICE-ID>124</SERVICE-ID>
              <IS-REENTRANT>false</IS-REENTRANT>
              <IS-SYNCHRONOUS>true</IS-SYNCHRONOUS>
              <CALL-TYPE>REGULAR</CALL-TYPE>
              <EXECUTION-CONTEXT>UNSPECIFIED</EXECUTION-CONTEXT>
              <SW-SERVICE-IMPL-POLICY>STANDARD</SW-SERVICE-IMPL-POLICY>
              <BSW-ENTRY-KIND>CONCRETE</BSW-ENTRY-KIND>
            </BSW-MODULE-ENTRY>  
            <BSW-MODULE-ENTRY UUID="7dab93fb-c5ea-4c8d-91b3-c42b5d7b87e4">
              <SHORT-NAME>Cdd_Pwm_InvertCaptureInputPolarity</SHORT-NAME>
              <SERVICE-ID>125</SERVICE-ID>
              <IS-REENTRANT>false</IS-REENTRANT>
              <IS-SYNCHRONOUS>true</IS-SYNCHRONOUS>
              <CALL-TYPE>REGULAR</CALL-TYPE>
              <EXECUTION-CONTEXT>UNSPECIFIED</EXECUTION-CONTEXT>
              <SW-SERVICE-IMPL-POLICY>STANDARD</SW-SERVICE-IMPL-POLICY>
              <BSW-ENTRY-KIND>CONCRETE</BSW-ENTRY-KIND>
            </BSW-MODULE-ENTRY>  
            <BSW-MODULE-ENTRY UUID="2bc18ee5-b4ae-4a51-a0d3-f7e884ef9fac">
              <SHORT-NAME>Cdd_Pwm_ConfigureIndependentPulseLogic</SHORT-NAME>
              <SERVICE-ID>126</SERVICE-ID>
              <IS-REENTRANT>false</IS-REENTRANT>
              <IS-SYNCHRONOUS>true</IS-SYNCHRONOUS>
              <CALL-TYPE>REGULAR</CALL-TYPE>
              <EXECUTION-CONTEXT>UNSPECIFIED</EXECUTION-CONTEXT>
              <SW-SERVICE-IMPL-POLICY>STANDARD</SW-SERVICE-IMPL-POLICY>
              <BSW-ENTRY-KIND>CONCRETE</BSW-ENTRY-KIND>
            </BSW-MODULE-ENTRY>  
            <BSW-MODULE-ENTRY UUID="de7072ca-3925-4cb9-9f72-dd0497c9f54b">
              <SHORT-NAME>Cdd_Pwm_ForceCaptureEventLoad</SHORT-NAME>
              <SERVICE-ID>127</SERVICE-ID>
              <IS-REENTRANT>false</IS-REENTRANT>
              <IS-SYNCHRONOUS>true</IS-SYNCHRONOUS>
              <CALL-TYPE>REGULAR</CALL-TYPE>
              <EXECUTION-CONTEXT>UNSPECIFIED</EXECUTION-CONTEXT>
              <SW-SERVICE-IMPL-POLICY>STANDARD</SW-SERVICE-IMPL-POLICY>
              <BSW-ENTRY-KIND>CONCRETE</BSW-ENTRY-KIND>
            </BSW-MODULE-ENTRY>  
            <BSW-MODULE-ENTRY UUID="a3a78a7d-0492-4047-95eb-95476e9be237">
              <SHORT-NAME>Cdd_Pwm_SelectCaptureTripInput</SHORT-NAME>
              <SERVICE-ID>128</SERVICE-ID>
              <IS-REENTRANT>false</IS-REENTRANT>
              <IS-SYNCHRONOUS>true</IS-SYNCHRONOUS>
              <CALL-TYPE>REGULAR</CALL-TYPE>
              <EXECUTION-CONTEXT>UNSPECIFIED</EXECUTION-CONTEXT>
              <SW-SERVICE-IMPL-POLICY>STANDARD</SW-SERVICE-IMPL-POLICY>
              <BSW-ENTRY-KIND>CONCRETE</BSW-ENTRY-KIND>
            </BSW-MODULE-ENTRY>  
            <BSW-MODULE-ENTRY UUID="3e97950b-2ca2-4ec7-9dc0-7c578f47672b">
              <SHORT-NAME>Cdd_Pwm_ConfigureCaptureTripCombinationInput</SHORT-NAME>
              <SERVICE-ID>129</SERVICE-ID>
              <IS-REENTRANT>false</IS-REENTRANT>
              <IS-SYNCHRONOUS>true</IS-SYNCHRONOUS>
              <CALL-TYPE>REGULAR</CALL-TYPE>
              <EXECUTION-CONTEXT>UNSPECIFIED</EXECUTION-CONTEXT>
              <SW-SERVICE-IMPL-POLICY>STANDARD</SW-SERVICE-IMPL-POLICY>
              <BSW-ENTRY-KIND>CONCRETE</BSW-ENTRY-KIND>
            </BSW-MODULE-ENTRY>  
            <BSW-MODULE-ENTRY UUID="ca7bb0d0-a2b3-4613-9c6c-0f9e548ef141">
              <SHORT-NAME>Cdd_Pwm_ConfigureValleyCapture</SHORT-NAME>
              <SERVICE-ID>130</SERVICE-ID>
              <IS-REENTRANT>false</IS-REENTRANT>
              <IS-SYNCHRONOUS>true</IS-SYNCHRONOUS>
              <CALL-TYPE>REGULAR</CALL-TYPE>
              <EXECUTION-CONTEXT>UNSPECIFIED</EXECUTION-CONTEXT>
              <SW-SERVICE-IMPL-POLICY>STANDARD</SW-SERVICE-IMPL-POLICY>
              <BSW-ENTRY-KIND>CONCRETE</BSW-ENTRY-KIND>
            </BSW-MODULE-ENTRY>  
            <BSW-MODULE-ENTRY UUID="8cb92379-963d-4c94-bfd8-27e97c430ecc">
              <SHORT-NAME>Cdd_Pwm_StartValleyCapture</SHORT-NAME>
              <SERVICE-ID>131</SERVICE-ID>
              <IS-REENTRANT>false</IS-REENTRANT>
              <IS-SYNCHRONOUS>true</IS-SYNCHRONOUS>
              <CALL-TYPE>REGULAR</CALL-TYPE>
              <EXECUTION-CONTEXT>UNSPECIFIED</EXECUTION-CONTEXT>
              <SW-SERVICE-IMPL-POLICY>STANDARD</SW-SERVICE-IMPL-POLICY>
              <BSW-ENTRY-KIND>CONCRETE</BSW-ENTRY-KIND>
            </BSW-MODULE-ENTRY>  
            <BSW-MODULE-ENTRY UUID="d4aacd25-524b-497f-99bd-0c3adb05dfc6">
              <SHORT-NAME>Cdd_Pwm_SetValleyTriggerSource</SHORT-NAME>
              <SERVICE-ID>132</SERVICE-ID>
              <IS-REENTRANT>false</IS-REENTRANT>
              <IS-SYNCHRONOUS>true</IS-SYNCHRONOUS>
              <CALL-TYPE>REGULAR</CALL-TYPE>
              <EXECUTION-CONTEXT>UNSPECIFIED</EXECUTION-CONTEXT>
              <SW-SERVICE-IMPL-POLICY>STANDARD</SW-SERVICE-IMPL-POLICY>
              <BSW-ENTRY-KIND>CONCRETE</BSW-ENTRY-KIND>
            </BSW-MODULE-ENTRY>  
            <BSW-MODULE-ENTRY UUID="56950a8a-b814-4dbb-81ca-9d40997c8a27">
              <SHORT-NAME>Cdd_Pwm_SetValleyTriggerEdgeCounts</SHORT-NAME>
              <SERVICE-ID>133</SERVICE-ID>
              <IS-REENTRANT>false</IS-REENTRANT>
              <IS-SYNCHRONOUS>true</IS-SYNCHRONOUS>
              <CALL-TYPE>REGULAR</CALL-TYPE>
              <EXECUTION-CONTEXT>UNSPECIFIED</EXECUTION-CONTEXT>
              <SW-SERVICE-IMPL-POLICY>STANDARD</SW-SERVICE-IMPL-POLICY>
              <BSW-ENTRY-KIND>CONCRETE</BSW-ENTRY-KIND>
            </BSW-MODULE-ENTRY>  
            <BSW-MODULE-ENTRY UUID="c44cdbb5-4e88-4852-8b5b-0e8372ccb2ce">
              <SHORT-NAME>Cdd_Pwm_ConfigureValleyHwDelay</SHORT-NAME>
              <SERVICE-ID>134</SERVICE-ID>
              <IS-REENTRANT>false</IS-REENTRANT>
              <IS-SYNCHRONOUS>true</IS-SYNCHRONOUS>
              <CALL-TYPE>REGULAR</CALL-TYPE>
              <EXECUTION-CONTEXT>UNSPECIFIED</EXECUTION-CONTEXT>
              <SW-SERVICE-IMPL-POLICY>STANDARD</SW-SERVICE-IMPL-POLICY>
              <BSW-ENTRY-KIND>CONCRETE</BSW-ENTRY-KIND>
            </BSW-MODULE-ENTRY>  
            <BSW-MODULE-ENTRY UUID="f7b6583f-7004-4787-850d-55cd6f40961c">
              <SHORT-NAME>Cdd_Pwm_SetValleySwDelayValue</SHORT-NAME>
              <SERVICE-ID>135</SERVICE-ID>
              <IS-REENTRANT>false</IS-REENTRANT>
              <IS-SYNCHRONOUS>true</IS-SYNCHRONOUS>
              <CALL-TYPE>REGULAR</CALL-TYPE>
              <EXECUTION-CONTEXT>UNSPECIFIED</EXECUTION-CONTEXT>
              <SW-SERVICE-IMPL-POLICY>STANDARD</SW-SERVICE-IMPL-POLICY>
              <BSW-ENTRY-KIND>CONCRETE</BSW-ENTRY-KIND>
            </BSW-MODULE-ENTRY>  
            <BSW-MODULE-ENTRY UUID="c5f3e600-67a0-415a-a2ec-a1d30f8318ec">
              <SHORT-NAME>Cdd_Pwm_SetValleyDelayDivider</SHORT-NAME>
              <SERVICE-ID>136</SERVICE-ID>
              <IS-REENTRANT>false</IS-REENTRANT>
              <IS-SYNCHRONOUS>true</IS-SYNCHRONOUS>
              <CALL-TYPE>REGULAR</CALL-TYPE>
              <EXECUTION-CONTEXT>UNSPECIFIED</EXECUTION-CONTEXT>
              <SW-SERVICE-IMPL-POLICY>STANDARD</SW-SERVICE-IMPL-POLICY>
              <BSW-ENTRY-KIND>CONCRETE</BSW-ENTRY-KIND>
            </BSW-MODULE-ENTRY>  
            <BSW-MODULE-ENTRY UUID="a364d81b-d15c-4fa6-9786-a2fdfb54fd2e">
              <SHORT-NAME>Cdd_Pwm_GetValleyEdgeStatus</SHORT-NAME>
              <SERVICE-ID>137</SERVICE-ID>
              <IS-REENTRANT>false</IS-REENTRANT>
              <IS-SYNCHRONOUS>true</IS-SYNCHRONOUS>
              <CALL-TYPE>REGULAR</CALL-TYPE>
              <EXECUTION-CONTEXT>UNSPECIFIED</EXECUTION-CONTEXT>
              <SW-SERVICE-IMPL-POLICY>STANDARD</SW-SERVICE-IMPL-POLICY>
              <BSW-ENTRY-KIND>CONCRETE</BSW-ENTRY-KIND>
            </BSW-MODULE-ENTRY>  
            <BSW-MODULE-ENTRY UUID="809393a4-adf9-4c77-89d9-cc80186ca1e5">
              <SHORT-NAME>Cdd_Pwm_GetValleyCount</SHORT-NAME>
              <SERVICE-ID>138</SERVICE-ID>
              <IS-REENTRANT>false</IS-REENTRANT>
              <IS-SYNCHRONOUS>true</IS-SYNCHRONOUS>
              <CALL-TYPE>REGULAR</CALL-TYPE>
              <EXECUTION-CONTEXT>UNSPECIFIED</EXECUTION-CONTEXT>
              <SW-SERVICE-IMPL-POLICY>STANDARD</SW-SERVICE-IMPL-POLICY>
              <BSW-ENTRY-KIND>CONCRETE</BSW-ENTRY-KIND>
            </BSW-MODULE-ENTRY>  
            <BSW-MODULE-ENTRY UUID="2f3dfda6-981a-45d6-b4cf-69a03a78e83e">
              <SHORT-NAME>Cdd_Pwm_GetValleyHwDelay</SHORT-NAME>
              <SERVICE-ID>139</SERVICE-ID>
              <IS-REENTRANT>false</IS-REENTRANT>
              <IS-SYNCHRONOUS>true</IS-SYNCHRONOUS>
              <CALL-TYPE>REGULAR</CALL-TYPE>
              <EXECUTION-CONTEXT>UNSPECIFIED</EXECUTION-CONTEXT>
              <SW-SERVICE-IMPL-POLICY>STANDARD</SW-SERVICE-IMPL-POLICY>
              <BSW-ENTRY-KIND>CONCRETE</BSW-ENTRY-KIND>
            </BSW-MODULE-ENTRY>  
            <BSW-MODULE-ENTRY UUID="ee4ef118-8611-448a-903a-c5d0b52291f4">
              <SHORT-NAME>Cdd_Pwm_ConfigureGlobalLoad</SHORT-NAME>
              <SERVICE-ID>140</SERVICE-ID>
              <IS-REENTRANT>false</IS-REENTRANT>
              <IS-SYNCHRONOUS>true</IS-SYNCHRONOUS>
              <CALL-TYPE>REGULAR</CALL-TYPE>
              <EXECUTION-CONTEXT>UNSPECIFIED</EXECUTION-CONTEXT>
              <SW-SERVICE-IMPL-POLICY>STANDARD</SW-SERVICE-IMPL-POLICY>
              <BSW-ENTRY-KIND>CONCRETE</BSW-ENTRY-KIND>
            </BSW-MODULE-ENTRY>  
            <BSW-MODULE-ENTRY UUID="f4701f4f-2181-4197-b961-6215acabee6a">
              <SHORT-NAME>Cdd_Pwm_SetGlobalLoadTrigger</SHORT-NAME>
              <SERVICE-ID>141</SERVICE-ID>
              <IS-REENTRANT>false</IS-REENTRANT>
              <IS-SYNCHRONOUS>true</IS-SYNCHRONOUS>
              <CALL-TYPE>REGULAR</CALL-TYPE>
              <EXECUTION-CONTEXT>UNSPECIFIED</EXECUTION-CONTEXT>
              <SW-SERVICE-IMPL-POLICY>STANDARD</SW-SERVICE-IMPL-POLICY>
              <BSW-ENTRY-KIND>CONCRETE</BSW-ENTRY-KIND>
            </BSW-MODULE-ENTRY>  
            <BSW-MODULE-ENTRY UUID="6dc63c46-a4ea-4e59-97bb-701ee5be0ac5">
              <SHORT-NAME>Cdd_Pwm_SetGlobalLoadEventPrescale</SHORT-NAME>
              <SERVICE-ID>142</SERVICE-ID>
              <IS-REENTRANT>false</IS-REENTRANT>
              <IS-SYNCHRONOUS>true</IS-SYNCHRONOUS>
              <CALL-TYPE>REGULAR</CALL-TYPE>
              <EXECUTION-CONTEXT>UNSPECIFIED</EXECUTION-CONTEXT>
              <SW-SERVICE-IMPL-POLICY>STANDARD</SW-SERVICE-IMPL-POLICY>
              <BSW-ENTRY-KIND>CONCRETE</BSW-ENTRY-KIND>
            </BSW-MODULE-ENTRY>  
            <BSW-MODULE-ENTRY UUID="0a6ea403-bc18-42d0-b175-868f16c1f475">
              <SHORT-NAME>Cdd_Pwm_GetGlobalLoadEventCount</SHORT-NAME>
              <SERVICE-ID>143</SERVICE-ID>
              <IS-REENTRANT>false</IS-REENTRANT>
              <IS-SYNCHRONOUS>true</IS-SYNCHRONOUS>
              <CALL-TYPE>REGULAR</CALL-TYPE>
              <EXECUTION-CONTEXT>UNSPECIFIED</EXECUTION-CONTEXT>
              <SW-SERVICE-IMPL-POLICY>STANDARD</SW-SERVICE-IMPL-POLICY>
              <BSW-ENTRY-KIND>CONCRETE</BSW-ENTRY-KIND>
            </BSW-MODULE-ENTRY>  
            <BSW-MODULE-ENTRY UUID="77004e4e-cbdc-456e-ac88-7b324ff9d86c">
              <SHORT-NAME>Cdd_Pwm_SetGlobalLoadOneShotLatch</SHORT-NAME>
              <SERVICE-ID>144</SERVICE-ID>
              <IS-REENTRANT>false</IS-REENTRANT>
              <IS-SYNCHRONOUS>true</IS-SYNCHRONOUS>
              <CALL-TYPE>REGULAR</CALL-TYPE>
              <EXECUTION-CONTEXT>UNSPECIFIED</EXECUTION-CONTEXT>
              <SW-SERVICE-IMPL-POLICY>STANDARD</SW-SERVICE-IMPL-POLICY>
              <BSW-ENTRY-KIND>CONCRETE</BSW-ENTRY-KIND>
            </BSW-MODULE-ENTRY>  
            <BSW-MODULE-ENTRY UUID="54ec033e-fd43-4ba7-ab51-8ebd53b2c06f">
              <SHORT-NAME>Cdd_Pwm_ConfigureGlobalLoadOneShotMode</SHORT-NAME>
              <SERVICE-ID>145</SERVICE-ID>
              <IS-REENTRANT>false</IS-REENTRANT>
              <IS-SYNCHRONOUS>true</IS-SYNCHRONOUS>
              <CALL-TYPE>REGULAR</CALL-TYPE>
              <EXECUTION-CONTEXT>UNSPECIFIED</EXECUTION-CONTEXT>
              <SW-SERVICE-IMPL-POLICY>STANDARD</SW-SERVICE-IMPL-POLICY>
              <BSW-ENTRY-KIND>CONCRETE</BSW-ENTRY-KIND>
            </BSW-MODULE-ENTRY>  
            <BSW-MODULE-ENTRY UUID="1adf1cc8-a04b-4511-a566-d05cee8dbd38">
              <SHORT-NAME>Cdd_Pwm_ForceGlobalLoadOneShotEvent</SHORT-NAME>
              <SERVICE-ID>146</SERVICE-ID>
              <IS-REENTRANT>false</IS-REENTRANT>
              <IS-SYNCHRONOUS>true</IS-SYNCHRONOUS>
              <CALL-TYPE>REGULAR</CALL-TYPE>
              <EXECUTION-CONTEXT>UNSPECIFIED</EXECUTION-CONTEXT>
              <SW-SERVICE-IMPL-POLICY>STANDARD</SW-SERVICE-IMPL-POLICY>
              <BSW-ENTRY-KIND>CONCRETE</BSW-ENTRY-KIND>
            </BSW-MODULE-ENTRY>  
            <BSW-MODULE-ENTRY UUID="43b92ae0-7266-462c-b62d-f9792dad5447">
              <SHORT-NAME>Cdd_Pwm_ConfigureGlobalLoadRegisters</SHORT-NAME>
              <SERVICE-ID>147</SERVICE-ID>
              <IS-REENTRANT>false</IS-REENTRANT>
              <IS-SYNCHRONOUS>true</IS-SYNCHRONOUS>
              <CALL-TYPE>REGULAR</CALL-TYPE>
              <EXECUTION-CONTEXT>UNSPECIFIED</EXECUTION-CONTEXT>
              <SW-SERVICE-IMPL-POLICY>STANDARD</SW-SERVICE-IMPL-POLICY>
              <BSW-ENTRY-KIND>CONCRETE</BSW-ENTRY-KIND>
            </BSW-MODULE-ENTRY>  
            <BSW-MODULE-ENTRY UUID="a04dcbd5-0bc8-4b7c-a109-2ef5ba18cd7a">
              <SHORT-NAME>Cdd_Pwm_LockRegisters</SHORT-NAME>
              <SERVICE-ID>148</SERVICE-ID>
              <IS-REENTRANT>false</IS-REENTRANT>
              <IS-SYNCHRONOUS>true</IS-SYNCHRONOUS>
              <CALL-TYPE>REGULAR</CALL-TYPE>
              <EXECUTION-CONTEXT>UNSPECIFIED</EXECUTION-CONTEXT>
              <SW-SERVICE-IMPL-POLICY>STANDARD</SW-SERVICE-IMPL-POLICY>
              <BSW-ENTRY-KIND>CONCRETE</BSW-ENTRY-KIND>
            </BSW-MODULE-ENTRY>  
            <BSW-MODULE-ENTRY UUID="04cee44f-cd7c-411e-b6e3-49f321c50acf">
              <SHORT-NAME>Cdd_Pwm_ConfigureXCmpMode</SHORT-NAME>
              <SERVICE-ID>149</SERVICE-ID>
              <IS-REENTRANT>false</IS-REENTRANT>
              <IS-SYNCHRONOUS>true</IS-SYNCHRONOUS>
              <CALL-TYPE>REGULAR</CALL-TYPE>
              <EXECUTION-CONTEXT>UNSPECIFIED</EXECUTION-CONTEXT>
              <SW-SERVICE-IMPL-POLICY>STANDARD</SW-SERVICE-IMPL-POLICY>
              <BSW-ENTRY-KIND>CONCRETE</BSW-ENTRY-KIND>
            </BSW-MODULE-ENTRY>  
            <BSW-MODULE-ENTRY UUID="8a71a377-b865-4f03-ba20-384ca07216fd">
              <SHORT-NAME>Cdd_Pwm_ConfigureSplitXCmp</SHORT-NAME>
              <SERVICE-ID>150</SERVICE-ID>
              <IS-REENTRANT>false</IS-REENTRANT>
              <IS-SYNCHRONOUS>true</IS-SYNCHRONOUS>
              <CALL-TYPE>REGULAR</CALL-TYPE>
              <EXECUTION-CONTEXT>UNSPECIFIED</EXECUTION-CONTEXT>
              <SW-SERVICE-IMPL-POLICY>STANDARD</SW-SERVICE-IMPL-POLICY>
              <BSW-ENTRY-KIND>CONCRETE</BSW-ENTRY-KIND>
            </BSW-MODULE-ENTRY>  
            <BSW-MODULE-ENTRY UUID="e66644d1-63d4-4c36-8d9e-fbf24d6f25d3">
              <SHORT-NAME>Cdd_Pwm_AllocAXCmp</SHORT-NAME>
              <SERVICE-ID>151</SERVICE-ID>
              <IS-REENTRANT>false</IS-REENTRANT>
              <IS-SYNCHRONOUS>true</IS-SYNCHRONOUS>
              <CALL-TYPE>REGULAR</CALL-TYPE>
              <EXECUTION-CONTEXT>UNSPECIFIED</EXECUTION-CONTEXT>
              <SW-SERVICE-IMPL-POLICY>STANDARD</SW-SERVICE-IMPL-POLICY>
              <BSW-ENTRY-KIND>CONCRETE</BSW-ENTRY-KIND>
            </BSW-MODULE-ENTRY>  
            <BSW-MODULE-ENTRY UUID="97d0f36d-eaec-44df-b55b-ed582bf5a2f8">
              <SHORT-NAME>Cdd_Pwm_AllocBXCmp</SHORT-NAME>
              <SERVICE-ID>152</SERVICE-ID>
              <IS-REENTRANT>false</IS-REENTRANT>
              <IS-SYNCHRONOUS>true</IS-SYNCHRONOUS>
              <CALL-TYPE>REGULAR</CALL-TYPE>
              <EXECUTION-CONTEXT>UNSPECIFIED</EXECUTION-CONTEXT>
              <SW-SERVICE-IMPL-POLICY>STANDARD</SW-SERVICE-IMPL-POLICY>
              <BSW-ENTRY-KIND>CONCRETE</BSW-ENTRY-KIND>
            </BSW-MODULE-ENTRY>  
            <BSW-MODULE-ENTRY UUID="34d07666-078c-4a4e-84cd-7710a86222ad">
              <SHORT-NAME>Cdd_Pwm_SetXCmpRegValue</SHORT-NAME>
              <SERVICE-ID>153</SERVICE-ID>
              <IS-REENTRANT>false</IS-REENTRANT>
              <IS-SYNCHRONOUS>true</IS-SYNCHRONOUS>
              <CALL-TYPE>REGULAR</CALL-TYPE>
              <EXECUTION-CONTEXT>UNSPECIFIED</EXECUTION-CONTEXT>
              <SW-SERVICE-IMPL-POLICY>STANDARD</SW-SERVICE-IMPL-POLICY>
              <BSW-ENTRY-KIND>CONCRETE</BSW-ENTRY-KIND>
            </BSW-MODULE-ENTRY>  
            <BSW-MODULE-ENTRY UUID="544ab9af-5106-4736-a510-816a9f726f03">
              <SHORT-NAME>Cdd_Pwm_SetCmpShadowRegValue</SHORT-NAME>
              <SERVICE-ID>154</SERVICE-ID>
              <IS-REENTRANT>false</IS-REENTRANT>
              <IS-SYNCHRONOUS>true</IS-SYNCHRONOUS>
              <CALL-TYPE>REGULAR</CALL-TYPE>
              <EXECUTION-CONTEXT>UNSPECIFIED</EXECUTION-CONTEXT>
              <SW-SERVICE-IMPL-POLICY>STANDARD</SW-SERVICE-IMPL-POLICY>
              <BSW-ENTRY-KIND>CONCRETE</BSW-ENTRY-KIND>
            </BSW-MODULE-ENTRY>  
            <BSW-MODULE-ENTRY UUID="dc8fd9cb-faba-4479-8a8b-f10ea37d3bfe">
              <SHORT-NAME>Cdd_Pwm_SetXMinMaxRegValue</SHORT-NAME>
              <SERVICE-ID>155</SERVICE-ID>
              <IS-REENTRANT>false</IS-REENTRANT>
              <IS-SYNCHRONOUS>true</IS-SYNCHRONOUS>
              <CALL-TYPE>REGULAR</CALL-TYPE>
              <EXECUTION-CONTEXT>UNSPECIFIED</EXECUTION-CONTEXT>
              <SW-SERVICE-IMPL-POLICY>STANDARD</SW-SERVICE-IMPL-POLICY>
              <BSW-ENTRY-KIND>CONCRETE</BSW-ENTRY-KIND>
            </BSW-MODULE-ENTRY>  
            <BSW-MODULE-ENTRY UUID="35896cb6-4c30-4687-86f1-cc621f5c0699">
              <SHORT-NAME>Cdd_Pwm_SetXCmpActionQualifierAction</SHORT-NAME>
              <SERVICE-ID>156</SERVICE-ID>
              <IS-REENTRANT>false</IS-REENTRANT>
              <IS-SYNCHRONOUS>true</IS-SYNCHRONOUS>
              <CALL-TYPE>REGULAR</CALL-TYPE>
              <EXECUTION-CONTEXT>UNSPECIFIED</EXECUTION-CONTEXT>
              <SW-SERVICE-IMPL-POLICY>STANDARD</SW-SERVICE-IMPL-POLICY>
              <BSW-ENTRY-KIND>CONCRETE</BSW-ENTRY-KIND>
            </BSW-MODULE-ENTRY>  
            <BSW-MODULE-ENTRY UUID="53bfac6a-c199-4b35-b04c-6ec255fa3f97">
              <SHORT-NAME>Cdd_Pwm_EnableXLoad</SHORT-NAME>
              <SERVICE-ID>157</SERVICE-ID>
              <IS-REENTRANT>false</IS-REENTRANT>
              <IS-SYNCHRONOUS>true</IS-SYNCHRONOUS>
              <CALL-TYPE>REGULAR</CALL-TYPE>
              <EXECUTION-CONTEXT>UNSPECIFIED</EXECUTION-CONTEXT>
              <SW-SERVICE-IMPL-POLICY>STANDARD</SW-SERVICE-IMPL-POLICY>
              <BSW-ENTRY-KIND>CONCRETE</BSW-ENTRY-KIND>
            </BSW-MODULE-ENTRY>  
            <BSW-MODULE-ENTRY UUID="1d3bc59b-a691-4a87-b41c-4f210f0b4668">
              <SHORT-NAME>Cdd_Pwm_ForceXLoad</SHORT-NAME>
              <SERVICE-ID>158</SERVICE-ID>
              <IS-REENTRANT>false</IS-REENTRANT>
              <IS-SYNCHRONOUS>true</IS-SYNCHRONOUS>
              <CALL-TYPE>REGULAR</CALL-TYPE>
              <EXECUTION-CONTEXT>UNSPECIFIED</EXECUTION-CONTEXT>
              <SW-SERVICE-IMPL-POLICY>STANDARD</SW-SERVICE-IMPL-POLICY>
              <BSW-ENTRY-KIND>CONCRETE</BSW-ENTRY-KIND>
            </BSW-MODULE-ENTRY>  
            <BSW-MODULE-ENTRY UUID="cb74ee39-36e6-4b8e-83ce-cab939c5bfa9">
              <SHORT-NAME>Cdd_Pwm_SetXCmpLoadMode</SHORT-NAME>
              <SERVICE-ID>159</SERVICE-ID>
              <IS-REENTRANT>false</IS-REENTRANT>
              <IS-SYNCHRONOUS>true</IS-SYNCHRONOUS>
              <CALL-TYPE>REGULAR</CALL-TYPE>
              <EXECUTION-CONTEXT>UNSPECIFIED</EXECUTION-CONTEXT>
              <SW-SERVICE-IMPL-POLICY>STANDARD</SW-SERVICE-IMPL-POLICY>
              <BSW-ENTRY-KIND>CONCRETE</BSW-ENTRY-KIND>
            </BSW-MODULE-ENTRY>  
            <BSW-MODULE-ENTRY UUID="52ee488d-17b4-44ed-bf84-cf44940bd98d">
              <SHORT-NAME>Cdd_Pwm_SetXCmpShadowLevel</SHORT-NAME>
              <SERVICE-ID>160</SERVICE-ID>
              <IS-REENTRANT>false</IS-REENTRANT>
              <IS-SYNCHRONOUS>true</IS-SYNCHRONOUS>
              <CALL-TYPE>REGULAR</CALL-TYPE>
              <EXECUTION-CONTEXT>UNSPECIFIED</EXECUTION-CONTEXT>
              <SW-SERVICE-IMPL-POLICY>STANDARD</SW-SERVICE-IMPL-POLICY>
              <BSW-ENTRY-KIND>CONCRETE</BSW-ENTRY-KIND>
            </BSW-MODULE-ENTRY>  
            <BSW-MODULE-ENTRY UUID="7411cfdb-f390-463b-aec2-11cb7622ebda">
              <SHORT-NAME>Cdd_Pwm_SetXCmpShadowBufPtrLoadOnce</SHORT-NAME>
              <SERVICE-ID>161</SERVICE-ID>
              <IS-REENTRANT>false</IS-REENTRANT>
              <IS-SYNCHRONOUS>true</IS-SYNCHRONOUS>
              <CALL-TYPE>REGULAR</CALL-TYPE>
              <EXECUTION-CONTEXT>UNSPECIFIED</EXECUTION-CONTEXT>
              <SW-SERVICE-IMPL-POLICY>STANDARD</SW-SERVICE-IMPL-POLICY>
              <BSW-ENTRY-KIND>CONCRETE</BSW-ENTRY-KIND>
            </BSW-MODULE-ENTRY>  
            <BSW-MODULE-ENTRY UUID="90c13b87-6e18-4332-9b0b-88f5a5d94caa">
              <SHORT-NAME>Cdd_Pwm_SetXCmpShadowRepeatBufxCount</SHORT-NAME>
              <SERVICE-ID>162</SERVICE-ID>
              <IS-REENTRANT>false</IS-REENTRANT>
              <IS-SYNCHRONOUS>true</IS-SYNCHRONOUS>
              <CALL-TYPE>REGULAR</CALL-TYPE>
              <EXECUTION-CONTEXT>UNSPECIFIED</EXECUTION-CONTEXT>
              <SW-SERVICE-IMPL-POLICY>STANDARD</SW-SERVICE-IMPL-POLICY>
              <BSW-ENTRY-KIND>CONCRETE</BSW-ENTRY-KIND>
            </BSW-MODULE-ENTRY>  
            <BSW-MODULE-ENTRY UUID="5cda895f-5f6a-4854-a6ed-781c69dc98c1">
              <SHORT-NAME>Cdd_Pwm_ConfigureMinimumDeadBand</SHORT-NAME>
              <SERVICE-ID>163</SERVICE-ID>
              <IS-REENTRANT>false</IS-REENTRANT>
              <IS-SYNCHRONOUS>true</IS-SYNCHRONOUS>
              <CALL-TYPE>REGULAR</CALL-TYPE>
              <EXECUTION-CONTEXT>UNSPECIFIED</EXECUTION-CONTEXT>
              <SW-SERVICE-IMPL-POLICY>STANDARD</SW-SERVICE-IMPL-POLICY>
              <BSW-ENTRY-KIND>CONCRETE</BSW-ENTRY-KIND>
            </BSW-MODULE-ENTRY>  
            <BSW-MODULE-ENTRY UUID="b63baf76-1822-466f-84a3-9331468757f6">
              <SHORT-NAME>Cdd_Pwm_InvertMinimumDeadBandSignal</SHORT-NAME>
              <SERVICE-ID>164</SERVICE-ID>
              <IS-REENTRANT>false</IS-REENTRANT>
              <IS-SYNCHRONOUS>true</IS-SYNCHRONOUS>
              <CALL-TYPE>REGULAR</CALL-TYPE>
              <EXECUTION-CONTEXT>UNSPECIFIED</EXECUTION-CONTEXT>
              <SW-SERVICE-IMPL-POLICY>STANDARD</SW-SERVICE-IMPL-POLICY>
              <BSW-ENTRY-KIND>CONCRETE</BSW-ENTRY-KIND>
            </BSW-MODULE-ENTRY>  
            <BSW-MODULE-ENTRY UUID="a9f4249b-3b40-4b6f-87cc-a9a99a95fcc6">
              <SHORT-NAME>Cdd_Pwm_SelectMinimumDeadBandAndOrLogic</SHORT-NAME>
              <SERVICE-ID>165</SERVICE-ID>
              <IS-REENTRANT>false</IS-REENTRANT>
              <IS-SYNCHRONOUS>true</IS-SYNCHRONOUS>
              <CALL-TYPE>REGULAR</CALL-TYPE>
              <EXECUTION-CONTEXT>UNSPECIFIED</EXECUTION-CONTEXT>
              <SW-SERVICE-IMPL-POLICY>STANDARD</SW-SERVICE-IMPL-POLICY>
              <BSW-ENTRY-KIND>CONCRETE</BSW-ENTRY-KIND>
            </BSW-MODULE-ENTRY>  
            <BSW-MODULE-ENTRY UUID="a43b9dc5-8415-43e9-b8b3-b037e3325ab2">
              <SHORT-NAME>Cdd_Pwm_SelectMinimumDeadBandBlockingSignal</SHORT-NAME>
              <SERVICE-ID>166</SERVICE-ID>
              <IS-REENTRANT>false</IS-REENTRANT>
              <IS-SYNCHRONOUS>true</IS-SYNCHRONOUS>
              <CALL-TYPE>REGULAR</CALL-TYPE>
              <EXECUTION-CONTEXT>UNSPECIFIED</EXECUTION-CONTEXT>
              <SW-SERVICE-IMPL-POLICY>STANDARD</SW-SERVICE-IMPL-POLICY>
              <BSW-ENTRY-KIND>CONCRETE</BSW-ENTRY-KIND>
            </BSW-MODULE-ENTRY>  
            <BSW-MODULE-ENTRY UUID="65b6f8e8-1c23-4426-aa89-c3fb224d61d2">
              <SHORT-NAME>Cdd_Pwm_SelectMinimumDeadBandReferenceSignal</SHORT-NAME>
              <SERVICE-ID>167</SERVICE-ID>
              <IS-REENTRANT>false</IS-REENTRANT>
              <IS-SYNCHRONOUS>true</IS-SYNCHRONOUS>
              <CALL-TYPE>REGULAR</CALL-TYPE>
              <EXECUTION-CONTEXT>UNSPECIFIED</EXECUTION-CONTEXT>
              <SW-SERVICE-IMPL-POLICY>STANDARD</SW-SERVICE-IMPL-POLICY>
              <BSW-ENTRY-KIND>CONCRETE</BSW-ENTRY-KIND>
            </BSW-MODULE-ENTRY>  
            <BSW-MODULE-ENTRY UUID="c079ed37-32ca-40ad-aac8-70a9dcbf7d10">
              <SHORT-NAME>Cdd_Pwm_DisableDeadBandControlShadowLoadMode</SHORT-NAME>
              <SERVICE-ID>168</SERVICE-ID>
              <IS-REENTRANT>false</IS-REENTRANT>
              <IS-SYNCHRONOUS>true</IS-SYNCHRONOUS>
              <CALL-TYPE>REGULAR</CALL-TYPE>
              <EXECUTION-CONTEXT>UNSPECIFIED</EXECUTION-CONTEXT>
              <SW-SERVICE-IMPL-POLICY>STANDARD</SW-SERVICE-IMPL-POLICY>
              <BSW-ENTRY-KIND>CONCRETE</BSW-ENTRY-KIND>
            </BSW-MODULE-ENTRY>  
            <BSW-MODULE-ENTRY UUID="9f615611-f6ed-4ea6-a0fa-d3bf25a6dfcb">
              <SHORT-NAME>Cdd_Pwm_GetMinDeadBandDelay</SHORT-NAME>
              <SERVICE-ID>169</SERVICE-ID>
              <IS-REENTRANT>false</IS-REENTRANT>
              <IS-SYNCHRONOUS>true</IS-SYNCHRONOUS>
              <CALL-TYPE>REGULAR</CALL-TYPE>
              <EXECUTION-CONTEXT>UNSPECIFIED</EXECUTION-CONTEXT>
              <SW-SERVICE-IMPL-POLICY>STANDARD</SW-SERVICE-IMPL-POLICY>
              <BSW-ENTRY-KIND>CONCRETE</BSW-ENTRY-KIND>
            </BSW-MODULE-ENTRY>  
            <BSW-MODULE-ENTRY UUID="94f8cbea-289c-4a2b-8791-8ea7b92ad1c1">
              <SHORT-NAME>Cdd_Pwm_SetMinimumDeadBandDelay</SHORT-NAME>
              <SERVICE-ID>170</SERVICE-ID>
              <IS-REENTRANT>false</IS-REENTRANT>
              <IS-SYNCHRONOUS>true</IS-SYNCHRONOUS>
              <CALL-TYPE>REGULAR</CALL-TYPE>
              <EXECUTION-CONTEXT>UNSPECIFIED</EXECUTION-CONTEXT>
              <SW-SERVICE-IMPL-POLICY>STANDARD</SW-SERVICE-IMPL-POLICY>
              <BSW-ENTRY-KIND>CONCRETE</BSW-ENTRY-KIND>
            </BSW-MODULE-ENTRY>  
            <BSW-MODULE-ENTRY UUID="6955c802-0567-4853-9df9-57d9daad468c">
              <SHORT-NAME>Cdd_Pwm_SelectDigitalCompareTripInput</SHORT-NAME>
              <SERVICE-ID>171</SERVICE-ID>
              <IS-REENTRANT>false</IS-REENTRANT>
              <IS-SYNCHRONOUS>true</IS-SYNCHRONOUS>
              <CALL-TYPE>REGULAR</CALL-TYPE>
              <EXECUTION-CONTEXT>UNSPECIFIED</EXECUTION-CONTEXT>
              <SW-SERVICE-IMPL-POLICY>STANDARD</SW-SERVICE-IMPL-POLICY>
              <BSW-ENTRY-KIND>CONCRETE</BSW-ENTRY-KIND>
            </BSW-MODULE-ENTRY>  
            <BSW-MODULE-ENTRY UUID="5ed146e6-570a-4099-a911-89b9e9d39332">
              <SHORT-NAME>Cdd_Pwm_ConfigureIllegalComboLogic</SHORT-NAME>
              <SERVICE-ID>172</SERVICE-ID>
              <IS-REENTRANT>false</IS-REENTRANT>
              <IS-SYNCHRONOUS>true</IS-SYNCHRONOUS>
              <CALL-TYPE>REGULAR</CALL-TYPE>
              <EXECUTION-CONTEXT>UNSPECIFIED</EXECUTION-CONTEXT>
              <SW-SERVICE-IMPL-POLICY>STANDARD</SW-SERVICE-IMPL-POLICY>
              <BSW-ENTRY-KIND>CONCRETE</BSW-ENTRY-KIND>
            </BSW-MODULE-ENTRY>  
            <BSW-MODULE-ENTRY UUID="a9bd09e1-e447-4a66-b947-bc8de4444a58">
              <SHORT-NAME>Cdd_Pwm_SelectXbarInput</SHORT-NAME>
              <SERVICE-ID>173</SERVICE-ID>
              <IS-REENTRANT>false</IS-REENTRANT>
              <IS-SYNCHRONOUS>true</IS-SYNCHRONOUS>
              <CALL-TYPE>REGULAR</CALL-TYPE>
              <EXECUTION-CONTEXT>UNSPECIFIED</EXECUTION-CONTEXT>
              <SW-SERVICE-IMPL-POLICY>STANDARD</SW-SERVICE-IMPL-POLICY>
              <BSW-ENTRY-KIND>CONCRETE</BSW-ENTRY-KIND>
            </BSW-MODULE-ENTRY>  
            <BSW-MODULE-ENTRY UUID="fe592f25-9a29-4f18-9825-7fb4b5ad6d6b">
              <SHORT-NAME>Cdd_Pwm_SetLutDecX</SHORT-NAME>
              <SERVICE-ID>174</SERVICE-ID>
              <IS-REENTRANT>false</IS-REENTRANT>
              <IS-SYNCHRONOUS>true</IS-SYNCHRONOUS>
              <CALL-TYPE>REGULAR</CALL-TYPE>
              <EXECUTION-CONTEXT>UNSPECIFIED</EXECUTION-CONTEXT>
              <SW-SERVICE-IMPL-POLICY>STANDARD</SW-SERVICE-IMPL-POLICY>
              <BSW-ENTRY-KIND>CONCRETE</BSW-ENTRY-KIND>
            </BSW-MODULE-ENTRY>  
            <BSW-MODULE-ENTRY UUID="8e48c194-0e3a-495b-86ca-4e6859a0988d">
              <SHORT-NAME>Cdd_Pwm_ConfigureDiodeEmulationMode</SHORT-NAME>
              <SERVICE-ID>175</SERVICE-ID>
              <IS-REENTRANT>false</IS-REENTRANT>
              <IS-SYNCHRONOUS>true</IS-SYNCHRONOUS>
              <CALL-TYPE>REGULAR</CALL-TYPE>
              <EXECUTION-CONTEXT>UNSPECIFIED</EXECUTION-CONTEXT>
              <SW-SERVICE-IMPL-POLICY>STANDARD</SW-SERVICE-IMPL-POLICY>
              <BSW-ENTRY-KIND>CONCRETE</BSW-ENTRY-KIND>
            </BSW-MODULE-ENTRY>  
            <BSW-MODULE-ENTRY UUID="c162aa9c-d32c-4afa-9a9d-e198adca6607">
              <SHORT-NAME>Cdd_Pwm_SetDiodeEmulationMode</SHORT-NAME>
              <SERVICE-ID>176</SERVICE-ID>
              <IS-REENTRANT>false</IS-REENTRANT>
              <IS-SYNCHRONOUS>true</IS-SYNCHRONOUS>
              <CALL-TYPE>REGULAR</CALL-TYPE>
              <EXECUTION-CONTEXT>UNSPECIFIED</EXECUTION-CONTEXT>
              <SW-SERVICE-IMPL-POLICY>STANDARD</SW-SERVICE-IMPL-POLICY>
              <BSW-ENTRY-KIND>CONCRETE</BSW-ENTRY-KIND>
            </BSW-MODULE-ENTRY>  
            <BSW-MODULE-ENTRY UUID="c97b83fb-0906-4b9b-a96e-665699001a5e">
              <SHORT-NAME>Cdd_Pwm_SetDiodeEmulationReentryDelay</SHORT-NAME>
              <SERVICE-ID>177</SERVICE-ID>
              <IS-REENTRANT>false</IS-REENTRANT>
              <IS-SYNCHRONOUS>true</IS-SYNCHRONOUS>
              <CALL-TYPE>REGULAR</CALL-TYPE>
              <EXECUTION-CONTEXT>UNSPECIFIED</EXECUTION-CONTEXT>
              <SW-SERVICE-IMPL-POLICY>STANDARD</SW-SERVICE-IMPL-POLICY>
              <BSW-ENTRY-KIND>CONCRETE</BSW-ENTRY-KIND>
            </BSW-MODULE-ENTRY>  
            <BSW-MODULE-ENTRY UUID="80a55bf6-74dc-43ae-b7cc-c399a3808fb7">
              <SHORT-NAME>Cdd_Pwm_ConfigureDiodeEmulationTripLowSources</SHORT-NAME>
              <SERVICE-ID>178</SERVICE-ID>
              <IS-REENTRANT>false</IS-REENTRANT>
              <IS-SYNCHRONOUS>true</IS-SYNCHRONOUS>
              <CALL-TYPE>REGULAR</CALL-TYPE>
              <EXECUTION-CONTEXT>UNSPECIFIED</EXECUTION-CONTEXT>
              <SW-SERVICE-IMPL-POLICY>STANDARD</SW-SERVICE-IMPL-POLICY>
              <BSW-ENTRY-KIND>CONCRETE</BSW-ENTRY-KIND>
            </BSW-MODULE-ENTRY>  
            <BSW-MODULE-ENTRY UUID="3846e4eb-febc-4d2a-abac-32341ee23324">
              <SHORT-NAME>Cdd_Pwm_ConfigureDiodeEmulationTripHighSources</SHORT-NAME>
              <SERVICE-ID>179</SERVICE-ID>
              <IS-REENTRANT>false</IS-REENTRANT>
              <IS-SYNCHRONOUS>true</IS-SYNCHRONOUS>
              <CALL-TYPE>REGULAR</CALL-TYPE>
              <EXECUTION-CONTEXT>UNSPECIFIED</EXECUTION-CONTEXT>
              <SW-SERVICE-IMPL-POLICY>STANDARD</SW-SERVICE-IMPL-POLICY>
              <BSW-ENTRY-KIND>CONCRETE</BSW-ENTRY-KIND>
            </BSW-MODULE-ENTRY>  
            <BSW-MODULE-ENTRY UUID="c7c2103a-c6bb-4cf0-a5a6-cbab49016818">
              <SHORT-NAME>Cdd_Pwm_SelectDiodeEmulationPwmSignal</SHORT-NAME>
              <SERVICE-ID>180</SERVICE-ID>
              <IS-REENTRANT>false</IS-REENTRANT>
              <IS-SYNCHRONOUS>true</IS-SYNCHRONOUS>
              <CALL-TYPE>REGULAR</CALL-TYPE>
              <EXECUTION-CONTEXT>UNSPECIFIED</EXECUTION-CONTEXT>
              <SW-SERVICE-IMPL-POLICY>STANDARD</SW-SERVICE-IMPL-POLICY>
              <BSW-ENTRY-KIND>CONCRETE</BSW-ENTRY-KIND>
            </BSW-MODULE-ENTRY>  
            <BSW-MODULE-ENTRY UUID="91c9340a-22f0-4acb-9455-27c723b42293">
              <SHORT-NAME>Cdd_Pwm_SelectDiodeEmulationTripSignal</SHORT-NAME>
              <SERVICE-ID>181</SERVICE-ID>
              <IS-REENTRANT>false</IS-REENTRANT>
              <IS-SYNCHRONOUS>true</IS-SYNCHRONOUS>
              <CALL-TYPE>REGULAR</CALL-TYPE>
              <EXECUTION-CONTEXT>UNSPECIFIED</EXECUTION-CONTEXT>
              <SW-SERVICE-IMPL-POLICY>STANDARD</SW-SERVICE-IMPL-POLICY>
              <BSW-ENTRY-KIND>CONCRETE</BSW-ENTRY-KIND>
            </BSW-MODULE-ENTRY>  
            <BSW-MODULE-ENTRY UUID="51c976a4-674b-4ab6-a79d-425e2958f9b0">
              <SHORT-NAME>Cdd_Pwm_NoBypassDiodeEmulationLogic</SHORT-NAME>
              <SERVICE-ID>182</SERVICE-ID>
              <IS-REENTRANT>false</IS-REENTRANT>
              <IS-SYNCHRONOUS>true</IS-SYNCHRONOUS>
              <CALL-TYPE>REGULAR</CALL-TYPE>
              <EXECUTION-CONTEXT>UNSPECIFIED</EXECUTION-CONTEXT>
              <SW-SERVICE-IMPL-POLICY>STANDARD</SW-SERVICE-IMPL-POLICY>
              <BSW-ENTRY-KIND>CONCRETE</BSW-ENTRY-KIND>
            </BSW-MODULE-ENTRY>  
            <BSW-MODULE-ENTRY UUID="87277947-d9bb-40da-9d59-31dbf78d8858">
              <SHORT-NAME>Cdd_Pwm_ByPassDiodeEmulationLogic</SHORT-NAME>
              <SERVICE-ID>183</SERVICE-ID>
              <IS-REENTRANT>false</IS-REENTRANT>
              <IS-SYNCHRONOUS>true</IS-SYNCHRONOUS>
              <CALL-TYPE>REGULAR</CALL-TYPE>
              <EXECUTION-CONTEXT>UNSPECIFIED</EXECUTION-CONTEXT>
              <SW-SERVICE-IMPL-POLICY>STANDARD</SW-SERVICE-IMPL-POLICY>
              <BSW-ENTRY-KIND>CONCRETE</BSW-ENTRY-KIND>
            </BSW-MODULE-ENTRY>  
            <BSW-MODULE-ENTRY UUID="dba827a9-89a8-40a6-9048-a04635f7d23f">
              <SHORT-NAME>Cdd_Pwm_ForceDiodeEmulationActive</SHORT-NAME>
              <SERVICE-ID>184</SERVICE-ID>
              <IS-REENTRANT>false</IS-REENTRANT>
              <IS-SYNCHRONOUS>true</IS-SYNCHRONOUS>
              <CALL-TYPE>REGULAR</CALL-TYPE>
              <EXECUTION-CONTEXT>UNSPECIFIED</EXECUTION-CONTEXT>
              <SW-SERVICE-IMPL-POLICY>STANDARD</SW-SERVICE-IMPL-POLICY>
              <BSW-ENTRY-KIND>CONCRETE</BSW-ENTRY-KIND>
            </BSW-MODULE-ENTRY>  
            <BSW-MODULE-ENTRY UUID="b9b5e783-4d5a-4971-955d-88313fa7ca52">
              <SHORT-NAME>Cdd_Pwm_ConfigureDiodeEmulationMonitorModeControl</SHORT-NAME>
              <SERVICE-ID>185</SERVICE-ID>
              <IS-REENTRANT>false</IS-REENTRANT>
              <IS-SYNCHRONOUS>true</IS-SYNCHRONOUS>
              <CALL-TYPE>REGULAR</CALL-TYPE>
              <EXECUTION-CONTEXT>UNSPECIFIED</EXECUTION-CONTEXT>
              <SW-SERVICE-IMPL-POLICY>STANDARD</SW-SERVICE-IMPL-POLICY>
              <BSW-ENTRY-KIND>CONCRETE</BSW-ENTRY-KIND>
            </BSW-MODULE-ENTRY>  
            <BSW-MODULE-ENTRY UUID="87c816c7-ce87-433f-853e-5966f1e274a1">
              <SHORT-NAME>Cdd_Pwm_SetDiodeEmulationMonitorModeStep</SHORT-NAME>
              <SERVICE-ID>186</SERVICE-ID>
              <IS-REENTRANT>false</IS-REENTRANT>
              <IS-SYNCHRONOUS>true</IS-SYNCHRONOUS>
              <CALL-TYPE>REGULAR</CALL-TYPE>
              <EXECUTION-CONTEXT>UNSPECIFIED</EXECUTION-CONTEXT>
              <SW-SERVICE-IMPL-POLICY>STANDARD</SW-SERVICE-IMPL-POLICY>
              <BSW-ENTRY-KIND>CONCRETE</BSW-ENTRY-KIND>
            </BSW-MODULE-ENTRY>  
            <BSW-MODULE-ENTRY UUID="417cffbd-d95b-409c-9cd8-9d2dce961a96">
              <SHORT-NAME>Cdd_Pwm_SetDiodeEmulationMonitorCounterThreshold</SHORT-NAME>
              <SERVICE-ID>187</SERVICE-ID>
              <IS-REENTRANT>false</IS-REENTRANT>
              <IS-SYNCHRONOUS>true</IS-SYNCHRONOUS>
              <CALL-TYPE>REGULAR</CALL-TYPE>
              <EXECUTION-CONTEXT>UNSPECIFIED</EXECUTION-CONTEXT>
              <SW-SERVICE-IMPL-POLICY>STANDARD</SW-SERVICE-IMPL-POLICY>
              <BSW-ENTRY-KIND>CONCRETE</BSW-ENTRY-KIND>
            </BSW-MODULE-ENTRY>  
            <BSW-MODULE-ENTRY UUID="4a437883-ac41-469c-89d7-ef7897473039">
              <SHORT-NAME>Cdd_Pwm_ClearDiodeEmulationActiveFlag</SHORT-NAME>
              <SERVICE-ID>188</SERVICE-ID>
              <IS-REENTRANT>false</IS-REENTRANT>
              <IS-SYNCHRONOUS>true</IS-SYNCHRONOUS>
              <CALL-TYPE>REGULAR</CALL-TYPE>
              <EXECUTION-CONTEXT>UNSPECIFIED</EXECUTION-CONTEXT>
              <SW-SERVICE-IMPL-POLICY>STANDARD</SW-SERVICE-IMPL-POLICY>
              <BSW-ENTRY-KIND>CONCRETE</BSW-ENTRY-KIND>
            </BSW-MODULE-ENTRY>  
          [!IF "(num:i(ecu:get('ResourceAllocator_F29H85x.Cdd_Pwm_HrpwmCalCount')) > 0)"!]
            <BSW-MODULE-ENTRY UUID="f7dde521-c5e9-44d0-90a0-d27206040334">
              <SHORT-NAME>Cdd_Pwm_HrpwmSetPhaseShift</SHORT-NAME>
              <SERVICE-ID>189</SERVICE-ID>
              <IS-REENTRANT>false</IS-REENTRANT>
              <IS-SYNCHRONOUS>true</IS-SYNCHRONOUS>
              <CALL-TYPE>REGULAR</CALL-TYPE>
              <EXECUTION-CONTEXT>UNSPECIFIED</EXECUTION-CONTEXT>
              <SW-SERVICE-IMPL-POLICY>STANDARD</SW-SERVICE-IMPL-POLICY>
              <BSW-ENTRY-KIND>CONCRETE</BSW-ENTRY-KIND>
            </BSW-MODULE-ENTRY>  
            <BSW-MODULE-ENTRY UUID="931f44c0-92e6-4590-8d8c-5de18bd794fd">
              <SHORT-NAME>Cdd_Pwm_HrpwmSetHiResPhaseShiftOnly</SHORT-NAME>
              <SERVICE-ID>190</SERVICE-ID>
              <IS-REENTRANT>false</IS-REENTRANT>
              <IS-SYNCHRONOUS>true</IS-SYNCHRONOUS>
              <CALL-TYPE>REGULAR</CALL-TYPE>
              <EXECUTION-CONTEXT>UNSPECIFIED</EXECUTION-CONTEXT>
              <SW-SERVICE-IMPL-POLICY>STANDARD</SW-SERVICE-IMPL-POLICY>
              <BSW-ENTRY-KIND>CONCRETE</BSW-ENTRY-KIND>
            </BSW-MODULE-ENTRY>  
            <BSW-MODULE-ENTRY UUID="970d6614-0cdc-40d2-b855-0919198237d7">
              <SHORT-NAME>Cdd_Pwm_HrpwmSetTimeBasePeriod</SHORT-NAME>
              <SERVICE-ID>191</SERVICE-ID>
              <IS-REENTRANT>false</IS-REENTRANT>
              <IS-SYNCHRONOUS>true</IS-SYNCHRONOUS>
              <CALL-TYPE>REGULAR</CALL-TYPE>
              <EXECUTION-CONTEXT>UNSPECIFIED</EXECUTION-CONTEXT>
              <SW-SERVICE-IMPL-POLICY>STANDARD</SW-SERVICE-IMPL-POLICY>
              <BSW-ENTRY-KIND>CONCRETE</BSW-ENTRY-KIND>
            </BSW-MODULE-ENTRY>  
            <BSW-MODULE-ENTRY UUID="b95be57f-1b17-4a9b-9fdd-c8793814fb86">
              <SHORT-NAME>Cdd_Pwm_HrpwmSetHiResTimeBasePeriodOnly</SHORT-NAME>
              <SERVICE-ID>192</SERVICE-ID>
              <IS-REENTRANT>false</IS-REENTRANT>
              <IS-SYNCHRONOUS>true</IS-SYNCHRONOUS>
              <CALL-TYPE>REGULAR</CALL-TYPE>
              <EXECUTION-CONTEXT>UNSPECIFIED</EXECUTION-CONTEXT>
              <SW-SERVICE-IMPL-POLICY>STANDARD</SW-SERVICE-IMPL-POLICY>
              <BSW-ENTRY-KIND>CONCRETE</BSW-ENTRY-KIND>
            </BSW-MODULE-ENTRY>  
            <BSW-MODULE-ENTRY UUID="ae593d7d-4297-43cb-bf95-f6f149a7dab9">
              <SHORT-NAME>Cdd_Pwm_HrpwmGetTimeBasePeriod</SHORT-NAME>
              <SERVICE-ID>193</SERVICE-ID>
              <IS-REENTRANT>false</IS-REENTRANT>
              <IS-SYNCHRONOUS>true</IS-SYNCHRONOUS>
              <CALL-TYPE>REGULAR</CALL-TYPE>
              <EXECUTION-CONTEXT>UNSPECIFIED</EXECUTION-CONTEXT>
              <SW-SERVICE-IMPL-POLICY>STANDARD</SW-SERVICE-IMPL-POLICY>
              <BSW-ENTRY-KIND>CONCRETE</BSW-ENTRY-KIND>
            </BSW-MODULE-ENTRY>  
            <BSW-MODULE-ENTRY UUID="19284594-6b64-44b8-ba77-31202f93aa6e">
              <SHORT-NAME>Cdd_Pwm_HrpwmGetHiResTimeBasePeriodOnly</SHORT-NAME>
              <SERVICE-ID>194</SERVICE-ID>
              <IS-REENTRANT>false</IS-REENTRANT>
              <IS-SYNCHRONOUS>true</IS-SYNCHRONOUS>
              <CALL-TYPE>REGULAR</CALL-TYPE>
              <EXECUTION-CONTEXT>UNSPECIFIED</EXECUTION-CONTEXT>
              <SW-SERVICE-IMPL-POLICY>STANDARD</SW-SERVICE-IMPL-POLICY>
              <BSW-ENTRY-KIND>CONCRETE</BSW-ENTRY-KIND>
            </BSW-MODULE-ENTRY>  
            <BSW-MODULE-ENTRY UUID="7229bab6-166e-40f9-95d8-abcfc5c8920c">
              <SHORT-NAME>Cdd_Pwm_HrpwmSetMepEdgeSelect</SHORT-NAME>
              <SERVICE-ID>195</SERVICE-ID>
              <IS-REENTRANT>false</IS-REENTRANT>
              <IS-SYNCHRONOUS>true</IS-SYNCHRONOUS>
              <CALL-TYPE>REGULAR</CALL-TYPE>
              <EXECUTION-CONTEXT>UNSPECIFIED</EXECUTION-CONTEXT>
              <SW-SERVICE-IMPL-POLICY>STANDARD</SW-SERVICE-IMPL-POLICY>
              <BSW-ENTRY-KIND>CONCRETE</BSW-ENTRY-KIND>
            </BSW-MODULE-ENTRY>  
            <BSW-MODULE-ENTRY UUID="c77059a2-0569-4562-a31e-5870674a7218">
              <SHORT-NAME>Cdd_Pwm_HrpwmSetMepControlMode</SHORT-NAME>
              <SERVICE-ID>196</SERVICE-ID>
              <IS-REENTRANT>false</IS-REENTRANT>
              <IS-SYNCHRONOUS>true</IS-SYNCHRONOUS>
              <CALL-TYPE>REGULAR</CALL-TYPE>
              <EXECUTION-CONTEXT>UNSPECIFIED</EXECUTION-CONTEXT>
              <SW-SERVICE-IMPL-POLICY>STANDARD</SW-SERVICE-IMPL-POLICY>
              <BSW-ENTRY-KIND>CONCRETE</BSW-ENTRY-KIND>
            </BSW-MODULE-ENTRY>  
            <BSW-MODULE-ENTRY UUID="b7115e82-4458-4b82-a397-d2e22f37b1ea">
              <SHORT-NAME>Cdd_Pwm_HrpwmSetCounterCompareShadowLoadEvent</SHORT-NAME>
              <SERVICE-ID>197</SERVICE-ID>
              <IS-REENTRANT>false</IS-REENTRANT>
              <IS-SYNCHRONOUS>true</IS-SYNCHRONOUS>
              <CALL-TYPE>REGULAR</CALL-TYPE>
              <EXECUTION-CONTEXT>UNSPECIFIED</EXECUTION-CONTEXT>
              <SW-SERVICE-IMPL-POLICY>STANDARD</SW-SERVICE-IMPL-POLICY>
              <BSW-ENTRY-KIND>CONCRETE</BSW-ENTRY-KIND>
            </BSW-MODULE-ENTRY>  
            <BSW-MODULE-ENTRY UUID="4987e0f2-1da8-4fed-b625-20c8c5a6984d">
              <SHORT-NAME>Cdd_Pwm_HrpwmSetOutputSwapMode</SHORT-NAME>
              <SERVICE-ID>198</SERVICE-ID>
              <IS-REENTRANT>false</IS-REENTRANT>
              <IS-SYNCHRONOUS>true</IS-SYNCHRONOUS>
              <CALL-TYPE>REGULAR</CALL-TYPE>
              <EXECUTION-CONTEXT>UNSPECIFIED</EXECUTION-CONTEXT>
              <SW-SERVICE-IMPL-POLICY>STANDARD</SW-SERVICE-IMPL-POLICY>
              <BSW-ENTRY-KIND>CONCRETE</BSW-ENTRY-KIND>
            </BSW-MODULE-ENTRY>  
            <BSW-MODULE-ENTRY UUID="a9bcbb46-739b-46d7-bbc1-d89d569754dd">
              <SHORT-NAME>Cdd_Pwm_HrpwmSetChannelBOutputPath</SHORT-NAME>
              <SERVICE-ID>199</SERVICE-ID>
              <IS-REENTRANT>false</IS-REENTRANT>
              <IS-SYNCHRONOUS>true</IS-SYNCHRONOUS>
              <CALL-TYPE>REGULAR</CALL-TYPE>
              <EXECUTION-CONTEXT>UNSPECIFIED</EXECUTION-CONTEXT>
              <SW-SERVICE-IMPL-POLICY>STANDARD</SW-SERVICE-IMPL-POLICY>
              <BSW-ENTRY-KIND>CONCRETE</BSW-ENTRY-KIND>
            </BSW-MODULE-ENTRY>  
            <BSW-MODULE-ENTRY UUID="440e97af-d652-4bb4-9b88-e7343bc18689">
              <SHORT-NAME>Cdd_Pwm_HrpwmConfigureAutoConversion</SHORT-NAME>
              <SERVICE-ID>200</SERVICE-ID>
              <IS-REENTRANT>false</IS-REENTRANT>
              <IS-SYNCHRONOUS>true</IS-SYNCHRONOUS>
              <CALL-TYPE>REGULAR</CALL-TYPE>
              <EXECUTION-CONTEXT>UNSPECIFIED</EXECUTION-CONTEXT>
              <SW-SERVICE-IMPL-POLICY>STANDARD</SW-SERVICE-IMPL-POLICY>
              <BSW-ENTRY-KIND>CONCRETE</BSW-ENTRY-KIND>
            </BSW-MODULE-ENTRY>  
            <BSW-MODULE-ENTRY UUID="047cae3a-26d1-44e7-bbd3-a02794307a95">
              <SHORT-NAME>Cdd_Pwm_HrpwmConfigurePeriodControl</SHORT-NAME>
              <SERVICE-ID>201</SERVICE-ID>
              <IS-REENTRANT>false</IS-REENTRANT>
              <IS-SYNCHRONOUS>true</IS-SYNCHRONOUS>
              <CALL-TYPE>REGULAR</CALL-TYPE>
              <EXECUTION-CONTEXT>UNSPECIFIED</EXECUTION-CONTEXT>
              <SW-SERVICE-IMPL-POLICY>STANDARD</SW-SERVICE-IMPL-POLICY>
              <BSW-ENTRY-KIND>CONCRETE</BSW-ENTRY-KIND>
            </BSW-MODULE-ENTRY>  
            <BSW-MODULE-ENTRY UUID="54f3bc5f-fe26-43bf-ae64-ab33ee6f2fd8">
              <SHORT-NAME>Cdd_Pwm_HrpwmConfigurePhaseShiftLoad</SHORT-NAME>
              <SERVICE-ID>202</SERVICE-ID>
              <IS-REENTRANT>false</IS-REENTRANT>
              <IS-SYNCHRONOUS>true</IS-SYNCHRONOUS>
              <CALL-TYPE>REGULAR</CALL-TYPE>
              <EXECUTION-CONTEXT>UNSPECIFIED</EXECUTION-CONTEXT>
              <SW-SERVICE-IMPL-POLICY>STANDARD</SW-SERVICE-IMPL-POLICY>
              <BSW-ENTRY-KIND>CONCRETE</BSW-ENTRY-KIND>
            </BSW-MODULE-ENTRY>  
            <BSW-MODULE-ENTRY UUID="8892b88c-4250-4436-952b-93cb78f83372">
              <SHORT-NAME>Cdd_Pwm_HrpwmSetSyncPulseSource</SHORT-NAME>
              <SERVICE-ID>203</SERVICE-ID>
              <IS-REENTRANT>false</IS-REENTRANT>
              <IS-SYNCHRONOUS>true</IS-SYNCHRONOUS>
              <CALL-TYPE>REGULAR</CALL-TYPE>
              <EXECUTION-CONTEXT>UNSPECIFIED</EXECUTION-CONTEXT>
              <SW-SERVICE-IMPL-POLICY>STANDARD</SW-SERVICE-IMPL-POLICY>
              <BSW-ENTRY-KIND>CONCRETE</BSW-ENTRY-KIND>
            </BSW-MODULE-ENTRY>  
            <BSW-MODULE-ENTRY UUID="08ae44f4-4bbc-4ac6-96f0-c454292d53e9">
              <SHORT-NAME>Cdd_Pwm_HrpwmSetTranslatorRemainder</SHORT-NAME>
              <SERVICE-ID>204</SERVICE-ID>
              <IS-REENTRANT>false</IS-REENTRANT>
              <IS-SYNCHRONOUS>true</IS-SYNCHRONOUS>
              <CALL-TYPE>REGULAR</CALL-TYPE>
              <EXECUTION-CONTEXT>UNSPECIFIED</EXECUTION-CONTEXT>
              <SW-SERVICE-IMPL-POLICY>STANDARD</SW-SERVICE-IMPL-POLICY>
              <BSW-ENTRY-KIND>CONCRETE</BSW-ENTRY-KIND>
            </BSW-MODULE-ENTRY>  
            <BSW-MODULE-ENTRY UUID="f82ec8f5-62b9-4c8c-bd5f-d19b8c0e858d">
              <SHORT-NAME>Cdd_Pwm_HrpwmSetCounterCompareValue</SHORT-NAME>
              <SERVICE-ID>205</SERVICE-ID>
              <IS-REENTRANT>false</IS-REENTRANT>
              <IS-SYNCHRONOUS>true</IS-SYNCHRONOUS>
              <CALL-TYPE>REGULAR</CALL-TYPE>
              <EXECUTION-CONTEXT>UNSPECIFIED</EXECUTION-CONTEXT>
              <SW-SERVICE-IMPL-POLICY>STANDARD</SW-SERVICE-IMPL-POLICY>
              <BSW-ENTRY-KIND>CONCRETE</BSW-ENTRY-KIND>
            </BSW-MODULE-ENTRY>  
            <BSW-MODULE-ENTRY UUID="d17e7905-7fc7-4c89-af8f-1e7cf9254565">
              <SHORT-NAME>Cdd_Pwm_HrpwmSetHiResCounterCompareValueOnly</SHORT-NAME>
              <SERVICE-ID>206</SERVICE-ID>
              <IS-REENTRANT>false</IS-REENTRANT>
              <IS-SYNCHRONOUS>true</IS-SYNCHRONOUS>
              <CALL-TYPE>REGULAR</CALL-TYPE>
              <EXECUTION-CONTEXT>UNSPECIFIED</EXECUTION-CONTEXT>
              <SW-SERVICE-IMPL-POLICY>STANDARD</SW-SERVICE-IMPL-POLICY>
              <BSW-ENTRY-KIND>CONCRETE</BSW-ENTRY-KIND>
            </BSW-MODULE-ENTRY>  
            <BSW-MODULE-ENTRY UUID="cc5e094a-dc5c-438d-bcb9-c8ad0c2945e5">
              <SHORT-NAME>Cdd_Pwm_HrpwmGetCounterCompareValue</SHORT-NAME>
              <SERVICE-ID>207</SERVICE-ID>
              <IS-REENTRANT>false</IS-REENTRANT>
              <IS-SYNCHRONOUS>true</IS-SYNCHRONOUS>
              <CALL-TYPE>REGULAR</CALL-TYPE>
              <EXECUTION-CONTEXT>UNSPECIFIED</EXECUTION-CONTEXT>
              <SW-SERVICE-IMPL-POLICY>STANDARD</SW-SERVICE-IMPL-POLICY>
              <BSW-ENTRY-KIND>CONCRETE</BSW-ENTRY-KIND>
            </BSW-MODULE-ENTRY>  
            <BSW-MODULE-ENTRY UUID="3580e0c5-b067-47b7-9500-fbfcd1ea5f47">
              <SHORT-NAME>Cdd_Pwm_GetHiResCounterCompareValueOnly</SHORT-NAME>
              <SERVICE-ID>208</SERVICE-ID>
              <IS-REENTRANT>false</IS-REENTRANT>
              <IS-SYNCHRONOUS>true</IS-SYNCHRONOUS>
              <CALL-TYPE>REGULAR</CALL-TYPE>
              <EXECUTION-CONTEXT>UNSPECIFIED</EXECUTION-CONTEXT>
              <SW-SERVICE-IMPL-POLICY>STANDARD</SW-SERVICE-IMPL-POLICY>
              <BSW-ENTRY-KIND>CONCRETE</BSW-ENTRY-KIND>
            </BSW-MODULE-ENTRY>  
            <BSW-MODULE-ENTRY UUID="2e3390f7-0f7a-444c-bd54-3b81254a11ef">
              <SHORT-NAME>Cdd_Pwm_HrpwmSetRisingEdgeDelay</SHORT-NAME>
              <SERVICE-ID>209</SERVICE-ID>
              <IS-REENTRANT>false</IS-REENTRANT>
              <IS-SYNCHRONOUS>true</IS-SYNCHRONOUS>
              <CALL-TYPE>REGULAR</CALL-TYPE>
              <EXECUTION-CONTEXT>UNSPECIFIED</EXECUTION-CONTEXT>
              <SW-SERVICE-IMPL-POLICY>STANDARD</SW-SERVICE-IMPL-POLICY>
              <BSW-ENTRY-KIND>CONCRETE</BSW-ENTRY-KIND>
            </BSW-MODULE-ENTRY>  
            <BSW-MODULE-ENTRY UUID="877569f2-c752-41e9-90cb-f5f8c9cc8fe8">
              <SHORT-NAME>Cdd_Pwm_HrpwmSetHiResRisingEdgeDelayOnly</SHORT-NAME>
              <SERVICE-ID>210</SERVICE-ID>
              <IS-REENTRANT>false</IS-REENTRANT>
              <IS-SYNCHRONOUS>true</IS-SYNCHRONOUS>
              <CALL-TYPE>REGULAR</CALL-TYPE>
              <EXECUTION-CONTEXT>UNSPECIFIED</EXECUTION-CONTEXT>
              <SW-SERVICE-IMPL-POLICY>STANDARD</SW-SERVICE-IMPL-POLICY>
              <BSW-ENTRY-KIND>CONCRETE</BSW-ENTRY-KIND>
            </BSW-MODULE-ENTRY>  
            <BSW-MODULE-ENTRY UUID="e29a0156-6580-4463-887d-a50e951ee0d5">
              <SHORT-NAME>Cdd_Pwm_HrpwmSetFallingEdgeDelay</SHORT-NAME>
              <SERVICE-ID>211</SERVICE-ID>
              <IS-REENTRANT>false</IS-REENTRANT>
              <IS-SYNCHRONOUS>true</IS-SYNCHRONOUS>
              <CALL-TYPE>REGULAR</CALL-TYPE>
              <EXECUTION-CONTEXT>UNSPECIFIED</EXECUTION-CONTEXT>
              <SW-SERVICE-IMPL-POLICY>STANDARD</SW-SERVICE-IMPL-POLICY>
              <BSW-ENTRY-KIND>CONCRETE</BSW-ENTRY-KIND>
            </BSW-MODULE-ENTRY> 
            <BSW-MODULE-ENTRY UUID="c6fbe681-337d-4473-a093-2d21ac1399c0">
              <SHORT-NAME>Cdd_Pwm_HrpwmSetHiResFallingEdgeDelayOnly</SHORT-NAME>
              <SERVICE-ID>212</SERVICE-ID>
              <IS-REENTRANT>false</IS-REENTRANT>
              <IS-SYNCHRONOUS>true</IS-SYNCHRONOUS>
              <CALL-TYPE>REGULAR</CALL-TYPE>
              <EXECUTION-CONTEXT>UNSPECIFIED</EXECUTION-CONTEXT>
              <SW-SERVICE-IMPL-POLICY>STANDARD</SW-SERVICE-IMPL-POLICY>
              <BSW-ENTRY-KIND>CONCRETE</BSW-ENTRY-KIND>
            </BSW-MODULE-ENTRY>  
            <BSW-MODULE-ENTRY UUID="105d8f9f-7be6-402b-b819-6b348b7b216c">
              <SHORT-NAME>Cdd_Pwm_HrpwmSetMepStep</SHORT-NAME>
              <SERVICE-ID>213</SERVICE-ID>
              <IS-REENTRANT>false</IS-REENTRANT>
              <IS-SYNCHRONOUS>true</IS-SYNCHRONOUS>
              <CALL-TYPE>REGULAR</CALL-TYPE>
              <EXECUTION-CONTEXT>UNSPECIFIED</EXECUTION-CONTEXT>
              <SW-SERVICE-IMPL-POLICY>STANDARD</SW-SERVICE-IMPL-POLICY>
              <BSW-ENTRY-KIND>CONCRETE</BSW-ENTRY-KIND>
            </BSW-MODULE-ENTRY>  
            <BSW-MODULE-ENTRY UUID="d0f3a617-ce05-4cc3-ab90-a824dadcf423">
              <SHORT-NAME>Cdd_Pwm_HrpwmSetDeadbandMepEdgeSelect</SHORT-NAME>
              <SERVICE-ID>214</SERVICE-ID>
              <IS-REENTRANT>false</IS-REENTRANT>
              <IS-SYNCHRONOUS>true</IS-SYNCHRONOUS>
              <CALL-TYPE>REGULAR</CALL-TYPE>
              <EXECUTION-CONTEXT>UNSPECIFIED</EXECUTION-CONTEXT>
              <SW-SERVICE-IMPL-POLICY>STANDARD</SW-SERVICE-IMPL-POLICY>
              <BSW-ENTRY-KIND>CONCRETE</BSW-ENTRY-KIND>
            </BSW-MODULE-ENTRY>  
            <BSW-MODULE-ENTRY UUID="4444ee24-4a45-4235-bd07-336f643265c5">
              <SHORT-NAME>Cdd_Pwm_HrpwmSetRisingEdgeDelayLoadMode</SHORT-NAME>
              <SERVICE-ID>215</SERVICE-ID>
              <IS-REENTRANT>false</IS-REENTRANT>
              <IS-SYNCHRONOUS>true</IS-SYNCHRONOUS>
              <CALL-TYPE>REGULAR</CALL-TYPE>
              <EXECUTION-CONTEXT>UNSPECIFIED</EXECUTION-CONTEXT>
              <SW-SERVICE-IMPL-POLICY>STANDARD</SW-SERVICE-IMPL-POLICY>
              <BSW-ENTRY-KIND>CONCRETE</BSW-ENTRY-KIND>
            </BSW-MODULE-ENTRY>  
            <BSW-MODULE-ENTRY UUID="d84416ef-0e57-4f4e-8a7b-c0b286de27c3">
              <SHORT-NAME>Cdd_Pwm_HrpwmSetFallingEdgeDelayLoadMode</SHORT-NAME>
              <SERVICE-ID>216</SERVICE-ID>
              <IS-REENTRANT>false</IS-REENTRANT>
              <IS-SYNCHRONOUS>true</IS-SYNCHRONOUS>
              <CALL-TYPE>REGULAR</CALL-TYPE>
              <EXECUTION-CONTEXT>UNSPECIFIED</EXECUTION-CONTEXT>
              <SW-SERVICE-IMPL-POLICY>STANDARD</SW-SERVICE-IMPL-POLICY>
              <BSW-ENTRY-KIND>CONCRETE</BSW-ENTRY-KIND>
            </BSW-MODULE-ENTRY>  
            <BSW-MODULE-ENTRY UUID="a91f147a-f455-4edf-8a05-bf62a93abb01">
              <SHORT-NAME>Cdd_Pwm_HrpwmLockRegisters</SHORT-NAME>
              <SERVICE-ID>217</SERVICE-ID>
              <IS-REENTRANT>false</IS-REENTRANT>
              <IS-SYNCHRONOUS>true</IS-SYNCHRONOUS>
              <CALL-TYPE>REGULAR</CALL-TYPE>
              <EXECUTION-CONTEXT>UNSPECIFIED</EXECUTION-CONTEXT>
              <SW-SERVICE-IMPL-POLICY>STANDARD</SW-SERVICE-IMPL-POLICY>
              <BSW-ENTRY-KIND>CONCRETE</BSW-ENTRY-KIND>
            </BSW-MODULE-ENTRY>  
            <BSW-MODULE-ENTRY UUID="4433bb02-d72e-4298-a437-99553671cb34">
              <SHORT-NAME>Cdd_Pwm_HrpwmSetXCmpRegValue</SHORT-NAME>
              <SERVICE-ID>218</SERVICE-ID>
              <IS-REENTRANT>false</IS-REENTRANT>
              <IS-SYNCHRONOUS>true</IS-SYNCHRONOUS>
              <CALL-TYPE>REGULAR</CALL-TYPE>
              <EXECUTION-CONTEXT>UNSPECIFIED</EXECUTION-CONTEXT>
              <SW-SERVICE-IMPL-POLICY>STANDARD</SW-SERVICE-IMPL-POLICY>
              <BSW-ENTRY-KIND>CONCRETE</BSW-ENTRY-KIND>
            </BSW-MODULE-ENTRY>  
            <BSW-MODULE-ENTRY UUID="34f67f94-4392-4a95-99a0-d7ceacd3ae3a">
              <SHORT-NAME>Cdd_Pwm_HrpwmSetHiResXCmpRegValueOnly</SHORT-NAME>
              <SERVICE-ID>219</SERVICE-ID>
              <IS-REENTRANT>false</IS-REENTRANT>
              <IS-SYNCHRONOUS>true</IS-SYNCHRONOUS>
              <CALL-TYPE>REGULAR</CALL-TYPE>
              <EXECUTION-CONTEXT>UNSPECIFIED</EXECUTION-CONTEXT>
              <SW-SERVICE-IMPL-POLICY>STANDARD</SW-SERVICE-IMPL-POLICY>
              <BSW-ENTRY-KIND>CONCRETE</BSW-ENTRY-KIND>
            </BSW-MODULE-ENTRY>
            <BSW-MODULE-ENTRY UUID="cde445d7-3652-4756-938b-d6c1f8915b3a">
              <SHORT-NAME>Cdd_Pwm_ConfigureTripZone2Signals</SHORT-NAME>
              <SERVICE-ID>223</SERVICE-ID>
              <IS-REENTRANT>false</IS-REENTRANT>
              <IS-SYNCHRONOUS>true</IS-SYNCHRONOUS>
              <CALL-TYPE>REGULAR</CALL-TYPE>
              <EXECUTION-CONTEXT>UNSPECIFIED</EXECUTION-CONTEXT>
              <SW-SERVICE-IMPL-POLICY>STANDARD</SW-SERVICE-IMPL-POLICY>
              <BSW-ENTRY-KIND>CONCRETE</BSW-ENTRY-KIND>
            </BSW-MODULE-ENTRY>
            <BSW-MODULE-ENTRY UUID="cce445d7-3652-4756-938b-d6c1f8915b3a">
              <SHORT-NAME>Cdd_Pwm_Sfo</SHORT-NAME>
              <SERVICE-ID>224</SERVICE-ID>
              <IS-REENTRANT>false</IS-REENTRANT>
              <IS-SYNCHRONOUS>true</IS-SYNCHRONOUS>
              <CALL-TYPE>REGULAR</CALL-TYPE>
              <EXECUTION-CONTEXT>UNSPECIFIED</EXECUTION-CONTEXT>
              <SW-SERVICE-IMPL-POLICY>STANDARD</SW-SERVICE-IMPL-POLICY>
              <BSW-ENTRY-KIND>CONCRETE</BSW-ENTRY-KIND>
            </BSW-MODULE-ENTRY>
          [!ENDIF!]
          [!ENDIF!]
          </ELEMENTS>
        </AR-PACKAGE>
      </AR-PACKAGES>
    </AR-PACKAGE>
  </AR-PACKAGES>
</AUTOSAR>
