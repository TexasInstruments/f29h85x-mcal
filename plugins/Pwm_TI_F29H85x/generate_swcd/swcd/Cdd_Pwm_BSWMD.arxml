[part 1 of 3]
[!AUTOSPACING!][!//
<?xml version="1.0" encoding="UTF-8"?>
<AUTOSAR xmlns="http://autosar.org/schema/r4.0" xmlns:xsi="http://www.w3.org/2001/XMLSchema-instance" xsi:schemaLocation="http://autosar.org/schema/r4.0 AUTOSAR_00044.xsd">
  <AR-PACKAGES>
    <AR-PACKAGE UUID="367937c5-f61a-496f-8737-ac11c6ac205a">
      <SHORT-NAME>Cdd_Pwm_TI_F29H85x</SHORT-NAME>
      <ELEMENTS>
        <BSW-MODULE-DESCRIPTION UUID="5d910eeb-3de8-4ce7-830a-0e4bfc36d1ad">
          <SHORT-NAME>Cdd_Pwm</SHORT-NAME>
          <CATEGORY>BSW_MODULE</CATEGORY>
          <IMPLEMENTED-ENTRYS>
          [!LOOP "as:modconf('Cdd_Pwm/Cdd')[as:path(node:dtos(.))='/TI_F29H85x/Cdd_Pwm/Cdd']/CddPwmConfigSet/CddPwmHwUnitConfig/*/.//*[@name='CddPwmInterruptEnable']"!]
          [!IF "node:value(.) = 'true'"!]
            <BSW-MODULE-ENTRY-REF-CONDITIONAL>
              <BSW-MODULE-ENTRY-REF DEST="BSW-MODULE-ENTRY">/Cdd_Pwm_TI_F29H85x/Cdd_Pwm_ModuleEntry/Cdd_Pwm_Epwm[!"num:i(node:value(../CddPwmInstance))"!]_IntIsr</BSW-MODULE-ENTRY-REF>
            </BSW-MODULE-ENTRY-REF-CONDITIONAL>
          [!ENDIF!]
          [!ENDLOOP!]
          [!IF "as:modconf('Cdd_Pwm/Cdd')[as:path(node:dtos(.))='/TI_F29H85x/Cdd_Pwm/Cdd']/CddPwmGeneral/CddPwmNotificationSupported = 'true'"!]
            <BSW-MODULE-ENTRY-REF-CONDITIONAL>
              <BSW-MODULE-ENTRY-REF DEST="BSW-MODULE-ENTRY">/Cdd_Pwm_TI_F29H85x/Cdd_Pwm_ModuleEntry/Cdd_Pwm_EnableNotification</BSW-MODULE-ENTRY-REF>
            </BSW-MODULE-ENTRY-REF-CONDITIONAL>
            <BSW-MODULE-ENTRY-REF-CONDITIONAL>
              <BSW-MODULE-ENTRY-REF DEST="BSW-MODULE-ENTRY">/Cdd_Pwm_TI_F29H85x/Cdd_Pwm_ModuleEntry/Cdd_Pwm_DisableNotification</BSW-MODULE-ENTRY-REF>
            </BSW-MODULE-ENTRY-REF-CONDITIONAL>
          [!ENDIF!]
          [!IF "as:modconf('Cdd_Pwm/Cdd')[as:path(node:dtos(.))='/TI_F29H85x/Cdd_Pwm/Cdd']/CddPwmGeneral/CddPwmVersionInfoApi = 'true'"!]
            <BSW-MODULE-ENTRY-REF-CONDITIONAL>
              <BSW-MODULE-ENTRY-REF DEST="BSW-MODULE-ENTRY">/Cdd_Pwm_TI_F29H85x/Cdd_Pwm_ModuleEntry/Cdd_Pwm_GetVersionInfo</BSW-MODULE-ENTRY-REF>
            </BSW-MODULE-ENTRY-REF-CONDITIONAL>
          [!ENDIF!]
            <BSW-MODULE-ENTRY-REF-CONDITIONAL>
              <BSW-MODULE-ENTRY-REF DEST="BSW-MODULE-ENTRY">/Cdd_Pwm_TI_F29H85x/Cdd_Pwm_ModuleEntry/Cdd_Pwm_Init</BSW-MODULE-ENTRY-REF>
            </BSW-MODULE-ENTRY-REF-CONDITIONAL>
            <BSW-MODULE-ENTRY-REF-CONDITIONAL>
              <BSW-MODULE-ENTRY-REF DEST="BSW-MODULE-ENTRY">/Cdd_Pwm_TI_F29H85x/Cdd_Pwm_ModuleEntry/Cdd_Pwm_SetInterruptEventCount</BSW-MODULE-ENTRY-REF>
            </BSW-MODULE-ENTRY-REF-CONDITIONAL>
          [!IF "node:value(as:modconf('Cdd_Pwm/Cdd')[as:path(node:dtos(.))='/TI_F29H85x/Cdd_Pwm/Cdd']/CddPwmConfigSet/CddPwmAdvancedMode) = 'false'"!]
            [!IF "as:modconf('Cdd_Pwm/Cdd')[as:path(node:dtos(.))='/TI_F29H85x/Cdd_Pwm/Cdd']/CddPwmGeneral/CddPwmSetDutyCycle = 'true'"!]
            <BSW-MODULE-ENTRY-REF-CONDITIONAL>
              <BSW-MODULE-ENTRY-REF DEST="BSW-MODULE-ENTRY">/Cdd_Pwm_TI_F29H85x/Cdd_Pwm_ModuleEntry/Cdd_Pwm_SetDutyCycle</BSW-MODULE-ENTRY-REF>
            </BSW-MODULE-ENTRY-REF-CONDITIONAL>
            [!ENDIF!]
            [!IF "as:modconf('Cdd_Pwm/Cdd')[as:path(node:dtos(.))='/TI_F29H85x/Cdd_Pwm/Cdd']/CddPwmGeneral/CddPwmSetPeriod = 'true'"!]
            <BSW-MODULE-ENTRY-REF-CONDITIONAL>
              <BSW-MODULE-ENTRY-REF DEST="BSW-MODULE-ENTRY">/Cdd_Pwm_TI_F29H85x/Cdd_Pwm_ModuleEntry/Cdd_Pwm_SetPeriod</BSW-MODULE-ENTRY-REF>
            </BSW-MODULE-ENTRY-REF-CONDITIONAL>
            [!ENDIF!]
            [!IF "as:modconf('Cdd_Pwm/Cdd')[as:path(node:dtos(.))='/TI_F29H85x/Cdd_Pwm/Cdd']/CddPwmGeneral/CddPwmDeInitApi = 'true'"!]
            <BSW-MODULE-ENTRY-REF-CONDITIONAL>
              <BSW-MODULE-ENTRY-REF DEST="BSW-MODULE-ENTRY">/Cdd_Pwm_TI_F29H85x/Cdd_Pwm_ModuleEntry/Cdd_Pwm_DeInit</BSW-MODULE-ENTRY-REF>
            </BSW-MODULE-ENTRY-REF-CONDITIONAL>
            [!ENDIF!]
            [!IF "as:modconf('Cdd_Pwm/Cdd')[as:path(node:dtos(.))='/TI_F29H85x/Cdd_Pwm/Cdd']/CddPwmGeneral/CddPwmSetOutputToIdle = 'true'"!]
            <BSW-MODULE-ENTRY-REF-CONDITIONAL>
              <BSW-MODULE-ENTRY-REF DEST="BSW-MODULE-ENTRY">/Cdd_Pwm_TI_F29H85x/Cdd_Pwm_ModuleEntry/Cdd_Pwm_SetOutputToIdle</BSW-MODULE-ENTRY-REF>
            </BSW-MODULE-ENTRY-REF-CONDITIONAL>
            [!ENDIF!]
          [!ELSE!]
            [!LOOP "as:modconf('Cdd_Pwm/Cdd')[as:path(node:dtos(.))='/TI_F29H85x/Cdd_Pwm/Cdd']/CddPwmConfigSet/CddPwmHwUnitConfig/*/.//*[@name='CddPwmTripZoneInterruptEnable']"!]
            [!IF "node:value(.) = 'true'"!]
            <BSW-MODULE-ENTRY-REF-CONDITIONAL>
              <BSW-MODULE-ENTRY-REF DEST="BSW-MODULE-ENTRY">/Cdd_Pwm_TI_F29H85x/Cdd_Pwm_ModuleEntry/Cdd_Pwm_Epwm[!"num:i(node:value(../CddPwmInstance))"!]_TzIntIsr</BSW-MODULE-ENTRY-REF>
            </BSW-MODULE-ENTRY-REF-CONDITIONAL>
            [!ENDIF!]
            [!ENDLOOP!]
            <BSW-MODULE-ENTRY-REF-CONDITIONAL>
              <BSW-MODULE-ENTRY-REF DEST="BSW-MODULE-ENTRY">/Cdd_Pwm_TI_F29H85x/Cdd_Pwm_ModuleEntry/Cdd_Pwm_SetEmulationMode</BSW-MODULE-ENTRY-REF>
            </BSW-MODULE-ENTRY-REF-CONDITIONAL>
            <BSW-MODULE-ENTRY-REF-CONDITIONAL>
              <BSW-MODULE-ENTRY-REF DEST="BSW-MODULE-ENTRY">/Cdd_Pwm_TI_F29H85x/Cdd_Pwm_ModuleEntry/Cdd_Pwm_ConfigureTripZoneNotification</BSW-MODULE-ENTRY-REF>
            </BSW-MODULE-ENTRY-REF-CONDITIONAL>
            <BSW-MODULE-ENTRY-REF-CONDITIONAL>
              <BSW-MODULE-ENTRY-REF DEST="BSW-MODULE-ENTRY">/Cdd_Pwm_TI_F29H85x/Cdd_Pwm_ModuleEntry/Cdd_Pwm_SetTimeBaseCounter</BSW-MODULE-ENTRY-REF>
            </BSW-MODULE-ENTRY-REF-CONDITIONAL>
            <BSW-MODULE-ENTRY-REF-CONDITIONAL>
              <BSW-MODULE-ENTRY-REF DEST="BSW-MODULE-ENTRY">/Cdd_Pwm_TI_F29H85x/Cdd_Pwm_ModuleEntry/Cdd_Pwm_SetCountModeAfterSync</BSW-MODULE-ENTRY-REF>
            </BSW-MODULE-ENTRY-REF-CONDITIONAL>
            <BSW-MODULE-ENTRY-REF-CONDITIONAL>
              <BSW-MODULE-ENTRY-REF DEST="BSW-MODULE-ENTRY">/Cdd_Pwm_TI_F29H85x/Cdd_Pwm_ModuleEntry/Cdd_Pwm_SetClockPrescaler</BSW-MODULE-ENTRY-REF>
            </BSW-MODULE-ENTRY-REF-CONDITIONAL>
            <BSW-MODULE-ENTRY-REF-CONDITIONAL>
              <BSW-MODULE-ENTRY-REF DEST="BSW-MODULE-ENTRY">/Cdd_Pwm_TI_F29H85x/Cdd_Pwm_ModuleEntry/Cdd_Pwm_ForceSyncPulse</BSW-MODULE-ENTRY-REF>
            </BSW-MODULE-ENTRY-REF-CONDITIONAL>
            <BSW-MODULE-ENTRY-REF-CONDITIONAL>
              <BSW-MODULE-ENTRY-REF DEST="BSW-MODULE-ENTRY">/Cdd_Pwm_TI_F29H85x/Cdd_Pwm_ModuleEntry/Cdd_Pwm_SetSyncInPulseSource</BSW-MODULE-ENTRY-REF>
            </BSW-MODULE-ENTRY-REF-CONDITIONAL>
            <BSW-MODULE-ENTRY-REF-CONDITIONAL>
              <BSW-MODULE-ENTRY-REF DEST="BSW-MODULE-ENTRY">/Cdd_Pwm_TI_F29H85x/Cdd_Pwm_ModuleEntry/Cdd_Pwm_ConfigureSyncOutPulseSource</BSW-MODULE-ENTRY-REF>
            </BSW-MODULE-ENTRY-REF-CONDITIONAL>
            <BSW-MODULE-ENTRY-REF-CONDITIONAL>
              <BSW-MODULE-ENTRY-REF DEST="BSW-MODULE-ENTRY">/Cdd_Pwm_TI_F29H85x/Cdd_Pwm_ModuleEntry/Cdd_Pwm_SetOneShotSyncOutTrigger</BSW-MODULE-ENTRY-REF>
            </BSW-MODULE-ENTRY-REF-CONDITIONAL>
            <BSW-MODULE-ENTRY-REF-CONDITIONAL>
              <BSW-MODULE-ENTRY-REF DEST="BSW-MODULE-ENTRY">/Cdd_Pwm_TI_F29H85x/Cdd_Pwm_ModuleEntry/Cdd_Pwm_SetPeriodLoadMode</BSW-MODULE-ENTRY-REF>
            </BSW-MODULE-ENTRY-REF-CONDITIONAL>
            <BSW-MODULE-ENTRY-REF-CONDITIONAL>
              <BSW-MODULE-ENTRY-REF DEST="BSW-MODULE-ENTRY">/Cdd_Pwm_TI_F29H85x/Cdd_Pwm_ModuleEntry/Cdd_Pwm_ConfigurePhaseShiftLoad</BSW-MODULE-ENTRY-REF>
            </BSW-MODULE-ENTRY-REF-CONDITIONAL>
            <BSW-MODULE-ENTRY-REF-CONDITIONAL>
              <BSW-MODULE-ENTRY-REF DEST="BSW-MODULE-ENTRY">/Cdd_Pwm_TI_F29H85x/Cdd_Pwm_ModuleEntry/Cdd_Pwm_SetTimeBaseCounterMode</BSW-MODULE-ENTRY-REF>
            </BSW-MODULE-ENTRY-REF-CONDITIONAL>
            <BSW-MODULE-ENTRY-REF-CONDITIONAL>
              <BSW-MODULE-ENTRY-REF DEST="BSW-MODULE-ENTRY">/Cdd_Pwm_TI_F29H85x/Cdd_Pwm_ModuleEntry/Cdd_Pwm_SelectPeriodLoadEvent</BSW-MODULE-ENTRY-REF>
            </BSW-MODULE-ENTRY-REF-CONDITIONAL>
            <BSW-MODULE-ENTRY-REF-CONDITIONAL>
              <BSW-MODULE-ENTRY-REF DEST="BSW-MODULE-ENTRY">/Cdd_Pwm_TI_F29H85x/Cdd_Pwm_ModuleEntry/Cdd_Pwm_ConfigureOneShotSync</BSW-MODULE-ENTRY-REF>
            </BSW-MODULE-ENTRY-REF-CONDITIONAL>
            <BSW-MODULE-ENTRY-REF-CONDITIONAL>
              <BSW-MODULE-ENTRY-REF DEST="BSW-MODULE-ENTRY">/Cdd_Pwm_TI_F29H85x/Cdd_Pwm_ModuleEntry/Cdd_Pwm_StartOneShotSync</BSW-MODULE-ENTRY-REF>
            </BSW-MODULE-ENTRY-REF-CONDITIONAL>
            <BSW-MODULE-ENTRY-REF-CONDITIONAL>
              <BSW-MODULE-ENTRY-REF DEST="BSW-MODULE-ENTRY">/Cdd_Pwm_TI_F29H85x/Cdd_Pwm_ModuleEntry/Cdd_Pwm_GetTimeBaseCounterValue</BSW-MODULE-ENTRY-REF>
            </BSW-MODULE-ENTRY-REF-CONDITIONAL>
            <BSW-MODULE-ENTRY-REF-CONDITIONAL>
              <BSW-MODULE-ENTRY-REF DEST="BSW-MODULE-ENTRY">/Cdd_Pwm_TI_F29H85x/Cdd_Pwm_ModuleEntry/Cdd_Pwm_GetTimeBaseCounterOverflowStatus</BSW-MODULE-ENTRY-REF>
            </BSW-MODULE-ENTRY-REF-CONDITIONAL>
            <BSW-MODULE-ENTRY-REF-CONDITIONAL>
              <BSW-MODULE-ENTRY-REF DEST="BSW-MODULE-ENTRY">/Cdd_Pwm_TI_F29H85x/Cdd_Pwm_ModuleEntry/Cdd_Pwm_ClearTimeBaseCounterOverflowEvent</BSW-MODULE-ENTRY-REF>
            </BSW-MODULE-ENTRY-REF-CONDITIONAL>
            <BSW-MODULE-ENTRY-REF-CONDITIONAL>
              <BSW-MODULE-ENTRY-REF DEST="BSW-MODULE-ENTRY">/Cdd_Pwm_TI_F29H85x/Cdd_Pwm_ModuleEntry/Cdd_Pwm_GetSyncStatus</BSW-MODULE-ENTRY-REF>
            </BSW-MODULE-ENTRY-REF-CONDITIONAL>
            <BSW-MODULE-ENTRY-REF-CONDITIONAL>
              <BSW-MODULE-ENTRY-REF DEST="BSW-MODULE-ENTRY">/Cdd_Pwm_TI_F29H85x/Cdd_Pwm_ModuleEntry/Cdd_Pwm_ClearSyncEvent</BSW-MODULE-ENTRY-REF>
            </BSW-MODULE-ENTRY-REF-CONDITIONAL>
            <BSW-MODULE-ENTRY-REF-CONDITIONAL>
              <BSW-MODULE-ENTRY-REF DEST="BSW-MODULE-ENTRY">/Cdd_Pwm_TI_F29H85x/Cdd_Pwm_ModuleEntry/Cdd_Pwm_GetTimeBaseCounterDirection</BSW-MODULE-ENTRY-REF>
            </BSW-MODULE-ENTRY-REF-CONDITIONAL>
            <BSW-MODULE-ENTRY-REF-CONDITIONAL>
              <BSW-MODULE-ENTRY-REF DEST="BSW-MODULE-ENTRY">/Cdd_Pwm_TI_F29H85x/Cdd_Pwm_ModuleEntry/Cdd_Pwm_SetPhaseShift</BSW-MODULE-ENTRY-REF>
            </BSW-MODULE-ENTRY-REF-CONDITIONAL>
            <BSW-MODULE-ENTRY-REF-CONDITIONAL>
              <BSW-MODULE-ENTRY-REF DEST="BSW-MODULE-ENTRY">/Cdd_Pwm_TI_F29H85x/Cdd_Pwm_ModuleEntry/Cdd_Pwm_SetTimeBasePeriod</BSW-MODULE-ENTRY-REF>
            </BSW-MODULE-ENTRY-REF-CONDITIONAL>
            <BSW-MODULE-ENTRY-REF-CONDITIONAL>
              <BSW-MODULE-ENTRY-REF DEST="BSW-MODULE-ENTRY">/Cdd_Pwm_TI_F29H85x/Cdd_Pwm_ModuleEntry/Cdd_Pwm_GetTimeBasePeriod</BSW-MODULE-ENTRY-REF>
            </BSW-MODULE-ENTRY-REF-CONDITIONAL>
            <BSW-MODULE-ENTRY-REF-CONDITIONAL>
              <BSW-MODULE-ENTRY-REF DEST="BSW-MODULE-ENTRY">/Cdd_Pwm_TI_F29H85x/Cdd_Pwm_ModuleEntry/Cdd_Pwm_SetCounterCompareShadowLoadMode</BSW-MODULE-ENTRY-REF>
            </BSW-MODULE-ENTRY-REF-CONDITIONAL>
            <BSW-MODULE-ENTRY-REF-CONDITIONAL>
              <BSW-MODULE-ENTRY-REF DEST="BSW-MODULE-ENTRY">/Cdd_Pwm_TI_F29H85x/Cdd_Pwm_ModuleEntry/Cdd_Pwm_DisableCounterCompareShadowLoadMode</BSW-MODULE-ENTRY-REF>
            </BSW-MODULE-ENTRY-REF-CONDITIONAL>
            <BSW-MODULE-ENTRY-REF-CONDITIONAL>
              <BSW-MODULE-ENTRY-REF DEST="BSW-MODULE-ENTRY">/Cdd_Pwm_TI_F29H85x/Cdd_Pwm_ModuleEntry/Cdd_Pwm_SetCounterCompareValue</BSW-MODULE-ENTRY-REF>
            </BSW-MODULE-ENTRY-REF-CONDITIONAL>
            <BSW-MODULE-ENTRY-REF-CONDITIONAL>
              <BSW-MODULE-ENTRY-REF DEST="BSW-MODULE-ENTRY">/Cdd_Pwm_TI_F29H85x/Cdd_Pwm_ModuleEntry/Cdd_Pwm_GetCounterCompareValue</BSW-MODULE-ENTRY-REF>
            </BSW-MODULE-ENTRY-REF-CONDITIONAL>
            <BSW-MODULE-ENTRY-REF-CONDITIONAL>
              <BSW-MODULE-ENTRY-REF DEST="BSW-MODULE-ENTRY">/Cdd_Pwm_TI_F29H85x/Cdd_Pwm_ModuleEntry/Cdd_Pwm_GetCounterCompareShadowStatus</BSW-MODULE-ENTRY-REF>
            </BSW-MODULE-ENTRY-REF-CONDITIONAL>
            <BSW-MODULE-ENTRY-REF-CONDITIONAL>
              <BSW-MODULE-ENTRY-REF DEST="BSW-MODULE-ENTRY">/Cdd_Pwm_TI_F29H85x/Cdd_Pwm_ModuleEntry/Cdd_Pwm_ConfigureLinkDutyHR</BSW-MODULE-ENTRY-REF>
            </BSW-MODULE-ENTRY-REF-CONDITIONAL>
            <BSW-MODULE-ENTRY-REF-CONDITIONAL>
              <BSW-MODULE-ENTRY-REF DEST="BSW-MODULE-ENTRY">/Cdd_Pwm_TI_F29H85x/Cdd_Pwm_ModuleEntry/Cdd_Pwm_SetActionQualifierShadowLoadMode</BSW-MODULE-ENTRY-REF>
            </BSW-MODULE-ENTRY-REF-CONDITIONAL>
            <BSW-MODULE-ENTRY-REF-CONDITIONAL>
              <BSW-MODULE-ENTRY-REF DEST="BSW-MODULE-ENTRY">/Cdd_Pwm_TI_F29H85x/Cdd_Pwm_ModuleEntry/Cdd_Pwm_DisableActionQualifierShadowLoadMode</BSW-MODULE-ENTRY-REF>
            </BSW-MODULE-ENTRY-REF-CONDITIONAL>
            <BSW-MODULE-ENTRY-REF-CONDITIONAL>
              <BSW-MODULE-ENTRY-REF DEST="BSW-MODULE-ENTRY">/Cdd_Pwm_TI_F29H85x/Cdd_Pwm_ModuleEntry/Cdd_Pwm_SetActionQualifierT1TriggerSource</BSW-MODULE-ENTRY-REF>
            </BSW-MODULE-ENTRY-REF-CONDITIONAL>
            <BSW-MODULE-ENTRY-REF-CONDITIONAL>
              <BSW-MODULE-ENTRY-REF DEST="BSW-MODULE-ENTRY">/Cdd_Pwm_TI_F29H85x/Cdd_Pwm_ModuleEntry/Cdd_Pwm_SetActionQualifierT2TriggerSource</BSW-MODULE-ENTRY-REF>
            </BSW-MODULE-ENTRY-REF-CONDITIONAL>
            <BSW-MODULE-ENTRY-REF-CONDITIONAL>
              <BSW-MODULE-ENTRY-REF DEST="BSW-MODULE-ENTRY">/Cdd_Pwm_TI_F29H85x/Cdd_Pwm_ModuleEntry/Cdd_Pwm_SetActionQualifierAction</BSW-MODULE-ENTRY-REF>
            </BSW-MODULE-ENTRY-REF-CONDITIONAL>  
            <BSW-MODULE-ENTRY-REF-CONDITIONAL>
              <BSW-MODULE-ENTRY-REF DEST="BSW-MODULE-ENTRY">/Cdd_Pwm_TI_F29H85x/Cdd_Pwm_ModuleEntry/Cdd_Pwm_SetActionQualifierActionComplete</BSW-MODULE-ENTRY-REF>
            </BSW-MODULE-ENTRY-REF-CONDITIONAL>  
            <BSW-MODULE-ENTRY-REF-CONDITIONAL>
              <BSW-MODULE-ENTRY-REF DEST="BSW-MODULE-ENTRY">/Cdd_Pwm_TI_F29H85x/Cdd_Pwm_ModuleEntry/Cdd_Pwm_SetAdditionalActionQualifierActionComplete</BSW-MODULE-ENTRY-REF>
            </BSW-MODULE-ENTRY-REF-CONDITIONAL>
            <BSW-MODULE-ENTRY-REF-CONDITIONAL>
              <BSW-MODULE-ENTRY-REF DEST="BSW-MODULE-ENTRY">/Cdd_Pwm_TI_F29H85x/Cdd_Pwm_ModuleEntry/Cdd_Pwm_SetActionQualifierContSwForceShadowMode</BSW-MODULE-ENTRY-REF>
            </BSW-MODULE-ENTRY-REF-CONDITIONAL>
            <BSW-MODULE-ENTRY-REF-CONDITIONAL>
              <BSW-MODULE-ENTRY-REF DEST="BSW-MODULE-ENTRY">/Cdd_Pwm_TI_F29H85x/Cdd_Pwm_ModuleEntry/Cdd_Pwm_SetActionQualifierContSwForceAction</BSW-MODULE-ENTRY-REF>
            </BSW-MODULE-ENTRY-REF-CONDITIONAL>
            <BSW-MODULE-ENTRY-REF-CONDITIONAL>
              <BSW-MODULE-ENTRY-REF DEST="BSW-MODULE-ENTRY">/Cdd_Pwm_TI_F29H85x/Cdd_Pwm_ModuleEntry/Cdd_Pwm_SetActionQualifierSwAction</BSW-MODULE-ENTRY-REF>
            </BSW-MODULE-ENTRY-REF-CONDITIONAL>
            <BSW-MODULE-ENTRY-REF-CONDITIONAL>
              <BSW-MODULE-ENTRY-REF DEST="BSW-MODULE-ENTRY">/Cdd_Pwm_TI_F29H85x/Cdd_Pwm_ModuleEntry/Cdd_Pwm_ForceActionQualifierSwAction</BSW-MODULE-ENTRY-REF>
            </BSW-MODULE-ENTRY-REF-CONDITIONAL>
            <BSW-MODULE-ENTRY-REF-CONDITIONAL>
              <BSW-MODULE-ENTRY-REF DEST="BSW-MODULE-ENTRY">/Cdd_Pwm_TI_F29H85x/Cdd_Pwm_ModuleEntry/Cdd_Pwm_SetDeadBandOutputSwapMode</BSW-MODULE-ENTRY-REF>
            </BSW-MODULE-ENTRY-REF-CONDITIONAL>
            <BSW-MODULE-ENTRY-REF-CONDITIONAL>
              <BSW-MODULE-ENTRY-REF DEST="BSW-MODULE-ENTRY">/Cdd_Pwm_TI_F29H85x/Cdd_Pwm_ModuleEntry/Cdd_Pwm_SetDeadBandDelayMode</BSW-MODULE-ENTRY-REF>
            </BSW-MODULE-ENTRY-REF-CONDITIONAL>
            <BSW-MODULE-ENTRY-REF-CONDITIONAL>
              <BSW-MODULE-ENTRY-REF DEST="BSW-MODULE-ENTRY">/Cdd_Pwm_TI_F29H85x/Cdd_Pwm_ModuleEntry/Cdd_Pwm_SetDeadBandDelayPolarity</BSW-MODULE-ENTRY-REF>
            </BSW-MODULE-ENTRY-REF-CONDITIONAL>
            <BSW-MODULE-ENTRY-REF-CONDITIONAL>
              <BSW-MODULE-ENTRY-REF DEST="BSW-MODULE-ENTRY">/Cdd_Pwm_TI_F29H85x/Cdd_Pwm_ModuleEntry/Cdd_Pwm_SetRisingEdgeDeadBandDelayInput</BSW-MODULE-ENTRY-REF>
            </BSW-MODULE-ENTRY-REF-CONDITIONAL>
            <BSW-MODULE-ENTRY-REF-CONDITIONAL>
              <BSW-MODULE-ENTRY-REF DEST="BSW-MODULE-ENTRY">/Cdd_Pwm_TI_F29H85x/Cdd_Pwm_ModuleEntry/Cdd_Pwm_SetFallingEdgeDeadBandDelayInput</BSW-MODULE-ENTRY-REF>
            </BSW-MODULE-ENTRY-REF-CONDITIONAL>
            <BSW-MODULE-ENTRY-REF-CONDITIONAL>
              <BSW-MODULE-ENTRY-REF DEST="BSW-MODULE-ENTRY">/Cdd_Pwm_TI_F29H85x/Cdd_Pwm_ModuleEntry/Cdd_Pwm_SetDeadBandControlShadowLoadMode</BSW-MODULE-ENTRY-REF>
            </BSW-MODULE-ENTRY-REF-CONDITIONAL>
            <BSW-MODULE-ENTRY-REF-CONDITIONAL>
              <BSW-MODULE-ENTRY-REF DEST="BSW-MODULE-ENTRY">/Cdd_Pwm_TI_F29H85x/Cdd_Pwm_ModuleEntry/Cdd_Pwm_DisableDeadBandControlShadowLoadMode</BSW-MODULE-ENTRY-REF>
            </BSW-MODULE-ENTRY-REF-CONDITIONAL>
            <BSW-MODULE-ENTRY-REF-CONDITIONAL>
              <BSW-MODULE-ENTRY-REF DEST="BSW-MODULE-ENTRY">/Cdd_Pwm_TI_F29H85x/Cdd_Pwm_ModuleEntry/Cdd_Pwm_SetRisingEdgeDelayCountShadowLoadMode</BSW-MODULE-ENTRY-REF>
            </BSW-MODULE-ENTRY-REF-CONDITIONAL>
            <BSW-MODULE-ENTRY-REF-CONDITIONAL>
              <BSW-MODULE-ENTRY-REF DEST="BSW-MODULE-ENTRY">/Cdd_Pwm_TI_F29H85x/Cdd_Pwm_ModuleEntry/Cdd_Pwm_DisableRisingEdgeDelayCountShadowLoadMode</BSW-MODULE-ENTRY-REF>
            </BSW-MODULE-ENTRY-REF-CONDITIONAL>
            <BSW-MODULE-ENTRY-REF-CONDITIONAL>
              <BSW-MODULE-ENTRY-REF DEST="BSW-MODULE-ENTRY">/Cdd_Pwm_TI_F29H85x/Cdd_Pwm_ModuleEntry/Cdd_Pwm_SetFallingEdgeDelayCountShadowLoadMode</BSW-MODULE-ENTRY-REF>
            </BSW-MODULE-ENTRY-REF-CONDITIONAL>
            <BSW-MODULE-ENTRY-REF-CONDITIONAL>
              <BSW-MODULE-ENTRY-REF DEST="BSW-MODULE-ENTRY">/Cdd_Pwm_TI_F29H85x/Cdd_Pwm_ModuleEntry/Cdd_Pwm_DisableFallingEdgeDelayCountShadowLoadMode</BSW-MODULE-ENTRY-REF>
            </BSW-MODULE-ENTRY-REF-CONDITIONAL>
            <BSW-MODULE-ENTRY-REF-CONDITIONAL>
              <BSW-MODULE-ENTRY-REF DEST="BSW-MODULE-ENTRY">/Cdd_Pwm_TI_F29H85x/Cdd_Pwm_ModuleEntry/Cdd_Pwm_SetDeadBandCounterClock</BSW-MODULE-ENTRY-REF>
            </BSW-MODULE-ENTRY-REF-CONDITIONAL>
            <BSW-MODULE-ENTRY-REF-CONDITIONAL>
              <BSW-MODULE-ENTRY-REF DEST="BSW-MODULE-ENTRY">/Cdd_Pwm_TI_F29H85x/Cdd_Pwm_ModuleEntry/Cdd_Pwm_SetRisingEdgeDelayCount</BSW-MODULE-ENTRY-REF>
            </BSW-MODULE-ENTRY-REF-CONDITIONAL>
            <BSW-MODULE-ENTRY-REF-CONDITIONAL>
              <BSW-MODULE-ENTRY-REF DEST="BSW-MODULE-ENTRY">/Cdd_Pwm_TI_F29H85x/Cdd_Pwm_ModuleEntry/Cdd_Pwm_SetFallingEdgeDelayCount</BSW-MODULE-ENTRY-REF>
            </BSW-MODULE-ENTRY-REF-CONDITIONAL>
            <BSW-MODULE-ENTRY-REF-CONDITIONAL>
              <BSW-MODULE-ENTRY-REF DEST="BSW-MODULE-ENTRY">/Cdd_Pwm_TI_F29H85x/Cdd_Pwm_ModuleEntry/Cdd_Pwm_ConfigureChopper</BSW-MODULE-ENTRY-REF>
            </BSW-MODULE-ENTRY-REF-CONDITIONAL>
            <BSW-MODULE-ENTRY-REF-CONDITIONAL>
              <BSW-MODULE-ENTRY-REF DEST="BSW-MODULE-ENTRY">/Cdd_Pwm_TI_F29H85x/Cdd_Pwm_ModuleEntry/Cdd_Pwm_SetChopperDutyCycle</BSW-MODULE-ENTRY-REF>
            </BSW-MODULE-ENTRY-REF-CONDITIONAL>
            <BSW-MODULE-ENTRY-REF-CONDITIONAL>
              <BSW-MODULE-ENTRY-REF DEST="BSW-MODULE-ENTRY">/Cdd_Pwm_TI_F29H85x/Cdd_Pwm_ModuleEntry/Cdd_Pwm_SetChopperFreq</BSW-MODULE-ENTRY-REF>
            </BSW-MODULE-ENTRY-REF-CONDITIONAL>
            <BSW-MODULE-ENTRY-REF-CONDITIONAL>
              <BSW-MODULE-ENTRY-REF DEST="BSW-MODULE-ENTRY">/Cdd_Pwm_TI_F29H85x/Cdd_Pwm_ModuleEntry/Cdd_Pwm_SetChopperFirstPulseWidth</BSW-MODULE-ENTRY-REF>
            </BSW-MODULE-ENTRY-REF-CONDITIONAL>
            <BSW-MODULE-ENTRY-REF-CONDITIONAL>
              <BSW-MODULE-ENTRY-REF DEST="BSW-MODULE-ENTRY">/Cdd_Pwm_TI_F29H85x/Cdd_Pwm_ModuleEntry/Cdd_Pwm_ConfigureTripZoneSignals</BSW-MODULE-ENTRY-REF>
            </BSW-MODULE-ENTRY-REF-CONDITIONAL>
            <BSW-MODULE-ENTRY-REF-CONDITIONAL>
              <BSW-MODULE-ENTRY-REF DEST="BSW-MODULE-ENTRY">/Cdd_Pwm_TI_F29H85x/Cdd_Pwm_ModuleEntry/Cdd_Pwm_SetTripZoneDigitalCompareEventCondition</BSW-MODULE-ENTRY-REF>
            </BSW-MODULE-ENTRY-REF-CONDITIONAL>
            <BSW-MODULE-ENTRY-REF-CONDITIONAL>
              <BSW-MODULE-ENTRY-REF DEST="BSW-MODULE-ENTRY">/Cdd_Pwm_TI_F29H85x/Cdd_Pwm_ModuleEntry/Cdd_Pwm_ConfigureTripZoneAdvAction</BSW-MODULE-ENTRY-REF>
            </BSW-MODULE-ENTRY-REF-CONDITIONAL>
            <BSW-MODULE-ENTRY-REF-CONDITIONAL>
              <BSW-MODULE-ENTRY-REF DEST="BSW-MODULE-ENTRY">/Cdd_Pwm_TI_F29H85x/Cdd_Pwm_ModuleEntry/Cdd_Pwm_SetTripZoneAction</BSW-MODULE-ENTRY-REF>
            </BSW-MODULE-ENTRY-REF-CONDITIONAL>
            <BSW-MODULE-ENTRY-REF-CONDITIONAL>
              <BSW-MODULE-ENTRY-REF DEST="BSW-MODULE-ENTRY">/Cdd_Pwm_TI_F29H85x/Cdd_Pwm_ModuleEntry/Cdd_Pwm_SetTripZoneAdvAction</BSW-MODULE-ENTRY-REF>
            </BSW-MODULE-ENTRY-REF-CONDITIONAL>
            <BSW-MODULE-ENTRY-REF-CONDITIONAL>
              <BSW-MODULE-ENTRY-REF DEST="BSW-MODULE-ENTRY">/Cdd_Pwm_TI_F29H85x/Cdd_Pwm_ModuleEntry/Cdd_Pwm_SetTripZoneAdvDigitalCompareAction</BSW-MODULE-ENTRY-REF>
            </BSW-MODULE-ENTRY-REF-CONDITIONAL>
            <BSW-MODULE-ENTRY-REF-CONDITIONAL>
              <BSW-MODULE-ENTRY-REF DEST="BSW-MODULE-ENTRY">/Cdd_Pwm_TI_F29H85x/Cdd_Pwm_ModuleEntry/Cdd_Pwm_ConfigureTripZoneInterrupt</BSW-MODULE-ENTRY-REF>
            </BSW-MODULE-ENTRY-REF-CONDITIONAL>
            <BSW-MODULE-ENTRY-REF-CONDITIONAL>
              <BSW-MODULE-ENTRY-REF DEST="BSW-MODULE-ENTRY">/Cdd_Pwm_TI_F29H85x/Cdd_Pwm_ModuleEntry/Cdd_Pwm_GetTripZoneFlagStatus</BSW-MODULE-ENTRY-REF>
            </BSW-MODULE-ENTRY-REF-CONDITIONAL>
            <BSW-MODULE-ENTRY-REF-CONDITIONAL>
              <BSW-MODULE-ENTRY-REF DEST="BSW-MODULE-ENTRY">/Cdd_Pwm_TI_F29H85x/Cdd_Pwm_ModuleEntry/Cdd_Pwm_GetCycleByCycleTripZoneFlagStatus</BSW-MODULE-ENTRY-REF>
            </BSW-MODULE-ENTRY-REF-CONDITIONAL>
            <BSW-MODULE-ENTRY-REF-CONDITIONAL>
              <BSW-MODULE-ENTRY-REF DEST="BSW-MODULE-ENTRY">/Cdd_Pwm_TI_F29H85x/Cdd_Pwm_ModuleEntry/Cdd_Pwm_GetOneShotTripZoneFlagStatus</BSW-MODULE-ENTRY-REF>
            </BSW-MODULE-ENTRY-REF-CONDITIONAL>
            <BSW-MODULE-ENTRY-REF-CONDITIONAL>
              <BSW-MODULE-ENTRY-REF DEST="BSW-MODULE-ENTRY">/Cdd_Pwm_TI_F29H85x/Cdd_Pwm_ModuleEntry/Cdd_Pwm_SelectCycleByCycleTripZoneClearEvent</BSW-MODULE-ENTRY-REF>
            </BSW-MODULE-ENTRY-REF-CONDITIONAL>
            <BSW-MODULE-ENTRY-REF-CONDITIONAL>
              <BSW-MODULE-ENTRY-REF DEST="BSW-MODULE-ENTRY">/Cdd_Pwm_TI_F29H85x/Cdd_Pwm_ModuleEntry/Cdd_Pwm_ClearTripZoneFlag</BSW-MODULE-ENTRY-REF>
            </BSW-MODULE-ENTRY-REF-CONDITIONAL>
            <BSW-MODULE-ENTRY-REF-CONDITIONAL>
              <BSW-MODULE-ENTRY-REF DEST="BSW-MODULE-ENTRY">/Cdd_Pwm_TI_F29H85x/Cdd_Pwm_ModuleEntry/Cdd_Pwm_ClearCycleByCycleTripZoneFlag</BSW-MODULE-ENTRY-REF>
            </BSW-MODULE-ENTRY-REF-CONDITIONAL>
            <BSW-MODULE-ENTRY-REF-CONDITIONAL>
              <BSW-MODULE-ENTRY-REF DEST="BSW-MODULE-ENTRY">/Cdd_Pwm_TI_F29H85x/Cdd_Pwm_ModuleEntry/Cdd_Pwm_ClearOneShotTripZoneFlag</BSW-MODULE-ENTRY-REF>
            </BSW-MODULE-ENTRY-REF-CONDITIONAL>
            <BSW-MODULE-ENTRY-REF-CONDITIONAL>
              <BSW-MODULE-ENTRY-REF DEST="BSW-MODULE-ENTRY">/Cdd_Pwm_TI_F29H85x/Cdd_Pwm_ModuleEntry/Cdd_Pwm_ForceTripZoneEvent</BSW-MODULE-ENTRY-REF>
            </BSW-MODULE-ENTRY-REF-CONDITIONAL>
            <BSW-MODULE-ENTRY-REF-CONDITIONAL>
              <BSW-MODULE-ENTRY-REF DEST="BSW-MODULE-ENTRY">/Cdd_Pwm_TI_F29H85x/Cdd_Pwm_ModuleEntry/Cdd_Pwm_ConfigureTripOutSource</BSW-MODULE-ENTRY-REF>
            </BSW-MODULE-ENTRY-REF-CONDITIONAL>
            <BSW-MODULE-ENTRY-REF-CONDITIONAL>
              <BSW-MODULE-ENTRY-REF DEST="BSW-MODULE-ENTRY">/Cdd_Pwm_TI_F29H85x/Cdd_Pwm_ModuleEntry/Cdd_Pwm_ConfigureInterrupt</BSW-MODULE-ENTRY-REF>
            </BSW-MODULE-ENTRY-REF-CONDITIONAL>
            <BSW-MODULE-ENTRY-REF-CONDITIONAL>
              <BSW-MODULE-ENTRY-REF DEST="BSW-MODULE-ENTRY">/Cdd_Pwm_TI_F29H85x/Cdd_Pwm_ModuleEntry/Cdd_Pwm_SetInterruptSource</BSW-MODULE-ENTRY-REF>
            </BSW-MODULE-ENTRY-REF-CONDITIONAL>
            <BSW-MODULE-ENTRY-REF-CONDITIONAL>
              <BSW-MODULE-ENTRY-REF DEST="BSW-MODULE-ENTRY">/Cdd_Pwm_TI_F29H85x/Cdd_Pwm_ModuleEntry/Cdd_Pwm_GetEventTriggerInterruptStatus</BSW-MODULE-ENTRY-REF>
            </BSW-MODULE-ENTRY-REF-CONDITIONAL>
            <BSW-MODULE-ENTRY-REF-CONDITIONAL>
              <BSW-MODULE-ENTRY-REF DEST="BSW-MODULE-ENTRY">/Cdd_Pwm_TI_F29H85x/Cdd_Pwm_ModuleEntry/Cdd_Pwm_ClearEventTriggerInterruptFlag</BSW-MODULE-ENTRY-REF>
            </BSW-MODULE-ENTRY-REF-CONDITIONAL>
            <BSW-MODULE-ENTRY-REF-CONDITIONAL>
              <BSW-MODULE-ENTRY-REF DEST="BSW-MODULE-ENTRY">/Cdd_Pwm_TI_F29H85x/Cdd_Pwm_ModuleEntry/Cdd_Pwm_ConfigureInterruptEventCountInit</BSW-MODULE-ENTRY-REF>
            </BSW-MODULE-ENTRY-REF-CONDITIONAL>
            <BSW-MODULE-ENTRY-REF-CONDITIONAL>
              <BSW-MODULE-ENTRY-REF DEST="BSW-MODULE-ENTRY">/Cdd_Pwm_TI_F29H85x/Cdd_Pwm_ModuleEntry/Cdd_Pwm_ForceInterruptEventCountInit</BSW-MODULE-ENTRY-REF>
            </BSW-MODULE-ENTRY-REF-CONDITIONAL>
            <BSW-MODULE-ENTRY-REF-CONDITIONAL>
              <BSW-MODULE-ENTRY-REF DEST="BSW-MODULE-ENTRY">/Cdd_Pwm_TI_F29H85x/Cdd_Pwm_ModuleEntry/Cdd_Pwm_SetInterruptEventCountInitValue</BSW-MODULE-ENTRY-REF>
            </BSW-MODULE-ENTRY-REF-CONDITIONAL>
            <BSW-MODULE-ENTRY-REF-CONDITIONAL>
              <BSW-MODULE-ENTRY-REF DEST="BSW-MODULE-ENTRY">/Cdd_Pwm_TI_F29H85x/Cdd_Pwm_ModuleEntry/Cdd_Pwm_GetInterruptEventCount</BSW-MODULE-ENTRY-REF>
            </BSW-MODULE-ENTRY-REF-CONDITIONAL>
            <BSW-MODULE-ENTRY-REF-CONDITIONAL>
              <BSW-MODULE-ENTRY-REF DEST="BSW-MODULE-ENTRY">/Cdd_Pwm_TI_F29H85x/Cdd_Pwm_ModuleEntry/Cdd_Pwm_ForceEventTriggerInterrupt</BSW-MODULE-ENTRY-REF>
            </BSW-MODULE-ENTRY-REF-CONDITIONAL>
            <BSW-MODULE-ENTRY-REF-CONDITIONAL>
              <BSW-MODULE-ENTRY-REF DEST="BSW-MODULE-ENTRY">/Cdd_Pwm_TI_F29H85x/Cdd_Pwm_ModuleEntry/Cdd_Pwm_SetMixEvtTriggerSource</BSW-MODULE-ENTRY-REF>
            </BSW-MODULE-ENTRY-REF-CONDITIONAL>
            <BSW-MODULE-ENTRY-REF-CONDITIONAL>
              <BSW-MODULE-ENTRY-REF DEST="BSW-MODULE-ENTRY">/Cdd_Pwm_TI_F29H85x/Cdd_Pwm_ModuleEntry/Cdd_Pwm_ConfigureAdcTrigger</BSW-MODULE-ENTRY-REF>
            </BSW-MODULE-ENTRY-REF-CONDITIONAL>
            <BSW-MODULE-ENTRY-REF-CONDITIONAL>
              <BSW-MODULE-ENTRY-REF DEST="BSW-MODULE-ENTRY">/Cdd_Pwm_TI_F29H85x/Cdd_Pwm_ModuleEntry/Cdd_Pwm_SetAdcTriggerSource</BSW-MODULE-ENTRY-REF>
            </BSW-MODULE-ENTRY-REF-CONDITIONAL>
            <BSW-MODULE-ENTRY-REF-CONDITIONAL>
              <BSW-MODULE-ENTRY-REF DEST="BSW-MODULE-ENTRY">/Cdd_Pwm_TI_F29H85x/Cdd_Pwm_ModuleEntry/Cdd_Pwm_SetAdcTriggerEventPrescale</BSW-MODULE-ENTRY-REF>
            </BSW-MODULE-ENTRY-REF-CONDITIONAL>
            <BSW-MODULE-ENTRY-REF-CONDITIONAL>
              <BSW-MODULE-ENTRY-REF DEST="BSW-MODULE-ENTRY">/Cdd_Pwm_TI_F29H85x/Cdd_Pwm_ModuleEntry/Cdd_Pwm_GetAdcTriggerFlagStatus</BSW-MODULE-ENTRY-REF>
            </BSW-MODULE-ENTRY-REF-CONDITIONAL>
            <BSW-MODULE-ENTRY-REF-CONDITIONAL>
              <BSW-MODULE-ENTRY-REF DEST="BSW-MODULE-ENTRY">/Cdd_Pwm_TI_F29H85x/Cdd_Pwm_ModuleEntry/Cdd_Pwm_ClearAdcTriggerFlag</BSW-MODULE-ENTRY-REF>
            </BSW-MODULE-ENTRY-REF-CONDITIONAL>
            <BSW-MODULE-ENTRY-REF-CONDITIONAL>
              <BSW-MODULE-ENTRY-REF DEST="BSW-MODULE-ENTRY">/Cdd_Pwm_TI_F29H85x/Cdd_Pwm_ModuleEntry/Cdd_Pwm_ConfigureAdcTriggerEventCountInit</BSW-MODULE-ENTRY-REF>
            </BSW-MODULE-ENTRY-REF-CONDITIONAL>
            <BSW-MODULE-ENTRY-REF-CONDITIONAL>
              <BSW-MODULE-ENTRY-REF DEST="BSW-MODULE-ENTRY">/Cdd_Pwm_TI_F29H85x/Cdd_Pwm_ModuleEntry/Cdd_Pwm_ForceAdcTriggerEventCountInit</BSW-MODULE-ENTRY-REF>
            </BSW-MODULE-ENTRY-REF-CONDITIONAL>
            <BSW-MODULE-ENTRY-REF-CONDITIONAL>
              <BSW-MODULE-ENTRY-REF DEST="BSW-MODULE-ENTRY">/Cdd_Pwm_TI_F29H85x/Cdd_Pwm_ModuleEntry/Cdd_Pwm_SetAdcTriggerEventCountInitValue</BSW-MODULE-ENTRY-REF>
            </BSW-MODULE-ENTRY-REF-CONDITIONAL>
            <BSW-MODULE-ENTRY-REF-CONDITIONAL>
              <BSW-MODULE-ENTRY-REF DEST="BSW-MODULE-ENTRY">/Cdd_Pwm_TI_F29H85x/Cdd_Pwm_ModuleEntry/Cdd_Pwm_GetAdcTriggerEventCount</BSW-MODULE-ENTRY-REF>
            </BSW-MODULE-ENTRY-REF-CONDITIONAL>
            <BSW-MODULE-ENTRY-REF-CONDITIONAL>
              <BSW-MODULE-ENTRY-REF DEST="BSW-MODULE-ENTRY">/Cdd_Pwm_TI_F29H85x/Cdd_Pwm_ModuleEntry/Cdd_Pwm_ForceAdcTrigger</BSW-MODULE-ENTRY-REF>
            </BSW-MODULE-ENTRY-REF-CONDITIONAL>
            <BSW-MODULE-ENTRY-REF-CONDITIONAL>
              <BSW-MODULE-ENTRY-REF DEST="BSW-MODULE-ENTRY">/Cdd_Pwm_TI_F29H85x/Cdd_Pwm_ModuleEntry/Cdd_Pwm_SelectDigitalCompareTripInput</BSW-MODULE-ENTRY-REF>
            </BSW-MODULE-ENTRY-REF-CONDITIONAL>
            <BSW-MODULE-ENTRY-REF-CONDITIONAL>
              <BSW-MODULE-ENTRY-REF DEST="BSW-MODULE-ENTRY">/Cdd_Pwm_TI_F29H85x/Cdd_Pwm_ModuleEntry/Cdd_Pwm_ConfigureDigitalCompareBlankingWindow</BSW-MODULE-ENTRY-REF>
            </BSW-MODULE-ENTRY-REF-CONDITIONAL>
            <BSW-MODULE-ENTRY-REF-CONDITIONAL>
              <BSW-MODULE-ENTRY-REF DEST="BSW-MODULE-ENTRY">/Cdd_Pwm_TI_F29H85x/Cdd_Pwm_ModuleEntry/Cdd_Pwm_ConfigureDigitalCompareWindowInverseMode</BSW-MODULE-ENTRY-REF>
            </BSW-MODULE-ENTRY-REF-CONDITIONAL>
            <BSW-MODULE-ENTRY-REF-CONDITIONAL>
              <BSW-MODULE-ENTRY-REF DEST="BSW-MODULE-ENTRY">/Cdd_Pwm_TI_F29H85x/Cdd_Pwm_ModuleEntry/Cdd_Pwm_SetDigitalCompareBlankingEvent</BSW-MODULE-ENTRY-REF>
            </BSW-MODULE-ENTRY-REF-CONDITIONAL>
            <BSW-MODULE-ENTRY-REF-CONDITIONAL>
              <BSW-MODULE-ENTRY-REF DEST="BSW-MODULE-ENTRY">/Cdd_Pwm_TI_F29H85x/Cdd_Pwm_ModuleEntry/Cdd_Pwm_SetDigitalCompareFilterInput</BSW-MODULE-ENTRY-REF>
            </BSW-MODULE-ENTRY-REF-CONDITIONAL>
            <BSW-MODULE-ENTRY-REF-CONDITIONAL>
              <BSW-MODULE-ENTRY-REF DEST="BSW-MODULE-ENTRY">/Cdd_Pwm_TI_F29H85x/Cdd_Pwm_ModuleEntry/Cdd_Pwm_ConfigureDigitalCompareEdgeFilter</BSW-MODULE-ENTRY-REF>
            </BSW-MODULE-ENTRY-REF-CONDITIONAL>
            <BSW-MODULE-ENTRY-REF-CONDITIONAL>
              <BSW-MODULE-ENTRY-REF DEST="BSW-MODULE-ENTRY">/Cdd_Pwm_TI_F29H85x/Cdd_Pwm_ModuleEntry/Cdd_Pwm_SetDigitalCompareEdgeFilterMode</BSW-MODULE-ENTRY-REF>
            </BSW-MODULE-ENTRY-REF-CONDITIONAL>
            <BSW-MODULE-ENTRY-REF-CONDITIONAL>
              <BSW-MODULE-ENTRY-REF DEST="BSW-MODULE-ENTRY">/Cdd_Pwm_TI_F29H85x/Cdd_Pwm_ModuleEntry/Cdd_Pwm_SetDigitalCompareEdgeFilterEdgeCount</BSW-MODULE-ENTRY-REF>
            </BSW-MODULE-ENTRY-REF-CONDITIONAL>
            <BSW-MODULE-ENTRY-REF-CONDITIONAL>
              <BSW-MODULE-ENTRY-REF DEST="BSW-MODULE-ENTRY">/Cdd_Pwm_TI_F29H85x/Cdd_Pwm_ModuleEntry/Cdd_Pwm_GetDigitalCompareEdgeFilterEdgeCount</BSW-MODULE-ENTRY-REF>
            </BSW-MODULE-ENTRY-REF-CONDITIONAL>
            <BSW-MODULE-ENTRY-REF-CONDITIONAL>
              <BSW-MODULE-ENTRY-REF DEST="BSW-MODULE-ENTRY">/Cdd_Pwm_TI_F29H85x/Cdd_Pwm_ModuleEntry/Cdd_Pwm_GetDigitalCompareEdgeFilterEdgeStatus</BSW-MODULE-ENTRY-REF>
            </BSW-MODULE-ENTRY-REF-CONDITIONAL>
            <BSW-MODULE-ENTRY-REF-CONDITIONAL>
              <BSW-MODULE-ENTRY-REF DEST="BSW-MODULE-ENTRY">/Cdd_Pwm_TI_F29H85x/Cdd_Pwm_ModuleEntry/Cdd_Pwm_SetDigitalCompareWindowOffset</BSW-MODULE-ENTRY-REF>
            </BSW-MODULE-ENTRY-REF-CONDITIONAL>
            <BSW-MODULE-ENTRY-REF-CONDITIONAL>
              <BSW-MODULE-ENTRY-REF DEST="BSW-MODULE-ENTRY">/Cdd_Pwm_TI_F29H85x/Cdd_Pwm_ModuleEntry/Cdd_Pwm_SetDigitalCompareWindowLength</BSW-MODULE-ENTRY-REF>
            </BSW-MODULE-ENTRY-REF-CONDITIONAL>
            <BSW-MODULE-ENTRY-REF-CONDITIONAL>
              <BSW-MODULE-ENTRY-REF DEST="BSW-MODULE-ENTRY">/Cdd_Pwm_TI_F29H85x/Cdd_Pwm_ModuleEntry/Cdd_Pwm_GetDigitalCompareBlankingWindowOffsetCount</BSW-MODULE-ENTRY-REF>
            </BSW-MODULE-ENTRY-REF-CONDITIONAL>
            <BSW-MODULE-ENTRY-REF-CONDITIONAL>
              <BSW-MODULE-ENTRY-REF DEST="BSW-MODULE-ENTRY">/Cdd_Pwm_TI_F29H85x/Cdd_Pwm_ModuleEntry/Cdd_Pwm_GetDigitalCompareBlankingWindowLengthCount</BSW-MODULE-ENTRY-REF>
            </BSW-MODULE-ENTRY-REF-CONDITIONAL>
            <BSW-MODULE-ENTRY-REF-CONDITIONAL>
              <BSW-MODULE-ENTRY-REF DEST="BSW-MODULE-ENTRY">/Cdd_Pwm_TI_F29H85x/Cdd_Pwm_ModuleEntry/Cdd_Pwm_SetDigitalCompareEventSource</BSW-MODULE-ENTRY-REF>
            </BSW-MODULE-ENTRY-REF-CONDITIONAL>
            <BSW-MODULE-ENTRY-REF-CONDITIONAL>
              <BSW-MODULE-ENTRY-REF DEST="BSW-MODULE-ENTRY">/Cdd_Pwm_TI_F29H85x/Cdd_Pwm_ModuleEntry/Cdd_Pwm_SetDigitalCompareEventSyncMode</BSW-MODULE-ENTRY-REF>
            </BSW-MODULE-ENTRY-REF-CONDITIONAL>
            <BSW-MODULE-ENTRY-REF-CONDITIONAL>
              <BSW-MODULE-ENTRY-REF DEST="BSW-MODULE-ENTRY">/Cdd_Pwm_TI_F29H85x/Cdd_Pwm_ModuleEntry/Cdd_Pwm_ConfigureDigitalCompareAdcTrigger</BSW-MODULE-ENTRY-REF>
            </BSW-MODULE-ENTRY-REF-CONDITIONAL>
            <BSW-MODULE-ENTRY-REF-CONDITIONAL>
              <BSW-MODULE-ENTRY-REF DEST="BSW-MODULE-ENTRY">/Cdd_Pwm_TI_F29H85x/Cdd_Pwm_ModuleEntry/Cdd_Pwm_ConfigureDigitalCompareSyncEvent</BSW-MODULE-ENTRY-REF>
            </BSW-MODULE-ENTRY-REF-CONDITIONAL>
            <BSW-MODULE-ENTRY-REF-CONDITIONAL>
              <BSW-MODULE-ENTRY-REF DEST="BSW-MODULE-ENTRY">/Cdd_Pwm_TI_F29H85x/Cdd_Pwm_ModuleEntry/Cdd_Pwm_SetDigitalCompareCBCLatchMode</BSW-MODULE-ENTRY-REF>
            </BSW-MODULE-ENTRY-REF-CONDITIONAL>
            <BSW-MODULE-ENTRY-REF-CONDITIONAL>
              <BSW-MODULE-ENTRY-REF DEST="BSW-MODULE-ENTRY">/Cdd_Pwm_TI_F29H85x/Cdd_Pwm_ModuleEntry/Cdd_Pwm_SelectDigitalCompareCBCLatchClearEvent</BSW-MODULE-ENTRY-REF>
            </BSW-MODULE-ENTRY-REF-CONDITIONAL>
            <BSW-MODULE-ENTRY-REF-CONDITIONAL>
              <BSW-MODULE-ENTRY-REF DEST="BSW-MODULE-ENTRY">/Cdd_Pwm_TI_F29H85x/Cdd_Pwm_ModuleEntry/Cdd_Pwm_GetDigitalCompareCBCLatchStatus</BSW-MODULE-ENTRY-REF>
            </BSW-MODULE-ENTRY-REF-CONDITIONAL>
            <BSW-MODULE-ENTRY-REF-CONDITIONAL>
              <BSW-MODULE-ENTRY-REF DEST="BSW-MODULE-ENTRY">/Cdd_Pwm_TI_F29H85x/Cdd_Pwm_ModuleEntry/Cdd_Pwm_ConfigureDigitalCompareCounterCapture</BSW-MODULE-ENTRY-REF>
            </BSW-MODULE-ENTRY-REF-CONDITIONAL>
            <BSW-MODULE-ENTRY-REF-CONDITIONAL>
              <BSW-MODULE-ENTRY-REF DEST="BSW-MODULE-ENTRY">/Cdd_Pwm_TI_F29H85x/Cdd_Pwm_ModuleEntry/Cdd_Pwm_SetDigitalCompareCounterShadowMode</BSW-MODULE-ENTRY-REF>
            </BSW-MODULE-ENTRY-REF-CONDITIONAL>
            <BSW-MODULE-ENTRY-REF-CONDITIONAL>
              <BSW-MODULE-ENTRY-REF DEST="BSW-MODULE-ENTRY">/Cdd_Pwm_TI_F29H85x/Cdd_Pwm_ModuleEntry/Cdd_Pwm_GetDigitalCompareCaptureStatus</BSW-MODULE-ENTRY-REF>
            </BSW-MODULE-ENTRY-REF-CONDITIONAL>
            <BSW-MODULE-ENTRY-REF-CONDITIONAL>
              <BSW-MODULE-ENTRY-REF DEST="BSW-MODULE-ENTRY">/Cdd_Pwm_TI_F29H85x/Cdd_Pwm_ModuleEntry/Cdd_Pwm_ConfigureDigitalCompareCounterCaptureMode</BSW-MODULE-ENTRY-REF>
            </BSW-MODULE-ENTRY-REF-CONDITIONAL>
            <BSW-MODULE-ENTRY-REF-CONDITIONAL>
              <BSW-MODULE-ENTRY-REF DEST="BSW-MODULE-ENTRY">/Cdd_Pwm_TI_F29H85x/Cdd_Pwm_ModuleEntry/Cdd_Pwm_ClearDigitalCompareCaptureStatusFlag</BSW-MODULE-ENTRY-REF>
            </BSW-MODULE-ENTRY-REF-CONDITIONAL>
            <BSW-MODULE-ENTRY-REF-CONDITIONAL>
              <BSW-MODULE-ENTRY-REF DEST="BSW-MODULE-ENTRY">/Cdd_Pwm_TI_F29H85x/Cdd_Pwm_ModuleEntry/Cdd_Pwm_GetDigitalCompareCaptureCount</BSW-MODULE-ENTRY-REF>
            </BSW-MODULE-ENTRY-REF-CONDITIONAL>
            <BSW-MODULE-ENTRY-REF-CONDITIONAL>
              <BSW-MODULE-ENTRY-REF DEST="BSW-MODULE-ENTRY">/Cdd_Pwm_TI_F29H85x/Cdd_Pwm_ModuleEntry/Cdd_Pwm_ConfigureDigitalCompareTripCombinationInput</BSW-MODULE-ENTRY-REF>
            </BSW-MODULE-ENTRY-REF-CONDITIONAL>
            <BSW-MODULE-ENTRY-REF-CONDITIONAL>
              <BSW-MODULE-ENTRY-REF DEST="BSW-MODULE-ENTRY">/Cdd_Pwm_TI_F29H85x/Cdd_Pwm_ModuleEntry/Cdd_Pwm_ConfigureCaptureInEvent</BSW-MODULE-ENTRY-REF>
            </BSW-MODULE-ENTRY-REF-CONDITIONAL>
            <BSW-MODULE-ENTRY-REF-CONDITIONAL>
              <BSW-MODULE-ENTRY-REF DEST="BSW-MODULE-ENTRY">/Cdd_Pwm_TI_F29H85x/Cdd_Pwm_ModuleEntry/Cdd_Pwm_ConfigCaptureGateInputPolarity</BSW-MODULE-ENTRY-REF>
            </BSW-MODULE-ENTRY-REF-CONDITIONAL>
            <BSW-MODULE-ENTRY-REF-CONDITIONAL>
              <BSW-MODULE-ENTRY-REF DEST="BSW-MODULE-ENTRY">/Cdd_Pwm_TI_F29H85x/Cdd_Pwm_ModuleEntry/Cdd_Pwm_InvertCaptureInputPolarity</BSW-MODULE-ENTRY-REF>
            </BSW-MODULE-ENTRY-REF-CONDITIONAL>
            <BSW-MODULE-ENTRY-REF-CONDITIONAL>
              <BSW-MODULE-ENTRY-REF DEST="BSW-MODULE-ENTRY">/Cdd_Pwm_TI_F29H85x/Cdd_Pwm_ModuleEntry/Cdd_Pwm_ConfigureIndependentPulseLogic</BSW-MODULE-ENTRY-REF>
            </BSW-MODULE-ENTRY-REF-CONDITIONAL>
            <BSW-MODULE-ENTRY-REF-CONDITIONAL>
              <BSW-MODULE-ENTRY-REF DEST="BSW-MODULE-ENTRY">/Cdd_Pwm_TI_F29H85x/Cdd_Pwm_ModuleEntry/Cdd_Pwm_ForceCaptureEventLoad</BSW-MODULE-ENTRY-REF>
            </BSW-MODULE-ENTRY-REF-CONDITIONAL>
            <BSW-MODULE-ENTRY-REF-CONDITIONAL>
              <BSW-MODULE-ENTRY-REF DEST="BSW-MODULE-ENTRY">/Cdd_Pwm_TI_F29H85x/Cdd_Pwm_ModuleEntry/Cdd_Pwm_SelectCaptureTripInput</BSW-MODULE-ENTRY-REF>
            </BSW-MODULE-ENTRY-REF-CONDITIONAL>
            <BSW-MODULE-ENTRY-REF-CONDITIONAL>
              <BSW-MODULE-ENTRY-REF DEST="BSW-MODULE-ENTRY">/Cdd_Pwm_TI_F29H85x/Cdd_Pwm_ModuleEntry/Cdd_Pwm_ConfigureCaptureTripCombinationInput</BSW-MODULE-ENTRY-REF>
            </BSW-MODULE-ENTRY-REF-CONDITIONAL>
            <BSW-MODULE-ENTRY-REF-CONDITIONAL>
              <BSW-MODULE-ENTRY-REF DEST="BSW-MODULE-ENTRY">/Cdd_Pwm_TI_F29H85x/Cdd_Pwm_ModuleEntry/Cdd_Pwm_ConfigureValleyCapture</BSW-MODULE-ENTRY-REF>
            </BSW-MODULE-ENTRY-REF-CONDITIONAL>
            <BSW-MODULE-ENTRY-REF-CONDITIONAL>
              <BSW-MODULE-ENTRY-REF DEST="BSW-MODULE-ENTRY">/Cdd_Pwm_TI_F29H85x/Cdd_Pwm_ModuleEntry/Cdd_Pwm_StartValleyCapture</BSW-MODULE-ENTRY-REF>
            </BSW-MODULE-ENTRY-REF-CONDITIONAL>
            <BSW-MODULE-ENTRY-REF-CONDITIONAL>
              <BSW-MODULE-ENTRY-REF DEST="BSW-MODULE-ENTRY">/Cdd_Pwm_TI_F29H85x/Cdd_Pwm_ModuleEntry/Cdd_Pwm_SetValleyTriggerSource</BSW-MODULE-ENTRY-REF>
            </BSW-MODULE-ENTRY-REF-CONDITIONAL>
            <BSW-MODULE-ENTRY-REF-CONDITIONAL>
              <BSW-MODULE-ENTRY-REF DEST="BSW-MODULE-ENTRY">/Cdd_Pwm_TI_F29H85x/Cdd_Pwm_ModuleEntry/Cdd_Pwm_SetValleyTriggerEdgeCounts</BSW-MODULE-ENTRY-REF>
            </BSW-MODULE-ENTRY-REF-CONDITIONAL>
            <BSW-MODULE-ENTRY-REF-CONDITIONAL>
              <BSW-MODULE-ENTRY-REF DEST="BSW-MODULE-ENTRY">/Cdd_Pwm_TI_F29H85x/Cdd_Pwm_ModuleEntry/Cdd_Pwm_ConfigureValleyHwDelay</BSW-MODULE-ENTRY-REF>
            </BSW-MODULE-ENTRY-REF-CONDITIONAL>
            <BSW-MODULE-ENTRY-REF-CONDITIONAL>
              <BSW-MODULE-ENTRY-REF DEST="BSW-MODULE-ENTRY">/Cdd_Pwm_TI_F29H85x/Cdd_Pwm_ModuleEntry/Cdd_Pwm_SetValleySwDelayValue</BSW-MODULE-ENTRY-REF>
            </BSW-MODULE-ENTRY-REF-CONDITIONAL>
            <BSW-MODULE-ENTRY-REF-CONDITIONAL>
              <BSW-MODULE-ENTRY-REF DEST="BSW-MODULE-ENTRY">/Cdd_Pwm_TI_F29H85x/Cdd_Pwm_ModuleEntry/Cdd_Pwm_SetValleyDelayDivider</BSW-MODULE-ENTRY-REF>
            </BSW-MODULE-ENTRY-REF-CONDITIONAL>
            <BSW-MODULE-ENTRY-REF-CONDITIONAL>
              <BSW-MODULE-ENTRY-REF DEST="BSW-MODULE-ENTRY">/Cdd_Pwm_TI_F29H85x/Cdd_Pwm_ModuleEntry/Cdd_Pwm_GetValleyEdgeStatus</BSW-MODULE-ENTRY-REF>
            </BSW-MODULE-ENTRY-REF-CONDITIONAL>
            <BSW-MODULE-ENTRY-REF-CONDITIONAL>
              <BSW-MODULE-ENTRY-REF DEST="BSW-MODULE-ENTRY">/Cdd_Pwm_TI_F29H85x/Cdd_Pwm_ModuleEntry/Cdd_Pwm_GetValleyCount</BSW-MODULE-ENTRY-REF>
            </BSW-MODULE-ENTRY-REF-CONDITIONAL>
            <BSW-MODULE-ENTRY-REF-CONDITIONAL>
              <BSW-MODULE-ENTRY-REF DEST="BSW-MODULE-ENTRY">/Cdd_Pwm_TI_F29H85x/Cdd_Pwm_ModuleEntry/Cdd_Pwm_GetValleyHwDelay</BSW-MODULE-ENTRY-REF>
            </BSW-MODULE-ENTRY-REF-CONDITIONAL>
            <BSW-MODULE-ENTRY-REF-CONDITIONAL>
              <BSW-MODULE-ENTRY-REF DEST="BSW-MODULE-ENTRY">/Cdd_Pwm_TI_F29H85x/Cdd_Pwm_ModuleEntry/Cdd_Pwm_ConfigureGlobalLoad</BSW-MODULE-ENTRY-REF>
            </BSW-MODULE-ENTRY-REF-CONDITIONAL>
            <BSW-MODULE-ENTRY-REF-CONDITIONAL>
              <BSW-MODULE-ENTRY-REF DEST="BSW-MODULE-ENTRY">/Cdd_Pwm_TI_F29H85x/Cdd_Pwm_ModuleEntry/Cdd_Pwm_SetGlobalLoadTrigger</BSW-MODULE-ENTRY-REF>
            </BSW-MODULE-ENTRY-REF-CONDITIONAL>
            <BSW-MODULE-ENTRY-REF-CONDITIONAL>
              <BSW-MODULE-ENTRY-REF DEST="BSW-MODULE-ENTRY">/Cdd_Pwm_TI_F29H85x/Cdd_Pwm_ModuleEntry/Cdd_Pwm_SetGlobalLoadEventPrescale</BSW-MODULE-ENTRY-REF>
            </BSW-MODULE-ENTRY-REF-CONDITIONAL>
            <BSW-MODULE-ENTRY-REF-CONDITIONAL>
              <BSW-MODULE-ENTRY-REF DEST="BSW-MODULE-ENTRY">/Cdd_Pwm_TI_F29H85x/Cdd_Pwm_ModuleEntry/Cdd_Pwm_GetGlobalLoadEventCount</BSW-MODULE-ENTRY-REF>
            </BSW-MODULE-ENTRY-REF-CONDITIONAL>
            <BSW-MODULE-ENTRY-REF-CONDITIONAL>
              <BSW-MODULE-ENTRY-REF DEST="BSW-MODULE-ENTRY">/Cdd_Pwm_TI_F29H85x/Cdd_Pwm_ModuleEntry/Cdd_Pwm_ConfigureGlobalLoadOneShotMode</BSW-MODULE-ENTRY-REF>
            </BSW-MODULE-ENTRY-REF-CONDITIONAL>
            <BSW-MODULE-ENTRY-REF-CONDITIONAL>
              <BSW-MODULE-ENTRY-REF DEST="BSW-MODULE-ENTRY">/Cdd_Pwm_TI_F29H85x/Cdd_Pwm_ModuleEntry/Cdd_Pwm_SetGlobalLoadOneShotLatch</BSW-MODULE-ENTRY-REF>
            </BSW-MODULE-ENTRY-REF-CONDITIONAL>
            <BSW-MODULE-ENTRY-REF-CONDITIONAL>
              <BSW-MODULE-ENTRY-REF DEST="BSW-MODULE-ENTRY">/Cdd_Pwm_TI_F29H85x/Cdd_Pwm_ModuleEntry/Cdd_Pwm_ForceGlobalLoadOneShotEvent</BSW-MODULE-ENTRY-REF>
            </BSW-MODULE-ENTRY-REF-CONDITIONAL>
            <BSW-MODULE-ENTRY-REF-CONDITIONAL>
              <BSW-MODULE-ENTRY-REF DEST="BSW-MODULE-ENTRY">/Cdd_Pwm_TI_F29H85x/Cdd_Pwm_ModuleEntry/Cdd_Pwm_ConfigureGlobalLoadRegisters</BSW-MODULE-ENTRY-REF>
            </BSW-MODULE-ENTRY-REF-CONDITIONAL>
            <BSW-MODULE-ENTRY-REF-CONDITIONAL>
              <BSW-MODULE-ENTRY-REF DEST="BSW-MODULE-ENTRY">/Cdd_Pwm_TI_F29H85x/Cdd_Pwm_ModuleEntry/Cdd_Pwm_LockRegisters</BSW-MODULE-ENTRY-REF>
            </BSW-MODULE-ENTRY-REF-CONDITIONAL>
            <BSW-MODULE-ENTRY-REF-CONDITIONAL>
              <BSW-MODULE-ENTRY-REF DEST="BSW-MODULE-ENTRY">/Cdd_Pwm_TI_F29H85x/Cdd_Pwm_ModuleEntry/Cdd_Pwm_ConfigureXCmpMode</BSW-MODULE-ENTRY-REF>
            </BSW-MODULE-ENTRY-REF-CONDITIONAL>
            <BSW-MODULE-ENTRY-REF-CONDITIONAL>
              <BSW-MODULE-ENTRY-REF DEST="BSW-MODULE-ENTRY">/Cdd_Pwm_TI_F29H85x/Cdd_Pwm_ModuleEntry/Cdd_Pwm_ConfigureSplitXCmp</BSW-MODULE-ENTRY-REF>
            </BSW-MODULE-ENTRY-REF-CONDITIONAL>
            <BSW-MODULE-ENTRY-REF-CONDITIONAL>
              <BSW-MODULE-ENTRY-REF DEST="BSW-MODULE-ENTRY">/Cdd_Pwm_TI_F29H85x/Cdd_Pwm_ModuleEntry/Cdd_Pwm_AllocAXCmp</BSW-MODULE-ENTRY-REF>
            </BSW-MODULE-ENTRY-REF-CONDITIONAL>
            <BSW-MODULE-ENTRY-REF-CONDITIONAL>
              <BSW-MODULE-ENTRY-REF DEST="BSW-MODULE-ENTRY">/Cdd_Pwm_TI_F29H85x/Cdd_Pwm_ModuleEntry/Cdd_Pwm_AllocBXCmp</BSW-MODULE-ENTRY-REF>
            </BSW-MODULE-ENTRY-REF-CONDITIONAL>
            <BSW-MODULE-ENTRY-REF-CONDITIONAL>
              <BSW-MODULE-ENTRY-REF DEST="BSW-MODULE-ENTRY">/Cdd_Pwm_TI_F29H85x/Cdd_Pwm_ModuleEntry/Cdd_Pwm_SetXCmpRegValue</BSW-MODULE-ENTRY-REF>
            </BSW-MODULE-ENTRY-REF-CONDITIONAL>
            <BSW-MODULE-ENTRY-REF-CONDITIONAL>
              <BSW-MODULE-ENTRY-REF DEST="BSW-MODULE-ENTRY">/Cdd_Pwm_TI_F29H85x/Cdd_Pwm_ModuleEntry/Cdd_Pwm_SetCmpShadowRegValue</BSW-MODULE-ENTRY-REF>
            </BSW-MODULE-ENTRY-REF-CONDITIONAL>
            <BSW-MODULE-ENTRY-REF-CONDITIONAL>
              <BSW-MODULE-ENTRY-REF DEST="BSW-MODULE-ENTRY">/Cdd_Pwm_TI_F29H85x/Cdd_Pwm_ModuleEntry/Cdd_Pwm_SetXMinMaxRegValue</BSW-MODULE-ENTRY-REF>
            </BSW-MODULE-ENTRY-REF-CONDITIONAL>
            <BSW-MODULE-ENTRY-REF-CONDITIONAL>
              <BSW-MODULE-ENTRY-REF DEST="BSW-MODULE-ENTRY">/Cdd_Pwm_TI_F29H85x/Cdd_Pwm_ModuleEntry/Cdd_Pwm_SetXCmpActionQualifierAction</BSW-MODULE-ENTRY-REF>
            </BSW-MODULE-ENTRY-REF-CONDITIONAL>
            <BSW-MODULE-ENTRY-REF-CONDITIONAL>
              <BSW-MODULE-ENTRY-REF DEST="BSW-MODULE-ENTRY">/Cdd_Pwm_TI_F29H85x/Cdd_Pwm_ModuleEntry/Cdd_Pwm_EnableXLoad</BSW-MODULE-ENTRY-REF>
            </BSW-MODULE-ENTRY-REF-CONDITIONAL>
            <BSW-MODULE-ENTRY-REF-CONDITIONAL>
              <BSW-MODULE-ENTRY-REF DEST="BSW-MODULE-ENTRY">/Cdd_Pwm_TI_F29H85x/Cdd_Pwm_ModuleEntry/Cdd_Pwm_ForceXLoad</BSW-MODULE-ENTRY-REF>
            </BSW-MODULE-ENTRY-REF-CONDITIONAL>
            <BSW-MODULE-ENTRY-REF-CONDITIONAL>
              <BSW-MODULE-ENTRY-REF DEST="BSW-MODULE-ENTRY">/Cdd_Pwm_TI_F29H85x/Cdd_Pwm_ModuleEntry/Cdd_Pwm_SetXCmpLoadMode</BSW-MODULE-ENTRY-REF>
            </BSW-MODULE-ENTRY-REF-CONDITIONAL>
            <BSW-MODULE-ENTRY-REF-CONDITIONAL>
              <BSW-MODULE-ENTRY-REF DEST="BSW-MODULE-ENTRY">/Cdd_Pwm_TI_F29H85x/Cdd_Pwm_ModuleEntry/Cdd_Pwm_SetXCmpShadowLevel</BSW-MODULE-ENTRY-REF>
            </BSW-MODULE-ENTRY-REF-CONDITIONAL>
            <BSW-MODULE-ENTRY-REF-CONDITIONAL>
              <BSW-MODULE-ENTRY-REF DEST="BSW-MODULE-ENTRY">/Cdd_Pwm_TI_F29H85x/Cdd_Pwm_ModuleEntry/Cdd_Pwm_SetXCmpShadowBufPtrLoadOnce</BSW-MODULE-ENTRY-REF>
            </BSW-MODULE-ENTRY-REF-CONDITIONAL>
            <BSW-MODULE-ENTRY-REF-CONDITIONAL>
              <BSW-MODULE-ENTRY-REF DEST="BSW-MODULE-ENTRY">/Cdd_Pwm_TI_F29H85x/Cdd_Pwm_ModuleEntry/Cdd_Pwm_SetXCmpShadowRepeatBufxCount</BSW-MODULE-ENTRY-REF>
            </BSW-MODULE-ENTRY-REF-CONDITIONAL>
            <BSW-MODULE-ENTRY-REF-CONDITIONAL>
              <BSW-MODULE-ENTRY-REF DEST="BSW-MODULE-ENTRY">/Cdd_Pwm_TI_F29H85x/Cdd_Pwm_ModuleEntry/Cdd_Pwm_ConfigureMinimumDeadBand</BSW-MODULE-ENTRY-REF>
            </BSW-MODULE-ENTRY-REF-CONDITIONAL>
            <BSW-MODULE-ENTRY-REF-CONDITIONAL>
              <BSW-MODULE-ENTRY-REF DEST="BSW-MODULE-ENTRY">/Cdd_Pwm_TI_F29H85x/Cdd_Pwm_ModuleEntry/Cdd_Pwm_InvertMinimumDeadBandSignal</BSW-MODULE-ENTRY-REF>
            </BSW-MODULE-ENTRY-REF-CONDITIONAL>
            <BSW-MODULE-ENTRY-REF-CONDITIONAL>
              <BSW-MODULE-ENTRY-REF DEST="BSW-MODULE-ENTRY">/Cdd_Pwm_TI_F29H85x/Cdd_Pwm_ModuleEntry/Cdd_Pwm_SelectMinimumDeadBandAndOrLogic</BSW-MODULE-ENTRY-REF>
            </BSW-MODULE-ENTRY-REF-CONDITIONAL>
            <BSW-MODULE-ENTRY-REF-CONDITIONAL>
              <BSW-MODULE-ENTRY-REF DEST="BSW-MODULE-ENTRY">/Cdd_Pwm_TI_F29H85x/Cdd_Pwm_ModuleEntry/Cdd_Pwm_SelectMinimumDeadBandBlockingSignal</BSW-MODULE-ENTRY-REF>
            </BSW-MODULE-ENTRY-REF-CONDITIONAL>
            <BSW-MODULE-ENTRY-REF-CONDITIONAL>
              <BSW-MODULE-ENTRY-REF DEST="BSW-MODULE-ENTRY">/Cdd_Pwm_TI_F29H85x/Cdd_Pwm_ModuleEntry/Cdd_Pwm_SelectMinimumDeadBandReferenceSignal</BSW-MODULE-ENTRY-REF>
            </BSW-MODULE-ENTRY-REF-CONDITIONAL>
            <BSW-MODULE-ENTRY-REF-CONDITIONAL>
              <BSW-MODULE-ENTRY-REF DEST="BSW-MODULE-ENTRY">/Cdd_Pwm_TI_F29H85x/Cdd_Pwm_ModuleEntry/Cdd_Pwm_GetMinDeadBandDelay</BSW-MODULE-ENTRY-REF>
            </BSW-MODULE-ENTRY-REF-CONDITIONAL>
            <BSW-MODULE-ENTRY-REF-CONDITIONAL>
              <BSW-MODULE-ENTRY-REF DEST="BSW-MODULE-ENTRY">/Cdd_Pwm_TI_F29H85x/Cdd_Pwm_ModuleEntry/Cdd_Pwm_SetMinimumDeadBandDelay</BSW-MODULE-ENTRY-REF>
            </BSW-MODULE-ENTRY-REF-CONDITIONAL>
            <BSW-MODULE-ENTRY-REF-CONDITIONAL>
              <BSW-MODULE-ENTRY-REF DEST="BSW-MODULE-ENTRY">/Cdd_Pwm_TI_F29H85x/Cdd_Pwm_ModuleEntry/Cdd_Pwm_ConfigureIllegalComboLogic</BSW-MODULE-ENTRY-REF>
            </BSW-MODULE-ENTRY-REF-CONDITIONAL>
            <BSW-MODULE-ENTRY-REF-CONDITIONAL>
              <BSW-MODULE-ENTRY-REF DEST="BSW-MODULE-ENTRY">/Cdd_Pwm_TI_F29H85x/Cdd_Pwm_ModuleEntry/Cdd_Pwm_SelectXbarInput</BSW-MODULE-ENTRY-REF>
            </BSW-MODULE-ENTRY-REF-CONDITIONAL>
            <BSW-MODULE-ENTRY-REF-CONDITIONAL>
              <BSW-MODULE-ENTRY-REF DEST="BSW-MODULE-ENTRY">/Cdd_Pwm_TI_F29H85x/Cdd_Pwm_ModuleEntry/Cdd_Pwm_SetLutDecX</BSW-MODULE-ENTRY-REF>
            </BSW-MODULE-ENTRY-REF-CONDITIONAL>
            <BSW-MODULE-ENTRY-REF-CONDITIONAL>
              <BSW-MODULE-ENTRY-REF DEST="BSW-MODULE-ENTRY">/Cdd_Pwm_TI_F29H85x/Cdd_Pwm_ModuleEntry/Cdd_Pwm_ConfigureDiodeEmulationMode</BSW-MODULE-ENTRY-REF>
            </BSW-MODULE-ENTRY-REF-CONDITIONAL>
            <BSW-MODULE-ENTRY-REF-CONDITIONAL>
              <BSW-MODULE-ENTRY-REF DEST="BSW-MODULE-ENTRY">/Cdd_Pwm_TI_F29H85x/Cdd_Pwm_ModuleEntry/Cdd_Pwm_SetDiodeEmulationMode</BSW-MODULE-ENTRY-REF>
            </BSW-MODULE-ENTRY-REF-CONDITIONAL>
            <BSW-MODULE-ENTRY-REF-CONDITIONAL>
              <BSW-MODULE-ENTRY-REF DEST="BSW-MODULE-ENTRY">/Cdd_Pwm_TI_F29H85x/Cdd_Pwm_ModuleEntry/Cdd_Pwm_SetDiodeEmulationReentryDelay</BSW-MODULE-ENTRY-REF>
            </BSW-MODULE-ENTRY-REF-CONDITIONAL>
            <BSW-MODULE-ENTRY-REF-CONDITIONAL>
              <BSW-MODULE-ENTRY-REF DEST="BSW-MODULE-ENTRY">/Cdd_Pwm_TI_F29H85x/Cdd_Pwm_ModuleEntry/Cdd_Pwm_ConfigureDiodeEmulationTripLowSources</BSW-MODULE-ENTRY-REF>
            </BSW-MODULE-ENTRY-REF-CONDITIONAL>
            <BSW-MODULE-ENTRY-REF-CONDITIONAL>
              <BSW-MODULE-ENTRY-REF DEST="BSW-MODULE-ENTRY">/Cdd_Pwm_TI_F29H85x/Cdd_Pwm_ModuleEntry/Cdd_Pwm_ConfigureDiodeEmulationTripHighSources</BSW-MODULE-ENTRY-REF>
            </BSW-MODULE-ENTRY-REF-CONDITIONAL>
            <BSW-MODULE-ENTRY-REF-CONDITIONAL>
              <BSW-MODULE-ENTRY-REF DEST="BSW-MODULE-ENTRY">/Cdd_Pwm_TI_F29H85x/Cdd_Pwm_ModuleEntry/Cdd_Pwm_SelectDiodeEmulationPwmSignal</BSW-MODULE-ENTRY-REF>
            </BSW-MODULE-ENTRY-REF-CONDITIONAL>
            <BSW-MODULE-ENTRY-REF-CONDITIONAL>
              <BSW-MODULE-ENTRY-REF DEST="BSW-MODULE-ENTRY">/Cdd_Pwm_TI_F29H85x/Cdd_Pwm_ModuleEntry/Cdd_Pwm_SelectDiodeEmulationTripSignal</BSW-MODULE-ENTRY-REF>
            </BSW-MODULE-ENTRY-REF-CONDITIONAL>
            <BSW-MODULE-ENTRY-REF-CONDITIONAL>
              <BSW-MODULE-ENTRY-REF DEST="BSW-MODULE-ENTRY">/Cdd_Pwm_TI_F29H85x/Cdd_Pwm_ModuleEntry/Cdd_Pwm_NoBypassDiodeEmulationLogic</BSW-MODULE-ENTRY-REF>
            </BSW-MODULE-ENTRY-REF-CONDITIONAL>
            <BSW-MODULE-ENTRY-REF-CONDITIONAL>
              <BSW-MODULE-ENTRY-REF DEST="BSW-MODULE-ENTRY">/Cdd_Pwm_TI_F29H85x/Cdd_Pwm_ModuleEntry/Cdd_Pwm_ByPassDiodeEmulationLogic</BSW-MODULE-ENTRY-REF>
            </BSW-MODULE-ENTRY-REF-CONDITIONAL>
            <BSW-MODULE-ENTRY-REF-CONDITIONAL>
              <BSW-MODULE-ENTRY-REF DEST="BSW-MODULE-ENTRY">/Cdd_Pwm_TI_F29H85x/Cdd_Pwm_ModuleEntry/Cdd_Pwm_ForceDiodeEmulationActive</BSW-MODULE-ENTRY-REF>
            </BSW-MODULE-ENTRY-REF-CONDITIONAL>
            <BSW-MODULE-ENTRY-REF-CONDITIONAL>
              <BSW-MODULE-ENTRY-REF DEST="BSW-MODULE-ENTRY">/Cdd_Pwm_TI_F29H85x/Cdd_Pwm_ModuleEntry/Cdd_Pwm_ConfigureDiodeEmulationMonitorModeControl</BSW-MODULE-ENTRY-REF>
            </BSW-MODULE-ENTRY-REF-CONDITIONAL>
            <BSW-MODULE-ENTRY-REF-CONDITIONAL>
              <BSW-MODULE-ENTRY-REF DEST="BSW-MODULE-ENTRY">/Cdd_Pwm_TI_F29H85x/Cdd_Pwm_ModuleEntry/Cdd_Pwm_SetDiodeEmulationMonitorModeStep</BSW-MODULE-ENTRY-REF>
            </BSW-MODULE-ENTRY-REF-CONDITIONAL>
            <BSW-MODULE-ENTRY-REF-CONDITIONAL>
              <BSW-MODULE-ENTRY-REF DEST="BSW-MODULE-ENTRY">/Cdd_Pwm_TI_F29H85x/Cdd_Pwm_ModuleEntry/Cdd_Pwm_SetDiodeEmulationMonitorCounterThreshold</BSW-MODULE-ENTRY-REF>
            </BSW-MODULE-ENTRY-REF-CONDITIONAL>
            <BSW-MODULE-ENTRY-REF-CONDITIONAL>
              <BSW-MODULE-ENTRY-REF DEST="BSW-MODULE-ENTRY">/Cdd_Pwm_TI_F29H85x/Cdd_Pwm_ModuleEntry/Cdd_Pwm_ClearDiodeEmulationActiveFlag</BSW-MODULE-ENTRY-REF>
            </BSW-MODULE-ENTRY-REF-CONDITIONAL>
            [!IF "(num:i(ecu:get('ResourceAllocator_F29H85x.Cdd_Pwm_HrpwmCalCount')) > 0)"!]
            <BSW-MODULE-ENTRY-REF-CONDITIONAL>
              <BSW-MODULE-ENTRY-REF DEST="BSW-MODULE-ENTRY">/Cdd_Pwm_TI_F29H85x/Cdd_Pwm_ModuleEntry/Cdd_Pwm_HrpwmSetPhaseShift</BSW-MODULE-ENTRY-REF>
            </BSW-MODULE-ENTRY-REF-CONDITIONAL>
            <BSW-MODULE-ENTRY-REF-CONDITIONAL>
              <BSW-MODULE-ENTRY-REF DEST="BSW-MODULE-ENTRY">/Cdd_Pwm_TI_F29H85x/Cdd_Pwm_ModuleEntry/Cdd_Pwm_HrpwmSetHiResPhaseShiftOnly</BSW-MODULE-ENTRY-REF>
            </BSW-MODULE-ENTRY-REF-CONDITIONAL>
            <BSW-MODULE-ENTRY-REF-CONDITIONAL>
              <BSW-MODULE-ENTRY-REF DEST="BSW-MODULE-ENTRY">/Cdd_Pwm_TI_F29H85x/Cdd_Pwm_ModuleEntry/Cdd_Pwm_HrpwmSetTimeBasePeriod</BSW-MODULE-ENTRY-REF>
            </BSW-MODULE-ENTRY-REF-CONDITIONAL>
            <BSW-MODULE-ENTRY-REF-CONDITIONAL>
              <BSW-MODULE-ENTRY-REF DEST="BSW-MODULE-ENTRY">/Cdd_Pwm_TI_F29H85x/Cdd_Pwm_ModuleEntry/Cdd_Pwm_HrpwmSetHiResTimeBasePeriodOnly</BSW-MODULE-ENTRY-REF>
            </BSW-MODULE-ENTRY-REF-CONDITIONAL>
            <BSW-MODULE-ENTRY-REF-CONDITIONAL>
              <BSW-MODULE-ENTRY-REF DEST="BSW-MODULE-ENTRY">/Cdd_Pwm_TI_F29H85x/Cdd_Pwm_ModuleEntry/Cdd_Pwm_HrpwmGetTimeBasePeriod</BSW-MODULE-ENTRY-REF>
            </BSW-MODULE-ENTRY-REF-CONDITIONAL>
            <BSW-MODULE-ENTRY-REF-CONDITIONAL>
              <BSW-MODULE-ENTRY-REF DEST="BSW-MODULE-ENTRY">/Cdd_Pwm_TI_F29H85x/Cdd_Pwm_ModuleEntry/Cdd_Pwm_HrpwmGetHiResTimeBasePeriodOnly</BSW-MODULE-ENTRY-REF>
            </BSW-MODULE-ENTRY-REF-CONDITIONAL>
            <BSW-MODULE-ENTRY-REF-CONDITIONAL>
              <BSW-MODULE-ENTRY-REF DEST="BSW-MODULE-ENTRY">/Cdd_Pwm_TI_F29H85x/Cdd_Pwm_ModuleEntry/Cdd_Pwm_HrpwmSetMepEdgeSelect</BSW-MODULE-ENTRY-REF>
            </BSW-MODULE-ENTRY-REF-CONDITIONAL>
            <BSW-MODULE-ENTRY-REF-CONDITIONAL>
              <BSW-MODULE-ENTRY-REF DEST="BSW-MODULE-ENTRY">/Cdd_Pwm_TI_F29H85x/Cdd_Pwm_ModuleEntry/Cdd_Pwm_HrpwmSetMepControlMode</BSW-MODULE-ENTRY-REF>
            </BSW-MODULE-ENTRY-REF-CONDITIONAL>
            <BSW-MODULE-ENTRY-REF-CONDITIONAL>
              <BSW-MODULE-ENTRY-REF DEST="BSW-MODULE-ENTRY">/Cdd_Pwm_TI_F29H85x/Cdd_Pwm_ModuleEntry/Cdd_Pwm_HrpwmSetCounterCompareShadowLoadEvent</BSW-MODULE-ENTRY-REF>
            </BSW-MODULE-ENTRY-REF-CONDITIONAL>
            <BSW-MODULE-ENTRY-REF-CONDITIONAL>
              <BSW-MODULE-ENTRY-REF DEST="BSW-MODULE-ENTRY">/Cdd_Pwm_TI_F29H85x/Cdd_Pwm_ModuleEntry/Cdd_Pwm_HrpwmSetOutputSwapMode</BSW-MODULE-ENTRY-REF>
            </BSW-MODULE-ENTRY-REF-CONDITIONAL>
            <BSW-MODULE-ENTRY-REF-CONDITIONAL>
              <BSW-MODULE-ENTRY-REF DEST="BSW-MODULE-ENTRY">/Cdd_Pwm_TI_F29H85x/Cdd_Pwm_ModuleEntry/Cdd_Pwm_HrpwmSetChannelBOutputPath</BSW-MODULE-ENTRY-REF>
            </BSW-MODULE-ENTRY-REF-CONDITIONAL>
            <BSW-MODULE-ENTRY-REF-CONDITIONAL>
              <BSW-MODULE-ENTRY-REF DEST="BSW-MODULE-ENTRY">/Cdd_Pwm_TI_F29H85x/Cdd_Pwm_ModuleEntry/Cdd_Pwm_HrpwmConfigureAutoConversion</BSW-MODULE-ENTRY-REF>
            </BSW-MODULE-ENTRY-REF-CONDITIONAL>
            <BSW-MODULE-ENTRY-REF-CONDITIONAL>
              <BSW-MODULE-ENTRY-REF DEST="BSW-MODULE-ENTRY">/Cdd_Pwm_TI_F29H85x/Cdd_Pwm_ModuleEntry/Cdd_Pwm_HrpwmConfigurePeriodControl</BSW-MODULE-ENTRY-REF>
            </BSW-MODULE-ENTRY-REF-CONDITIONAL>
            <BSW-MODULE-ENTRY-REF-CONDITIONAL>
              <BSW-MODULE-ENTRY-REF DEST="BSW-MODULE-ENTRY">/Cdd_Pwm_TI_F29H85x/Cdd_Pwm_ModuleEntry/Cdd_Pwm_HrpwmConfigurePhaseShiftLoad</BSW-MODULE-ENTRY-REF>
            </BSW-MODULE-ENTRY-REF-CONDITIONAL>
            <BSW-MODULE-ENTRY-REF-CONDITIONAL>
              <BSW-MODULE-ENTRY-REF DEST="BSW-MODULE-ENTRY">/Cdd_Pwm_TI_F29H85x/Cdd_Pwm_ModuleEntry/Cdd_Pwm_HrpwmSetSyncPulseSource</BSW-MODULE-ENTRY-REF>
            </BSW-MODULE-ENTRY-REF-CONDITIONAL>
            <BSW-MODULE-ENTRY-REF-CONDITIONAL>
              <BSW-MODULE-ENTRY-REF DEST="BSW-MODULE-ENTRY">/Cdd_Pwm_TI_F29H85x/Cdd_Pwm_ModuleEntry/Cdd_Pwm_HrpwmSetTranslatorRemainder</BSW-MODULE-ENTRY-REF>
            </BSW-MODULE-ENTRY-REF-CONDITIONAL>
            <BSW-MODULE-ENTRY-REF-CONDITIONAL>
              <BSW-MODULE-ENTRY-REF DEST="BSW-MODULE-ENTRY">/Cdd_Pwm_TI_F29H85x/Cdd_Pwm_ModuleEntry/Cdd_Pwm_HrpwmSetCounterCompareValue</BSW-MODULE-ENTRY-REF>
            </BSW-MODULE-ENTRY-REF-CONDITIONAL>
            <BSW-MODULE-ENTRY-REF-CONDITIONAL>
              <BSW-MODULE-ENTRY-REF DEST="BSW-MODULE-ENTRY">/Cdd_Pwm_TI_F29H85x/Cdd_Pwm_ModuleEntry/Cdd_Pwm_HrpwmSetHiResCounterCompareValueOnly</BSW-MODULE-ENTRY-REF>
            </BSW-MODULE-ENTRY-REF-CONDITIONAL>
            <BSW-MODULE-ENTRY-REF-CONDITIONAL>
              <BSW-MODULE-ENTRY-REF DEST="BSW-MODULE-ENTRY">/Cdd_Pwm_TI_F29H85x/Cdd_Pwm_ModuleEntry/Cdd_Pwm_HrpwmGetCounterCompareValue</BSW-MODULE-ENTRY-REF>
            </BSW-MODULE-ENTRY-REF-CONDITIONAL>
            <BSW-MODULE-ENTRY-REF-CONDITIONAL>
              <BSW-MODULE-ENTRY-REF DEST="BSW-MODULE-ENTRY">/Cdd_Pwm_TI_F29H85x/Cdd_Pwm_ModuleEntry/Cdd_Pwm_GetHiResCounterCompareValueOnly</BSW-MODULE-ENTRY-REF>
            </BSW-MODULE-ENTRY-REF-CONDITIONAL>
            <BSW-MODULE-ENTRY-REF-CONDITIONAL>
              <BSW-MODULE-ENTRY-REF DEST="BSW-MODULE-ENTRY">/Cdd_Pwm_TI_F29H85x/Cdd_Pwm_ModuleEntry/Cdd_Pwm_HrpwmSetRisingEdgeDelay</BSW-MODULE-ENTRY-REF>
            </BSW-MODULE-ENTRY-REF-CONDITIONAL>
            <BSW-MODULE-ENTRY-REF-CONDITIONAL>
              <BSW-MODULE-ENTRY-REF DEST="BSW-MODULE-ENTRY">/Cdd_Pwm_TI_F29H85x/Cdd_Pwm_ModuleEntry/Cdd_Pwm_HrpwmSetHiResRisingEdgeDelayOnly</BSW-MODULE-ENTRY-REF>
            </BSW-MODULE-ENTRY-REF-CONDITIONAL>
            <BSW-MODULE-ENTRY-REF-CONDITIONAL>
              <BSW-MODULE-ENTRY-REF DEST="BSW-MODULE-ENTRY">/Cdd_Pwm_TI_F29H85x/Cdd_Pwm_ModuleEntry/Cdd_Pwm_HrpwmSetFallingEdgeDelay</BSW-MODULE-ENTRY-REF>
            </BSW-MODULE-ENTRY-REF-CONDITIONAL>
            <BSW-MODULE-ENTRY-REF-CONDITIONAL>
              <BSW-MODULE-ENTRY-REF DEST="BSW-MODULE-ENTRY">/Cdd_Pwm_TI_F29H85x/Cdd_Pwm_ModuleEntry/Cdd_Pwm_HrpwmSetMepStep</BSW-MODULE-ENTRY-REF>
            </BSW-MODULE-ENTRY-REF-CONDITIONAL>
            <BSW-MODULE-ENTRY-REF-CONDITIONAL>
              <BSW-MODULE-ENTRY-REF DEST="BSW-MODULE-ENTRY">/Cdd_Pwm_TI_F29H85x/Cdd_Pwm_ModuleEntry/Cdd_Pwm_HrpwmSetDeadbandMepEdgeSelect</BSW-MODULE-ENTRY-REF>
            </BSW-MODULE-ENTRY-REF-CONDITIONAL>
            <BSW-MODULE-ENTRY-REF-CONDITIONAL>
              <BSW-MODULE-ENTRY-REF DEST="BSW-MODULE-ENTRY">/Cdd_Pwm_TI_F29H85x/Cdd_Pwm_ModuleEntry/Cdd_Pwm_HrpwmSetRisingEdgeDelayLoadMode</BSW-MODULE-ENTRY-REF>
            </BSW-MODULE-ENTRY-REF-CONDITIONAL>
            <BSW-MODULE-ENTRY-REF-CONDITIONAL>
              <BSW-MODULE-ENTRY-REF DEST="BSW-MODULE-ENTRY">/Cdd_Pwm_TI_F29H85x/Cdd_Pwm_ModuleEntry/Cdd_Pwm_HrpwmSetFallingEdgeDelayLoadMode</BSW-MODULE-ENTRY-REF>
            </BSW-MODULE-ENTRY-REF-CONDITIONAL>
            <BSW-MODULE-ENTRY-REF-CONDITIONAL>
              <BSW-MODULE-ENTRY-REF DEST="BSW-MODULE-ENTRY">/Cdd_Pwm_TI_F29H85x/Cdd_Pwm_ModuleEntry/Cdd_Pwm_HrpwmLockRegisters</BSW-MODULE-ENTRY-REF>
            </BSW-MODULE-ENTRY-REF-CONDITIONAL>
            <BSW-MODULE-ENTRY-REF-CONDITIONAL>
              <BSW-MODULE-ENTRY-REF DEST="BSW-MODULE-ENTRY">/Cdd_Pwm_TI_F29H85x/Cdd_Pwm_ModuleEntry/Cdd_Pwm_HrpwmSetXCmpRegValue</BSW-MODULE-ENTRY-REF>
            </BSW-MODULE-ENTRY-REF-CONDITIONAL>
            <BSW-MODULE-ENTRY-REF-CONDITIONAL>
              <BSW-MODULE-ENTRY-REF DEST="BSW-MODULE-ENTRY">/Cdd_Pwm_TI_F29H85x/Cdd_Pwm_ModuleEntry/Cdd_Pwm_HrpwmSetHiResXCmpRegValueOnly</BSW-MODULE-ENTRY-REF>
            </BSW-MODULE-ENTRY-REF-CONDITIONAL>
            <BSW-MODULE-ENTRY-REF-CONDITIONAL>
              <BSW-MODULE-ENTRY-REF DEST="BSW-MODULE-ENTRY">/Cdd_Pwm_TI_F29H85x/Cdd_Pwm_ModuleEntry/Cdd_Pwm_ConfigureTripZone2Signals</BSW-MODULE-ENTRY-REF>
            </BSW-MODULE-ENTRY-REF-CONDITIONAL>
            <BSW-MODULE-ENTRY-REF-CONDITIONAL>
              <BSW-MODULE-ENTRY-REF DEST="BSW-MODULE-ENTRY">/Cdd_Pwm_TI_F29H85x/Cdd_Pwm_ModuleEntry/Cdd_Pwm_Sfo</BSW-MODULE-ENTRY-REF>
            </BSW-MODULE-ENTRY-REF-CONDITIONAL>
          [!ENDIF!]
          [!ENDIF!]
          </IMPLEMENTED-ENTRYS>
          <MODULE-ID>255</MODULE-ID>
          [!IF "(as:modconf('Cdd_Pwm/Cdd')[as:path(node:dtos(.))='/TI_F29H85x/Cdd_Pwm/Cdd']/CddPwmGeneral/CddPwmDevErrorDetect = 'true') or (as:modconf('Cdd_Pwm/Cdd')[as:path(node:dtos(.))='/TI_F29H85x/Cdd_Pwm/Cdd']/CddPwmConfigSet/CddPwmAdvancedMode = 'false')"!]
          <BSW-MODULE-DEPENDENCYS>
            <BSW-MODULE-DEPENDENCY UUID="444f21b0-f4a8-46c4-862a-8048f9c96990">
              <SHORT-NAME>Det</SHORT-NAME>
              <TARGET-MODULE-ID>15</TARGET-MODULE-ID>
              <TARGET-MODULE-REFS>
                <BSW-MODULE-DESCRIPTION-REF-CONDITIONAL>
                  <BSW-MODULE-DESCRIPTION-REF DEST="BSW-MODULE-DESCRIPTION">/AUTOSAR_Det/Det</BSW-MODULE-DESCRIPTION-REF>
                </BSW-MODULE-DESCRIPTION-REF-CONDITIONAL>
              </TARGET-MODULE-REFS>
            </BSW-MODULE-DEPENDENCY>
          </BSW-MODULE-DEPENDENCYS>
          [!ENDIF!]
          <INTERNAL-BEHAVIORS>
            <BSW-INTERNAL-BEHAVIOR UUID="a6980fe6-e16e-469a-9394-903e0a6f33ce">
              <SHORT-NAME>Cdd_Pwm_Behavior</SHORT-NAME>
              <EXCLUSIVE-AREAS>
                <EXCLUSIVE-AREA UUID="9ce6d3c7-4c6c-48aa-8364-0a594d37c05e">
                  <SHORT-NAME>CDD_PWM_EXCLUSIVE_AREA_0</SHORT-NAME>
                </EXCLUSIVE-AREA>
              </EXCLUSIVE-AREAS>
              <ENTITYS>
            [!LOOP "as:modconf('Cdd_Pwm/Cdd')[as:path(node:dtos(.))='/TI_F29H85x/Cdd_Pwm/Cdd']/CddPwmConfigSet/CddPwmHwUnitConfig/*/.//*[@name='CddPwmInterruptEnable']"!]
              [!IF "((node:value(../CddPwmInstance) = num:i(1)) and (node:value(.) = 'true'))"!]
                <BSW-INTERRUPT-ENTITY UUID="470e25d5-7ce7-4bf7-8308-ed9fc0d72215">
                  <SHORT-NAME>Cdd_Pwm_Epwm1_IntIsr</SHORT-NAME>
                  <REENTRANCY-LEVEL>NON-REENTRANT</REENTRANCY-LEVEL>
                  <IMPLEMENTED-ENTRY-REF DEST="BSW-MODULE-ENTRY">/Cdd_Pwm_TI_F29H85x/Cdd_Pwm_ModuleEntry/Cdd_Pwm_Epwm1_IntIsr</IMPLEMENTED-ENTRY-REF>
                  [!IF "node:value(../CddPwmInterruptCategory) = 'ISR_CAT2_INT'"!]
                  <INTERRUPT-CATEGORY>CAT-2</INTERRUPT-CATEGORY>
                  [!ELSE!]
                  <INTERRUPT-CATEGORY>CAT-1</INTERRUPT-CATEGORY>
                  [!ENDIF!]
                </BSW-INTERRUPT-ENTITY>
              [!ENDIF!]
            [!ENDLOOP!]
            [!LOOP "as:modconf('Cdd_Pwm/Cdd')[as:path(node:dtos(.))='/TI_F29H85x/Cdd_Pwm/Cdd']/CddPwmConfigSet/CddPwmHwUnitConfig/*/.//*[@name='CddPwmInterruptEnable']"!]
              [!IF "((node:value(../CddPwmInstance) = num:i(2)) and (node:value(.) = 'true'))"!]
                <BSW-INTERRUPT-ENTITY UUID="f3f33e9b-79a0-4e48-ace9-7444dac07af4">
                  <SHORT-NAME>Cdd_Pwm_Epwm2_IntIsr</SHORT-NAME>
                  <REENTRANCY-LEVEL>NON-REENTRANT</REENTRANCY-LEVEL>
                  <IMPLEMENTED-ENTRY-REF DEST="BSW-MODULE-ENTRY">/Cdd_Pwm_TI_F29H85x/Cdd_Pwm_ModuleEntry/Cdd_Pwm_Epwm2_IntIsr</IMPLEMENTED-ENTRY-REF>
                  [!IF "node:value(../CddPwmInterruptCategory) = 'ISR_CAT2_INT'"!]
                  <INTERRUPT-CATEGORY>CAT-2</INTERRUPT-CATEGORY>
                  [!ELSE!]
                  <INTERRUPT-CATEGORY>CAT-1</INTERRUPT-CATEGORY>
                  [!ENDIF!]
                </BSW-INTERRUPT-ENTITY>
              [!ENDIF!]
            [!ENDLOOP!]
            [!LOOP "as:modconf('Cdd_Pwm/Cdd')[as:path(node:dtos(.))='/TI_F29H85x/Cdd_Pwm/Cdd']/CddPwmConfigSet/CddPwmHwUnitConfig/*/.//*[@name='CddPwmInterruptEnable']"!]
              [!IF "((node:value(../CddPwmInstance) = num:i(3)) and (node:value(.) = 'true'))"!]
                <BSW-INTERRUPT-ENTITY UUID="5b52d342-cb2c-492c-8b8d-48714e82d305">
                  <SHORT-NAME>Cdd_Pwm_Epwm3_IntIsr</SHORT-NAME>
                  <REENTRANCY-LEVEL>NON-REENTRANT</REENTRANCY-LEVEL>
                  <IMPLEMENTED-ENTRY-REF DEST="BSW-MODULE-ENTRY">/Cdd_Pwm_TI_F29H85x/Cdd_Pwm_ModuleEntry/Cdd_Pwm_Epwm3_IntIsr</IMPLEMENTED-ENTRY-REF>
                  [!IF "node:value(../CddPwmInterruptCategory) = 'ISR_CAT2_INT'"!]
                  <INTERRUPT-CATEGORY>CAT-2</INTERRUPT-CATEGORY>
                  [!ELSE!]
                  <INTERRUPT-CATEGORY>CAT-1</INTERRUPT-CATEGORY>
                  [!ENDIF!]
                </BSW-INTERRUPT-ENTITY>
              [!ENDIF!]
            [!ENDLOOP!]
            [!LOOP "as:modconf('Cdd_Pwm/Cdd')[as:path(node:dtos(.))='/TI_F29H85x/Cdd_Pwm/Cdd']/CddPwmConfigSet/CddPwmHwUnitConfig/*/.//*[@name='CddPwmInterruptEnable']"!]
              [!IF "((node:value(../CddPwmInstance) = num:i(4)) and (node:value(.) = 'true'))"!]
                <BSW-INTERRUPT-ENTITY UUID="3dedf158-e83d-49d9-bfcd-8fcc0dbe39aa">
                  <SHORT-NAME>Cdd_Pwm_Epwm4_IntIsr</SHORT-NAME>
                  <REENTRANCY-LEVEL>NON-REENTRANT</REENTRANCY-LEVEL>
                  <IMPLEMENTED-ENTRY-REF DEST="BSW-MODULE-ENTRY">/Cdd_Pwm_TI_F29H85x/Cdd_Pwm_ModuleEntry/Cdd_Pwm_Epwm4_IntIsr</IMPLEMENTED-ENTRY-REF>
                  [!IF "node:value(../CddPwmInterruptCategory) = 'ISR_CAT2_INT'"!]
                  <INTERRUPT-CATEGORY>CAT-2</INTERRUPT-CATEGORY>
                  [!ELSE!]
                  <INTERRUPT-CATEGORY>CAT-1</INTERRUPT-CATEGORY>
                  [!ENDIF!]
                </BSW-INTERRUPT-ENTITY>
              [!ENDIF!]
            [!ENDLOOP!]
            [!LOOP "as:modconf('Cdd_Pwm/Cdd')[as:path(node:dtos(.))='/TI_F29H85x/Cdd_Pwm/Cdd']/CddPwmConfigSet/CddPwmHwUnitConfig/*/.//*[@name='CddPwmInterruptEnable']"!]
              [!IF "((node:value(../CddPwmInstance) = num:i(5)) and (node:value(.) = 'true'))"!]
                <BSW-INTERRUPT-ENTITY UUID="63b3c04c-e1ce-48bf-9780-2f2e47d4ffa6">
                  <SHORT-NAME>Cdd_Pwm_Epwm5_IntIsr</SHORT-NAME>
                  <REENTRANCY-LEVEL>NON-REENTRANT</REENTRANCY-LEVEL>
                  <IMPLEMENTED-ENTRY-REF DEST="BSW-MODULE-ENTRY">/Cdd_Pwm_TI_F29H85x/Cdd_Pwm_ModuleEntry/Cdd_Pwm_Epwm5_IntIsr</IMPLEMENTED-ENTRY-REF>
                  [!IF "node:value(../CddPwmInterruptCategory) = 'ISR_CAT2_INT'"!]
                  <INTERRUPT-CATEGORY>CAT-2</INTERRUPT-CATEGORY>
                  [!ELSE!]
                  <INTERRUPT-CATEGORY>CAT-1</INTERRUPT-CATEGORY>
                  [!ENDIF!]
                </BSW-INTERRUPT-ENTITY>
              [!ENDIF!]
            [!ENDLOOP!]
            [!LOOP "as:modconf('Cdd_Pwm/Cdd')[as:path(node:dtos(.))='/TI_F29H85x/Cdd_Pwm/Cdd']/CddPwmConfigSet/CddPwmHwUnitConfig/*/.//*[@name='CddPwmInterruptEnable']"!]
              [!IF "((node:value(../CddPwmInstance) = num:i(6)) and (node:value(.) = 'true'))"!]
                <BSW-INTERRUPT-ENTITY UUID="cfd67d6e-5bdd-41ec-820f-ad4f3b8f6907">
                  <SHORT-NAME>Cdd_Pwm_Epwm6_IntIsr</SHORT-NAME>
                  <REENTRANCY-LEVEL>NON-REENTRANT</REENTRANCY-LEVEL>
                  <IMPLEMENTED-ENTRY-REF DEST="BSW-MODULE-ENTRY">/Cdd_Pwm_TI_F29H85x/Cdd_Pwm_ModuleEntry/Cdd_Pwm_Epwm6_IntIsr</IMPLEMENTED-ENTRY-REF>
                  [!IF "node:value(../CddPwmInterruptCategory) = 'ISR_CAT2_INT'"!]
                  <INTERRUPT-CATEGORY>CAT-2</INTERRUPT-CATEGORY>
                  [!ELSE!]
                  <INTERRUPT-CATEGORY>CAT-1</INTERRUPT-CATEGORY>
                  [!ENDIF!]
                </BSW-INTERRUPT-ENTITY>
              [!ENDIF!]
            [!ENDLOOP!]
            [!LOOP "as:modconf('Cdd_Pwm/Cdd')[as:path(node:dtos(.))='/TI_F29H85x/Cdd_Pwm/Cdd']/CddPwmConfigSet/CddPwmHwUnitConfig/*/.//*[@name='CddPwmInterruptEnable']"!]
              [!IF "((node:value(../CddPwmInstance) = num:i(7)) and (node:value(.) = 'true'))"!]
                <BSW-INTERRUPT-ENTITY UUID="68298dd7-ff9d-4cb7-a452-95f23994d0ae">
                  <SHORT-NAME>Cdd_Pwm_Epwm7_IntIsr</SHORT-NAME>
                  <REENTRANCY-LEVEL>NON-REENTRANT</REENTRANCY-LEVEL>
                  <IMPLEMENTED-ENTRY-REF DEST="BSW-MODULE-ENTRY">/Cdd_Pwm_TI_F29H85x/Cdd_Pwm_ModuleEntry/Cdd_Pwm_Epwm7_IntIsr</IMPLEMENTED-ENTRY-REF>
                  [!IF "node:value(../CddPwmInterruptCategory) = 'ISR_CAT2_INT'"!]
                  <INTERRUPT-CATEGORY>CAT-2</INTERRUPT-CATEGORY>
                  [!ELSE!]
                  <INTERRUPT-CATEGORY>CAT-1</INTERRUPT-CATEGORY>
                  [!ENDIF!]
                </BSW-INTERRUPT-ENTITY>
              [!ENDIF!]
            [!ENDLOOP!]
            [!LOOP "as:modconf('Cdd_Pwm/Cdd')[as:path(node:dtos(.))='/TI_F29H85x/Cdd_Pwm/Cdd']/CddPwmConfigSet/CddPwmHwUnitConfig/*/.//*[@name='CddPwmInterruptEnable']"!]
              [!IF "((node:value(../CddPwmInstance) = num:i(8)) and (node:value(.) = 'true'))"!]
                <BSW-INTERRUPT-ENTITY UUID="51f2cd47-fcb8-4d84-8a9c-ee38e0211e5c">
                  <SHORT-NAME>Cdd_Pwm_Epwm8_IntIsr</SHORT-NAME>
                  <REENTRANCY-LEVEL>NON-REENTRANT</REENTRANCY-LEVEL>
                  <IMPLEMENTED-ENTRY-REF DEST="BSW-MODULE-ENTRY">/Cdd_Pwm_TI_F29H85x/Cdd_Pwm_ModuleEntry/Cdd_Pwm_Epwm8_IntIsr</IMPLEMENTED-ENTRY-REF>
                  [!IF "node:value(../CddPwmInterruptCategory) = 'ISR_CAT2_INT'"!]
                  <INTERRUPT-CATEGORY>CAT-2</INTERRUPT-CATEGORY>
                  [!ELSE!]
                  <INTERRUPT-CATEGORY>CAT-1</INTERRUPT-CATEGORY>
                  [!ENDIF!]
                </BSW-INTERRUPT-ENTITY>
              [!ENDIF!]
            [!ENDLOOP!]
            [!LOOP "as:modconf('Cdd_Pwm/Cdd')[as:path(node:dtos(.))='/TI_F29H85x/Cdd_Pwm/Cdd']/CddPwmConfigSet/CddPwmHwUnitConfig/*/.//*[@name='CddPwmInterruptEnable']"!]
              [!IF "((node:value(../CddPwmInstance) = num:i(9)) and (node:value(.) = 'true'))"!]
                <BSW-INTERRUPT-ENTITY UUID="dfe74e47-29f9-4c87-8762-8977cc724b10">
                  <SHORT-NAME>Cdd_Pwm_Epwm9_IntIsr</SHORT-NAME>
                  <REENTRANCY-LEVEL>NON-REENTRANT</REENTRANCY-LEVEL>
                  <IMPLEMENTED-ENTRY-REF DEST="BSW-MODULE-ENTRY">/Cdd_Pwm_TI_F29H85x/Cdd_Pwm_ModuleEntry/Cdd_Pwm_Epwm9_IntIsr</IMPLEMENTED-ENTRY-REF>
                  [!IF "node:value(../CddPwmInterruptCategory) = 'ISR_CAT2_INT'"!]
                  <INTERRUPT-CATEGORY>CAT-2</INTERRUPT-CATEGORY>
                  [!ELSE!]
                  <INTERRUPT-CATEGORY>CAT-1</INTERRUPT-CATEGORY>
                  [!ENDIF!]
                </BSW-INTERRUPT-ENTITY>
              [!ENDIF!]
            [!ENDLOOP!]
            [!LOOP "as:modconf('Cdd_Pwm/Cdd')[as:path(node:dtos(.))='/TI_F29H85x/Cdd_Pwm/Cdd']/CddPwmConfigSet/CddPwmHwUnitConfig/*/.//*[@name='CddPwmInterruptEnable']"!]
              [!IF "((node:value(../CddPwmInstance) = num:i(10)) and (node:value(.) = 'true'))"!]
                <BSW-INTERRUPT-ENTITY UUID="e909442b-e787-4db2-a59b-9cfd9995dc07">
                  <SHORT-NAME>Cdd_Pwm_Epwm10_IntIsr</SHORT-NAME>
                  <REENTRANCY-LEVEL>NON-REENTRANT</REENTRANCY-LEVEL>
                  <IMPLEMENTED-ENTRY-REF DEST="BSW-MODULE-ENTRY">/Cdd_Pwm_TI_F29H85x/Cdd_Pwm_ModuleEntry/Cdd_Pwm_Epwm10_IntIsr</IMPLEMENTED-ENTRY-REF>
                  [!IF "node:value(../CddPwmInterruptCategory) = 'ISR_CAT2_INT'"!]
                  <INTERRUPT-CATEGORY>CAT-2</INTERRUPT-CATEGORY>
                  [!ELSE!]
                  <INTERRUPT-CATEGORY>CAT-1</INTERRUPT-CATEGORY>
                  [!ENDIF!]
                </BSW-INTERRUPT-ENTITY>
              [!ENDIF!]
            [!ENDLOOP!]
            [!LOOP "as:modconf('Cdd_Pwm/Cdd')[as:path(node:dtos(.))='/TI_F29H85x/Cdd_Pwm/Cdd']/CddPwmConfigSet/CddPwmHwUnitConfig/*/.//*[@name='CddPwmInterruptEnable']"!]
              [!IF "((node:value(../CddPwmInstance) = num:i(11)) and (node:value(.) = 'true'))"!]
                <BSW-INTERRUPT-ENTITY UUID="d086d4b9-bf4c-4b8d-8452-3b55b1ca9d9c">
                  <SHORT-NAME>Cdd_Pwm_Epwm11_IntIsr</SHORT-NAME>
                  <REENTRANCY-LEVEL>NON-REENTRANT</REENTRANCY-LEVEL>
                  <IMPLEMENTED-ENTRY-REF DEST="BSW-MODULE-ENTRY">/Cdd_Pwm_TI_F29H85x/Cdd_Pwm_ModuleEntry/Cdd_Pwm_Epwm11_IntIsr</IMPLEMENTED-ENTRY-REF>
                  [!IF "node:value(../CddPwmInterruptCategory) = 'ISR_CAT2_INT'"!]
                  <INTERRUPT-CATEGORY>CAT-2</INTERRUPT-CATEGORY>
                  [!ELSE!]
                  <INTERRUPT-CATEGORY>CAT-1</INTERRUPT-CATEGORY>
                  [!ENDIF!]
                </BSW-INTERRUPT-ENTITY>
              [!ENDIF!]
            [!ENDLOOP!]
            [!LOOP "as:modconf('Cdd_Pwm/Cdd')[as:path(node:dtos(.))='/TI_F29H85x/Cdd_Pwm/Cdd']/CddPwmConfigSet/CddPwmHwUnitConfig/*/.//*[@name='CddPwmInterruptEnable']"!]
              [!IF "((node:value(../CddPwmInstance) = num:i(12)) and (node:value(.) = 'true'))"!]
                <BSW-INTERRUPT-ENTITY UUID="cf18c78e-6a6b-4dc6-9d52-1319342664c1">
                  <SHORT-NAME>Cdd_Pwm_Epwm12_IntIsr</SHORT-NAME>
                  <REENTRANCY-LEVEL>NON-REENTRANT</REENTRANCY-LEVEL>
                  <IMPLEMENTED-ENTRY-REF DEST="BSW-MODULE-ENTRY">/Cdd_Pwm_TI_F29H85x/Cdd_Pwm_ModuleEntry/Cdd_Pwm_Epwm12_IntIsr</IMPLEMENTED-ENTRY-REF>
                  [!IF "node:value(../CddPwmInterruptCategory) = 'ISR_CAT2_INT'"!]
                  <INTERRUPT-CATEGORY>CAT-2</INTERRUPT-CATEGORY>
                  [!ELSE!]
                  <INTERRUPT-CATEGORY>CAT-1</INTERRUPT-CATEGORY>
                  [!ENDIF!]
                </BSW-INTERRUPT-ENTITY>
              [!ENDIF!]
            [!ENDLOOP!]
            [!LOOP "as:modconf('Cdd_Pwm/Cdd')[as:path(node:dtos(.))='/TI_F29H85x/Cdd_Pwm/Cdd']/CddPwmConfigSet/CddPwmHwUnitConfig/*/.//*[@name='CddPwmInterruptEnable']"!]
              [!IF "((node:value(../CddPwmInstance) = num:i(13)) and (node:value(.) = 'true'))"!]
                <BSW-INTERRUPT-ENTITY UUID="e2eba3d7-e75d-4746-8c88-1d36af2c3db4">
                  <SHORT-NAME>Cdd_Pwm_Epwm13_IntIsr</SHORT-NAME>
                  <REENTRANCY-LEVEL>NON-REENTRANT</REENTRANCY-LEVEL>
                  <IMPLEMENTED-ENTRY-REF DEST="BSW-MODULE-ENTRY">/Cdd_Pwm_TI_F29H85x/Cdd_Pwm_ModuleEntry/Cdd_Pwm_Epwm13_IntIsr</IMPLEMENTED-ENTRY-REF>
                  [!IF "node:value(../CddPwmInterruptCategory) = 'ISR_CAT2_INT'"!]
                  <INTERRUPT-CATEGORY>CAT-2</INTERRUPT-CATEGORY>
                  [!ELSE!]
                  <INTERRUPT-CATEGORY>CAT-1</INTERRUPT-CATEGORY>
                  [!ENDIF!]
                </BSW-INTERRUPT-ENTITY>
              [!ENDIF!]
            [!ENDLOOP!]
            [!LOOP "as:modconf('Cdd_Pwm/Cdd')[as:path(node:dtos(.))='/TI_F29H85x/Cdd_Pwm/Cdd']/CddPwmConfigSet/CddPwmHwUnitConfig/*/.//*[@name='CddPwmInterruptEnable']"!]
              [!IF "((node:value(../CddPwmInstance) = num:i(14)) and (node:value(.) = 'true'))"!]
                <BSW-INTERRUPT-ENTITY UUID="4abf8168-063d-4b55-9e4d-f80ccbb45b6d">
                  <SHORT-NAME>Cdd_Pwm_Epwm14_IntIsr</SHORT-NAME>
                  <REENTRANCY-LEVEL>NON-REENTRANT</REENTRANCY-LEVEL>
                  <IMPLEMENTED-ENTRY-REF DEST="BSW-MODULE-ENTRY">/Cdd_Pwm_TI_F29H85x/Cdd_Pwm_ModuleEntry/Cdd_Pwm_Epwm14_IntIsr</IMPLEMENTED-ENTRY-REF>
                  [!IF "node:value(../CddPwmInterruptCategory) = 'ISR_CAT2_INT'"!]
                  <INTERRUPT-CATEGORY>CAT-2</INTERRUPT-CATEGORY>
                  [!ELSE!]
                  <INTERRUPT-CATEGORY>CAT-1</INTERRUPT-CATEGORY>
                  [!ENDIF!]
                </BSW-INTERRUPT-ENTITY>
              [!ENDIF!]
            [!ENDLOOP!]
            [!LOOP "as:modconf('Cdd_Pwm/Cdd')[as:path(node:dtos(.))='/TI_F29H85x/Cdd_Pwm/Cdd']/CddPwmConfigSet/CddPwmHwUnitConfig/*/.//*[@name='CddPwmInterruptEnable']"!]
              [!IF "((node:value(../CddPwmInstance) = num:i(15)) and (node:value(.) = 'true'))"!]
                <BSW-INTERRUPT-ENTITY UUID="4bdcbdab-ffcc-4bab-8630-5847f92d31dd">
                  <SHORT-NAME>Cdd_Pwm_Epwm15_IntIsr</SHORT-NAME>
                  <REENTRANCY-LEVEL>NON-REENTRANT</REENTRANCY-LEVEL>
                  <IMPLEMENTED-ENTRY-REF DEST="BSW-MODULE-ENTRY">/Cdd_Pwm_TI_F29H85x/Cdd_Pwm_ModuleEntry/Cdd_Pwm_Epwm15_IntIsr</IMPLEMENTED-ENTRY-REF>
                  [!IF "node:value(../CddPwmInterruptCategory) = 'ISR_CAT2_INT'"!]
                  <INTERRUPT-CATEGORY>CAT-2</INTERRUPT-CATEGORY>
                  [!ELSE!]
                  <INTERRUPT-CATEGORY>CAT-1</INTERRUPT-CATEGORY>
                  [!ENDIF!]
                </BSW-INTERRUPT-ENTITY>
              [!ENDIF!]
            [!ENDLOOP!]
            [!LOOP "as:modconf('Cdd_Pwm/Cdd')[as:path(node:dtos(.))='/TI_F29H85x/Cdd_Pwm/Cdd']/CddPwmConfigSet/CddPwmHwUnitConfig/*/.//*[@name='CddPwmInterruptEnable']"!]
              [!IF "((node:value(../CddPwmInstance) = num:i(16)) and (node:value(.) = 'true'))"!]
                <BSW-INTERRUPT-ENTITY UUID="3a9916f5-0e16-44e4-ab79-bcbaed48f2d1">
                  <SHORT-NAME>Cdd_Pwm_Epwm16_IntIsr</SHORT-NAME>
                  <REENTRANCY-LEVEL>NON-REENTRANT</REENTRANCY-LEVEL>
                  <IMPLEMENTED-ENTRY-REF DEST="BSW-MODULE-ENTRY">/Cdd_Pwm_TI_F29H85x/Cdd_Pwm_ModuleEntry/Cdd_Pwm_Epwm16_IntIsr</IMPLEMENTED-ENTRY-REF>
                  [!IF "node:value(../CddPwmInterruptCategory) = 'ISR_CAT2_INT'"!]
                  <INTERRUPT-CATEGORY>CAT-2</INTERRUPT-CATEGORY>
                  [!ELSE!]
                  <INTERRUPT-CATEGORY>CAT-1</INTERRUPT-CATEGORY>
                  [!ENDIF!]
                </BSW-INTERRUPT-ENTITY>
              [!ENDIF!]
            [!ENDLOOP!]
            [!LOOP "as:modconf('Cdd_Pwm/Cdd')[as:path(node:dtos(.))='/TI_F29H85x/Cdd_Pwm/Cdd']/CddPwmConfigSet/CddPwmHwUnitConfig/*/.//*[@name='CddPwmInterruptEnable']"!]
              [!IF "((node:value(../CddPwmInstance) = num:i(17)) and (node:value(.) = 'true'))"!]
                <BSW-INTERRUPT-ENTITY UUID="fbb5c90c-8e36-4910-988c-8f8faccdff9b">
                  <SHORT-NAME>Cdd_Pwm_Epwm17_IntIsr</SHORT-NAME>
                  <REENTRANCY-LEVEL>NON-REENTRANT</REENTRANCY-LEVEL>
                  <IMPLEMENTED-ENTRY-REF DEST="BSW-MODULE-ENTRY">/Cdd_Pwm_TI_F29H85x/Cdd_Pwm_ModuleEntry/Cdd_Pwm_Epwm17_IntIsr</IMPLEMENTED-ENTRY-REF>
                  [!IF "node:value(../CddPwmInterruptCategory) = 'ISR_CAT2_INT'"!]
                  <INTERRUPT-CATEGORY>CAT-2</INTERRUPT-CATEGORY>
                  [!ELSE!]
                  <INTERRUPT-CATEGORY>CAT-1</INTERRUPT-CATEGORY>
                  [!ENDIF!]
                </BSW-INTERRUPT-ENTITY>
              [!ENDIF!]
            [!ENDLOOP!]
            [!LOOP "as:modconf('Cdd_Pwm/Cdd')[as:path(node:dtos(.))='/TI_F29H85x/Cdd_Pwm/Cdd']/CddPwmConfigSet/CddPwmHwUnitConfig/*/.//*[@name='CddPwmInterruptEnable']"!]
              [!IF "((node:value(../CddPwmInstance) = num:i(18)) and (node:value(.) = 'true'))"!]
                <BSW-INTERRUPT-ENTITY UUID="d0a4870b-9a1a-4c57-ae38-11d9a5fe1372">
                  <SHORT-NAME>Cdd_Pwm_Epwm18_IntIsr</SHORT-NAME>
                  <REENTRANCY-LEVEL>NON-REENTRANT</REENTRANCY-LEVEL>
                  <IMPLEMENTED-ENTRY-REF DEST="BSW-MODULE-ENTRY">/Cdd_Pwm_TI_F29H85x/Cdd_Pwm_ModuleEntry/Cdd_Pwm_Epwm18_IntIsr</IMPLEMENTED-ENTRY-REF>
                  [!IF "node:value(../CddPwmInterruptCategory) = 'ISR_CAT2_INT'"!]
                  <INTERRUPT-CATEGORY>CAT-2</INTERRUPT-CATEGORY>
                  [!ELSE!]
                  <INTERRUPT-CATEGORY>CAT-1</INTERRUPT-CATEGORY>
                  [!ENDIF!]
                </BSW-INTERRUPT-ENTITY>
              [!ENDIF!]
            [!ENDLOOP!]
          [!IF "(node:value(as:modconf('Cdd_Pwm/Cdd')[as:path(node:dtos(.))='/TI_F29H85x/Cdd_Pwm/Cdd']/CddPwmConfigSet/CddPwmAdvancedMode) = 'true')"!]
            [!LOOP "as:modconf('Cdd_Pwm/Cdd')[as:path(node:dtos(.))='/TI_F29H85x/Cdd_Pwm/Cdd']/CddPwmConfigSet/CddPwmHwUnitConfig/*/.//*[@name='CddPwmTripZoneInterruptEnable']"!]
              [!IF "((node:value(../CddPwmInstance) = num:i(1)) and (node:value(.) = 'true'))"!]
                <BSW-INTERRUPT-ENTITY UUID="00ef5b48-6eb4-4d58-aa05-83b0b112acff">
                  <SHORT-NAME>Cdd_Pwm_Epwm1_TzIntIsr</SHORT-NAME>
                  <REENTRANCY-LEVEL>NON-REENTRANT</REENTRANCY-LEVEL>
                  <IMPLEMENTED-ENTRY-REF DEST="BSW-MODULE-ENTRY">/Cdd_Pwm_TI_F29H85x/Cdd_Pwm_ModuleEntry/Cdd_Pwm_Epwm1_TzIntIsr</IMPLEMENTED-ENTRY-REF>
                  [!IF "node:value(../CddPwmInterruptCategory) = 'ISR_CAT2_INT'"!]
                  <INTERRUPT-CATEGORY>CAT-2</INTERRUPT-CATEGORY>
                  [!ELSE!]
                  <INTERRUPT-CATEGORY>CAT-1</INTERRUPT-CATEGORY>
                  [!ENDIF!]
                </BSW-INTERRUPT-ENTITY>
              [!ENDIF!]
            [!ENDLOOP!]
            [!LOOP "as:modconf('Cdd_Pwm/Cdd')[as:path(node:dtos(.))='/TI_F29H85x/Cdd_Pwm/Cdd']/CddPwmConfigSet/CddPwmHwUnitConfig/*/.//*[@name='CddPwmTripZoneInterruptEnable']"!]
              [!IF "((node:value(../CddPwmInstance) = num:i(2)) and (node:value(.) = 'true'))"!]
                <BSW-INTERRUPT-ENTITY UUID="ebcc7452-5b03-4ae1-b6b7-b2e174d1d8f6">
                  <SHORT-NAME>Cdd_Pwm_Epwm2_TzIntIsr</SHORT-NAME>
                  <REENTRANCY-LEVEL>NON-REENTRANT</REENTRANCY-LEVEL>
                  <IMPLEMENTED-ENTRY-REF DEST="BSW-MODULE-ENTRY">/Cdd_Pwm_TI_F29H85x/Cdd_Pwm_ModuleEntry/Cdd_Pwm_Epwm2_TzIntIsr</IMPLEMENTED-ENTRY-REF>
                  [!IF "node:value(../CddPwmInterruptCategory) = 'ISR_CAT2_INT'"!]
                  <INTERRUPT-CATEGORY>CAT-2</INTERRUPT-CATEGORY>
                  [!ELSE!]
                  <INTERRUPT-CATEGORY>CAT-1</INTERRUPT-CATEGORY>
                  [!ENDIF!]
                </BSW-INTERRUPT-ENTITY>
              [!ENDIF!]
            [!ENDLOOP!]
            [!LOOP "as:modconf('Cdd_Pwm/Cdd')[as:path(node:dtos(.))='/TI_F29H85x/Cdd_Pwm/Cdd']/CddPwmConfigSet/CddPwmHwUnitConfig/*/.//*[@name='CddPwmTripZoneInterruptEnable']"!]
              [!IF "((node:value(../CddPwmInstance) = num:i(3)) and (node:value(.) = 'true'))"!]
                <BSW-INTERRUPT-ENTITY UUID="9f05e25d-012d-4efa-88ef-3789aca8fbd4">
                  <SHORT-NAME>Cdd_Pwm_Epwm3_TzIntIsr</SHORT-NAME>
                  <REENTRANCY-LEVEL>NON-REENTRANT</REENTRANCY-LEVEL>
                  <IMPLEMENTED-ENTRY-REF DEST="BSW-MODULE-ENTRY">/Cdd_Pwm_TI_F29H85x/Cdd_Pwm_ModuleEntry/Cdd_Pwm_Epwm3_TzIntIsr</IMPLEMENTED-ENTRY-REF>
                  [!IF "node:value(../CddPwmInterruptCategory) = 'ISR_CAT2_INT'"!]
                  <INTERRUPT-CATEGORY>CAT-2</INTERRUPT-CATEGORY>
                  [!ELSE!]
                  <INTERRUPT-CATEGORY>CAT-1</INTERRUPT-CATEGORY>
                  [!ENDIF!]
                </BSW-INTERRUPT-ENTITY>
              [!ENDIF!]
            [!ENDLOOP!]
            [!LOOP "as:modconf('Cdd_Pwm/Cdd')[as:path(node:dtos(.))='/TI_F29H85x/Cdd_Pwm/Cdd']/CddPwmConfigSet/CddPwmHwUnitConfig/*/.//*[@name='CddPwmTripZoneInterruptEnable']"!]
              [!IF "((node:value(../CddPwmInstance) = num:i(4)) and (node:value(.) = 'true'))"!]
                <BSW-INTERRUPT-ENTITY UUID="8c3206bc-8ae8-4f06-be7a-832583e8146a">
                  <SHORT-NAME>Cdd_Pwm_Epwm4_TzIntIsr</SHORT-NAME>
                  <REENTRANCY-LEVEL>NON-REENTRANT</REENTRANCY-LEVEL>
                  <IMPLEMENTED-ENTRY-REF DEST="BSW-MODULE-ENTRY">/Cdd_Pwm_TI_F29H85x/Cdd_Pwm_ModuleEntry/Cdd_Pwm_Epwm4_TzIntIsr</IMPLEMENTED-ENTRY-REF>
                  [!IF "node:value(../CddPwmInterruptCategory) = 'ISR_CAT2_INT'"!]
                  <INTERRUPT-CATEGORY>CAT-2</INTERRUPT-CATEGORY>
                  [!ELSE!]
                  <INTERRUPT-CATEGORY>CAT-1</INTERRUPT-CATEGORY>
                  [!ENDIF!]
                </BSW-INTERRUPT-ENTITY>
              [!ENDIF!]
            [!ENDLOOP!]
            [!LOOP "as:modconf('Cdd_Pwm/Cdd')[as:path(node:dtos(.))='/TI_F29H85x/Cdd_Pwm/Cdd']/CddPwmConfigSet/CddPwmHwUnitConfig/*/.//*[@name='CddPwmTripZoneInterruptEnable']"!]
              [!IF "((node:value(../CddPwmInstance) = num:i(5)) and (node:value(.) = 'true'))"!]
                <BSW-INTERRUPT-ENTITY UUID="f2b9ca9e-dc80-4ef3-950e-bfede0e27c7c">
                  <SHORT-NAME>Cdd_Pwm_Epwm5_TzIntIsr</SHORT-NAME>
                  <REENTRANCY-LEVEL>NON-REENTRANT</REENTRANCY-LEVEL>
                  <IMPLEMENTED-ENTRY-REF DEST="BSW-MODULE-ENTRY">/Cdd_Pwm_TI_F29H85x/Cdd_Pwm_ModuleEntry/Cdd_Pwm_Epwm5_TzIntIsr</IMPLEMENTED-ENTRY-REF>
                  [!IF "node:value(../CddPwmInterruptCategory) = 'ISR_CAT2_INT'"!]
                  <INTERRUPT-CATEGORY>CAT-2</INTERRUPT-CATEGORY>
                  [!ELSE!]
                  <INTERRUPT-CATEGORY>CAT-1</INTERRUPT-CATEGORY>
                  [!ENDIF!]
                </BSW-INTERRUPT-ENTITY>
              [!ENDIF!]
            [!ENDLOOP!]
            [!LOOP "as:modconf('Cdd_Pwm/Cdd')[as:path(node:dtos(.))='/TI_F29H85x/Cdd_Pwm/Cdd']/CddPwmConfigSet/CddPwmHwUnitConfig/*/.//*[@name='CddPwmTripZoneInterruptEnable']"!]
              [!IF "((node:value(../CddPwmInstance) = num:i(6)) and (node:value(.) = 'true'))"!]
                <BSW-INTERRUPT-ENTITY UUID="5b330113-8b39-41d4-8082-5f58fc8b17f2">
                  <SHORT-NAME>Cdd_Pwm_Epwm6_TzIntIsr</SHORT-NAME>
                  <REENTRANCY-LEVEL>NON-REENTRANT</REENTRANCY-LEVEL>
                  <IMPLEMENTED-ENTRY-REF DEST="BSW-MODULE-ENTRY">/Cdd_Pwm_TI_F29H85x/Cdd_Pwm_ModuleEntry/Cdd_Pwm_Epwm6_TzIntIsr</IMPLEMENTED-ENTRY-REF>
                  [!IF "node:value(../CddPwmInterruptCategory) = 'ISR_CAT2_INT'"!]
                  <INTERRUPT-CATEGORY>CAT-2</INTERRUPT-CATEGORY>
                  [!ELSE!]
                  <INTERRUPT-CATEGORY>CAT-1</INTERRUPT-CATEGORY>
                  [!ENDIF!]
                </BSW-INTERRUPT-ENTITY>
              [!ENDIF!]
            [!ENDLOOP!]
            [!LOOP "as:modconf('Cdd_Pwm/Cdd')[as:path(node:dtos(.))='/TI_F29H85x/Cdd_Pwm/Cdd']/CddPwmConfigSet/CddPwmHwUnitConfig/*/.//*[@name='CddPwmTripZoneInterruptEnable']"!]
              [!IF "((node:value(../CddPwmInstance) = num:i(7)) and (node:value(.) = 'true'))"!]
                <BSW-INTERRUPT-ENTITY UUID="2f958e55-8880-4d71-a153-73afda24764d">
                  <SHORT-NAME>Cdd_Pwm_Epwm7_TzIntIsr</SHORT-NAME>
                  <REENTRANCY-LEVEL>NON-REENTRANT</REENTRANCY-LEVEL>
                  <IMPLEMENTED-ENTRY-REF DEST="BSW-MODULE-ENTRY">/Cdd_Pwm_TI_F29H85x/Cdd_Pwm_ModuleEntry/Cdd_Pwm_Epwm7_TzIntIsr</IMPLEMENTED-ENTRY-REF>
                  [!IF "node:value(../CddPwmInterruptCategory) = 'ISR_CAT2_INT'"!]
                  <INTERRUPT-CATEGORY>CAT-2</INTERRUPT-CATEGORY>
                  [!ELSE!]
                  <INTERRUPT-CATEGORY>CAT-1</INTERRUPT-CATEGORY>
                  [!ENDIF!]
                </BSW-INTERRUPT-ENTITY>
              [!ENDIF!]
            [!ENDLOOP!]
            [!LOOP "as:modconf('Cdd_Pwm/Cdd')[as:path(node:dtos(.))='/TI_F29H85x/Cdd_Pwm/Cdd']/CddPwmConfigSet/CddPwmHwUnitConfig/*/.//*[@name='CddPwmTripZoneInterruptEnable']"!]
              [!IF "((node:value(../CddPwmInstance) = num:i(8)) and (node:value(.) = 'true'))"!]
                <BSW-INTERRUPT-ENTITY UUID="e2adc96c-adee-46e7-adc8-64699528fca3">
                  <SHORT-NAME>Cdd_Pwm_Epwm8_TzIntIsr</SHORT-NAME>
                  <REENTRANCY-LEVEL>NON-REENTRANT</REENTRANCY-LEVEL>
                  <IMPLEMENTED-ENTRY-REF DEST="BSW-MODULE-ENTRY">/Cdd_Pwm_TI_F29H85x/Cdd_Pwm_ModuleEntry/Cdd_Pwm_Epwm8_TzIntIsr</IMPLEMENTED-ENTRY-REF>
                  [!IF "node:value(../CddPwmInterruptCategory) = 'ISR_CAT2_INT'"!]
                  <INTERRUPT-CATEGORY>CAT-2</INTERRUPT-CATEGORY>
                  [!ELSE!]
                  <INTERRUPT-CATEGORY>CAT-1</INTERRUPT-CATEGORY>
                  [!ENDIF!]
                </BSW-INTERRUPT-ENTITY>
              [!ENDIF!]
            [!ENDLOOP!]
            [!LOOP "as:modconf('Cdd_Pwm/Cdd')[as:path(node:dtos(.))='/TI_F29H85x/Cdd_Pwm/Cdd']/CddPwmConfigSet/CddPwmHwUnitConfig/*/.//*[@name='CddPwmTripZoneInterruptEnable']"!]
              [!IF "((node:value(../CddPwmInstance) = num:i(9)) and (node:value(.) = 'true'))"!]
                <BSW-INTERRUPT-ENTITY UUID="77426145-83f4-4753-a612-6da664f61ac4">
                  <SHORT-NAME>Cdd_Pwm_Epwm9_TzIntIsr</SHORT-NAME>
                  <REENTRANCY-LEVEL>NON-REENTRANT</REENTRANCY-LEVEL>
                  <IMPLEMENTED-ENTRY-REF DEST="BSW-MODULE-ENTRY">/Cdd_Pwm_TI_F29H85x/Cdd_Pwm_ModuleEntry/Cdd_Pwm_Epwm9_TzIntIsr</IMPLEMENTED-ENTRY-REF>
                  [!IF "node:value(../CddPwmInterruptCategory) = 'ISR_CAT2_INT'"!]
                  <INTERRUPT-CATEGORY>CAT-2</INTERRUPT-CATEGORY>
                  [!ELSE!]
                  <INTERRUPT-CATEGORY>CAT-1</INTERRUPT-CATEGORY>
                  [!ENDIF!]
                </BSW-INTERRUPT-ENTITY>
              [!ENDIF!]
            [!ENDLOOP!]
            [!LOOP "as:modconf('Cdd_Pwm/Cdd')[as:path(node:dtos(.))='/TI_F29H85x/Cdd_Pwm/Cdd']/CddPwmConfigSet/CddPwmHwUnitConfig/*/.//*[@name='CddPwmTripZoneInterruptEnable']"!]
              [!IF "((node:value(../CddPwmInstance) = num:i(10)) and (node:value(.) = 'true'))"!]
                <BSW-INTERRUPT-ENTITY UUID="ab3ade3b-8d77-4803-b0bc-86f60d006e32">
                  <SHORT-NAME>Cdd_Pwm_Epwm10_TzIntIsr</SHORT-NAME>
                  <REENTRANCY-LEVEL>NON-REENTRANT</REENTRANCY-LEVEL>
                  <IMPLEMENTED-ENTRY-REF DEST="BSW-MODULE-ENTRY">/Cdd_Pwm_TI_F29H85x/Cdd_Pwm_ModuleEntry/Cdd_Pwm_Epwm10_TzIntIsr</IMPLEMENTED-ENTRY-REF>
                  [!IF "node:value(../CddPwmInterruptCategory) = 'ISR_CAT2_INT'"!]
                  <INTERRUPT-CATEGORY>CAT-2</INTERRUPT-CATEGORY>
                  [!ELSE!]
                  <INTERRUPT-CATEGORY>CAT-1</INTERRUPT-CATEGORY>
                  [!ENDIF!]
                </BSW-INTERRUPT-ENTITY>
              [!ENDIF!]
            [!ENDLOOP!]
            [!LOOP "as:modconf('Cdd_Pwm/Cdd')[as:path(node:dtos(.))='/TI_F29H85x/Cdd_Pwm/Cdd']/CddPwmConfigSet/CddPwmHwUnitConfig/*/.//*[@name='CddPwmTripZoneInterruptEnable']"!]
              [!IF "((node:value(../CddPwmInstance) = num:i(11)) and (node:value(.) = 'true'))"!]
                <BSW-INTERRUPT-ENTITY UUID="a023ef2d-6cd3-4795-a29d-20b02c7e17d9">
                  <SHORT-NAME>Cdd_Pwm_Epwm11_TzIntIsr</SHORT-NAME>
                  <REENTRANCY-LEVEL>NON-REENTRANT</REENTRANCY-LEVEL>
                  <IMPLEMENTED-ENTRY-REF DEST="BSW-MODULE-ENTRY">/Cdd_Pwm_TI_F29H85x/Cdd_Pwm_ModuleEntry/Cdd_Pwm_Epwm11_TzIntIsr</IMPLEMENTED-ENTRY-REF>
                  [!IF "node:value(../CddPwmInterruptCategory) = 'ISR_CAT2_INT'"!]
                  <INTERRUPT-CATEGORY>CAT-2</INTERRUPT-CATEGORY>
                  [!ELSE!]
                  <INTERRUPT-CATEGORY>CAT-1</INTERRUPT-CATEGORY>
                  [!ENDIF!]
                </BSW-INTERRUPT-ENTITY>
              [!ENDIF!]
            [!ENDLOOP!]
            [!LOOP "as:modconf('Cdd_Pwm/Cdd')[as:path(node:dtos(.))='/TI_F29H85x/Cdd_Pwm/Cdd']/CddPwmConfigSet/CddPwmHwUnitConfig/*/.//*[@name='CddPwmTripZoneInterruptEnable']"!]
              [!IF "((node:value(../CddPwmInstance) = num:i(12)) and (node:value(.) = 'true'))"!]
                <BSW-INTERRUPT-ENTITY UUID="63fcd7c0-6760-4aa9-baea-c017ecd82c66">
                  <SHORT-NAME>Cdd_Pwm_Epwm12_TzIntIsr</SHORT-NAME>
                  <REENTRANCY-LEVEL>NON-REENTRANT</REENTRANCY-LEVEL>
                  <IMPLEMENTED-ENTRY-REF DEST="BSW-MODULE-ENTRY">/Cdd_Pwm_TI_F29H85x/Cdd_Pwm_ModuleEntry/Cdd_Pwm_Epwm12_TzIntIsr</IMPLEMENTED-ENTRY-REF>
                  [!IF "node:value(../CddPwmInterruptCategory) = 'ISR_CAT2_INT'"!]
                  <INTERRUPT-CATEGORY>CAT-2</INTERRUPT-CATEGORY>
                  [!ELSE!]
                  <INTERRUPT-CATEGORY>CAT-1</INTERRUPT-CATEGORY>
                  [!ENDIF!]
                </BSW-INTERRUPT-ENTITY>
              [!ENDIF!]
            [!ENDLOOP!]
            [!LOOP "as:modconf('Cdd_Pwm/Cdd')[as:path(node:dtos(.))='/TI_F29H85x/Cdd_Pwm/Cdd']/CddPwmConfigSet/CddPwmHwUnitConfig/*/.//*[@name='CddPwmTripZoneInterruptEnable']"!]
              [!IF "((node:value(../CddPwmInstance) = num:i(13)) and (node:value(.) = 'true'))"!]
                <BSW-INTERRUPT-ENTITY UUID="d90574f2-669b-466a-ac3b-a3c4d302ce1b">
                  <SHORT-NAME>Cdd_Pwm_Epwm13_TzIntIsr</SHORT-NAME>
                  <REENTRANCY-LEVEL>NON-REENTRANT</REENTRANCY-LEVEL>
                  <IMPLEMENTED-ENTRY-REF DEST="BSW-MODULE-ENTRY">/Cdd_Pwm_TI_F29H85x/Cdd_Pwm_ModuleEntry/Cdd_Pwm_Epwm13_TzIntIsr</IMPLEMENTED-ENTRY-REF>
                  [!IF "node:value(../CddPwmInterruptCategory) = 'ISR_CAT2_INT'"!]
                  <INTERRUPT-CATEGORY>CAT-2</INTERRUPT-CATEGORY>
                  [!ELSE!]
                  <INTERRUPT-CATEGORY>CAT-1</INTERRUPT-CATEGORY>
                  [!ENDIF!]
                </BSW-INTERRUPT-ENTITY>
              [!ENDIF!]
            [!ENDLOOP!]
            [!LOOP "as:modconf('Cdd_Pwm/Cdd')[as:path(node:dtos(.))='/TI_F29H85x/Cdd_Pwm/Cdd']/CddPwmConfigSet/CddPwmHwUnitConfig/*/.//*[@name='CddPwmTripZoneInterruptEnable']"!]
              [!IF "((node:value(../CddPwmInstance) = num:i(14)) and (node:value(.) = 'true'))"!]
                <BSW-INTERRUPT-ENTITY UUID="7ada5fdd-eebc-4dd4-9ebd-7098ceebbf94">
                  <SHORT-NAME>Cdd_Pwm_Epwm14_TzIntIsr</SHORT-NAME>
                  <REENTRANCY-LEVEL>NON-REENTRANT</REENTRANCY-LEVEL>
                  <IMPLEMENTED-ENTRY-REF DEST="BSW-MODULE-ENTRY">/Cdd_Pwm_TI_F29H85x/Cdd_Pwm_ModuleEntry/Cdd_Pwm_Epwm14_TzIntIsr</IMPLEMENTED-ENTRY-REF>
                  [!IF "node:value(../CddPwmInterruptCategory) = 'ISR_CAT2_INT'"!]
                  <INTERRUPT-CATEGORY>CAT-2</INTERRUPT-CATEGORY>
                  [!ELSE!]
                  <INTERRUPT-CATEGORY>CAT-1</INTERRUPT-CATEGORY>
                  [!ENDIF!]
                </BSW-INTERRUPT-ENTITY>
              [!ENDIF!]
            [!ENDLOOP!]
            [!LOOP "as:modconf('Cdd_Pwm/Cdd')[as:path(node:dtos(.))='/TI_F29H85x/Cdd_Pwm/Cdd']/CddPwmConfigSet/CddPwmHwUnitConfig/*/.//*[@name='CddPwmTripZoneInterruptEnable']"!]
              [!IF "((node:value(../CddPwmInstance) = num:i(15)) and (node:value(.) = 'true'))"!]
                <BSW-INTERRUPT-ENTITY UUID="5e1313b7-7e01-4d64-903a-b6f86fb9cf94">
                  <SHORT-NAME>Cdd_Pwm_Epwm15_TzIntIsr</SHORT-NAME>
                  <REENTRANCY-LEVEL>NON-REENTRANT</REENTRANCY-LEVEL>
                  <IMPLEMENTED-ENTRY-REF DEST="BSW-MODULE-ENTRY">/Cdd_Pwm_TI_F29H85x/Cdd_Pwm_ModuleEntry/Cdd_Pwm_Epwm15_TzIntIsr</IMPLEMENTED-ENTRY-REF>
                  [!IF "node:value(../CddPwmInterruptCategory) = 'ISR_CAT2_INT'"!]
                  <INTERRUPT-CATEGORY>CAT-2</INTERRUPT-CATEGORY>
                  [!ELSE!]
                  <INTERRUPT-CATEGORY>CAT-1</INTERRUPT-CATEGORY>
                  [!ENDIF!]
                </BSW-INTERRUPT-ENTITY>
              [!ENDIF!]
            [!ENDLOOP!]
            [!LOOP "as:modconf('Cdd_Pwm/Cdd')[as:path(node:dtos(.))='/TI_F29H85x/Cdd_Pwm/Cdd']/CddPwmConfigSet/CddPwmHwUnitConfig/*/.//*[@name='CddPwmTripZoneInterruptEnable']"!]
              [!IF "((node:value(../CddPwmInstance) = num:i(16)) and (node:value(.) = 'true'))"!]
                <BSW-INTERRUPT-ENTITY UUID="327e1686-f8ca-4d7c-b5b7-ce4b1981d0dd">
                  <SHORT-NAME>Cdd_Pwm_Epwm16_TzIntIsr</SHORT-NAME>
                  <REENTRANCY-LEVEL>NON-REENTRANT</REENTRANCY-LEVEL>
                  <IMPLEMENTED-ENTRY-REF DEST="BSW-MODULE-ENTRY">/Cdd_Pwm_TI_F29H85x/Cdd_Pwm_ModuleEntry/Cdd_Pwm_Epwm16_TzIntIsr</IMPLEMENTED-ENTRY-REF>
                  [!IF "node:value(../CddPwmInterruptCategory) = 'ISR_CAT2_INT'"!]
                  <INTERRUPT-CATEGORY>CAT-2</INTERRUPT-CATEGORY>
                  [!ELSE!]
                  <INTERRUPT-CATEGORY>CAT-1</INTERRUPT-CATEGORY>
                  [!ENDIF!]
                </BSW-INTERRUPT-ENTITY>
              [!ENDIF!]
            [!ENDLOOP!]
            [!LOOP "as:modconf('Cdd_Pwm/Cdd')[as:path(node:dtos(.))='/TI_F29H85x/Cdd_Pwm/Cdd']/CddPwmConfigSet/CddPwmHwUnitConfig/*/.//*[@name='CddPwmTripZoneInterruptEnable']"!]
              [!IF "((node:value(../CddPwmInstance) = num:i(17)) and (node:value(.) = 'true'))"!]
                <BSW-INTERRUPT-ENTITY UUID="9927d5a5-7c6c-4436-9496-56b2565c77bd">
                  <SHORT-NAME>Cdd_Pwm_Epwm17_TzIntIsr</SHORT-NAME>
                  <REENTRANCY-LEVEL>NON-REENTRANT</REENTRANCY-LEVEL>
                  <IMPLEMENTED-ENTRY-REF DEST="BSW-MODULE-ENTRY">/Cdd_Pwm_TI_F29H85x/Cdd_Pwm_ModuleEntry/Cdd_Pwm_Epwm17_TzIntIsr</IMPLEMENTED-ENTRY-REF>
                  [!IF "node:value(../CddPwmInterruptCategory) = 'ISR_CAT2_INT'"!]
                  <INTERRUPT-CATEGORY>CAT-2</INTERRUPT-CATEGORY>
                  [!ELSE!]
                  <INTERRUPT-CATEGORY>CAT-1</INTERRUPT-CATEGORY>
                  [!ENDIF!]
                </BSW-INTERRUPT-ENTITY>
              [!ENDIF!]
            [!ENDLOOP!]
            [!LOOP "as:modconf('Cdd_Pwm/Cdd')[as:path(node:dtos(.))='/TI_F29H85x/Cdd_Pwm/Cdd']/CddPwmConfigSet/CddPwmHwUnitConfig/*/.//*[@name='CddPwmTripZoneInterruptEnable']"!]
              [!IF "((node:value(../CddPwmInstance) = num:i(18)) and (node:value(.) = 'true'))"!]
                <BSW-INTERRUPT-ENTITY UUID="5b5572ef-3966-4bb6-a273-a46bf44e28bc">
                  <SHORT-NAME>Cdd_Pwm_Epwm18_TzIntIsr</SHORT-NAME>
                  <REENTRANCY-LEVEL>NON-REENTRANT</REENTRANCY-LEVEL>
                  <IMPLEMENTED-ENTRY-REF DEST="BSW-MODULE-ENTRY">/Cdd_Pwm_TI_F29H85x/Cdd_Pwm_ModuleEntry/Cdd_Pwm_Epwm18_TzIntIsr</IMPLEMENTED-ENTRY-REF>
                  [!IF "node:value(../CddPwmInterruptCategory) = 'ISR_CAT2_INT'"!]
                  <INTERRUPT-CATEGORY>CAT-2</INTERRUPT-CATEGORY>
                  [!ELSE!]
                  <INTERRUPT-CATEGORY>CAT-1</INTERRUPT-CATEGORY>
                  [!ENDIF!]
                </BSW-INTERRUPT-ENTITY>
              [!ENDIF!]
            [!ENDLOOP!]
          [!ENDIF!]
                <BSW-CALLED-ENTITY UUID="358aa211-d177-466c-929e-7832fe041173">
                  <SHORT-NAME>Cdd_Pwm_Init</SHORT-NAME>
                  <REENTRANCY-LEVEL>NON-REENTRANT</REENTRANCY-LEVEL>
                  [!IF "as:modconf('Cdd_Pwm/Cdd')[as:path(node:dtos(.))='/TI_F29H85x/Cdd_Pwm/Cdd']/CddPwmGeneral/CddPwmDevErrorDetect = 'true'"!]
                  <CALL-POINTS>
                    <BSW-DIRECT-CALL-POINT>
                      <SHORT-NAME>Det</SHORT-NAME>
                      <CALLED-ENTRY-REF DEST="BSW-MODULE-ENTRY">/AUTOSAR_Det/Det/Det_ReportError</CALLED-ENTRY-REF>
                    </BSW-DIRECT-CALL-POINT>
                  </CALL-POINTS>
                  [!ENDIF!]
                  <IMPLEMENTED-ENTRY-REF DEST="BSW-MODULE-ENTRY">/Cdd_Pwm_TI_F29H85x/Cdd_Pwm_ModuleEntry/Cdd_Pwm_Init</IMPLEMENTED-ENTRY-REF>
                </BSW-CALLED-ENTITY>
                <BSW-CALLED-ENTITY UUID="cc969659-8133-4853-ae59-3e9028252e38">
                  <SHORT-NAME>Cdd_Pwm_SetInterruptEventCount</SHORT-NAME>
                  [!IF "(as:modconf('Cdd_Pwm/Cdd')[as:path(node:dtos(.))='/TI_F29H85x/Cdd_Pwm/Cdd']/CddPwmConfigSet/CddPwmAdvancedMode) = 'false'"!]
                  <CAN-ENTER-EXCLUSIVE-AREA-REFS>
                    <CAN-ENTER-EXCLUSIVE-AREA-REF DEST="EXCLUSIVE-AREA">/Cdd_Pwm_TI_F29H85x/Cdd_Pwm/Cdd_Pwm_Behavior/CDD_PWM_EXCLUSIVE_AREA_0</CAN-ENTER-EXCLUSIVE-AREA-REF>
                  </CAN-ENTER-EXCLUSIVE-AREA-REFS>
                  <REENTRANCY-LEVEL>SINGLE-CORE-REENTRANT</REENTRANCY-LEVEL>
                  [!ELSE!]
                  <REENTRANCY-LEVEL>NON-REENTRANT</REENTRANCY-LEVEL>
                  [!ENDIF!]
                  <CALL-POINTS>
                  [!IF "as:modconf('Cdd_Pwm/Cdd')[as:path(node:dtos(.))='/TI_F29H85x/Cdd_Pwm/Cdd']/CddPwmGeneral/CddPwmDevErrorDetect = 'true'"!]
                    <BSW-DIRECT-CALL-POINT>
                      <SHORT-NAME>Det</SHORT-NAME>
                      <CALLED-ENTRY-REF DEST="BSW-MODULE-ENTRY">/AUTOSAR_Det/Det/Det_ReportError</CALLED-ENTRY-REF>
                    </BSW-DIRECT-CALL-POINT>
                  [!ENDIF!]
                  [!IF "(as:modconf('Cdd_Pwm/Cdd')[as:path(node:dtos(.))='/TI_F29H85x/Cdd_Pwm/Cdd']/CddPwmConfigSet/CddPwmAdvancedMode) = 'false'"!]
                    <BSW-DIRECT-CALL-POINT>
                      <SHORT-NAME>Det_Runtime</SHORT-NAME>
                      <CALLED-ENTRY-REF DEST="BSW-MODULE-ENTRY">/AUTOSAR_Det/Det/Det_ReportRuntimeError</CALLED-ENTRY-REF>
                    </BSW-DIRECT-CALL-POINT>
                  [!ENDIF!]
                  </CALL-POINTS>
                  <IMPLEMENTED-ENTRY-REF DEST="BSW-MODULE-ENTRY">/Cdd_Pwm_TI_F29H85x/Cdd_Pwm_ModuleEntry/Cdd_Pwm_SetInterruptEventCount</IMPLEMENTED-ENTRY-REF>
                </BSW-CALLED-ENTITY>
                [!IF "as:modconf('Cdd_Pwm/Cdd')[as:path(node:dtos(.))='/TI_F29H85x/Cdd_Pwm/Cdd']/CddPwmGeneral/CddPwmVersionInfoApi = 'true'"!]
                <BSW-CALLED-ENTITY UUID="25cb90e6-8524-49a2-994e-6cf73824d12c">
                  <SHORT-NAME>Cdd_Pwm_GetVersionInfo</SHORT-NAME>
                  <REENTRANCY-LEVEL>SINGLE-CORE-REENTRANT</REENTRANCY-LEVEL>
                  [!IF "as:modconf('Cdd_Pwm/Cdd')[as:path(node:dtos(.))='/TI_F29H85x/Cdd_Pwm/Cdd']/CddPwmGeneral/CddPwmDevErrorDetect = 'true'"!]
                  <CALL-POINTS>
                    <BSW-DIRECT-CALL-POINT>
                      <SHORT-NAME>Det</SHORT-NAME>
                      <CALLED-ENTRY-REF DEST="BSW-MODULE-ENTRY">/AUTOSAR_Det/Det/Det_ReportError</CALLED-ENTRY-REF>
                    </BSW-DIRECT-CALL-POINT>
                  </CALL-POINTS>
                  [!ENDIF!]
                  <IMPLEMENTED-ENTRY-REF DEST="BSW-MODULE-ENTRY">/Cdd_Pwm_TI_F29H85x/Cdd_Pwm_ModuleEntry/Cdd_Pwm_GetVersionInfo</IMPLEMENTED-ENTRY-REF>
                </BSW-CALLED-ENTITY>
                [!ENDIF!]
                [!IF "as:modconf('Cdd_Pwm/Cdd')[as:path(node:dtos(.))='/TI_F29H85x/Cdd_Pwm/Cdd']/CddPwmGeneral/CddPwmNotificationSupported = 'true'"!]
                <BSW-CALLED-ENTITY UUID="076e65f9-97b7-4016-8853-b8a55dc428b3">
                  <SHORT-NAME>Cdd_Pwm_EnableNotification</SHORT-NAME>
                  <CAN-ENTER-EXCLUSIVE-AREA-REFS>
                    <CAN-ENTER-EXCLUSIVE-AREA-REF DEST="EXCLUSIVE-AREA">/Cdd_Pwm_TI_F29H85x/Cdd_Pwm/Cdd_Pwm_Behavior/CDD_PWM_EXCLUSIVE_AREA_0</CAN-ENTER-EXCLUSIVE-AREA-REF>
                  </CAN-ENTER-EXCLUSIVE-AREA-REFS>
                  <REENTRANCY-LEVEL>SINGLE-CORE-REENTRANT</REENTRANCY-LEVEL>
                  <CALL-POINTS>
                  [!IF "as:modconf('Cdd_Pwm/Cdd')[as:path(node:dtos(.))='/TI_F29H85x/Cdd_Pwm/Cdd']/CddPwmGeneral/CddPwmDevErrorDetect = 'true'"!]
                    <BSW-DIRECT-CALL-POINT>
                      <SHORT-NAME>Det</SHORT-NAME>
                      <CALLED-ENTRY-REF DEST="BSW-MODULE-ENTRY">/AUTOSAR_Det/Det/Det_ReportError</CALLED-ENTRY-REF>
                    </BSW-DIRECT-CALL-POINT>
                  [!ENDIF!]
                  [!IF "node:value(as:modconf('Cdd_Pwm/Cdd')[as:path(node:dtos(.))='/TI_F29H85x/Cdd_Pwm/Cdd']/CddPwmConfigSet/CddPwmAdvancedMode) = 'false'"!]
                    <BSW-DIRECT-CALL-POINT>
                      <SHORT-NAME>Det_Runtime</SHORT-NAME>
                      <CALLED-ENTRY-REF DEST="BSW-MODULE-ENTRY">/AUTOSAR_Det/Det/Det_ReportRuntimeError</CALLED-ENTRY-REF>
                    </BSW-DIRECT-CALL-POINT>
                   [!ENDIF!] 
                  </CALL-POINTS>
                  <IMPLEMENTED-ENTRY-REF DEST="BSW-MODULE-ENTRY">/Cdd_Pwm_TI_F29H85x/Cdd_Pwm_ModuleEntry/Cdd_Pwm_EnableNotification</IMPLEMENTED-ENTRY-REF>
                </BSW-CALLED-ENTITY>
                <BSW-CALLED-ENTITY UUID="ba7547ca-f24e-4284-9470-45ed73c2a581">
                  <SHORT-NAME>Cdd_Pwm_DisableNotification</SHORT-NAME>
                  <CAN-ENTER-EXCLUSIVE-AREA-REFS>
                    <CAN-ENTER-EXCLUSIVE-AREA-REF DEST="EXCLUSIVE-AREA">/Cdd_Pwm_TI_F29H85x/Cdd_Pwm/Cdd_Pwm_Behavior/CDD_PWM_EXCLUSIVE_AREA_0</CAN-ENTER-EXCLUSIVE-AREA-REF>
                  </CAN-ENTER-EXCLUSIVE-AREA-REFS>
                  <REENTRANCY-LEVEL>SINGLE-CORE-REENTRANT</REENTRANCY-LEVEL>
                  [!IF "as:modconf('Cdd_Pwm/Cdd')[as:path(node:dtos(.))='/TI_F29H85x/Cdd_Pwm/Cdd']/CddPwmGeneral/CddPwmDevErrorDetect = 'true'"!]
                  <CALL-POINTS>
                    <BSW-DIRECT-CALL-POINT>
                      <SHORT-NAME>Det</SHORT-NAME>
                      <CALLED-ENTRY-REF DEST="BSW-MODULE-ENTRY">/AUTOSAR_Det/Det/Det_ReportError</CALLED-ENTRY-REF>
                    </BSW-DIRECT-CALL-POINT>
                  </CALL-POINTS>
                  [!ENDIF!]
                  <IMPLEMENTED-ENTRY-REF DEST="BSW-MODULE-ENTRY">/Cdd_Pwm_TI_F29H85x/Cdd_Pwm_ModuleEntry/Cdd_Pwm_DisableNotification</IMPLEMENTED-ENTRY-REF>
                </BSW-CALLED-ENTITY>
                [!ENDIF!]
          [!IF "node:value(as:modconf('Cdd_Pwm/Cdd')[as:path(node:dtos(.))='/TI_F29H85x/Cdd_Pwm/Cdd']/CddPwmConfigSet/CddPwmAdvancedMode) = 'false'"!]
                [!IF "as:modconf('Cdd_Pwm/Cdd')[as:path(node:dtos(.))='/TI_F29H85x/Cdd_Pwm/Cdd']/CddPwmGeneral/CddPwmSetDutyCycle = 'true'"!]
                <BSW-CALLED-ENTITY UUID="754b1fe8-4b41-4404-a489-7a78a8862632">
                  <SHORT-NAME>Cdd_Pwm_SetDutyCycle</SHORT-NAME>
                  <CAN-ENTER-EXCLUSIVE-AREA-REFS>
                    <CAN-ENTER-EXCLUSIVE-AREA-REF DEST="EXCLUSIVE-AREA">/Cdd_Pwm_TI_F29H85x/Cdd_Pwm/Cdd_Pwm_Behavior/CDD_PWM_EXCLUSIVE_AREA_0</CAN-ENTER-EXCLUSIVE-AREA-REF>
                  </CAN-ENTER-EXCLUSIVE-AREA-REFS>
                  <REENTRANCY-LEVEL>SINGLE-CORE-REENTRANT</REENTRANCY-LEVEL>
                  [!IF "as:modconf('Cdd_Pwm/Cdd')[as:path(node:dtos(.))='/TI_F29H85x/Cdd_Pwm/Cdd']/CddPwmGeneral/CddPwmDevErrorDetect = 'true'"!]
                  <CALL-POINTS>
                    <BSW-DIRECT-CALL-POINT>
                      <SHORT-NAME>Det</SHORT-NAME>
                      <CALLED-ENTRY-REF DEST="BSW-MODULE-ENTRY">/AUTOSAR_Det/Det/Det_ReportError</CALLED-ENTRY-REF>
                    </BSW-DIRECT-CALL-POINT>                  
                  </CALL-POINTS>
                  [!ENDIF!]
                  <IMPLEMENTED-ENTRY-REF DEST="BSW-MODULE-ENTRY">/Cdd_Pwm_TI_F29H85x/Cdd_Pwm_ModuleEntry/Cdd_Pwm_SetDutyCycle</IMPLEMENTED-ENTRY-REF>
                </BSW-CALLED-ENTITY>
                [!ENDIF!]
                [!IF "as:modconf('Cdd_Pwm/Cdd')[as:path(node:dtos(.))='/TI_F29H85x/Cdd_Pwm/Cdd']/CddPwmGeneral/CddPwmSetPeriod = 'true'"!]
                <BSW-CALLED-ENTITY UUID="13a6fb9d-fa67-4678-b2bc-17573156c087">
                  <SHORT-NAME>Cdd_Pwm_SetPeriod</SHORT-NAME>
                  <CAN-ENTER-EXCLUSIVE-AREA-REFS>
                    <CAN-ENTER-EXCLUSIVE-AREA-REF DEST="EXCLUSIVE-AREA">/Cdd_Pwm_TI_F29H85x/Cdd_Pwm/Cdd_Pwm_Behavior/CDD_PWM_EXCLUSIVE_AREA_0</CAN-ENTER-EXCLUSIVE-AREA-REF>
                  </CAN-ENTER-EXCLUSIVE-AREA-REFS>
                  <REENTRANCY-LEVEL>SINGLE-CORE-REENTRANT</REENTRANCY-LEVEL>
                  <CALL-POINTS>
                  [!IF "as:modconf('Cdd_Pwm/Cdd')[as:path(node:dtos(.))='/TI_F29H85x/Cdd_Pwm/Cdd']/CddPwmGeneral/CddPwmDevErrorDetect = 'true'"!]
                    <BSW-DIRECT-CALL-POINT>
                      <SHORT-NAME>Det</SHORT-NAME>
                      <CALLED-ENTRY-REF DEST="BSW-MODULE-ENTRY">/AUTOSAR_Det/Det/Det_ReportError</CALLED-ENTRY-REF>
                    </BSW-DIRECT-CALL-POINT>
                  [!ENDIF!]
                  </CALL-POINTS>
                  <IMPLEMENTED-ENTRY-REF DEST="BSW-MODULE-ENTRY">/Cdd_Pwm_TI_F29H85x/Cdd_Pwm_ModuleEntry/Cdd_Pwm_SetPeriod</IMPLEMENTED-ENTRY-REF>
                </BSW-CALLED-ENTITY>
                [!ENDIF!]
                [!IF "as:modconf('Cdd_Pwm/Cdd')[as:path(node:dtos(.))='/TI_F29H85x/Cdd_Pwm/Cdd']/CddPwmGeneral/CddPwmSetOutputToIdle  = 'true'"!]
                <BSW-CALLED-ENTITY UUID="d85868a2-91fe-4b4b-b023-0de85b614193">
                  <SHORT-NAME>Cdd_Pwm_SetOutputToIdle</SHORT-NAME>
                  <CAN-ENTER-EXCLUSIVE-AREA-REFS>
                    <CAN-ENTER-EXCLUSIVE-AREA-REF DEST="EXCLUSIVE-AREA">/Cdd_Pwm_TI_F29H85x/Cdd_Pwm/Cdd_Pwm_Behavior/CDD_PWM_EXCLUSIVE_AREA_0</CAN-ENTER-EXCLUSIVE-AREA-REF>
                  </CAN-ENTER-EXCLUSIVE-AREA-REFS>
                  <REENTRANCY-LEVEL>SINGLE-CORE-REENTRANT</REENTRANCY-LEVEL>
                  [!IF "as:modconf('Cdd_Pwm/Cdd')[as:path(node:dtos(.))='/TI_F29H85x/Cdd_Pwm/Cdd']/CddPwmGeneral/CddPwmDevErrorDetect = 'true'"!]
                  <CALL-POINTS>
                    <BSW-DIRECT-CALL-POINT>
                      <SHORT-NAME>Det</SHORT-NAME>
                      <CALLED-ENTRY-REF DEST="BSW-MODULE-ENTRY">/AUTOSAR_Det/Det/Det_ReportError</CALLED-ENTRY-REF>
                    </BSW-DIRECT-CALL-POINT>
                  </CALL-POINTS>
                  [!ENDIF!]
                  <IMPLEMENTED-ENTRY-REF DEST="BSW-MODULE-ENTRY">/Cdd_Pwm_TI_F29H85x/Cdd_Pwm_ModuleEntry/Cdd_Pwm_SetOutputToIdle</IMPLEMENTED-ENTRY-REF>
                </BSW-CALLED-ENTITY>
                [!ENDIF!]
                [!IF "as:modconf('Cdd_Pwm/Cdd')[as:path(node:dtos(.))='/TI_F29H85x/Cdd_Pwm/Cdd']/CddPwmGeneral/CddPwmDeInitApi = 'true'"!]
                <BSW-CALLED-ENTITY UUID="fc90f7a1-577b-477b-909d-d94511ed7be2">
                  <SHORT-NAME>Cdd_Pwm_DeInit</SHORT-NAME>
                  <REENTRANCY-LEVEL>NON-REENTRANT</REENTRANCY-LEVEL>
                  [!IF "as:modconf('Cdd_Pwm/Cdd')[as:path(node:dtos(.))='/TI_F29H85x/Cdd_Pwm/Cdd']/CddPwmGeneral/CddPwmDevErrorDetect = 'true'"!]
                  <CALL-POINTS>
                    <BSW-DIRECT-CALL-POINT>
                      <SHORT-NAME>Det</SHORT-NAME>
                      <CALLED-ENTRY-REF DEST="BSW-MODULE-ENTRY">/AUTOSAR_Det/Det/Det_ReportError</CALLED-ENTRY-REF>
                    </BSW-DIRECT-CALL-POINT>
                  </CALL-POINTS>
                  [!ENDIF!]
                  <IMPLEMENTED-ENTRY-REF DEST="BSW-MODULE-ENTRY">/Cdd_Pwm_TI_F29H85x/Cdd_Pwm_ModuleEntry/Cdd_Pwm_DeInit</IMPLEMENTED-ENTRY-REF>
                </BSW-CALLED-ENTITY>
                [!ENDIF!]
          [!ELSE!]
                <BSW-CALLED-ENTITY UUID="4a9596d9-7733-4e8c-be06-dcc194350590">
                  <SHORT-NAME>Cdd_Pwm_SetEmulationMode</SHORT-NAME>
                  <REENTRANCY-LEVEL>NON-REENTRANT</REENTRANCY-LEVEL>
                  [!IF "as:modconf('Cdd_Pwm/Cdd')[as:path(node:dtos(.))='/TI_F29H85x/Cdd_Pwm/Cdd']/CddPwmGeneral/CddPwmDevErrorDetect = 'true'"!]
                  <CALL-POINTS>
                    <BSW-DIRECT-CALL-POINT>
                      <SHORT-NAME>Det</SHORT-NAME>
                      <CALLED-ENTRY-REF DEST="BSW-MODULE-ENTRY">/AUTOSAR_Det/Det/Det_ReportError</CALLED-ENTRY-REF>
                    </BSW-DIRECT-CALL-POINT>
                  </CALL-POINTS>
                  [!ENDIF!]
                  <IMPLEMENTED-ENTRY-REF DEST="BSW-MODULE-ENTRY">/Cdd_Pwm_TI_F29H85x/Cdd_Pwm_ModuleEntry/Cdd_Pwm_SetEmulationMode</IMPLEMENTED-ENTRY-REF>
                </BSW-CALLED-ENTITY>
                <BSW-CALLED-ENTITY UUID="016a1589-d64b-4f41-8062-4bfdbfc32888">
                  <SHORT-NAME>Cdd_Pwm_ConfigureTripZoneNotification</SHORT-NAME>
                  <CAN-ENTER-EXCLUSIVE-AREA-REFS>
                    <CAN-ENTER-EXCLUSIVE-AREA-REF DEST="EXCLUSIVE-AREA">/Cdd_Pwm_TI_F29H85x/Cdd_Pwm/Cdd_Pwm_Behavior/CDD_PWM_EXCLUSIVE_AREA_0</CAN-ENTER-EXCLUSIVE-AREA-REF>
                  </CAN-ENTER-EXCLUSIVE-AREA-REFS>
                  <REENTRANCY-LEVEL>SINGLE-CORE-REENTRANT</REENTRANCY-LEVEL>
                  [!IF "as:modconf('Cdd_Pwm/Cdd')[as:path(node:dtos(.))='/TI_F29H85x/Cdd_Pwm/Cdd']/CddPwmGeneral/CddPwmDevErrorDetect = 'true'"!]
                  <CALL-POINTS>
                    <BSW-DIRECT-CALL-POINT>
                      <SHORT-NAME>Det</SHORT-NAME>
                      <CALLED-ENTRY-REF DEST="BSW-MODULE-ENTRY">/AUTOSAR_Det/Det/Det_ReportError</CALLED-ENTRY-REF>
                    </BSW-DIRECT-CALL-POINT>
                  </CALL-POINTS>
                  [!ENDIF!]
                  <IMPLEMENTED-ENTRY-REF DEST="BSW-MODULE-ENTRY">/Cdd_Pwm_TI_F29H85x/Cdd_Pwm_ModuleEntry/Cdd_Pwm_ConfigureTripZoneNotification</IMPLEMENTED-ENTRY-REF>
                </BSW-CALLED-ENTITY>
                <BSW-CALLED-ENTITY UUID="4ecd2020-a081-4064-b593-a61b1f24ff50">
                  <SHORT-NAME>Cdd_Pwm_SetTimeBaseCounter</SHORT-NAME>
                  <REENTRANCY-LEVEL>NON-REENTRANT</REENTRANCY-LEVEL>
                  [!IF "as:modconf('Cdd_Pwm/Cdd')[as:path(node:dtos(.))='/TI_F29H85x/Cdd_Pwm/Cdd']/CddPwmGeneral/CddPwmDevErrorDetect = 'true'"!]
                  <CALL-POINTS>
                    <BSW-DIRECT-CALL-POINT>
                      <SHORT-NAME>Det</SHORT-NAME>
                      <CALLED-ENTRY-REF DEST="BSW-MODULE-ENTRY">/AUTOSAR_Det/Det/Det_ReportError</CALLED-ENTRY-REF>
                    </BSW-DIRECT-CALL-POINT>
                  </CALL-POINTS>
                  [!ENDIF!]
                  <IMPLEMENTED-ENTRY-REF DEST="BSW-MODULE-ENTRY">/Cdd_Pwm_TI_F29H85x/Cdd_Pwm_ModuleEntry/Cdd_Pwm_SetTimeBaseCounter</IMPLEMENTED-ENTRY-REF>
                </BSW-CALLED-ENTITY>
                <BSW-CALLED-ENTITY UUID="db46b231-d5ae-473b-b508-79890e597dde">
                  <SHORT-NAME>Cdd_Pwm_SetCountModeAfterSync</SHORT-NAME>
                  <REENTRANCY-LEVEL>NON-REENTRANT</REENTRANCY-LEVEL>
                  [!IF "as:modconf('Cdd_Pwm/Cdd')[as:path(node:dtos(.))='/TI_F29H85x/Cdd_Pwm/Cdd']/CddPwmGeneral/CddPwmDevErrorDetect = 'true'"!]
                  <CALL-POINTS>
                    <BSW-DIRECT-CALL-POINT>
                      <SHORT-NAME>Det</SHORT-NAME>
                      <CALLED-ENTRY-REF DEST="BSW-MODULE-ENTRY">/AUTOSAR_Det/Det/Det_ReportError</CALLED-ENTRY-REF>
                    </BSW-DIRECT-CALL-POINT>
                  </CALL-POINTS>
                  [!ENDIF!]
                  <IMPLEMENTED-ENTRY-REF DEST="BSW-MODULE-ENTRY">/Cdd_Pwm_TI_F29H85x/Cdd_Pwm_ModuleEntry/Cdd_Pwm_SetCountModeAfterSync</IMPLEMENTED-ENTRY-REF>
                </BSW-CALLED-ENTITY>
                <BSW-CALLED-ENTITY UUID="b05fcff6-cabe-48c9-82e7-e1b60c9bc27c">
                  <SHORT-NAME>Cdd_Pwm_SetClockPrescaler</SHORT-NAME>
                  <REENTRANCY-LEVEL>NON-REENTRANT</REENTRANCY-LEVEL>
                  [!IF "as:modconf('Cdd_Pwm/Cdd')[as:path(node:dtos(.))='/TI_F29H85x/Cdd_Pwm/Cdd']/CddPwmGeneral/CddPwmDevErrorDetect = 'true'"!]
                  <CALL-POINTS>
                    <BSW-DIRECT-CALL-POINT>
                      <SHORT-NAME>Det</SHORT-NAME>
                      <CALLED-ENTRY-REF DEST="BSW-MODULE-ENTRY">/AUTOSAR_Det/Det/Det_ReportError</CALLED-ENTRY-REF>
                    </BSW-DIRECT-CALL-POINT>
                  </CALL-POINTS>
                  [!ENDIF!]
                  <IMPLEMENTED-ENTRY-REF DEST="BSW-MODULE-ENTRY">/Cdd_Pwm_TI_F29H85x/Cdd_Pwm_ModuleEntry/Cdd_Pwm_SetClockPrescaler</IMPLEMENTED-ENTRY-REF>
                </BSW-CALLED-ENTITY>
                <BSW-CALLED-ENTITY UUID="54333505-9218-43f4-bf1e-e32d0c6ebc79">
                  <SHORT-NAME>Cdd_Pwm_ForceSyncPulse</SHORT-NAME>
                  <REENTRANCY-LEVEL>NON-REENTRANT</REENTRANCY-LEVEL>
                  [!IF "as:modconf('Cdd_Pwm/Cdd')[as:path(node:dtos(.))='/TI_F29H85x/Cdd_Pwm/Cdd']/CddPwmGeneral/CddPwmDevErrorDetect = 'true'"!]
                  <CALL-POINTS>
                    <BSW-DIRECT-CALL-POINT>
                      <SHORT-NAME>Det</SHORT-NAME>
                      <CALLED-ENTRY-REF DEST="BSW-MODULE-ENTRY">/AUTOSAR_Det/Det/Det_ReportError</CALLED-ENTRY-REF>
                    </BSW-DIRECT-CALL-POINT>
                  </CALL-POINTS>
                  [!ENDIF!]
                  <IMPLEMENTED-ENTRY-REF DEST="BSW-MODULE-ENTRY">/Cdd_Pwm_TI_F29H85x/Cdd_Pwm_ModuleEntry/Cdd_Pwm_ForceSyncPulse</IMPLEMENTED-ENTRY-REF>
                </BSW-CALLED-ENTITY>
                <BSW-CALLED-ENTITY UUID="aa0bb20e-e1e8-4019-a1b0-36c5c20cb04f">
                  <SHORT-NAME>Cdd_Pwm_SetSyncInPulseSource</SHORT-NAME>
                  <REENTRANCY-LEVEL>NON-REENTRANT</REENTRANCY-LEVEL>
                  [!IF "as:modconf('Cdd_Pwm/Cdd')[as:path(node:dtos(.))='/TI_F29H85x/Cdd_Pwm/Cdd']/CddPwmGeneral/CddPwmDevErrorDetect = 'true'"!]
                  <CALL-POINTS>
                    <BSW-DIRECT-CALL-POINT>
                      <SHORT-NAME>Det</SHORT-NAME>
                      <CALLED-ENTRY-REF DEST="BSW-MODULE-ENTRY">/AUTOSAR_Det/Det/Det_ReportError</CALLED-ENTRY-REF>
                    </BSW-DIRECT-CALL-POINT>
                  </CALL-POINTS>
                  [!ENDIF!]
                  <IMPLEMENTED-ENTRY-REF DEST="BSW-MODULE-ENTRY">/Cdd_Pwm_TI_F29H85x/Cdd_Pwm_ModuleEntry/Cdd_Pwm_SetSyncInPulseSource</IMPLEMENTED-ENTRY-REF>
                </BSW-CALLED-ENTITY>
                <BSW-CALLED-ENTITY UUID="ac563f76-6380-444d-9730-3ffc3e47e885">
                  <SHORT-NAME>Cdd_Pwm_ConfigureSyncOutPulseSource</SHORT-NAME>
                  <REENTRANCY-LEVEL>NON-REENTRANT</REENTRANCY-LEVEL>
                  [!IF "as:modconf('Cdd_Pwm/Cdd')[as:path(node:dtos(.))='/TI_F29H85x/Cdd_Pwm/Cdd']/CddPwmGeneral/CddPwmDevErrorDetect = 'true'"!]
                  <CALL-POINTS>
                    <BSW-DIRECT-CALL-POINT>
                      <SHORT-NAME>Det</SHORT-NAME>
                      <CALLED-ENTRY-REF DEST="BSW-MODULE-ENTRY">/AUTOSAR_Det/Det/Det_ReportError</CALLED-ENTRY-REF>
                    </BSW-DIRECT-CALL-POINT>
                  </CALL-POINTS>
                  [!ENDIF!]
                  <IMPLEMENTED-ENTRY-REF DEST="BSW-MODULE-ENTRY">/Cdd_Pwm_TI_F29H85x/Cdd_Pwm_ModuleEntry/Cdd_Pwm_ConfigureSyncOutPulseSource</IMPLEMENTED-ENTRY-REF>
                </BSW-CALLED-ENTITY>
                <BSW-CALLED-ENTITY UUID="6749b85a-cd67-4cb3-aa9e-088dcba4da26">
                  <SHORT-NAME>Cdd_Pwm_SetOneShotSyncOutTrigger</SHORT-NAME>
                  <REENTRANCY-LEVEL>NON-REENTRANT</REENTRANCY-LEVEL>
                  [!IF "as:modconf('Cdd_Pwm/Cdd')[as:path(node:dtos(.))='/TI_F29H85x/Cdd_Pwm/Cdd']/CddPwmGeneral/CddPwmDevErrorDetect = 'true'"!]
                  <CALL-POINTS>
                    <BSW-DIRECT-CALL-POINT>
                      <SHORT-NAME>Det</SHORT-NAME>
                      <CALLED-ENTRY-REF DEST="BSW-MODULE-ENTRY">/AUTOSAR_Det/Det/Det_ReportError</CALLED-ENTRY-REF>
                    </BSW-DIRECT-CALL-POINT>
                  </CALL-POINTS>
                  [!ENDIF!]
                  <IMPLEMENTED-ENTRY-REF DEST="BSW-MODULE-ENTRY">/Cdd_Pwm_TI_F29H85x/Cdd_Pwm_ModuleEntry/Cdd_Pwm_SetOneShotSyncOutTrigger</IMPLEMENTED-ENTRY-REF>
                </BSW-CALLED-ENTITY>
                <BSW-CALLED-ENTITY UUID="5bcf489d-08ba-4e5e-b8b8-1b127d0d64fb">
                  <SHORT-NAME>Cdd_Pwm_SetPeriodLoadMode</SHORT-NAME>
                  <REENTRANCY-LEVEL>NON-REENTRANT</REENTRANCY-LEVEL>
                  [!IF "as:modconf('Cdd_Pwm/Cdd')[as:path(node:dtos(.))='/TI_F29H85x/Cdd_Pwm/Cdd']/CddPwmGeneral/CddPwmDevErrorDetect = 'true'"!]
                  <CALL-POINTS>
                    <BSW-DIRECT-CALL-POINT>
                      <SHORT-NAME>Det</SHORT-NAME>
                      <CALLED-ENTRY-REF DEST="BSW-MODULE-ENTRY">/AUTOSAR_Det/Det/Det_ReportError</CALLED-ENTRY-REF>
                    </BSW-DIRECT-CALL-POINT>
                  </CALL-POINTS>
                  [!ENDIF!]
                  <IMPLEMENTED-ENTRY-REF DEST="BSW-MODULE-ENTRY">/Cdd_Pwm_TI_F29H85x/Cdd_Pwm_ModuleEntry/Cdd_Pwm_SetPeriodLoadMode</IMPLEMENTED-ENTRY-REF>
                </BSW-CALLED-ENTITY>
                <BSW-CALLED-ENTITY UUID="0ad4adc4-9bbd-4845-9db6-cae205ea4468">
                  <SHORT-NAME>Cdd_Pwm_ConfigurePhaseShiftLoad</SHORT-NAME>
                  <REENTRANCY-LEVEL>NON-REENTRANT</REENTRANCY-LEVEL>
                  [!IF "as:modconf('Cdd_Pwm/Cdd')[as:path(node:dtos(.))='/TI_F29H85x/Cdd_Pwm/Cdd']/CddPwmGeneral/CddPwmDevErrorDetect = 'true'"!]
                  <CALL-POINTS>
                    <BSW-DIRECT-CALL-POINT>
                      <SHORT-NAME>Det</SHORT-NAME>
                      <CALLED-ENTRY-REF DEST="BSW-MODULE-ENTRY">/AUTOSAR_Det/Det/Det_ReportError</CALLED-ENTRY-REF>
                    </BSW-DIRECT-CALL-POINT>
                  </CALL-POINTS>
                  [!ENDIF!]
                  <IMPLEMENTED-ENTRY-REF DEST="BSW-MODULE-ENTRY">/Cdd_Pwm_TI_F29H85x/Cdd_Pwm_ModuleEntry/Cdd_Pwm_ConfigurePhaseShiftLoad</IMPLEMENTED-ENTRY-REF>
                </BSW-CALLED-ENTITY>
                <BSW-CALLED-ENTITY UUID="35dfb458-38ca-4519-bc42-ea6c891f6cca">
                  <SHORT-NAME>Cdd_Pwm_SetTimeBaseCounterMode</SHORT-NAME>
                  <REENTRANCY-LEVEL>NON-REENTRANT</REENTRANCY-LEVEL>
                  [!IF "as:modconf('Cdd_Pwm/Cdd')[as:path(node:dtos(.))='/TI_F29H85x/Cdd_Pwm/Cdd']/CddPwmGeneral/CddPwmDevErrorDetect = 'true'"!]
                  <CALL-POINTS>
                    <BSW-DIRECT-CALL-POINT>
                      <SHORT-NAME>Det</SHORT-NAME>
                      <CALLED-ENTRY-REF DEST="BSW-MODULE-ENTRY">/AUTOSAR_Det/Det/Det_ReportError</CALLED-ENTRY-REF>
                    </BSW-DIRECT-CALL-POINT>
                  </CALL-POINTS>
                  [!ENDIF!]
                  <IMPLEMENTED-ENTRY-REF DEST="BSW-MODULE-ENTRY">/Cdd_Pwm_TI_F29H85x/Cdd_Pwm_ModuleEntry/Cdd_Pwm_SetTimeBaseCounterMode</IMPLEMENTED-ENTRY-REF>
                </BSW-CALLED-ENTITY>
                <BSW-CALLED-ENTITY UUID="59d82845-dd08-45d8-842f-130a7a0ec0d2">
                  <SHORT-NAME>Cdd_Pwm_SelectPeriodLoadEvent</SHORT-NAME>
                  <REENTRANCY-LEVEL>NON-REENTRANT</REENTRANCY-LEVEL>
                  [!IF "as:modconf('Cdd_Pwm/Cdd')[as:path(node:dtos(.))='/TI_F29H85x/Cdd_Pwm/Cdd']/CddPwmGeneral/CddPwmDevErrorDetect = 'true'"!]
                  <CALL-POINTS>
                    <BSW-DIRECT-CALL-POINT>
                      <SHORT-NAME>Det</SHORT-NAME>
                      <CALLED-ENTRY-REF DEST="BSW-MODULE-ENTRY">/AUTOSAR_Det/Det/Det_ReportError</CALLED-ENTRY-REF>
                    </BSW-DIRECT-CALL-POINT>
                  </CALL-POINTS>
                  [!ENDIF!]
                  <IMPLEMENTED-ENTRY-REF DEST="BSW-MODULE-ENTRY">/Cdd_Pwm_TI_F29H85x/Cdd_Pwm_ModuleEntry/Cdd_Pwm_SelectPeriodLoadEvent</IMPLEMENTED-ENTRY-REF>
                </BSW-CALLED-ENTITY>
                <BSW-CALLED-ENTITY UUID="20576508-d918-4d93-8eba-be164ef88b10">
                  <SHORT-NAME>Cdd_Pwm_ConfigureOneShotSync</SHORT-NAME>
                  <REENTRANCY-LEVEL>NON-REENTRANT</REENTRANCY-LEVEL>
                  [!IF "as:modconf('Cdd_Pwm/Cdd')[as:path(node:dtos(.))='/TI_F29H85x/Cdd_Pwm/Cdd']/CddPwmGeneral/CddPwmDevErrorDetect = 'true'"!]
                  <CALL-POINTS>
                    <BSW-DIRECT-CALL-POINT>
                      <SHORT-NAME>Det</SHORT-NAME>
                      <CALLED-ENTRY-REF DEST="BSW-MODULE-ENTRY">/AUTOSAR_Det/Det/Det_ReportError</CALLED-ENTRY-REF>
                    </BSW-DIRECT-CALL-POINT>
                  </CALL-POINTS>
                  [!ENDIF!]
                  <IMPLEMENTED-ENTRY-REF DEST="BSW-MODULE-ENTRY">/Cdd_Pwm_TI_F29H85x/Cdd_Pwm_ModuleEntry/Cdd_Pwm_ConfigureOneShotSync</IMPLEMENTED-ENTRY-REF>
                </BSW-CALLED-ENTITY>
                <BSW-CALLED-ENTITY UUID="156137d1-44e2-4ae0-b316-b57646ab5e1c">
                  <SHORT-NAME>Cdd_Pwm_StartOneShotSync</SHORT-NAME>
                  <REENTRANCY-LEVEL>NON-REENTRANT</REENTRANCY-LEVEL>
                  [!IF "as:modconf('Cdd_Pwm/Cdd')[as:path(node:dtos(.))='/TI_F29H85x/Cdd_Pwm/Cdd']/CddPwmGeneral/CddPwmDevErrorDetect = 'true'"!]
                  <CALL-POINTS>
                    <BSW-DIRECT-CALL-POINT>
                      <SHORT-NAME>Det</SHORT-NAME>
                      <CALLED-ENTRY-REF DEST="BSW-MODULE-ENTRY">/AUTOSAR_Det/Det/Det_ReportError</CALLED-ENTRY-REF>
                    </BSW-DIRECT-CALL-POINT>
                  </CALL-POINTS>
                  [!ENDIF!]
                  <IMPLEMENTED-ENTRY-REF DEST="BSW-MODULE-ENTRY">/Cdd_Pwm_TI_F29H85x/Cdd_Pwm_ModuleEntry/Cdd_Pwm_StartOneShotSync</IMPLEMENTED-ENTRY-REF>
                </BSW-CALLED-ENTITY>
                <BSW-CALLED-ENTITY UUID="e3732204-d9c5-455d-9afc-48a1cdddb075">
                  <SHORT-NAME>Cdd_Pwm_GetTimeBaseCounterValue</SHORT-NAME>
                  <REENTRANCY-LEVEL>NON-REENTRANT</REENTRANCY-LEVEL>
                  [!IF "as:modconf('Cdd_Pwm/Cdd')[as:path(node:dtos(.))='/TI_F29H85x/Cdd_Pwm/Cdd']/CddPwmGeneral/CddPwmDevErrorDetect = 'true'"!]
                  <CALL-POINTS>
                    <BSW-DIRECT-CALL-POINT>
                      <SHORT-NAME>Det</SHORT-NAME>
                      <CALLED-ENTRY-REF DEST="BSW-MODULE-ENTRY">/AUTOSAR_Det/Det/Det_ReportError</CALLED-ENTRY-REF>
                    </BSW-DIRECT-CALL-POINT>
                  </CALL-POINTS>
                  [!ENDIF!]
                  <IMPLEMENTED-ENTRY-REF DEST="BSW-MODULE-ENTRY">/Cdd_Pwm_TI_F29H85x/Cdd_Pwm_ModuleEntry/Cdd_Pwm_GetTimeBaseCounterValue</IMPLEMENTED-ENTRY-REF>
                </BSW-CALLED-ENTITY>
                <BSW-CALLED-ENTITY UUID="5fb65953-d79b-4c02-8cb4-e5804a9780d7">
                  <SHORT-NAME>Cdd_Pwm_GetTimeBaseCounterOverflowStatus</SHORT-NAME>
                  <REENTRANCY-LEVEL>NON-REENTRANT</REENTRANCY-LEVEL>
                  [!IF "as:modconf('Cdd_Pwm/Cdd')[as:path(node:dtos(.))='/TI_F29H85x/Cdd_Pwm/Cdd']/CddPwmGeneral/CddPwmDevErrorDetect = 'true'"!]
                  <CALL-POINTS>
                    <BSW-DIRECT-CALL-POINT>
                      <SHORT-NAME>Det</SHORT-NAME>
                      <CALLED-ENTRY-REF DEST="BSW-MODULE-ENTRY">/AUTOSAR_Det/Det/Det_ReportError</CALLED-ENTRY-REF>
                    </BSW-DIRECT-CALL-POINT>
                  </CALL-POINTS>
                  [!ENDIF!]
                  <IMPLEMENTED-ENTRY-REF DEST="BSW-MODULE-ENTRY">/Cdd_Pwm_TI_F29H85x/Cdd_Pwm_ModuleEntry/Cdd_Pwm_GetTimeBaseCounterOverflowStatus</IMPLEMENTED-ENTRY-REF>
                </BSW-CALLED-ENTITY>
                <BSW-CALLED-ENTITY UUID="d4618203-75d3-48a5-909e-0bdd464b5cd5">
                  <SHORT-NAME>Cdd_Pwm_ClearTimeBaseCounterOverflowEvent</SHORT-NAME>
                  <REENTRANCY-LEVEL>NON-REENTRANT</REENTRANCY-LEVEL>
                  [!IF "as:modconf('Cdd_Pwm/Cdd')[as:path(node:dtos(.))='/TI_F29H85x/Cdd_Pwm/Cdd']/CddPwmGeneral/CddPwmDevErrorDetect = 'true'"!]
                  <CALL-POINTS>
                    <BSW-DIRECT-CALL-POINT>
                      <SHORT-NAME>Det</SHORT-NAME>
                      <CALLED-ENTRY-REF DEST="BSW-MODULE-ENTRY">/AUTOSAR_Det/Det/Det_ReportError</CALLED-ENTRY-REF>
                    </BSW-DIRECT-CALL-POINT>
                  </CALL-POINTS>
                  [!ENDIF!]
                  <IMPLEMENTED-ENTRY-REF DEST="BSW-MODULE-ENTRY">/Cdd_Pwm_TI_F29H85x/Cdd_Pwm_ModuleEntry/Cdd_Pwm_ClearTimeBaseCounterOverflowEvent</IMPLEMENTED-ENTRY-REF>
                </BSW-CALLED-ENTITY>
                <BSW-CALLED-ENTITY UUID="3aecadf4-bbff-4f2e-a594-ebc578babcac">
                  <SHORT-NAME>Cdd_Pwm_GetSyncStatus</SHORT-NAME>
                  <REENTRANCY-LEVEL>NON-REENTRANT</REENTRANCY-LEVEL>
                  [!IF "as:modconf('Cdd_Pwm/Cdd')[as:path(node:dtos(.))='/TI_F29H85x/Cdd_Pwm/Cdd']/CddPwmGeneral/CddPwmDevErrorDetect = 'true'"!]
                  <CALL-POINTS>
                    <BSW-DIRECT-CALL-POINT>
                      <SHORT-NAME>Det</SHORT-NAME>
                      <CALLED-ENTRY-REF DEST="BSW-MODULE-ENTRY">/AUTOSAR_Det/Det/Det_ReportError</CALLED-ENTRY-REF>
                    </BSW-DIRECT-CALL-POINT>
                  </CALL-POINTS>
                  [!ENDIF!]
                  <IMPLEMENTED-ENTRY-REF DEST="BSW-MODULE-ENTRY">/Cdd_Pwm_TI_F29H85x/Cdd_Pwm_ModuleEntry/Cdd_Pwm_GetSyncStatus</IMPLEMENTED-ENTRY-REF>
                </BSW-CALLED-ENTITY>
                <BSW-CALLED-ENTITY UUID="7c5c3b04-eefc-4b6e-9f59-01fadad054de">
                  <SHORT-NAME>Cdd_Pwm_ClearSyncEvent</SHORT-NAME>
                  <REENTRANCY-LEVEL>NON-REENTRANT</REENTRANCY-LEVEL>
                  [!IF "as:modconf('Cdd_Pwm/Cdd')[as:path(node:dtos(.))='/TI_F29H85x/Cdd_Pwm/Cdd']/CddPwmGeneral/CddPwmDevErrorDetect = 'true'"!]
                  <CALL-POINTS>
                    <BSW-DIRECT-CALL-POINT>
                      <SHORT-NAME>Det</SHORT-NAME>
                      <CALLED-ENTRY-REF DEST="BSW-MODULE-ENTRY">/AUTOSAR_Det/Det/Det_ReportError</CALLED-ENTRY-REF>
                    </BSW-DIRECT-CALL-POINT>
                  </CALL-POINTS>
                  [!ENDIF!]
                  <IMPLEMENTED-ENTRY-REF DEST="BSW-MODULE-ENTRY">/Cdd_Pwm_TI_F29H85x/Cdd_Pwm_ModuleEntry/Cdd_Pwm_ClearSyncEvent</IMPLEMENTED-ENTRY-REF>
                </BSW-CALLED-ENTITY>
                <BSW-CALLED-ENTITY UUID="63e07d2d-9aa5-4b90-8ab6-bd6db7c9639d">
                  <SHORT-NAME>Cdd_Pwm_GetTimeBaseCounterDirection</SHORT-NAME>
                  <REENTRANCY-LEVEL>NON-REENTRANT</REENTRANCY-LEVEL>
                  [!IF "as:modconf('Cdd_Pwm/Cdd')[as:path(node:dtos(.))='/TI_F29H85x/Cdd_Pwm/Cdd']/CddPwmGeneral/CddPwmDevErrorDetect = 'true'"!]
                  <CALL-POINTS>
                    <BSW-DIRECT-CALL-POINT>
                      <SHORT-NAME>Det</SHORT-NAME>
                      <CALLED-ENTRY-REF DEST="BSW-MODULE-ENTRY">/AUTOSAR_Det/Det/Det_ReportError</CALLED-ENTRY-REF>
                    </BSW-DIRECT-CALL-POINT>
                  </CALL-POINTS>
                  [!ENDIF!]
                  <IMPLEMENTED-ENTRY-REF DEST="BSW-MODULE-ENTRY">/Cdd_Pwm_TI_F29H85x/Cdd_Pwm_ModuleEntry/Cdd_Pwm_GetTimeBaseCounterDirection</IMPLEMENTED-ENTRY-REF>
                </BSW-CALLED-ENTITY>
                <BSW-CALLED-ENTITY UUID="08420cb8-166f-4b78-82ff-6fe0c90b6001">
                  <SHORT-NAME>Cdd_Pwm_SetPhaseShift</SHORT-NAME>
                  <REENTRANCY-LEVEL>NON-REENTRANT</REENTRANCY-LEVEL>
                  [!IF "as:modconf('Cdd_Pwm/Cdd')[as:path(node:dtos(.))='/TI_F29H85x/Cdd_Pwm/Cdd']/CddPwmGeneral/CddPwmDevErrorDetect = 'true'"!]
                  <CALL-POINTS>
                    <BSW-DIRECT-CALL-POINT>
                      <SHORT-NAME>Det</SHORT-NAME>
                      <CALLED-ENTRY-REF DEST="BSW-MODULE-ENTRY">/AUTOSAR_Det/Det/Det_ReportError</CALLED-ENTRY-REF>
                    </BSW-DIRECT-CALL-POINT>
                  </CALL-POINTS>
                  [!ENDIF!]
                  <IMPLEMENTED-ENTRY-REF DEST="BSW-MODULE-ENTRY">/Cdd_Pwm_TI_F29H85x/Cdd_Pwm_ModuleEntry/Cdd_Pwm_SetPhaseShift</IMPLEMENTED-ENTRY-REF>
                </BSW-CALLED-ENTITY>
                <BSW-CALLED-ENTITY UUID="6026e491-66c7-43f9-b5c7-fbe63d2539d1">
                  <SHORT-NAME>Cdd_Pwm_SetTimeBasePeriod</SHORT-NAME>
                  <REENTRANCY-LEVEL>NON-REENTRANT</REENTRANCY-LEVEL>
                  [!IF "as:modconf('Cdd_Pwm/Cdd')[as:path(node:dtos(.))='/TI_F29H85x/Cdd_Pwm/Cdd']/CddPwmGeneral/CddPwmDevErrorDetect = 'true'"!]
                  <CALL-POINTS>
                    <BSW-DIRECT-CALL-POINT>
                      <SHORT-NAME>Det</SHORT-NAME>
                      <CALLED-ENTRY-REF DEST="BSW-MODULE-ENTRY">/AUTOSAR_Det/Det/Det_ReportError</CALLED-ENTRY-REF>
                    </BSW-DIRECT-CALL-POINT>
                  </CALL-POINTS>
                  [!ENDIF!]
                  <IMPLEMENTED-ENTRY-REF DEST="BSW-MODULE-ENTRY">/Cdd_Pwm_TI_F29H85x/Cdd_Pwm_ModuleEntry/Cdd_Pwm_SetTimeBasePeriod</IMPLEMENTED-ENTRY-REF>
                </BSW-CALLED-ENTITY>
                <BSW-CALLED-ENTITY UUID="a3fe935f-661e-423c-b3d7-58060a0937be">
                  <SHORT-NAME>Cdd_Pwm_GetTimeBasePeriod</SHORT-NAME>
                  <REENTRANCY-LEVEL>NON-REENTRANT</REENTRANCY-LEVEL>
                  [!IF "as:modconf('Cdd_Pwm/Cdd')[as:path(node:dtos(.))='/TI_F29H85x/Cdd_Pwm/Cdd']/CddPwmGeneral/CddPwmDevErrorDetect = 'true'"!]
                  <CALL-POINTS>
                    <BSW-DIRECT-CALL-POINT>
                      <SHORT-NAME>Det</SHORT-NAME>
                      <CALLED-ENTRY-REF DEST="BSW-MODULE-ENTRY">/AUTOSAR_Det/Det/Det_ReportError</CALLED-ENTRY-REF>
                    </BSW-DIRECT-CALL-POINT>
                  </CALL-POINTS>
                  [!ENDIF!]
                  <IMPLEMENTED-ENTRY-REF DEST="BSW-MODULE-ENTRY">/Cdd_Pwm_TI_F29H85x/Cdd_Pwm_ModuleEntry/Cdd_Pwm_GetTimeBasePeriod</IMPLEMENTED-ENTRY-REF>
                </BSW-CALLED-ENTITY>
                <BSW-CALLED-ENTITY UUID="ace8fd3e-2386-41c8-a883-e0df96e1865d">
                  <SHORT-NAME>Cdd_Pwm_SetCounterCompareShadowLoadMode</SHORT-NAME>
                  <REENTRANCY-LEVEL>NON-REENTRANT</REENTRANCY-LEVEL>
                  [!IF "as:modconf('Cdd_Pwm/Cdd')[as:path(node:dtos(.))='/TI_F29H85x/Cdd_Pwm/Cdd']/CddPwmGeneral/CddPwmDevErrorDetect = 'true'"!]
                  <CALL-POINTS>
                    <BSW-DIRECT-CALL-POINT>
                      <SHORT-NAME>Det</SHORT-NAME>
                      <CALLED-ENTRY-REF DEST="BSW-MODULE-ENTRY">/AUTOSAR_Det/Det/Det_ReportError</CALLED-ENTRY-REF>
                    </BSW-DIRECT-CALL-POINT>
                  </CALL-POINTS>
                  [!ENDIF!]
                  <IMPLEMENTED-ENTRY-REF DEST="BSW-MODULE-ENTRY">/Cdd_Pwm_TI_F29H85x/Cdd_Pwm_ModuleEntry/Cdd_Pwm_SetCounterCompareShadowLoadMode</IMPLEMENTED-ENTRY-REF>
                </BSW-CALLED-ENTITY>
                <BSW-CALLED-ENTITY UUID="ef46c427-2f09-4e51-a77e-ebf6a9254bcb">
                  <SHORT-NAME>Cdd_Pwm_DisableCounterCompareShadowLoadMode</SHORT-NAME>
                  <REENTRANCY-LEVEL>NON-REENTRANT</REENTRANCY-LEVEL>
                  [!IF "as:modconf('Cdd_Pwm/Cdd')[as:path(node:dtos(.))='/TI_F29H85x/Cdd_Pwm/Cdd']/CddPwmGeneral/CddPwmDevErrorDetect = 'true'"!]
                  <CALL-POINTS>
                    <BSW-DIRECT-CALL-POINT>
                      <SHORT-NAME>Det</SHORT-NAME>
                      <CALLED-ENTRY-REF DEST="BSW-MODULE-ENTRY">/AUTOSAR_Det/Det/Det_ReportError</CALLED-ENTRY-REF>
                    </BSW-DIRECT-CALL-POINT>
                  </CALL-POINTS>
                  [!ENDIF!]
                  <IMPLEMENTED-ENTRY-REF DEST="BSW-MODULE-ENTRY">/Cdd_Pwm_TI_F29H85x/Cdd_Pwm_ModuleEntry/Cdd_Pwm_DisableCounterCompareShadowLoadMode</IMPLEMENTED-ENTRY-REF>
                </BSW-CALLED-ENTITY>
                <BSW-CALLED-ENTITY UUID="3ee18722-b3d7-4efd-9323-d6e0cf82c8fa">
                  <SHORT-NAME>Cdd_Pwm_SetCounterCompareValue</SHORT-NAME>
                  <REENTRANCY-LEVEL>NON-REENTRANT</REENTRANCY-LEVEL>
                  [!IF "as:modconf('Cdd_Pwm/Cdd')[as:path(node:dtos(.))='/TI_F29H85x/Cdd_Pwm/Cdd']/CddPwmGeneral/CddPwmDevErrorDetect = 'true'"!]
                  <CALL-POINTS>
                    <BSW-DIRECT-CALL-POINT>
                      <SHORT-NAME>Det</SHORT-NAME>
                      <CALLED-ENTRY-REF DEST="BSW-MODULE-ENTRY">/AUTOSAR_Det/Det/Det_ReportError</CALLED-ENTRY-REF>
                    </BSW-DIRECT-CALL-POINT>
                  </CALL-POINTS>
                  [!ENDIF!]
                  <IMPLEMENTED-ENTRY-REF DEST="BSW-MODULE-ENTRY">/Cdd_Pwm_TI_F29H85x/Cdd_Pwm_ModuleEntry/Cdd_Pwm_SetCounterCompareValue</IMPLEMENTED-ENTRY-REF>
                </BSW-CALLED-ENTITY>
                <BSW-CALLED-ENTITY UUID="7cacc679-a8ef-4c07-9764-3fc96e8b7ac8">
                  <SHORT-NAME>Cdd_Pwm_GetCounterCompareValue</SHORT-NAME>
                  <REENTRANCY-LEVEL>NON-REENTRANT</REENTRANCY-LEVEL>
                  [!IF "as:modconf('Cdd_Pwm/Cdd')[as:path(node:dtos(.))='/TI_F29H85x/Cdd_Pwm/Cdd']/CddPwmGeneral/CddPwmDevErrorDetect = 'true'"!]
                  <CALL-POINTS>
                    <BSW-DIRECT-CALL-POINT>
                      <SHORT-NAME>Det</SHORT-NAME>
                      <CALLED-ENTRY-REF DEST="BSW-MODULE-ENTRY">/AUTOSAR_Det/Det/Det_ReportError</CALLED-ENTRY-REF>
                    </BSW-DIRECT-CALL-POINT>
                  </CALL-POINTS>
                  [!ENDIF!]
                  <IMPLEMENTED-ENTRY-REF DEST="BSW-MODULE-ENTRY">/Cdd_Pwm_TI_F29H85x/Cdd_Pwm_ModuleEntry/Cdd_Pwm_GetCounterCompareValue</IMPLEMENTED-ENTRY-REF>
                </BSW-CALLED-ENTITY>
                <BSW-CALLED-ENTITY UUID="d5564a53-5a44-4b64-b054-430506f6954b">
                  <SHORT-NAME>Cdd_Pwm_GetCounterCompareShadowStatus</SHORT-NAME>
                  <REENTRANCY-LEVEL>NON-REENTRANT</REENTRANCY-LEVEL>
                  [!IF "as:modconf('Cdd_Pwm/Cdd')[as:path(node:dtos(.))='/TI_F29H85x/Cdd_Pwm/Cdd']/CddPwmGeneral/CddPwmDevErrorDetect = 'true'"!]
                  <CALL-POINTS>
                    <BSW-DIRECT-CALL-POINT>
                      <SHORT-NAME>Det</SHORT-NAME>
                      <CALLED-ENTRY-REF DEST="BSW-MODULE-ENTRY">/AUTOSAR_Det/Det/Det_ReportError</CALLED-ENTRY-REF>
                    </BSW-DIRECT-CALL-POINT>
                  </CALL-POINTS>
                  [!ENDIF!]
                  <IMPLEMENTED-ENTRY-REF DEST="BSW-MODULE-ENTRY">/Cdd_Pwm_TI_F29H85x/Cdd_Pwm_ModuleEntry/Cdd_Pwm_GetCounterCompareShadowStatus</IMPLEMENTED-ENTRY-REF>
                </BSW-CALLED-ENTITY>
                <BSW-CALLED-ENTITY UUID="4832d003-1dea-40bf-ae01-00ecf8d6183f">
                  <SHORT-NAME>Cdd_Pwm_ConfigureLinkDutyHR</SHORT-NAME>
                  <REENTRANCY-LEVEL>NON-REENTRANT</REENTRANCY-LEVEL>
                  [!IF "as:modconf('Cdd_Pwm/Cdd')[as:path(node:dtos(.))='/TI_F29H85x/Cdd_Pwm/Cdd']/CddPwmGeneral/CddPwmDevErrorDetect = 'true'"!]
                  <CALL-POINTS>
                    <BSW-DIRECT-CALL-POINT>
                      <SHORT-NAME>Det</SHORT-NAME>
                      <CALLED-ENTRY-REF DEST="BSW-MODULE-ENTRY">/AUTOSAR_Det/Det/Det_ReportError</CALLED-ENTRY-REF>
                    </BSW-DIRECT-CALL-POINT>
                  </CALL-POINTS>
                  [!ENDIF!]
                  <IMPLEMENTED-ENTRY-REF DEST="BSW-MODULE-ENTRY">/Cdd_Pwm_TI_F29H85x/Cdd_Pwm_ModuleEntry/Cdd_Pwm_ConfigureLinkDutyHR</IMPLEMENTED-ENTRY-REF>
                </BSW-CALLED-ENTITY>
                <BSW-CALLED-ENTITY UUID="180991ec-fc18-4cbb-9e96-ce9ec78a3f94">
                  <SHORT-NAME>Cdd_Pwm_SetActionQualifierShadowLoadMode</SHORT-NAME>
                  <REENTRANCY-LEVEL>NON-REENTRANT</REENTRANCY-LEVEL>
                  [!IF "as:modconf('Cdd_Pwm/Cdd')[as:path(node:dtos(.))='/TI_F29H85x/Cdd_Pwm/Cdd']/CddPwmGeneral/CddPwmDevErrorDetect = 'true'"!]
                  <CALL-POINTS>
                    <BSW-DIRECT-CALL-POINT>
                      <SHORT-NAME>Det</SHORT-NAME>
                      <CALLED-ENTRY-REF DEST="BSW-MODULE-ENTRY">/AUTOSAR_Det/Det/Det_ReportError</CALLED-ENTRY-REF>
                    </BSW-DIRECT-CALL-POINT>
                  </CALL-POINTS>
                  [!ENDIF!]
                  <IMPLEMENTED-ENTRY-REF DEST="BSW-MODULE-ENTRY">/Cdd_Pwm_TI_F29H85x/Cdd_Pwm_ModuleEntry/Cdd_Pwm_SetActionQualifierShadowLoadMode</IMPLEMENTED-ENTRY-REF>
                </BSW-CALLED-ENTITY>
                <BSW-CALLED-ENTITY UUID="b43b2403-3e49-4b02-8e83-d4a5542e9479">
                  <SHORT-NAME>Cdd_Pwm_DisableActionQualifierShadowLoadMode</SHORT-NAME>
                  <REENTRANCY-LEVEL>NON-REENTRANT</REENTRANCY-LEVEL>
                  [!IF "as:modconf('Cdd_Pwm/Cdd')[as:path(node:dtos(.))='/TI_F29H85x/Cdd_Pwm/Cdd']/CddPwmGeneral/CddPwmDevErrorDetect = 'true'"!]
                  <CALL-POINTS>
                    <BSW-DIRECT-CALL-POINT>
                      <SHORT-NAME>Det</SHORT-NAME>
                      <CALLED-ENTRY-REF DEST="BSW-MODULE-ENTRY">/AUTOSAR_Det/Det/Det_ReportError</CALLED-ENTRY-REF>
                    </BSW-DIRECT-CALL-POINT>
                  </CALL-POINTS>
                  [!ENDIF!]
                  <IMPLEMENTED-ENTRY-REF DEST="BSW-MODULE-ENTRY">/Cdd_Pwm_TI_F29H85x/Cdd_Pwm_ModuleEntry/Cdd_Pwm_DisableActionQualifierShadowLoadMode</IMPLEMENTED-ENTRY-REF>
                </BSW-CALLED-ENTITY>
                <BSW-CALLED-ENTITY UUID="5e648d7a-738c-4872-b6b4-de8efbc92287">
                  <SHORT-NAME>Cdd_Pwm_SetActionQualifierT1TriggerSource</SHORT-NAME>
                  <REENTRANCY-LEVEL>NON-REENTRANT</REENTRANCY-LEVEL>
                  [!IF "as:modconf('Cdd_Pwm/Cdd')[as:path(node:dtos(.))='/TI_F29H85x/Cdd_Pwm/Cdd']/CddPwmGeneral/CddPwmDevErrorDetect = 'true'"!]
                  <CALL-POINTS>
                    <BSW-DIRECT-CALL-POINT>
                      <SHORT-NAME>Det</SHORT-NAME>
                      <CALLED-ENTRY-REF DEST="BSW-MODULE-ENTRY">/AUTOSAR_Det/Det/Det_ReportError</CALLED-ENTRY-REF>
                    </BSW-DIRECT-CALL-POINT>
                  </CALL-POINTS>
                  [!ENDIF!]
                  <IMPLEMENTED-ENTRY-REF DEST="BSW-MODULE-ENTRY">/Cdd_Pwm_TI_F29H85x/Cdd_Pwm_ModuleEntry/Cdd_Pwm_SetActionQualifierT1TriggerSource</IMPLEMENTED-ENTRY-REF>
                </BSW-CALLED-ENTITY>
                <BSW-CALLED-ENTITY UUID="d90e6a29-712a-4ed6-9978-7b70a29f2eee">
                  <SHORT-NAME>Cdd_Pwm_SetActionQualifierT2TriggerSource</SHORT-NAME>
                  <REENTRANCY-LEVEL>NON-REENTRANT</REENTRANCY-LEVEL>
                  [!IF "as:modconf('Cdd_Pwm/Cdd')[as:path(node:dtos(.))='/TI_F29H85x/Cdd_Pwm/Cdd']/CddPwmGeneral/CddPwmDevErrorDetect = 'true'"!]
                  <CALL-POINTS>
                    <BSW-DIRECT-CALL-POINT>
                      <SHORT-NAME>Det</SHORT-NAME>
                      <CALLED-ENTRY-REF DEST="BSW-MODULE-ENTRY">/AUTOSAR_Det/Det/Det_ReportError</CALLED-ENTRY-REF>
                    </BSW-DIRECT-CALL-POINT>
                  </CALL-POINTS>
                  [!ENDIF!]
                  <IMPLEMENTED-ENTRY-REF DEST="BSW-MODULE-ENTRY">/Cdd_Pwm_TI_F29H85x/Cdd_Pwm_ModuleEntry/Cdd_Pwm_SetActionQualifierT2TriggerSource</IMPLEMENTED-ENTRY-REF>
                </BSW-CALLED-ENTITY>
                <BSW-CALLED-ENTITY UUID="09810312-3524-4e04-8e24-9bb2e1a1f00e">
                  <SHORT-NAME>Cdd_Pwm_SetActionQualifierAction</SHORT-NAME>
                  <REENTRANCY-LEVEL>NON-REENTRANT</REENTRANCY-LEVEL>
                  [!IF "as:modconf('Cdd_Pwm/Cdd')[as:path(node:dtos(.))='/TI_F29H85x/Cdd_Pwm/Cdd']/CddPwmGeneral/CddPwmDevErrorDetect = 'true'"!]
                  <CALL-POINTS>
                    <BSW-DIRECT-CALL-POINT>
                      <SHORT-NAME>Det</SHORT-NAME>
                      <CALLED-ENTRY-REF DEST="BSW-MODULE-ENTRY">/AUTOSAR_Det/Det/Det_ReportError</CALLED-ENTRY-REF>
                    </BSW-DIRECT-CALL-POINT>
                  </CALL-POINTS>
                  [!ENDIF!]
                  <IMPLEMENTED-ENTRY-REF DEST="BSW-MODULE-ENTRY">/Cdd_Pwm_TI_F29H85x/Cdd_Pwm_ModuleEntry/Cdd_Pwm_SetActionQualifierAction</IMPLEMENTED-ENTRY-REF>
                </BSW-CALLED-ENTITY>   
                <BSW-CALLED-ENTITY UUID="021740ed-96a7-446a-a285-aadf7022b2b0">
                  <SHORT-NAME>Cdd_Pwm_SetActionQualifierActionComplete</SHORT-NAME>
                  <REENTRANCY-LEVEL>NON-REENTRANT</REENTRANCY-LEVEL>
                  [!IF "as:modconf('Cdd_Pwm/Cdd')[as:path(node:dtos(.))='/TI_F29H85x/Cdd_Pwm/Cdd']/CddPwmGeneral/CddPwmDevErrorDetect = 'true'"!]
                  <CALL-POINTS>
                    <BSW-DIRECT-CALL-POINT>
                      <SHORT-NAME>Det</SHORT-NAME>
                      <CALLED-ENTRY-REF DEST="BSW-MODULE-ENTRY">/AUTOSAR_Det/Det/Det_ReportError</CALLED-ENTRY-REF>
                    </BSW-DIRECT-CALL-POINT>
                  </CALL-POINTS>
                  [!ENDIF!]
                  <IMPLEMENTED-ENTRY-REF DEST="BSW-MODULE-ENTRY">/Cdd_Pwm_TI_F29H85x/Cdd_Pwm_ModuleEntry/Cdd_Pwm_SetActionQualifierActionComplete</IMPLEMENTED-ENTRY-REF>
                </BSW-CALLED-ENTITY>
                <BSW-CALLED-ENTITY UUID="9b1eb0f5-906a-4817-b7cd-d79456e88fd0">
                  <SHORT-NAME>Cdd_Pwm_SetAdditionalActionQualifierActionComplete</SHORT-NAME>
                  <REENTRANCY-LEVEL>NON-REENTRANT</REENTRANCY-LEVEL>
                  [!IF "as:modconf('Cdd_Pwm/Cdd')[as:path(node:dtos(.))='/TI_F29H85x/Cdd_Pwm/Cdd']/CddPwmGeneral/CddPwmDevErrorDetect = 'true'"!]
                  <CALL-POINTS>
                    <BSW-DIRECT-CALL-POINT>
                      <SHORT-NAME>Det</SHORT-NAME>
                      <CALLED-ENTRY-REF DEST="BSW-MODULE-ENTRY">/AUTOSAR_Det/Det/Det_ReportError</CALLED-ENTRY-REF>
                    </BSW-DIRECT-CALL-POINT>
                  </CALL-POINTS>
                  [!ENDIF!]
                  <IMPLEMENTED-ENTRY-REF DEST="BSW-MODULE-ENTRY">/Cdd_Pwm_TI_F29H85x/Cdd_Pwm_ModuleEntry/Cdd_Pwm_SetAdditionalActionQualifierActionComplete</IMPLEMENTED-ENTRY-REF>
                </BSW-CALLED-ENTITY>
                <BSW-CALLED-ENTITY UUID="85305316-2207-44bc-9405-1a1928b584dc">
                  <SHORT-NAME>Cdd_Pwm_SetActionQualifierContSwForceShadowMode</SHORT-NAME>
                  <REENTRANCY-LEVEL>NON-REENTRANT</REENTRANCY-LEVEL>
                  [!IF "as:modconf('Cdd_Pwm/Cdd')[as:path(node:dtos(.))='/TI_F29H85x/Cdd_Pwm/Cdd']/CddPwmGeneral/CddPwmDevErrorDetect = 'true'"!]
                  <CALL-POINTS>
                    <BSW-DIRECT-CALL-POINT>
                      <SHORT-NAME>Det</SHORT-NAME>
                      <CALLED-ENTRY-REF DEST="BSW-MODULE-ENTRY">/AUTOSAR_Det/Det/Det_ReportError</CALLED-ENTRY-REF>
                    </BSW-DIRECT-CALL-POINT>
                  </CALL-POINTS>
                  [!ENDIF!]
                  <IMPLEMENTED-ENTRY-REF DEST="BSW-MODULE-ENTRY">/Cdd_Pwm_TI_F29H85x/Cdd_Pwm_ModuleEntry/Cdd_Pwm_SetActionQualifierContSwForceShadowMode</IMPLEMENTED-ENTRY-REF>
                </BSW-CALLED-ENTITY>
                <BSW-CALLED-ENTITY UUID="f3a3b85f-8165-41f2-bcaf-2de238d08c3e">
                  <SHORT-NAME>Cdd_Pwm_SetActionQualifierContSwForceAction</SHORT-NAME>
                  <REENTRANCY-LEVEL>NON-REENTRANT</REENTRANCY-LEVEL>
                  [!IF "as:modconf('Cdd_Pwm/Cdd')[as:path(node:dtos(.))='/TI_F29H85x/Cdd_Pwm/Cdd']/CddPwmGeneral/CddPwmDevErrorDetect = 'true'"!]
                  <CALL-POINTS>
                    <BSW-DIRECT-CALL-POINT>
                      <SHORT-NAME>Det</SHORT-NAME>
                      <CALLED-ENTRY-REF DEST="BSW-MODULE-ENTRY">/AUTOSAR_Det/Det/Det_ReportError</CALLED-ENTRY-REF>
                    </BSW-DIRECT-CALL-POINT>
                  </CALL-POINTS>
                  [!ENDIF!]
                  <IMPLEMENTED-ENTRY-REF DEST="BSW-MODULE-ENTRY">/Cdd_Pwm_TI_F29H85x/Cdd_Pwm_ModuleEntry/Cdd_Pwm_SetActionQualifierContSwForceAction</IMPLEMENTED-ENTRY-REF>
                </BSW-CALLED-ENTITY>
                <BSW-CALLED-ENTITY UUID="67271baf-7e53-4d81-8c08-820e20f3a7cc">
                  <SHORT-NAME>Cdd_Pwm_SetActionQualifierSwAction</SHORT-NAME>
                  <REENTRANCY-LEVEL>NON-REENTRANT</REENTRANCY-LEVEL>
                  [!IF "as:modconf('Cdd_Pwm/Cdd')[as:path(node:dtos(.))='/TI_F29H85x/Cdd_Pwm/Cdd']/CddPwmGeneral/CddPwmDevErrorDetect = 'true'"!]
                  <CALL-POINTS>
                    <BSW-DIRECT-CALL-POINT>
                      <SHORT-NAME>Det</SHORT-NAME>
                      <CALLED-ENTRY-REF DEST="BSW-MODULE-ENTRY">/AUTOSAR_Det/Det/Det_ReportError</CALLED-ENTRY-REF>
                    </BSW-DIRECT-CALL-POINT>
                  </CALL-POINTS>
                  [!ENDIF!]
                  <IMPLEMENTED-ENTRY-REF DEST="BSW-MODULE-ENTRY">/Cdd_Pwm_TI_F29H85x/Cdd_Pwm_ModuleEntry/Cdd_Pwm_SetActionQualifierSwAction</IMPLEMENTED-ENTRY-REF>
                </BSW-CALLED-ENTITY>
                <BSW-CALLED-ENTITY UUID="1160f5ac-a427-4c01-9ab9-ad956c2f592c">
                  <SHORT-NAME>Cdd_Pwm_ForceActionQualifierSwAction</SHORT-NAME>
                  <REENTRANCY-LEVEL>NON-REENTRANT</REENTRANCY-LEVEL>
                  [!IF "as:modconf('Cdd_Pwm/Cdd')[as:path(node:dtos(.))='/TI_F29H85x/Cdd_Pwm/Cdd']/CddPwmGeneral/CddPwmDevErrorDetect = 'true'"!]
                  <CALL-POINTS>
                    <BSW-DIRECT-CALL-POINT>
                      <SHORT-NAME>Det</SHORT-NAME>
                      <CALLED-ENTRY-REF DEST="BSW-MODULE-ENTRY">/AUTOSAR_Det/Det/Det_ReportError</CALLED-ENTRY-REF>
                    </BSW-DIRECT-CALL-POINT>
                  </CALL-POINTS>
                  [!ENDIF!]
                  <IMPLEMENTED-ENTRY-REF DEST="BSW-MODULE-ENTRY">/Cdd_Pwm_TI_F29H85x/Cdd_Pwm_ModuleEntry/Cdd_Pwm_ForceActionQualifierSwAction</IMPLEMENTED-ENTRY-REF>
                </BSW-CALLED-ENTITY>
                <BSW-CALLED-ENTITY UUID="6a3c983a-b689-4ff1-a7bc-0d9c66633860">
                  <SHORT-NAME>Cdd_Pwm_SetDeadBandOutputSwapMode</SHORT-NAME>
                  <REENTRANCY-LEVEL>NON-REENTRANT</REENTRANCY-LEVEL>
                  [!IF "as:modconf('Cdd_Pwm/Cdd')[as:path(node:dtos(.))='/TI_F29H85x/Cdd_Pwm/Cdd']/CddPwmGeneral/CddPwmDevErrorDetect = 'true'"!]
                  <CALL-POINTS>
                    <BSW-DIRECT-CALL-POINT>
                      <SHORT-NAME>Det</SHORT-NAME>
                      <CALLED-ENTRY-REF DEST="BSW-MODULE-ENTRY">/AUTOSAR_Det/Det/Det_ReportError</CALLED-ENTRY-REF>
                    </BSW-DIRECT-CALL-POINT>
                  </CALL-POINTS>
                  [!ENDIF!]
                  <IMPLEMENTED-ENTRY-REF DEST="BSW-MODULE-ENTRY">/Cdd_Pwm_TI_F29H85x/Cdd_Pwm_ModuleEntry/Cdd_Pwm_SetDeadBandOutputSwapMode</IMPLEMENTED-ENTRY-REF>
                </BSW-CALLED-ENTITY>
                <BSW-CALLED-ENTITY UUID="6d6fb5e3-2371-4f48-bc40-e648f46d48a3">
                  <SHORT-NAME>Cdd_Pwm_SetDeadBandDelayMode</SHORT-NAME>
                  <REENTRANCY-LEVEL>NON-REENTRANT</REENTRANCY-LEVEL>
                  [!IF "as:modconf('Cdd_Pwm/Cdd')[as:path(node:dtos(.))='/TI_F29H85x/Cdd_Pwm/Cdd']/CddPwmGeneral/CddPwmDevErrorDetect = 'true'"!]
                  <CALL-POINTS>
                    <BSW-DIRECT-CALL-POINT>
                      <SHORT-NAME>Det</SHORT-NAME>
                      <CALLED-ENTRY-REF DEST="BSW-MODULE-ENTRY">/AUTOSAR_Det/Det/Det_ReportError</CALLED-ENTRY-REF>
                    </BSW-DIRECT-CALL-POINT>
                  </CALL-POINTS>
                  [!ENDIF!]
                  <IMPLEMENTED-ENTRY-REF DEST="BSW-MODULE-ENTRY">/Cdd_Pwm_TI_F29H85x/Cdd_Pwm_ModuleEntry/Cdd_Pwm_SetDeadBandDelayMode</IMPLEMENTED-ENTRY-REF>
                </BSW-CALLED-ENTITY>
                <BSW-CALLED-ENTITY UUID="06e9694f-dc3c-4f4f-a59a-84a24262a55b">
                  <SHORT-NAME>Cdd_Pwm_SetDeadBandDelayPolarity</SHORT-NAME>
                  <REENTRANCY-LEVEL>NON-REENTRANT</REENTRANCY-LEVEL>
                  [!IF "as:modconf('Cdd_Pwm/Cdd')[as:path(node:dtos(.))='/TI_F29H85x/Cdd_Pwm/Cdd']/CddPwmGeneral/CddPwmDevErrorDetect = 'true'"!]
                  <CALL-POINTS>
                    <BSW-DIRECT-CALL-POINT>
                      <SHORT-NAME>Det</SHORT-NAME>
                      <CALLED-ENTRY-REF DEST="BSW-MODULE-ENTRY">/AUTOSAR_Det/Det/Det_ReportError</CALLED-ENTRY-REF>
                    </BSW-DIRECT-CALL-POINT>
                  </CALL-POINTS>
                  [!ENDIF!]
                  <IMPLEMENTED-ENTRY-REF DEST="BSW-MODULE-ENTRY">/Cdd_Pwm_TI_F29H85x/Cdd_Pwm_ModuleEntry/Cdd_Pwm_SetDeadBandDelayPolarity</IMPLEMENTED-ENTRY-REF>
                </BSW-CALLED-ENTITY>
                <BSW-CALLED-ENTITY UUID="b526422b-e5f0-4b88-9f09-04288f93443f">
                  <SHORT-NAME>Cdd_Pwm_SetRisingEdgeDeadBandDelayInput</SHORT-NAME>
                  <REENTRANCY-LEVEL>NON-REENTRANT</REENTRANCY-LEVEL>
                  [!IF "as:modconf('Cdd_Pwm/Cdd')[as:path(node:dtos(.))='/TI_F29H85x/Cdd_Pwm/Cdd']/CddPwmGeneral/CddPwmDevErrorDetect = 'true'"!]
                  <CALL-POINTS>
                    <BSW-DIRECT-CALL-POINT>
                      <SHORT-NAME>Det</SHORT-NAME>
                      <CALLED-ENTRY-REF DEST="BSW-MODULE-ENTRY">/AUTOSAR_Det/Det/Det_ReportError</CALLED-ENTRY-REF>
                    </BSW-DIRECT-CALL-POINT>
                  </CALL-POINTS>
                  [!ENDIF!]
                  <IMPLEMENTED-ENTRY-REF DEST="BSW-MODULE-ENTRY">/Cdd_Pwm_TI_F29H85x/Cdd_Pwm_ModuleEntry/Cdd_Pwm_SetRisingEdgeDeadBandDelayInput</IMPLEMENTED-ENTRY-REF>
                </BSW-CALLED-ENTITY>
                <BSW-CALLED-ENTITY UUID="bebecb7e-3af9-4224-8cbf-6f18c0aec69c">
                  <SHORT-NAME>Cdd_Pwm_SetFallingEdgeDeadBandDelayInput</SHORT-NAME>
                  <REENTRANCY-LEVEL>NON-REENTRANT</REENTRANCY-LEVEL>
                  [!IF "as:modconf('Cdd_Pwm/Cdd')[as:path(node:dtos(.))='/TI_F29H85x/Cdd_Pwm/Cdd']/CddPwmGeneral/CddPwmDevErrorDetect = 'true'"!]
                  <CALL-POINTS>
                    <BSW-DIRECT-CALL-POINT>
                      <SHORT-NAME>Det</SHORT-NAME>
                      <CALLED-ENTRY-REF DEST="BSW-MODULE-ENTRY">/AUTOSAR_Det/Det/Det_ReportError</CALLED-ENTRY-REF>
                    </BSW-DIRECT-CALL-POINT>
                  </CALL-POINTS>
                  [!ENDIF!]
                  <IMPLEMENTED-ENTRY-REF DEST="BSW-MODULE-ENTRY">/Cdd_Pwm_TI_F29H85x/Cdd_Pwm_ModuleEntry/Cdd_Pwm_SetFallingEdgeDeadBandDelayInput</IMPLEMENTED-ENTRY-REF>
                </BSW-CALLED-ENTITY>
                <BSW-CALLED-ENTITY UUID="f908fd54-91c8-442b-aeba-39062a541dbc">
                  <SHORT-NAME>Cdd_Pwm_SetDeadBandControlShadowLoadMode</SHORT-NAME>
                  <REENTRANCY-LEVEL>NON-REENTRANT</REENTRANCY-LEVEL>
                  [!IF "as:modconf('Cdd_Pwm/Cdd')[as:path(node:dtos(.))='/TI_F29H85x/Cdd_Pwm/Cdd']/CddPwmGeneral/CddPwmDevErrorDetect = 'true'"!]
                  <CALL-POINTS>
                    <BSW-DIRECT-CALL-POINT>
                      <SHORT-NAME>Det</SHORT-NAME>
                      <CALLED-ENTRY-REF DEST="BSW-MODULE-ENTRY">/AUTOSAR_Det/Det/Det_ReportError</CALLED-ENTRY-REF>
                    </BSW-DIRECT-CALL-POINT>
                  </CALL-POINTS>
                  [!ENDIF!]
                  <IMPLEMENTED-ENTRY-REF DEST="BSW-MODULE-ENTRY">/Cdd_Pwm_TI_F29H85x/Cdd_Pwm_ModuleEntry/Cdd_Pwm_SetDeadBandControlShadowLoadMode</IMPLEMENTED-ENTRY-REF>
                </BSW-CALLED-ENTITY>
                <BSW-CALLED-ENTITY UUID="b35cac1a-9af2-4f1f-93c4-e13fc6c87e5b">
                  <SHORT-NAME>Cdd_Pwm_DisableDeadBandControlShadowLoadMode</SHORT-NAME>
                  <REENTRANCY-LEVEL>NON-REENTRANT</REENTRANCY-LEVEL>
                  [!IF "as:modconf('Cdd_Pwm/Cdd')[as:path(node:dtos(.))='/TI_F29H85x/Cdd_Pwm/Cdd']/CddPwmGeneral/CddPwmDevErrorDetect = 'true'"!]
                  <CALL-POINTS>
                    <BSW-DIRECT-CALL-POINT>
                      <SHORT-NAME>Det</SHORT-NAME>
                      <CALLED-ENTRY-REF DEST="BSW-MODULE-ENTRY">/AUTOSAR_Det/Det/Det_ReportError</CALLED-ENTRY-REF>
                    </BSW-DIRECT-CALL-POINT>
                  </CALL-POINTS>
                  [!ENDIF!]
                  <IMPLEMENTED-ENTRY-REF DEST="BSW-MODULE-ENTRY">/Cdd_Pwm_TI_F29H85x/Cdd_Pwm_ModuleEntry/Cdd_Pwm_DisableDeadBandControlShadowLoadMode</IMPLEMENTED-ENTRY-REF>
                </BSW-CALLED-ENTITY>
                <BSW-CALLED-ENTITY UUID="9b6bc1fc-47b9-4cef-9fdb-4d8a98daac8c">
                  <SHORT-NAME>Cdd_Pwm_SetRisingEdgeDelayCountShadowLoadMode</SHORT-NAME>
                  <REENTRANCY-LEVEL>NON-REENTRANT</REENTRANCY-LEVEL>
                  [!IF "as:modconf('Cdd_Pwm/Cdd')[as:path(node:dtos(.))='/TI_F29H85x/Cdd_Pwm/Cdd']/CddPwmGeneral/CddPwmDevErrorDetect = 'true'"!]
                  <CALL-POINTS>
                    <BSW-DIRECT-CALL-POINT>
                      <SHORT-NAME>Det</SHORT-NAME>
                      <CALLED-ENTRY-REF DEST="BSW-MODULE-ENTRY">/AUTOSAR_Det/Det/Det_ReportError</CALLED-ENTRY-REF>
                    </BSW-DIRECT-CALL-POINT>
                  </CALL-POINTS>
                  [!ENDIF!]
                  <IMPLEMENTED-ENTRY-REF DEST="BSW-MODULE-ENTRY">/Cdd_Pwm_TI_F29H85x/Cdd_Pwm_ModuleEntry/Cdd_Pwm_SetRisingEdgeDelayCountShadowLoadMode</IMPLEMENTED-ENTRY-REF>
                </BSW-CALLED-ENTITY>
                <BSW-CALLED-ENTITY UUID="e4ffe91a-5278-4468-ad55-d09e1ac832b5">
                  <SHORT-NAME>Cdd_Pwm_DisableRisingEdgeDelayCountShadowLoadMode</SHORT-NAME>
                  <REENTRANCY-LEVEL>NON-REENTRANT</REENTRANCY-LEVEL>
                  [!IF "as:modconf('Cdd_Pwm/Cdd')[as:path(node:dtos(.))='/TI_F29H85x/Cdd_Pwm/Cdd']/CddPwmGeneral/CddPwmDevErrorDetect = 'true'"!]
                  <CALL-POINTS>
                    <BSW-DIRECT-CALL-POINT>
                      <SHORT-NAME>Det</SHORT-NAME>
                      <CALLED-ENTRY-REF DEST="BSW-MODULE-ENTRY">/AUTOSAR_Det/Det/Det_ReportError</CALLED-ENTRY-REF>
                    </BSW-DIRECT-CALL-POINT>
                  </CALL-POINTS>
                  [!ENDIF!]
                  <IMPLEMENTED-ENTRY-REF DEST="BSW-MODULE-ENTRY">/Cdd_Pwm_TI_F29H85x/Cdd_Pwm_ModuleEntry/Cdd_Pwm_DisableRisingEdgeDelayCountShadowLoadMode</IMPLEMENTED-ENTRY-REF>
                </BSW-CALLED-ENTITY>
                <BSW-CALLED-ENTITY UUID="f19f687e-4956-4285-8cca-3074581d8bc7">
                  <SHORT-NAME>Cdd_Pwm_SetFallingEdgeDelayCountShadowLoadMode</SHORT-NAME>
                  <REENTRANCY-LEVEL>NON-REENTRANT</REENTRANCY-LEVEL>
                  [!IF "as:modconf('Cdd_Pwm/Cdd')[as:path(node:dtos(.))='/TI_F29H85x/Cdd_Pwm/Cdd']/CddPwmGeneral/CddPwmDevErrorDetect = 'true'"!]
                  <CALL-POINTS>
                    <BSW-DIRECT-CALL-POINT>
                      <SHORT-NAME>Det</SHORT-NAME>
                      <CALLED-ENTRY-REF DEST="BSW-MODULE-ENTRY">/AUTOSAR_Det/Det/Det_ReportError</CALLED-ENTRY-REF>
                    </BSW-DIRECT-CALL-POINT>
                  </CALL-POINTS>
                  [!ENDIF!]
                  <IMPLEMENTED-ENTRY-REF DEST="BSW-MODULE-ENTRY">/Cdd_Pwm_TI_F29H85x/Cdd_Pwm_ModuleEntry/Cdd_Pwm_SetFallingEdgeDelayCountShadowLoadMode</IMPLEMENTED-ENTRY-REF>
                </BSW-CALLED-ENTITY>
                <BSW-CALLED-ENTITY UUID="51270804-c458-4667-b05a-a07e59f38bba">
                  <SHORT-NAME>Cdd_Pwm_DisableFallingEdgeDelayCountShadowLoadMode</SHORT-NAME>
                  <REENTRANCY-LEVEL>NON-REENTRANT</REENTRANCY-LEVEL>
                  [!IF "as:modconf('Cdd_Pwm/Cdd')[as:path(node:dtos(.))='/TI_F29H85x/Cdd_Pwm/Cdd']/CddPwmGeneral/CddPwmDevErrorDetect = 'true'"!]
                  <CALL-POINTS>
                    <BSW-DIRECT-CALL-POINT>
                      <SHORT-NAME>Det</SHORT-NAME>
                      <CALLED-ENTRY-REF DEST="BSW-MODULE-ENTRY">/AUTOSAR_Det/Det/Det_ReportError</CALLED-ENTRY-REF>
                    </BSW-DIRECT-CALL-POINT>
                  </CALL-POINTS>
                  [!ENDIF!]
                  <IMPLEMENTED-ENTRY-REF DEST="BSW-MODULE-ENTRY">/Cdd_Pwm_TI_F29H85x/Cdd_Pwm_ModuleEntry/Cdd_Pwm_DisableFallingEdgeDelayCountShadowLoadMode</IMPLEMENTED-ENTRY-REF>
                </BSW-CALLED-ENTITY>
                <BSW-CALLED-ENTITY UUID="741fc729-3436-4ca9-a38e-85b4ea583395">
                  <SHORT-NAME>Cdd_Pwm_SetDeadBandCounterClock</SHORT-NAME>
                  <REENTRANCY-LEVEL>NON-REENTRANT</REENTRANCY-LEVEL>
                  [!IF "as:modconf('Cdd_Pwm/Cdd')[as:path(node:dtos(.))='/TI_F29H85x/Cdd_Pwm/Cdd']/CddPwmGeneral/CddPwmDevErrorDetect = 'true'"!]
                  <CALL-POINTS>
                    <BSW-DIRECT-CALL-POINT>
                      <SHORT-NAME>Det</SHORT-NAME>
                      <CALLED-ENTRY-REF DEST="BSW-MODULE-ENTRY">/AUTOSAR_Det/Det/Det_ReportError</CALLED-ENTRY-REF>
                    </BSW-DIRECT-CALL-POINT>
                  </CALL-POINTS>
                  [!ENDIF!]
                  <IMPLEMENTED-ENTRY-REF DEST="BSW-MODULE-ENTRY">/Cdd_Pwm_TI_F29H85x/Cdd_Pwm_ModuleEntry/Cdd_Pwm_SetDeadBandCounterClock</IMPLEMENTED-ENTRY-REF>
                </BSW-CALLED-ENTITY>
                <BSW-CALLED-ENTITY UUID="79f4ba4b-c5ba-465f-bd77-89fe3d6f8075">
                  <SHORT-NAME>Cdd_Pwm_SetRisingEdgeDelayCount</SHORT-NAME>
                  <REENTRANCY-LEVEL>NON-REENTRANT</REENTRANCY-LEVEL>
                  [!IF "as:modconf('Cdd_Pwm/Cdd')[as:path(node:dtos(.))='/TI_F29H85x/Cdd_Pwm/Cdd']/CddPwmGeneral/CddPwmDevErrorDetect = 'true'"!]
                  <CALL-POINTS>
                    <BSW-DIRECT-CALL-POINT>
                      <SHORT-NAME>Det</SHORT-NAME>
                      <CALLED-ENTRY-REF DEST="BSW-MODULE-ENTRY">/AUTOSAR_Det/Det/Det_ReportError</CALLED-ENTRY-REF>
                    </BSW-DIRECT-CALL-POINT>
                  </CALL-POINTS>
                  [!ENDIF!]
                  <IMPLEMENTED-ENTRY-REF DEST="BSW-MODULE-ENTRY">/Cdd_Pwm_TI_F29H85x/Cdd_Pwm_ModuleEntry/Cdd_Pwm_SetRisingEdgeDelayCount</IMPLEMENTED-ENTRY-REF>
                </BSW-CALLED-ENTITY>
                <BSW-CALLED-ENTITY UUID="d6e41a3b-6df4-4c59-9258-b9cce540c13e">
                  <SHORT-NAME>Cdd_Pwm_SetFallingEdgeDelayCount</SHORT-NAME>
                  <REENTRANCY-LEVEL>NON-REENTRANT</REENTRANCY-LEVEL>
                  [!IF "as:modconf('Cdd_Pwm/Cdd')[as:path(node:dtos(.))='/TI_F29H85x/Cdd_Pwm/Cdd']/CddPwmGeneral/CddPwmDevErrorDetect = 'true'"!]
                  <CALL-POINTS>
                    <BSW-DIRECT-CALL-POINT>
                      <SHORT-NAME>Det</SHORT-NAME>
                      <CALLED-ENTRY-REF DEST="BSW-MODULE-ENTRY">/AUTOSAR_Det/Det/Det_ReportError</CALLED-ENTRY-REF>
                    </BSW-DIRECT-CALL-POINT>
                  </CALL-POINTS>
                  [!ENDIF!]
                  <IMPLEMENTED-ENTRY-REF DEST="BSW-MODULE-ENTRY">/Cdd_Pwm_TI_F29H85x/Cdd_Pwm_ModuleEntry/Cdd_Pwm_SetFallingEdgeDelayCount</IMPLEMENTED-ENTRY-REF>
                </BSW-CALLED-ENTITY>
                <BSW-CALLED-ENTITY UUID="ead48a41-ed7e-4035-bbb1-fa1b4156d4d9">
                  <SHORT-NAME>Cdd_Pwm_ConfigureChopper</SHORT-NAME>
                  <REENTRANCY-LEVEL>NON-REENTRANT</REENTRANCY-LEVEL>
                  [!IF "as:modconf('Cdd_Pwm/Cdd')[as:path(node:dtos(.))='/TI_F29H85x/Cdd_Pwm/Cdd']/CddPwmGeneral/CddPwmDevErrorDetect = 'true'"!]
                  <CALL-POINTS>
                    <BSW-DIRECT-CALL-POINT>
                      <SHORT-NAME>Det</SHORT-NAME>
                      <CALLED-ENTRY-REF DEST="BSW-MODULE-ENTRY">/AUTOSAR_Det/Det/Det_ReportError</CALLED-ENTRY-REF>
                    </BSW-DIRECT-CALL-POINT>
                  </CALL-POINTS>
                  [!ENDIF!]
                  <IMPLEMENTED-ENTRY-REF DEST="BSW-MODULE-ENTRY">/Cdd_Pwm_TI_F29H85x/Cdd_Pwm_ModuleEntry/Cdd_Pwm_ConfigureChopper</IMPLEMENTED-ENTRY-REF>
                </BSW-CALLED-ENTITY>
                <BSW-CALLED-ENTITY UUID="907c183a-9d69-447d-8846-2da074ab9bbb">
                  <SHORT-NAME>Cdd_Pwm_SetChopperDutyCycle</SHORT-NAME>
                  <REENTRANCY-LEVEL>NON-REENTRANT</REENTRANCY-LEVEL>
                  [!IF "as:modconf('Cdd_Pwm/Cdd')[as:path(node:dtos(.))='/TI_F29H85x/Cdd_Pwm/Cdd']/CddPwmGeneral/CddPwmDevErrorDetect = 'true'"!]
                  <CALL-POINTS>
                    <BSW-DIRECT-CALL-POINT>
                      <SHORT-NAME>Det</SHORT-NAME>
                      <CALLED-ENTRY-REF DEST="BSW-MODULE-ENTRY">/AUTOSAR_Det/Det/Det_ReportError</CALLED-ENTRY-REF>
                    </BSW-DIRECT-CALL-POINT>
                  </CALL-POINTS>
                  [!ENDIF!]
                  <IMPLEMENTED-ENTRY-REF DEST="BSW-MODULE-ENTRY">/Cdd_Pwm_TI_F29H85x/Cdd_Pwm_ModuleEntry/Cdd_Pwm_SetChopperDutyCycle</IMPLEMENTED-ENTRY-REF>
                </BSW-CALLED-ENTITY>
                <BSW-CALLED-ENTITY UUID="da3252e9-4b6b-49a6-a79e-7113fd1d1953">
                  <SHORT-NAME>Cdd_Pwm_SetChopperFreq</SHORT-NAME>
                  <REENTRANCY-LEVEL>NON-REENTRANT</REENTRANCY-LEVEL>
                  [!IF "as:modconf('Cdd_Pwm/Cdd')[as:path(node:dtos(.))='/TI_F29H85x/Cdd_Pwm/Cdd']/CddPwmGeneral/CddPwmDevErrorDetect = 'true'"!]
                  <CALL-POINTS>
                    <BSW-DIRECT-CALL-POINT>
                      <SHORT-NAME>Det</SHORT-NAME>
                      <CALLED-ENTRY-REF DEST="BSW-MODULE-ENTRY">/AUTOSAR_Det/Det/Det_ReportError</CALLED-ENTRY-REF>
                    </BSW-DIRECT-CALL-POINT>
                  </CALL-POINTS>
                  [!ENDIF!]
                  <IMPLEMENTED-ENTRY-REF DEST="BSW-MODULE-ENTRY">/Cdd_Pwm_TI_F29H85x/Cdd_Pwm_ModuleEntry/Cdd_Pwm_SetChopperFreq</IMPLEMENTED-ENTRY-REF>
                </BSW-CALLED-ENTITY>
                <BSW-CALLED-ENTITY UUID="e70fa917-2c98-4714-b26a-58b58cb8d933">
                  <SHORT-NAME>Cdd_Pwm_SetChopperFirstPulseWidth</SHORT-NAME>
                  <REENTRANCY-LEVEL>NON-REENTRANT</REENTRANCY-LEVEL>
                  [!IF "as:modconf('Cdd_Pwm/Cdd')[as:path(node:dtos(.))='/TI_F29H85x/Cdd_Pwm/Cdd']/CddPwmGeneral/CddPwmDevErrorDetect = 'true'"!]
                  <CALL-POINTS>
                    <BSW-DIRECT-CALL-POINT>
                      <SHORT-NAME>Det</SHORT-NAME>
                      <CALLED-ENTRY-REF DEST="BSW-MODULE-ENTRY">/AUTOSAR_Det/Det/Det_ReportError</CALLED-ENTRY-REF>
                    </BSW-DIRECT-CALL-POINT>
                  </CALL-POINTS>
                  [!ENDIF!]
                  <IMPLEMENTED-ENTRY-REF DEST="BSW-MODULE-ENTRY">/Cdd_Pwm_TI_F29H85x/Cdd_Pwm_ModuleEntry/Cdd_Pwm_SetChopperFirstPulseWidth</IMPLEMENTED-ENTRY-REF>
                </BSW-CALLED-ENTITY>
                <BSW-CALLED-ENTITY UUID="9e3b198a-0e78-4c34-a207-4b6773e1c862">
                  <SHORT-NAME>Cdd_Pwm_ConfigureTripZoneSignals</SHORT-NAME>
                  <REENTRANCY-LEVEL>NON-REENTRANT</REENTRANCY-LEVEL>
                  [!IF "as:modconf('Cdd_Pwm/Cdd')[as:path(node:dtos(.))='/TI_F29H85x/Cdd_Pwm/Cdd']/CddPwmGeneral/CddPwmDevErrorDetect = 'true'"!]
                  <CALL-POINTS>
                    <BSW-DIRECT-CALL-POINT>
                      <SHORT-NAME>Det</SHORT-NAME>
                      <CALLED-ENTRY-REF DEST="BSW-MODULE-ENTRY">/AUTOSAR_Det/Det/Det_ReportError</CALLED-ENTRY-REF>
                    </BSW-DIRECT-CALL-POINT>
                  </CALL-POINTS>
                  [!ENDIF!]
                  <IMPLEMENTED-ENTRY-REF DEST="BSW-MODULE-ENTRY">/Cdd_Pwm_TI_F29H85x/Cdd_Pwm_ModuleEntry/Cdd_Pwm_ConfigureTripZoneSignals</IMPLEMENTED-ENTRY-REF>
                </BSW-CALLED-ENTITY>
                <BSW-CALLED-ENTITY UUID="35cf2c9f-834d-4d2e-b1c8-39845a5bbbc0">
                  <SHORT-NAME>Cdd_Pwm_SetTripZoneDigitalCompareEventCondition</SHORT-NAME>
                  <REENTRANCY-LEVEL>NON-REENTRANT</REENTRANCY-LEVEL>
                  [!IF "as:modconf('Cdd_Pwm/Cdd')[as:path(node:dtos(.))='/TI_F29H85x/Cdd_Pwm/Cdd']/CddPwmGeneral/CddPwmDevErrorDetect = 'true'"!]
                  <CALL-POINTS>
                    <BSW-DIRECT-CALL-POINT>
                      <SHORT-NAME>Det</SHORT-NAME>
                      <CALLED-ENTRY-REF DEST="BSW-MODULE-ENTRY">/AUTOSAR_Det/Det/Det_ReportError</CALLED-ENTRY-REF>
                    </BSW-DIRECT-CALL-POINT>
                  </CALL-POINTS>
                  [!ENDIF!]
                  <IMPLEMENTED-ENTRY-REF DEST="BSW-MODULE-ENTRY">/Cdd_Pwm_TI_F29H85x/Cdd_Pwm_ModuleEntry/Cdd_Pwm_SetTripZoneDigitalCompareEventCondition</IMPLEMENTED-ENTRY-REF>
                </BSW-CALLED-ENTITY>
                <BSW-CALLED-ENTITY UUID="f2c86bff-7ab3-4499-8d56-44a258d45e7d">
                  <SHORT-NAME>Cdd_Pwm_ConfigureTripZoneAdvAction</SHORT-NAME>
                  <REENTRANCY-LEVEL>NON-REENTRANT</REENTRANCY-LEVEL>
                  [!IF "as:modconf('Cdd_Pwm/Cdd')[as:path(node:dtos(.))='/TI_F29H85x/Cdd_Pwm/Cdd']/CddPwmGeneral/CddPwmDevErrorDetect = 'true'"!]
                  <CALL-POINTS>
                    <BSW-DIRECT-CALL-POINT>
                      <SHORT-NAME>Det</SHORT-NAME>
                      <CALLED-ENTRY-REF DEST="BSW-MODULE-ENTRY">/AUTOSAR_Det/Det/Det_ReportError</CALLED-ENTRY-REF>
                    </BSW-DIRECT-CALL-POINT>
                  </CALL-POINTS>
                  [!ENDIF!]
                  <IMPLEMENTED-ENTRY-REF DEST="BSW-MODULE-ENTRY">/Cdd_Pwm_TI_F29H85x/Cdd_Pwm_ModuleEntry/Cdd_Pwm_ConfigureTripZoneAdvAction</IMPLEMENTED-ENTRY-REF>
                </BSW-CALLED-ENTITY>
                <BSW-CALLED-ENTITY UUID="f31bb017-e327-4644-8faf-979cf4544ecc">
                  <SHORT-NAME>Cdd_Pwm_SetTripZoneAction</SHORT-NAME>
                  <REENTRANCY-LEVEL>NON-REENTRANT</REENTRANCY-LEVEL>
                  [!IF "as:modconf('Cdd_Pwm/Cdd')[as:path(node:dtos(.))='/TI_F29H85x/Cdd_Pwm/Cdd']/CddPwmGeneral/CddPwmDevErrorDetect = 'true'"!]
                  <CALL-POINTS>
                    <BSW-DIRECT-CALL-POINT>
                      <SHORT-NAME>Det</SHORT-NAME>
                      <CALLED-ENTRY-REF DEST="BSW-MODULE-ENTRY">/AUTOSAR_Det/Det/Det_ReportError</CALLED-ENTRY-REF>
                    </BSW-DIRECT-CALL-POINT>
                  </CALL-POINTS>
                  [!ENDIF!]
                  <IMPLEMENTED-ENTRY-REF DEST="BSW-MODULE-ENTRY">/Cdd_Pwm_TI_F29H85x/Cdd_Pwm_ModuleEntry/Cdd_Pwm_SetTripZoneAction</IMPLEMENTED-ENTRY-REF>
                </BSW-CALLED-ENTITY>
