AUTOSAR XML (schema 00044)
package /TI_F29H85x/Cdd_Pwm
  ecuc definition collection ecuParameterDefinition: module=Cdd
  module definition Cdd: api-service-prefix=Cdd_Pwm, refined-module-def=Cdd, variants pre-compile  # Configuration of Pwm (Pulse Width Modulation) module.
    container CddPwmConfigSet  # This container contains the configuration parameters and sub containers of the AUTOSAR Pwm instance.
      boolean CddPwmAdvancedMode: origin=Texas Instruments, set at pre-compile, default-value=false  # Enables/disables the advanced mode for the PWM driver.
      container CddPwmHwUnitConfig [1..18]: multiplicity set at pre-compile  # Configuration of an individual PWM instance.
        string CddPwmInstance: origin=Texas Instruments, set at pre-compile, default-value=1  # Pwm hardware instance.
        string CddPwmHwId: origin=Texas Instruments, set at pre-compile, symbolic-name-value=true, default-value=0  # Symbolic ID of the PWM instance.
        enumeration CddPwmEmulationMode [0..1]: {CDD_PWM_EMULATION_STOP_AFTER_NEXT_TB, CDD_PWM_EMULATION_STOP_AFTER_FULL_CYCLE, CDD_PWM_EMULATION_FREE_RUN}, multiplicity set at pre-compile, origin=Texas Instruments, set at pre-compile, default-value=CDD_PWM_EMULATION_STOP_AFTER_NEXT_TB  # Emulation mode for the EPWM instance.
        enumeration CddPwmClockDivider: {CDD_PWM_CLOCK_DIVIDER_1, CDD_PWM_CLOCK_DIVIDER_2, CDD_PWM_CLOCK_DIVIDER_4, CDD_PWM_CLOCK_DIVIDER_8, CDD_PWM_CLOCK_DIVIDER_16, CDD_PWM_CLOCK_DIVIDER_32, CDD_PWM_CLOCK_DIVIDER_64, CDD_PWM_CLOCK_DIVIDER_128}, origin=Texas Instruments, set at pre-compile, default-value=CDD_PWM_CLOCK_DIVIDER_1  # Time base clock pre-scale value.
        enumeration CddPwmHighSpeedClockDivider: {CDD_PWM_HSCLOCK_DIVIDER_1, CDD_PWM_HSCLOCK_DIVIDER_2, CDD_PWM_HSCLOCK_DIVIDER_4, CDD_PWM_HSCLOCK_DIVIDER_6, CDD_PWM_HSCLOCK_DIVIDER_8, CDD_PWM_HSCLOCK_DIVIDER_10, CDD_PWM_HSCLOCK_DIVIDER_12, CDD_PWM_HSCLOCK_DIVIDER_14}, origin=Texas Instruments, set at pre-compile, default-value=CDD_PWM_HSCLOCK_DIVIDER_1  # High speed clock divider for the PWM instance.
        float CddPwmFrequency: 55803.0..2.0E8, origin=Texas Instruments, set at pre-compile, default-value=1.0E8  # This parameter defines the frequency of the PWM instance.
        boolean CddPwmInterruptEnable: origin=Texas Instruments, set at pre-compile, default-value=true  # Enables/disables the interrupt for the PWM instance.
        enumeration CddPwmInterruptCategory: {ISR_CAT1_INT, ISR_CAT1_RTINT, ISR_CAT2_INT}, origin=Texas Instruments, set at pre-compile, default-value=ISR_CAT1_RTINT  # This parameters defines the category of the interrupt.
        function name CddPwmInterruptNotification [0..1]: multiplicity set at pre-compile, origin=Texas Instruments, set at pre-compile, default-value=NULL_PTR  # Definition of the callback function.
        boolean CddPwmTripZoneInterruptEnable [0..1]: multiplicity set at pre-compile, origin=Texas Instruments, set at pre-compile, default-value=false  # Enables/disables the trip zone interrupt for the PWM instance.
        enumeration CddPwmTripZoneInterruptCategory [0..1]: {ISR_CAT1_INT, ISR_CAT1_RTINT, ISR_CAT2_INT}, multiplicity set at pre-compile, origin=Texas Instruments, set at pre-compile, default-value=ISR_CAT1_RTINT  # This parameters defines the category of the interrupt.
        function name CddPwmTripZoneNotification [0..1]: multiplicity set at pre-compile, origin=Texas Instruments, set at pre-compile, default-value=NULL_PTR  # Definition of the trip zone's callback function.
        enumeration CddPwmOutputClass [0..1]: {CDD_PWM_FIXED_PERIOD, CDD_PWM_VARIABLE_PERIOD}, multiplicity set at pre-compile, origin=Texas Instruments, set at pre-compile, default-value=CDD_PWM_VARIABLE_PERIOD  # Class of PWM Channel.
        integer CddPwmDefaultPeriod [0..1]: 0..65535, multiplicity set at pre-compile, origin=Texas Instruments, set at pre-compile, default-value=0  # Value of period used for Initialization. This value will be written into the TBPRD register
        enumeration CddPwmSymmetry [0..1]: {CDD_PWM_ASYMMETRIC_WAVEFORM, CDD_PWM_SYMMETRIC_WAVEFORM}, multiplicity set at pre-compile, origin=Texas Instruments, set at pre-compile, default-value=CDD_PWM_ASYMMETRIC_WAVEFORM  # This parameter defines the symmetry of the generated waveform.
        reference CddPwmInstanceRef: origin=Texas Instruments, set at pre-compile, destination=Cdd_PwmAllocatedInstance  # Reference to the PWM instance.
        reference CddPwmMcuClockReferencePoint: scope=ECU, origin=Texas Instruments, set at pre-compile, destination=McuClockReferencePoint  # This parameter contains reference to the McuClockReferencePoint
        container CddPwmOutputChannel [1..2]: multiplicity set at pre-compile  # Configuration of output channel A or B.
          enumeration CddPwmChannel: {CDD_PWM_OUTPUT_A, CDD_PWM_OUTPUT_B}, origin=Texas Instruments, set at pre-compile, default-value=CDD_PWM_OUTPUT_A  # Defines the output channel for the PWM instance.
          enumeration CddPwmPolarity [0..1]: {CDD_PWM_HIGH, CDD_PWM_LOW}, multiplicity set at pre-compile, origin=Texas Instruments, set at pre-compile, default-value=CDD_PWM_LOW  # Defines the starting polarity of the PWM channel.
          enumeration CddPwmIdleState: {CDD_PWM_HIGH, CDD_PWM_LOW}, origin=Texas Instruments, set at pre-compile, default-value=CDD_PWM_LOW  # The parameter PWM_IDLE_STATE represents the output state of the channel after the signal is stopped (e.g.call of Pwm_SetOutputToIdle).
          integer CddPwmDefaultDutyCycle [0..1]: 0..32768, multiplicity set at pre-compile, origin=Texas Instruments, set at pre-compile, default-value=16384  # Value of duty cycle used for Initialization
          float CddPwmDefaultDutyCycleInPercentage [0..1]: 0.0..100.0, multiplicity set at pre-compile, origin=Texas Instruments, set at pre-compile, default-value=50.0  # This parameter defines the configured duty cycle in percentage.
      container CddPwmXlinkConfig [0..1]: multiplicity set at pre-compile  # Xlink configuration for a frame.
        string CddPwmXlinkId: origin=Texas Instruments, set at pre-compile, symbolic-name-value=true, default-value=0  # Xlink symbolic ID.
        reference CddPwmXlinkInstanceRef: origin=Texas Instruments, set at pre-compile, destination=Cdd_PwmAllocatedInstance  # Reference to the xlink instance.
        container CddPwmLinkHwUnit [1..18]: multiplicity set at pre-compile  # Xlink configuration for a frame.
          reference CddPwmHwUnit: origin=Texas Instruments, set at pre-compile, destination=CddPwmHwUnitConfig  # Link Pwm hardware instance to enable XLINK for the instance.
      container CddPwmHrpwmCalibrationConfig [0..3]: multiplicity set at pre-compile  # Hrpwm calibration instance configuration for a frame.
        container CddPwmHrpwmCalConfig [1..3]: multiplicity set at pre-compile  # Hrpwm calibration instance configuration for a frame.
          string CddPwmHrpwmCalInstanceId: origin=Texas Instruments, set at pre-compile, symbolic-name-value=true, default-value=0  # Hrpwm Calibration symbolic ID.
          reference CddPwmHrpwmCalInstanceRef: origin=Texas Instruments, set at pre-compile, destination=CddPwmHrpwmCalInstance  # Reference to the hrpwm calibration instance.
    container CddPwmGeneral  # General configuration (parameters) of the PWM Driver software module.
      boolean CddPwmDevErrorDetect: origin=Texas Instruments, set at pre-compile, default-value=false  # Switches the development error detection on or off.
      boolean CddPwmDeInitApi [0..1]: multiplicity set at pre-compile, origin=Texas Instruments, set at pre-compile, default-value=false  # Adds / removes the service Cdd_Pwm_DeInit() from the code.
      boolean CddPwmNotificationSupported: origin=Texas Instruments, set at pre-compile, default-value=true  # Switch to indicate that the notifications are supported
      boolean CddPwmVersionInfoApi: origin=Texas Instruments, set at pre-compile, default-value=false  # Switch to indicate that the Pwm_ GetVersionInfo is supported
      boolean CddPwmSetDutyCycle [0..1]: multiplicity set at pre-compile, origin=Texas Instruments, set at pre-compile, default-value=false  # Adds / removes the service Cdd_Pwm_SetDutyCycle() from the code.
      boolean CddPwmSetOutputToIdle [0..1]: multiplicity set at pre-compile, origin=Texas Instruments, set at pre-compile, default-value=false  # Adds / removes the service Cdd_Pwm_SetOutputToIdle() from the code.
      boolean CddPwmSetPeriod [0..1]: multiplicity set at pre-compile, origin=Texas Instruments, set at pre-compile, default-value=false  # Adds / removes the service Cdd_Pwm_SetPeriod() from the code.
