AUTOSAR XML (schema 00044)
package /TI_F29H85x/Cdd_Pwm
  ecuc definition collection ecuParameterDefinition: module=Cdd
  module definition Cdd: api-service-prefix=Cdd_Pwm, refined-module-def=Cdd, variants pre-compile  # Configuration of Pwm (Pulse Width Modulation) module.
    container CddPwmConfigSet  # This container contains the configuration parameters and sub containers of the AUTOSAR Pwm instance.
      container CddPwmHwUnitConfig [1..18]  # Configuration of an individual PWM instance.
        integer CddPwmInstanceId: 1..1, origin=Texas Instruments, set at pre-compile, default-value=1  # Pwm hardware instance.
        enumeration CddPwmOutputClass: {CDD_PWM_FIXED_PERIOD, CDD_PWM_VARIABLE_PERIOD}, origin=Texas Instruments, set at pre-compile, default-value=CDD_PWM_VARIABLE_PERIOD  # Class of PWM Channel.
        enumeration CddPwmClockDivider: {CDD_PWM_CLK_DIVIDER_1}, origin=Texas Instruments, set at pre-compile, default-value=CDD_PWM_CLK_DIVIDER_1  # Time base clock pre-scale value.
        enumeration CddPwmHighSpeedClockDivider: {CDD_PWM_HSCLK_DIVIDER_1}, origin=Texas Instruments, set at pre-compile, default-value=CDD_PWM_HSCLK_DIVIDER_1  # High speed clock divider for the PWM instance.
        float CddPwmFrequency: origin=Texas Instruments, set at pre-compile, default-value=1.0E8  # This parameter defines the frequency of the PWM instance.
        integer CddPwmPeriod: 0..65535, origin=Texas Instruments, set at pre-compile, default-value=0  # Value of period used for Initialization. This value will be written into the TBPRD register
        boolean CddPwmInterruptEnable: origin=Texas Instruments, set at pre-compile, default-value=false  # Enables/disables the interrupt for the PWM instance.
        enumeration CddPwmInterruptCategory: {ISR_CAT1_INT, ISR_CAT1_RTINT, ISR_CAT2_INT}, origin=Texas Instruments, set at pre-compile, default-value=ISR_CAT1_RTINT  # This parameters defines the category of the interrupt.
        enumeration CddPwmSymmetry: {CDD_PWM_ASYMMETRIC_WAVEFORM, CDD_PWM_SYMMETRIC_WAVEFORM}, origin=Texas Instruments, set at pre-compile, default-value=CDD_PWM_ASYMMETRIC_WAVEFORM  # This parameter defines the symmetry of the generated waveform.
        function name CddPwmNotification [0..1]: multiplicity set at pre-compile, origin=Texas Instruments, set at pre-compile, default-value=NULL_PTR  # Definition of the Callback function.
        reference CddPwmMcuClockReferencePoint: scope=ECU, origin=Texas Instruments, set at pre-compile, destination=McuClockReferencePoint  # This parameter contains reference to the McuClockReferencePoint
        container CddPwmOutputChannel [1..2]  # Configuration of output channel A.
          enumeration CddPwmChannel: {CDD_PWM_OUTPUT_A, CDD_PWM_OUTPUT_B}, origin=Texas Instruments, set at pre-compile, default-value=CDD_PWM_OUTPUT_A  # Defines the output channel for the PWM instance.
          enumeration CddPwmPolarity: {CDD_PWM_HIGH, CDD_PWM_LOW}, origin=Texas Instruments, set at pre-compile, default-value=CDD_PWM_LOW  # Defines the starting polarity of the PWM channel.
          enumeration CddPwmIdleState: {CDD_PWM_HIGH, CDD_PWM_LOW}, origin=Texas Instruments, set at pre-compile, default-value=CDD_PWM_LOW  # The parameter PWM_IDLE_STATE represents the output state of the channel after the signal is stopped (e.g.call of Pwm_SetOutputToIdle).
          integer CddPwmDutyCycle: 0..32768, origin=Texas Instruments, set at pre-compile, default-value=16384  # Value of duty cycle used for Initialization
          float CddPwmDutyCycleInPercentage: origin=Texas Instruments, set at pre-compile, default-value=50.0  # This parameter defines the configured duty cycle in percentage.
    container CddPwmGeneral  # General configuration (parameters) of the PWM Driver software module.
      boolean CddPwmDevErrorDetect: origin=Texas Instruments, set at pre-compile, default-value=false  # Switches the development error detection on or off.
      boolean CddPwmDeInitApi: origin=Texas Instruments, set at pre-compile, default-value=true  # Adds / removes the service Cdd_Pwm_DeInit() from the code.
      boolean CddPwmSetDutyCycle: origin=Texas Instruments, set at pre-compile, default-value=true  # Adds / removes the service Cdd_Pwm_SetDutyCycle() from the code.
      boolean CddPwmSetOutputToIdle: origin=Texas Instruments, set at pre-compile, default-value=true  # Adds / removes the service Cdd_Pwm_SetOutputToIdle() from the code.
      boolean CddPwmSetPeriod: origin=Texas Instruments, set at pre-compile, default-value=true  # Adds / removes the service Cdd_Pwm_SetPeriod() from the code.
      boolean CddPwmVersionInfoApi: origin=Texas Instruments, set at pre-compile, default-value=false  # Switch to indicate that the Pwm_ GetVersionInfo is supported
      boolean CddPwmNotificationSupported: origin=Texas Instruments, set at pre-compile, default-value=true  # Switch to indicate that the notifications are supported
