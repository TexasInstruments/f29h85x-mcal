[!AUTOSPACING!][!//
<?xml version="1.0" encoding="UTF-8"?>
[!SELECT "as:modconf('Cdd_Ipc/Cdd')[as:path(node:dtos(.))='/TI_F29H85x/Cdd_Ipc/Cdd']"!]
<AUTOSAR xmlns="http://autosar.org/schema/r4.0" xmlns:xsi="http://www.w3.org/2001/XMLSchema-instance" xsi:schemaLocation="http://autosar.org/schema/r4.0 AUTOSAR_00044.xsd">
[!VAR "Cdd_Ipc_CPU1_L_CPU2_R_INST0_ISR_cat"="1"!]
[!VAR "Cdd_Ipc_CPU1_L_CPU2_R_INST1_ISR_cat"="1"!]
[!VAR "Cdd_Ipc_CPU1_L_CPU2_R_INST2_ISR_cat"="1"!]
[!VAR "Cdd_Ipc_CPU1_L_CPU2_R_INST3_ISR_cat"="1"!]
[!VAR "Cdd_Ipc_CPU1_L_CPU3_R_INST0_ISR_cat"="1"!]
[!VAR "Cdd_Ipc_CPU1_L_CPU3_R_INST1_ISR_cat"="1"!]
[!VAR "Cdd_Ipc_CPU1_L_CPU3_R_INST2_ISR_cat"="1"!]
[!VAR "Cdd_Ipc_CPU1_L_CPU3_R_INST3_ISR_cat"="1"!]
[!VAR "Cdd_Ipc_CPU2_L_CPU1_R_INST0_ISR_cat"="1"!]
[!VAR "Cdd_Ipc_CPU2_L_CPU1_R_INST1_ISR_cat"="1"!]
[!VAR "Cdd_Ipc_CPU2_L_CPU1_R_INST2_ISR_cat"="1"!]
[!VAR "Cdd_Ipc_CPU2_L_CPU1_R_INST3_ISR_cat"="1"!]
[!VAR "Cdd_Ipc_CPU2_L_CPU3_R_INST0_ISR_cat"="1"!]
[!VAR "Cdd_Ipc_CPU2_L_CPU3_R_INST1_ISR_cat"="1"!]
[!VAR "Cdd_Ipc_CPU2_L_CPU3_R_INST2_ISR_cat"="1"!]
[!VAR "Cdd_Ipc_CPU2_L_CPU3_R_INST3_ISR_cat"="1"!]
[!VAR "Cdd_Ipc_CPU3_L_CPU1_R_INST0_ISR_cat"="1"!]
[!VAR "Cdd_Ipc_CPU3_L_CPU1_R_INST1_ISR_cat"="1"!]
[!VAR "Cdd_Ipc_CPU3_L_CPU1_R_INST2_ISR_cat"="1"!]
[!VAR "Cdd_Ipc_CPU3_L_CPU1_R_INST3_ISR_cat"="1"!]
[!VAR "Cdd_Ipc_CPU3_L_CPU2_R_INST0_ISR_cat"="1"!]
[!VAR "Cdd_Ipc_CPU3_L_CPU2_R_INST1_ISR_cat"="1"!]
[!VAR "Cdd_Ipc_CPU3_L_CPU2_R_INST2_ISR_cat"="1"!]
[!VAR "Cdd_Ipc_CPU3_L_CPU2_R_INST3_ISR_cat"="1"!]
[!LOOP "CddIpcConfig/CddIpcRemoteCoreConfig/*/CddIpcRxInstanceConfig/*"!]
[!IF "node:value(CddIpcRxInstance) = 'CDD_IPC_CPU1_L_CPU2_R_INST0'"!]
[!IF "node:value(CddIpcInteruptType) = 'ISR_CAT2_INT'"!]
[!VAR "Cdd_Ipc_CPU1_L_CPU2_R_INST0_ISR_cat" = "$Cdd_Ipc_CPU1_L_CPU2_R_INST0_ISR_cat + 1"!]
[!ENDIF!]
[!ELSEIF "node:value(CddIpcRxInstance) = 'CDD_IPC_CPU1_L_CPU2_R_INST1'"!]
[!IF "node:value(CddIpcInteruptType) = 'ISR_CAT2_INT'"!]
[!VAR "Cdd_Ipc_CPU1_L_CPU2_R_INST1_ISR_cat" = "$Cdd_Ipc_CPU1_L_CPU2_R_INST1_ISR_cat + 1"!]
[!ENDIF!]
[!ELSEIF "node:value(CddIpcRxInstance) = 'CDD_IPC_CPU1_L_CPU2_R_INST2'"!]
[!IF "node:value(CddIpcInteruptType) = 'ISR_CAT2_INT'"!]
[!VAR "Cdd_Ipc_CPU1_L_CPU2_R_INST2_ISR_cat" = "$Cdd_Ipc_CPU1_L_CPU2_R_INST2_ISR_cat + 1"!]
[!ENDIF!]
[!ELSEIF "node:value(CddIpcRxInstance) = 'CDD_IPC_CPU1_L_CPU2_R_INST3'"!]
[!IF "node:value(CddIpcInteruptType) = 'ISR_CAT2_INT'"!]
[!VAR "Cdd_Ipc_CPU1_L_CPU2_R_INST3_ISR_cat" = "$Cdd_Ipc_CPU1_L_CPU2_R_INST3_ISR_cat + 1"!]
[!ENDIF!]
[!ELSEIF "node:value(CddIpcRxInstance) = 'CDD_IPC_CPU1_L_CPU3_R_INST0'"!]
[!IF "node:value(CddIpcInteruptType) = 'ISR_CAT2_INT'"!]
[!VAR "Cdd_Ipc_CPU1_L_CPU3_R_INST0_ISR_cat" = "$Cdd_Ipc_CPU1_L_CPU3_R_INST0_ISR_cat + 1"!]
[!ENDIF!]
[!ELSEIF "node:value(CddIpcRxInstance) = 'CDD_IPC_CPU1_L_CPU3_R_INST1'"!]
[!IF "node:value(CddIpcInteruptType) = 'ISR_CAT2_INT'"!]
[!VAR "Cdd_Ipc_CPU1_L_CPU3_R_INST1_ISR_cat" = "$Cdd_Ipc_CPU1_L_CPU3_R_INST1_ISR_cat + 1"!]
[!ENDIF!]
[!ELSEIF "node:value(CddIpcRxInstance) = 'CDD_IPC_CPU1_L_CPU3_R_INST2'"!]
[!IF "node:value(CddIpcInteruptType) = 'ISR_CAT2_INT'"!]
[!VAR "Cdd_Ipc_CPU1_L_CPU3_R_INST2_ISR_cat" = "$Cdd_Ipc_CPU1_L_CPU3_R_INST2_ISR_cat + 1"!]
[!ENDIF!]
[!ELSEIF "node:value(CddIpcRxInstance) = 'CDD_IPC_CPU1_L_CPU3_R_INST3'"!]
[!IF "node:value(CddIpcInteruptType) = 'ISR_CAT2_INT'"!]
[!VAR "Cdd_Ipc_CPU1_L_CPU3_R_INST3_ISR_cat" = "$Cdd_Ipc_CPU1_L_CPU3_R_INST3_ISR_cat + 1"!]
[!ENDIF!]
[!ELSEIF "node:value(CddIpcRxInstance) = 'CDD_IPC_CPU2_L_CPU1_R_INST0'"!]
[!IF "node:value(CddIpcInteruptType) = 'ISR_CAT2_INT'"!]
[!VAR "Cdd_Ipc_CPU2_L_CPU1_R_INST0_ISR_cat" = "$Cdd_Ipc_CPU2_L_CPU1_R_INST0_ISR_cat + 1"!]
[!ENDIF!]
[!ELSEIF "node:value(CddIpcRxInstance) = 'CDD_IPC_CPU2_L_CPU1_R_INST1'"!]
[!IF "node:value(CddIpcInteruptType) = 'ISR_CAT2_INT'"!]
[!VAR "Cdd_Ipc_CPU2_L_CPU1_R_INST1_ISR_cat" = "$Cdd_Ipc_CPU2_L_CPU1_R_INST1_ISR_cat + 1"!]
[!ENDIF!]
[!ELSEIF "node:value(CddIpcRxInstance) = 'CDD_IPC_CPU2_L_CPU1_R_INST2'"!]
[!IF "node:value(CddIpcInteruptType) = 'ISR_CAT2_INT'"!]
[!VAR "Cdd_Ipc_CPU2_L_CPU1_R_INST2_ISR_cat" = "$Cdd_Ipc_CPU2_L_CPU1_R_INST2_ISR_cat + 1"!]
[!ENDIF!]
[!ELSEIF "node:value(CddIpcRxInstance) = 'CDD_IPC_CPU2_L_CPU1_R_INST3'"!]
[!IF "node:value(CddIpcInteruptType) = 'ISR_CAT2_INT'"!]
[!VAR "Cdd_Ipc_CPU2_L_CPU1_R_INST3_ISR_cat" = "$Cdd_Ipc_CPU2_L_CPU1_R_INST3_ISR_cat + 1"!]
[!ENDIF!]
[!ELSEIF "node:value(CddIpcRxInstance) = 'CDD_IPC_CPU2_L_CPU3_R_INST0'"!]
[!IF "node:value(CddIpcInteruptType) = 'ISR_CAT2_INT'"!]
[!VAR "Cdd_Ipc_CPU2_L_CPU3_R_INST0_ISR_cat" = "$Cdd_Ipc_CPU2_L_CPU3_R_INST0_ISR_cat + 1"!]
[!ENDIF!]
[!ELSEIF "node:value(CddIpcRxInstance) = 'CDD_IPC_CPU2_L_CPU3_R_INST1'"!]
[!IF "node:value(CddIpcInteruptType) = 'ISR_CAT2_INT'"!]
[!VAR "Cdd_Ipc_CPU2_L_CPU3_R_INST1_ISR_cat" = "$Cdd_Ipc_CPU2_L_CPU3_R_INST1_ISR_cat + 1"!]
[!ENDIF!]
[!ELSEIF "node:value(CddIpcRxInstance) = 'CDD_IPC_CPU2_L_CPU3_R_INST2'"!]
[!IF "node:value(CddIpcInteruptType) = 'ISR_CAT2_INT'"!]
[!VAR "Cdd_Ipc_CPU2_L_CPU3_R_INST2_ISR_cat" = "$Cdd_Ipc_CPU2_L_CPU3_R_INST2_ISR_cat + 1"!]
[!ENDIF!]
[!ELSEIF "node:value(CddIpcRxInstance) = 'CDD_IPC_CPU2_L_CPU3_R_INST3'"!]
[!IF "node:value(CddIpcInteruptType) = 'ISR_CAT2_INT'"!]
[!VAR "Cdd_Ipc_CPU2_L_CPU3_R_INST3_ISR_cat" = "$Cdd_Ipc_CPU2_L_CPU3_R_INST3_ISR_cat + 1"!]
[!ENDIF!]
[!ELSEIF "node:value(CddIpcRxInstance) = 'CDD_IPC_CPU3_L_CPU1_R_INST0'"!]
[!IF "node:value(CddIpcInteruptType) = 'ISR_CAT2_INT'"!]
[!VAR "Cdd_Ipc_CPU3_L_CPU1_R_INST0_ISR_cat" = "$Cdd_Ipc_CPU3_L_CPU1_R_INST0_ISR_cat + 1"!]
[!ENDIF!]
[!ELSEIF "node:value(CddIpcRxInstance) = 'CDD_IPC_CPU3_L_CPU1_R_INST1'"!]
[!IF "node:value(CddIpcInteruptType) = 'ISR_CAT2_INT'"!]
[!VAR "Cdd_Ipc_CPU3_L_CPU1_R_INST1_ISR_cat" = "$Cdd_Ipc_CPU3_L_CPU1_R_INST1_ISR_cat + 1"!]
[!ENDIF!]
[!ELSEIF "node:value(CddIpcRxInstance) = 'CDD_IPC_CPU3_L_CPU1_R_INST2'"!]
[!IF "node:value(CddIpcInteruptType) = 'ISR_CAT2_INT'"!]
[!VAR "Cdd_Ipc_CPU3_L_CPU1_R_INST2_ISR_cat" = "$Cdd_Ipc_CPU3_L_CPU1_R_INST2_ISR_cat + 1"!]
[!ENDIF!]
[!ELSEIF "node:value(CddIpcRxInstance) = 'CDD_IPC_CPU3_L_CPU1_R_INST3'"!]
[!IF "node:value(CddIpcInteruptType) = 'ISR_CAT2_INT'"!]
[!VAR "Cdd_Ipc_CPU3_L_CPU1_R_INST3_ISR_cat" = "$Cdd_Ipc_CPU3_L_CPU1_R_INST3_ISR_cat + 1"!]
[!ENDIF!]
[!ELSEIF "node:value(CddIpcRxInstance) = 'CDD_IPC_CPU3_L_CPU2_R_INST0'"!]
[!IF "node:value(CddIpcInteruptType) = 'ISR_CAT2_INT'"!]
[!VAR "Cdd_Ipc_CPU3_L_CPU2_R_INST0_ISR_cat" = "$Cdd_Ipc_CPU3_L_CPU2_R_INST0_ISR_cat + 1"!]
[!ENDIF!]
[!ELSEIF "node:value(CddIpcRxInstance) = 'CDD_IPC_CPU3_L_CPU2_R_INST1'"!]
[!IF "node:value(CddIpcInteruptType) = 'ISR_CAT2_INT'"!]
[!VAR "Cdd_Ipc_CPU3_L_CPU2_R_INST1_ISR_cat" = "$Cdd_Ipc_CPU3_L_CPU2_R_INST1_ISR_cat + 1"!]
[!ENDIF!]
[!ELSEIF "node:value(CddIpcRxInstance) = 'CDD_IPC_CPU3_L_CPU2_R_INST2'"!]
[!IF "node:value(CddIpcInteruptType) = 'ISR_CAT2_INT'"!]
[!VAR "Cdd_Ipc_CPU3_L_CPU2_R_INST2_ISR_cat" = "$Cdd_Ipc_CPU3_L_CPU2_R_INST2_ISR_cat + 1"!]
[!ENDIF!]
[!ELSEIF "node:value(CddIpcRxInstance) = 'CDD_IPC_CPU3_L_CPU2_R_INST3'"!]
[!IF "node:value(CddIpcInteruptType) = 'ISR_CAT2_INT'"!]
[!VAR "Cdd_Ipc_CPU3_L_CPU2_R_INST3_ISR_cat" = "$Cdd_Ipc_CPU3_L_CPU2_R_INST3_ISR_cat + 1"!]
[!ENDIF!]
[!ENDIF!]
[!ENDLOOP!]
  <AR-PACKAGES>
    <AR-PACKAGE UUID="4cc3ffbe-8526-4003-b94e-d8976469aa76">
      <SHORT-NAME>Cdd_Ipc_TI_F29H85x</SHORT-NAME>
      <ELEMENTS>
        <BSW-MODULE-DESCRIPTION UUID="c3cf11eb-cd88-4853-a6df-9fc323db83cc">
          <SHORT-NAME>Cdd_Ipc</SHORT-NAME>
          <CATEGORY>BSW_MODULE</CATEGORY>
          <IMPLEMENTED-ENTRYS>
          [!LOOP "CddIpcConfig/CddIpcRemoteCoreConfig/*/CddIpcRxInstanceConfig/*"!]
          [!IF "node:value(CddIpcRxInstance) = 'CDD_IPC_CPU1_L_CPU2_R_INST0'"!]
            <BSW-MODULE-ENTRY-REF-CONDITIONAL>
              <BSW-MODULE-ENTRY-REF DEST="BSW-MODULE-ENTRY">/Cdd_Ipc_TI_F29H85x/BSWModuleEntry/Cdd_Ipc_CPU1_L_CPU2_R_INST0_ISR</BSW-MODULE-ENTRY-REF>
            </BSW-MODULE-ENTRY-REF-CONDITIONAL>
          [!ELSEIF "node:value(CddIpcRxInstance) = 'CDD_IPC_CPU1_L_CPU2_R_INST1'"!]
            <BSW-MODULE-ENTRY-REF-CONDITIONAL>
              <BSW-MODULE-ENTRY-REF DEST="BSW-MODULE-ENTRY">/Cdd_Ipc_TI_F29H85x/BSWModuleEntry/Cdd_Ipc_CPU1_L_CPU2_R_INST1_ISR</BSW-MODULE-ENTRY-REF>
            </BSW-MODULE-ENTRY-REF-CONDITIONAL>
          [!ELSEIF "node:value(CddIpcRxInstance) = 'CDD_IPC_CPU1_L_CPU2_R_INST2'"!]
            <BSW-MODULE-ENTRY-REF-CONDITIONAL>
              <BSW-MODULE-ENTRY-REF DEST="BSW-MODULE-ENTRY">/Cdd_Ipc_TI_F29H85x/BSWModuleEntry/Cdd_Ipc_CPU1_L_CPU2_R_INST2_ISR</BSW-MODULE-ENTRY-REF>
            </BSW-MODULE-ENTRY-REF-CONDITIONAL>
          [!ELSEIF "node:value(CddIpcRxInstance) = 'CDD_IPC_CPU1_L_CPU2_R_INST3'"!]
            <BSW-MODULE-ENTRY-REF-CONDITIONAL>
              <BSW-MODULE-ENTRY-REF DEST="BSW-MODULE-ENTRY">/Cdd_Ipc_TI_F29H85x/BSWModuleEntry/Cdd_Ipc_CPU1_L_CPU2_R_INST3_ISR</BSW-MODULE-ENTRY-REF>
            </BSW-MODULE-ENTRY-REF-CONDITIONAL>
          [!ELSEIF "node:value(CddIpcRxInstance) = 'CDD_IPC_CPU1_L_CPU3_R_INST0'"!]
            <BSW-MODULE-ENTRY-REF-CONDITIONAL>
              <BSW-MODULE-ENTRY-REF DEST="BSW-MODULE-ENTRY">/Cdd_Ipc_TI_F29H85x/BSWModuleEntry/Cdd_Ipc_CPU1_L_CPU3_R_INST0_ISR</BSW-MODULE-ENTRY-REF>
            </BSW-MODULE-ENTRY-REF-CONDITIONAL>
          [!ELSEIF "node:value(CddIpcRxInstance) = 'CDD_IPC_CPU1_L_CPU3_R_INST1'"!]
            <BSW-MODULE-ENTRY-REF-CONDITIONAL>
              <BSW-MODULE-ENTRY-REF DEST="BSW-MODULE-ENTRY">/Cdd_Ipc_TI_F29H85x/BSWModuleEntry/Cdd_Ipc_CPU1_L_CPU3_R_INST1_ISR</BSW-MODULE-ENTRY-REF>
            </BSW-MODULE-ENTRY-REF-CONDITIONAL>
          [!ELSEIF "node:value(CddIpcRxInstance) = 'CDD_IPC_CPU1_L_CPU3_R_INST2'"!]
            <BSW-MODULE-ENTRY-REF-CONDITIONAL>
              <BSW-MODULE-ENTRY-REF DEST="BSW-MODULE-ENTRY">/Cdd_Ipc_TI_F29H85x/BSWModuleEntry/Cdd_Ipc_CPU1_L_CPU3_R_INST2_ISR</BSW-MODULE-ENTRY-REF>
            </BSW-MODULE-ENTRY-REF-CONDITIONAL>
          [!ELSEIF "node:value(CddIpcRxInstance) = 'CDD_IPC_CPU1_L_CPU3_R_INST3'"!]
            <BSW-MODULE-ENTRY-REF-CONDITIONAL>
              <BSW-MODULE-ENTRY-REF DEST="BSW-MODULE-ENTRY">/Cdd_Ipc_TI_F29H85x/BSWModuleEntry/Cdd_Ipc_CPU1_L_CPU3_R_INST3_ISR</BSW-MODULE-ENTRY-REF>
            </BSW-MODULE-ENTRY-REF-CONDITIONAL>
          [!ELSEIF "node:value(CddIpcRxInstance) = 'CDD_IPC_CPU2_L_CPU1_R_INST0'"!]
            <BSW-MODULE-ENTRY-REF-CONDITIONAL>
              <BSW-MODULE-ENTRY-REF DEST="BSW-MODULE-ENTRY">/Cdd_Ipc_TI_F29H85x/BSWModuleEntry/Cdd_Ipc_CPU2_L_CPU1_R_INST0_ISR</BSW-MODULE-ENTRY-REF>
            </BSW-MODULE-ENTRY-REF-CONDITIONAL>
          [!ELSEIF "node:value(CddIpcRxInstance) = 'CDD_IPC_CPU2_L_CPU1_R_INST1'"!]
            <BSW-MODULE-ENTRY-REF-CONDITIONAL>
              <BSW-MODULE-ENTRY-REF DEST="BSW-MODULE-ENTRY">/Cdd_Ipc_TI_F29H85x/BSWModuleEntry/Cdd_Ipc_CPU2_L_CPU1_R_INST1_ISR</BSW-MODULE-ENTRY-REF>
            </BSW-MODULE-ENTRY-REF-CONDITIONAL>
          [!ELSEIF "node:value(CddIpcRxInstance) = 'CDD_IPC_CPU2_L_CPU1_R_INST2'"!]
            <BSW-MODULE-ENTRY-REF-CONDITIONAL>
              <BSW-MODULE-ENTRY-REF DEST="BSW-MODULE-ENTRY">/Cdd_Ipc_TI_F29H85x/BSWModuleEntry/Cdd_Ipc_CPU2_L_CPU1_R_INST2_ISR</BSW-MODULE-ENTRY-REF>
            </BSW-MODULE-ENTRY-REF-CONDITIONAL>
          [!ELSEIF "node:value(CddIpcRxInstance) = 'CDD_IPC_CPU2_L_CPU1_R_INST3'"!]
            <BSW-MODULE-ENTRY-REF-CONDITIONAL>
              <BSW-MODULE-ENTRY-REF DEST="BSW-MODULE-ENTRY">/Cdd_Ipc_TI_F29H85x/BSWModuleEntry/Cdd_Ipc_CPU2_L_CPU1_R_INST3_ISR</BSW-MODULE-ENTRY-REF>
            </BSW-MODULE-ENTRY-REF-CONDITIONAL>
          [!ELSEIF "node:value(CddIpcRxInstance) = 'CDD_IPC_CPU2_L_CPU3_R_INST0'"!]
            <BSW-MODULE-ENTRY-REF-CONDITIONAL>
              <BSW-MODULE-ENTRY-REF DEST="BSW-MODULE-ENTRY">/Cdd_Ipc_TI_F29H85x/BSWModuleEntry/Cdd_Ipc_CPU2_L_CPU3_R_INST0_ISR</BSW-MODULE-ENTRY-REF>
            </BSW-MODULE-ENTRY-REF-CONDITIONAL>
          [!ELSEIF "node:value(CddIpcRxInstance) = 'CDD_IPC_CPU2_L_CPU3_R_INST1'"!]
            <BSW-MODULE-ENTRY-REF-CONDITIONAL>
              <BSW-MODULE-ENTRY-REF DEST="BSW-MODULE-ENTRY">/Cdd_Ipc_TI_F29H85x/BSWModuleEntry/Cdd_Ipc_CPU2_L_CPU3_R_INST1_ISR</BSW-MODULE-ENTRY-REF>
            </BSW-MODULE-ENTRY-REF-CONDITIONAL>
          [!ELSEIF "node:value(CddIpcRxInstance) = 'CDD_IPC_CPU2_L_CPU3_R_INST2'"!]
            <BSW-MODULE-ENTRY-REF-CONDITIONAL>
              <BSW-MODULE-ENTRY-REF DEST="BSW-MODULE-ENTRY">/Cdd_Ipc_TI_F29H85x/BSWModuleEntry/Cdd_Ipc_CPU2_L_CPU3_R_INST2_ISR</BSW-MODULE-ENTRY-REF>
            </BSW-MODULE-ENTRY-REF-CONDITIONAL>
          [!ELSEIF "node:value(CddIpcRxInstance) = 'CDD_IPC_CPU2_L_CPU3_R_INST3'"!]
            <BSW-MODULE-ENTRY-REF-CONDITIONAL>
              <BSW-MODULE-ENTRY-REF DEST="BSW-MODULE-ENTRY">/Cdd_Ipc_TI_F29H85x/BSWModuleEntry/Cdd_Ipc_CPU2_L_CPU3_R_INST3_ISR</BSW-MODULE-ENTRY-REF>
            </BSW-MODULE-ENTRY-REF-CONDITIONAL>
          [!ELSEIF "node:value(CddIpcRxInstance) = 'CDD_IPC_CPU3_L_CPU1_R_INST0'"!]
            <BSW-MODULE-ENTRY-REF-CONDITIONAL>
              <BSW-MODULE-ENTRY-REF DEST="BSW-MODULE-ENTRY">/Cdd_Ipc_TI_F29H85x/BSWModuleEntry/Cdd_Ipc_CPU3_L_CPU1_R_INST0_ISR</BSW-MODULE-ENTRY-REF>
            </BSW-MODULE-ENTRY-REF-CONDITIONAL>
          [!ELSEIF "node:value(CddIpcRxInstance) = 'CDD_IPC_CPU3_L_CPU1_R_INST1'"!]
            <BSW-MODULE-ENTRY-REF-CONDITIONAL>
              <BSW-MODULE-ENTRY-REF DEST="BSW-MODULE-ENTRY">/Cdd_Ipc_TI_F29H85x/BSWModuleEntry/Cdd_Ipc_CPU3_L_CPU1_R_INST1_ISR</BSW-MODULE-ENTRY-REF>
            </BSW-MODULE-ENTRY-REF-CONDITIONAL>
          [!ELSEIF "node:value(CddIpcRxInstance) = 'CDD_IPC_CPU3_L_CPU1_R_INST2'"!]
            <BSW-MODULE-ENTRY-REF-CONDITIONAL>
              <BSW-MODULE-ENTRY-REF DEST="BSW-MODULE-ENTRY">/Cdd_Ipc_TI_F29H85x/BSWModuleEntry/Cdd_Ipc_CPU3_L_CPU1_R_INST2_ISR</BSW-MODULE-ENTRY-REF>
            </BSW-MODULE-ENTRY-REF-CONDITIONAL>
          [!ELSEIF "node:value(CddIpcRxInstance) = 'CDD_IPC_CPU3_L_CPU1_R_INST3'"!]
            <BSW-MODULE-ENTRY-REF-CONDITIONAL>
              <BSW-MODULE-ENTRY-REF DEST="BSW-MODULE-ENTRY">/Cdd_Ipc_TI_F29H85x/BSWModuleEntry/Cdd_Ipc_CPU3_L_CPU1_R_INST3_ISR</BSW-MODULE-ENTRY-REF>
            </BSW-MODULE-ENTRY-REF-CONDITIONAL>
          [!ELSEIF "node:value(CddIpcRxInstance) = 'CDD_IPC_CPU3_L_CPU2_R_INST0'"!]
            <BSW-MODULE-ENTRY-REF-CONDITIONAL>
              <BSW-MODULE-ENTRY-REF DEST="BSW-MODULE-ENTRY">/Cdd_Ipc_TI_F29H85x/BSWModuleEntry/Cdd_Ipc_CPU3_L_CPU2_R_INST0_ISR</BSW-MODULE-ENTRY-REF>
            </BSW-MODULE-ENTRY-REF-CONDITIONAL>
          [!ELSEIF "node:value(CddIpcRxInstance) = 'CDD_IPC_CPU3_L_CPU2_R_INST1'"!]
            <BSW-MODULE-ENTRY-REF-CONDITIONAL>
              <BSW-MODULE-ENTRY-REF DEST="BSW-MODULE-ENTRY">/Cdd_Ipc_TI_F29H85x/BSWModuleEntry/Cdd_Ipc_CPU3_L_CPU2_R_INST1_ISR</BSW-MODULE-ENTRY-REF>
            </BSW-MODULE-ENTRY-REF-CONDITIONAL>
          [!ELSEIF "node:value(CddIpcRxInstance) = 'CDD_IPC_CPU3_L_CPU2_R_INST2'"!]
            <BSW-MODULE-ENTRY-REF-CONDITIONAL>
              <BSW-MODULE-ENTRY-REF DEST="BSW-MODULE-ENTRY">/Cdd_Ipc_TI_F29H85x/BSWModuleEntry/Cdd_Ipc_CPU3_L_CPU2_R_INST2_ISR</BSW-MODULE-ENTRY-REF>
            </BSW-MODULE-ENTRY-REF-CONDITIONAL>
          [!ELSEIF "node:value(CddIpcRxInstance) = 'CDD_IPC_CPU3_L_CPU2_R_INST3'"!]
            <BSW-MODULE-ENTRY-REF-CONDITIONAL>
              <BSW-MODULE-ENTRY-REF DEST="BSW-MODULE-ENTRY">/Cdd_Ipc_TI_F29H85x/BSWModuleEntry/Cdd_Ipc_CPU3_L_CPU2_R_INST3_ISR</BSW-MODULE-ENTRY-REF>
            </BSW-MODULE-ENTRY-REF-CONDITIONAL>
          [!ENDIF!]
          [!ENDLOOP!]
            <BSW-MODULE-ENTRY-REF-CONDITIONAL>
              <BSW-MODULE-ENTRY-REF DEST="BSW-MODULE-ENTRY">/Cdd_Ipc_TI_F29H85x/BSWModuleEntry/Cdd_Ipc_GetCounter</BSW-MODULE-ENTRY-REF>
            </BSW-MODULE-ENTRY-REF-CONDITIONAL>
          [!IF "CddIpcGeneral/CddIpcVersionInfoApi = 'true'"!]
            <BSW-MODULE-ENTRY-REF-CONDITIONAL>
              <BSW-MODULE-ENTRY-REF DEST="BSW-MODULE-ENTRY">/Cdd_Ipc_TI_F29H85x/BSWModuleEntry/Cdd_Ipc_GetVersionInfo</BSW-MODULE-ENTRY-REF>
            </BSW-MODULE-ENTRY-REF-CONDITIONAL>
          [!ENDIF!]
            <BSW-MODULE-ENTRY-REF-CONDITIONAL>
              <BSW-MODULE-ENTRY-REF DEST="BSW-MODULE-ENTRY">/Cdd_Ipc_TI_F29H85x/BSWModuleEntry/Cdd_Ipc_Init</BSW-MODULE-ENTRY-REF>
            </BSW-MODULE-ENTRY-REF-CONDITIONAL>
            <BSW-MODULE-ENTRY-REF-CONDITIONAL>
              <BSW-MODULE-ENTRY-REF DEST="BSW-MODULE-ENTRY">/Cdd_Ipc_TI_F29H85x/BSWModuleEntry/Cdd_Ipc_IsTxInstanceFree</BSW-MODULE-ENTRY-REF>
            </BSW-MODULE-ENTRY-REF-CONDITIONAL>
            <BSW-MODULE-ENTRY-REF-CONDITIONAL>
              <BSW-MODULE-ENTRY-REF DEST="BSW-MODULE-ENTRY">/Cdd_Ipc_TI_F29H85x/BSWModuleEntry/Cdd_Ipc_MainFunction_Read</BSW-MODULE-ENTRY-REF>
            </BSW-MODULE-ENTRY-REF-CONDITIONAL>
            <BSW-MODULE-ENTRY-REF-CONDITIONAL>
              <BSW-MODULE-ENTRY-REF DEST="BSW-MODULE-ENTRY">/Cdd_Ipc_TI_F29H85x/BSWModuleEntry/Cdd_Ipc_Sync</BSW-MODULE-ENTRY-REF>
            </BSW-MODULE-ENTRY-REF-CONDITIONAL>
            <BSW-MODULE-ENTRY-REF-CONDITIONAL>
              <BSW-MODULE-ENTRY-REF DEST="BSW-MODULE-ENTRY">/Cdd_Ipc_TI_F29H85x/BSWModuleEntry/Cdd_Ipc_Transmit</BSW-MODULE-ENTRY-REF>
            </BSW-MODULE-ENTRY-REF-CONDITIONAL>
          </IMPLEMENTED-ENTRYS>
          <MODULE-ID>255</MODULE-ID>
          <BSW-MODULE-DEPENDENCYS>
           [!IF "CddIpcGeneral/CddIpcDevErrorDetect"!]
            <BSW-MODULE-DEPENDENCY UUID="b7eab596-c541-42ae-8bde-aeab7dd9215a">
              <SHORT-NAME>Det</SHORT-NAME>
              <TARGET-MODULE-ID>15</TARGET-MODULE-ID>
              <TARGET-MODULE-REFS>
                <BSW-MODULE-DESCRIPTION-REF-CONDITIONAL>
                  <BSW-MODULE-DESCRIPTION-REF DEST="BSW-MODULE-DESCRIPTION">/AUTOSAR_Det/Det</BSW-MODULE-DESCRIPTION-REF>
                </BSW-MODULE-DESCRIPTION-REF-CONDITIONAL>
              </TARGET-MODULE-REFS>
            </BSW-MODULE-DEPENDENCY>
           [!ENDIF!]
            [!IF "CddIpcGeneral/CddIpcIntegrationWithAsrComStackEnable = 'true'"!]
            <BSW-MODULE-DEPENDENCY UUID="ed6d0c22-58ff-45dd-9f2b-66aa5b33b39b">
              <SHORT-NAME>PduR</SHORT-NAME>
              <TARGET-MODULE-ID>51</TARGET-MODULE-ID>
              <TARGET-MODULE-REFS>
                <BSW-MODULE-DESCRIPTION-REF-CONDITIONAL>
                  <BSW-MODULE-DESCRIPTION-REF DEST="BSW-MODULE-DESCRIPTION">/AUTOSAR_PduR/PduR</BSW-MODULE-DESCRIPTION-REF>
                </BSW-MODULE-DESCRIPTION-REF-CONDITIONAL>
              </TARGET-MODULE-REFS>
            </BSW-MODULE-DEPENDENCY>
            [!ENDIF!]
          </BSW-MODULE-DEPENDENCYS>
          <INTERNAL-BEHAVIORS>
            <BSW-INTERNAL-BEHAVIOR UUID="c9924e24-e2d6-4d0d-a5b2-c958755b4d75">
              <SHORT-NAME>Cdd_Ipc_Behavior</SHORT-NAME>
              <EXCLUSIVE-AREAS>
                <EXCLUSIVE-AREA UUID="d81ab087-eb21-4856-8f0e-e9905a614b29">
                  <SHORT-NAME>CDD_IPC_EXCLUSIVE_AREA_0</SHORT-NAME>
                </EXCLUSIVE-AREA>
                <EXCLUSIVE-AREA UUID="b894c7fe-cfe0-4032-ab40-5042337fbfbf">
                  <SHORT-NAME>CDD_IPC_EXCLUSIVE_AREA_1</SHORT-NAME>
                </EXCLUSIVE-AREA>
              </EXCLUSIVE-AREAS>
              <ENTITYS>
                [!LOOP "CddIpcConfig/CddIpcRemoteCoreConfig/*/CddIpcRxInstanceConfig/*"!]
                [!IF "node:value(CddIpcRxInstance) = 'CDD_IPC_CPU1_L_CPU2_R_INST0'"!]
                <BSW-INTERRUPT-ENTITY UUID="0919f480-8665-401d-beb7-a4f9a9d1964c">
                  <SHORT-NAME>Cdd_Ipc_CPU1_L_CPU2_R_INST0_ISR</SHORT-NAME>
                  <REENTRANCY-LEVEL>NON-REENTRANT</REENTRANCY-LEVEL>
                  [!IF "as:modconf('Cdd_Ipc/Cdd')[as:path(node:dtos(.))='/TI_F29H85x/Cdd_Ipc/Cdd']/CddIpcGeneral/CddIpcIntegrationWithAsrComStackEnable = 'true'"!]
                  <CALL-POINTS>
                    <BSW-DIRECT-CALL-POINT>
                      <SHORT-NAME>PduR_Cdd_Ipc_RxIndication</SHORT-NAME>
                      <CALLED-ENTRY-REF DEST="BSW-MODULE-ENTRY">/AUTOSAR_PduR/BSWModuleEntry/PduR_Cdd_Ipc_RxIndication</CALLED-ENTRY-REF>
                    </BSW-DIRECT-CALL-POINT>
                  </CALL-POINTS>
                  [!ENDIF!]
                  <IMPLEMENTED-ENTRY-REF DEST="BSW-MODULE-ENTRY">/Cdd_Ipc_TI_F29H85x/BSWModuleEntry/Cdd_Ipc_CPU1_L_CPU2_R_INST0_ISR</IMPLEMENTED-ENTRY-REF>
                  [!IF "node:value(CddIpcInteruptType) = 'ISR_CAT2_INT'"!]
                  <INTERRUPT-CATEGORY>CAT-2</INTERRUPT-CATEGORY>
                  [!ELSE!]
                  <INTERRUPT-CATEGORY>CAT-1</INTERRUPT-CATEGORY>
                  [!ENDIF!]
                </BSW-INTERRUPT-ENTITY>
                [!ELSEIF "node:value(CddIpcRxInstance) = 'CDD_IPC_CPU1_L_CPU2_R_INST1'"!]
                <BSW-INTERRUPT-ENTITY UUID="c5c830e6-b532-42b9-bfa1-d0f5b0f6de33">
                  <SHORT-NAME>Cdd_Ipc_CPU1_L_CPU2_R_INST1_ISR</SHORT-NAME>
                  <REENTRANCY-LEVEL>NON-REENTRANT</REENTRANCY-LEVEL>
                  [!IF "as:modconf('Cdd_Ipc/Cdd')[as:path(node:dtos(.))='/TI_F29H85x/Cdd_Ipc/Cdd']/CddIpcGeneral/CddIpcIntegrationWithAsrComStackEnable = 'true'"!]
                  <CALL-POINTS>
                    <BSW-DIRECT-CALL-POINT>
                      <SHORT-NAME>PduR_Cdd_Ipc_RxIndication</SHORT-NAME>
                      <CALLED-ENTRY-REF DEST="BSW-MODULE-ENTRY">/AUTOSAR_PduR/BSWModuleEntry/PduR_Cdd_Ipc_RxIndication</CALLED-ENTRY-REF>
                    </BSW-DIRECT-CALL-POINT>
                  </CALL-POINTS>
                  [!ENDIF!]
                  <IMPLEMENTED-ENTRY-REF DEST="BSW-MODULE-ENTRY">/Cdd_Ipc_TI_F29H85x/BSWModuleEntry/Cdd_Ipc_CPU1_L_CPU2_R_INST1_ISR</IMPLEMENTED-ENTRY-REF>
                  [!IF "node:value(CddIpcInteruptType) = 'ISR_CAT2_INT'"!]
                  <INTERRUPT-CATEGORY>CAT-2</INTERRUPT-CATEGORY>
                  [!ELSE!]
                  <INTERRUPT-CATEGORY>CAT-1</INTERRUPT-CATEGORY>
                  [!ENDIF!]
                </BSW-INTERRUPT-ENTITY>
                [!ELSEIF "node:value(CddIpcRxInstance) = 'CDD_IPC_CPU1_L_CPU2_R_INST2'"!]
                <BSW-INTERRUPT-ENTITY UUID="ad73d82c-4076-4b7c-8a8a-828a7d14d570">
                  <SHORT-NAME>Cdd_Ipc_CPU1_L_CPU2_R_INST2_ISR</SHORT-NAME>
                  <REENTRANCY-LEVEL>NON-REENTRANT</REENTRANCY-LEVEL>
                  [!IF "as:modconf('Cdd_Ipc/Cdd')[as:path(node:dtos(.))='/TI_F29H85x/Cdd_Ipc/Cdd']/CddIpcGeneral/CddIpcIntegrationWithAsrComStackEnable = 'true'"!]
                  <CALL-POINTS>
                    <BSW-DIRECT-CALL-POINT>
                      <SHORT-NAME>PduR_Cdd_Ipc_RxIndication</SHORT-NAME>
                      <CALLED-ENTRY-REF DEST="BSW-MODULE-ENTRY">/AUTOSAR_PduR/BSWModuleEntry/PduR_Cdd_Ipc_RxIndication</CALLED-ENTRY-REF>
                    </BSW-DIRECT-CALL-POINT>
                  </CALL-POINTS>
                  [!ENDIF!]
                  <IMPLEMENTED-ENTRY-REF DEST="BSW-MODULE-ENTRY">/Cdd_Ipc_TI_F29H85x/BSWModuleEntry/Cdd_Ipc_CPU1_L_CPU2_R_INST2_ISR</IMPLEMENTED-ENTRY-REF>
                  [!IF "node:value(CddIpcInteruptType) = 'ISR_CAT2_INT'"!]
                  <INTERRUPT-CATEGORY>CAT-2</INTERRUPT-CATEGORY>
                  [!ELSE!]
                  <INTERRUPT-CATEGORY>CAT-1</INTERRUPT-CATEGORY>
                  [!ENDIF!]
                </BSW-INTERRUPT-ENTITY>
                [!ELSEIF "node:value(CddIpcRxInstance) = 'CDD_IPC_CPU1_L_CPU2_R_INST3'"!]
                <BSW-INTERRUPT-ENTITY UUID="684fb9cd-f870-46ce-b576-eb2fc3e50613">
                  <SHORT-NAME>Cdd_Ipc_CPU1_L_CPU2_R_INST3_ISR</SHORT-NAME>
                  <REENTRANCY-LEVEL>NON-REENTRANT</REENTRANCY-LEVEL>
                  [!IF "as:modconf('Cdd_Ipc/Cdd')[as:path(node:dtos(.))='/TI_F29H85x/Cdd_Ipc/Cdd']/CddIpcGeneral/CddIpcIntegrationWithAsrComStackEnable = 'true'"!]
                  <CALL-POINTS>
                    <BSW-DIRECT-CALL-POINT>
                      <SHORT-NAME>PduR_Cdd_Ipc_RxIndication</SHORT-NAME>
                      <CALLED-ENTRY-REF DEST="BSW-MODULE-ENTRY">/AUTOSAR_PduR/BSWModuleEntry/PduR_Cdd_Ipc_RxIndication</CALLED-ENTRY-REF>
                    </BSW-DIRECT-CALL-POINT>
                  </CALL-POINTS>
                  [!ENDIF!]
                  <IMPLEMENTED-ENTRY-REF DEST="BSW-MODULE-ENTRY">/Cdd_Ipc_TI_F29H85x/BSWModuleEntry/Cdd_Ipc_CPU1_L_CPU2_R_INST3_ISR</IMPLEMENTED-ENTRY-REF>
                  [!IF "node:value(CddIpcInteruptType) = 'ISR_CAT2_INT'"!]
                  <INTERRUPT-CATEGORY>CAT-2</INTERRUPT-CATEGORY>
                  [!ELSE!]
                  <INTERRUPT-CATEGORY>CAT-1</INTERRUPT-CATEGORY>
                  [!ENDIF!]
                </BSW-INTERRUPT-ENTITY>
                [!ELSEIF "node:value(CddIpcRxInstance) = 'CDD_IPC_CPU1_L_CPU3_R_INST0'"!]
                <BSW-INTERRUPT-ENTITY UUID="d6ce52d1-9781-43b0-a229-688bba48d106">
                  <SHORT-NAME>Cdd_Ipc_CPU1_L_CPU3_R_INST0_ISR</SHORT-NAME>
                  <REENTRANCY-LEVEL>NON-REENTRANT</REENTRANCY-LEVEL>
                  [!IF "as:modconf('Cdd_Ipc/Cdd')[as:path(node:dtos(.))='/TI_F29H85x/Cdd_Ipc/Cdd']/CddIpcGeneral/CddIpcIntegrationWithAsrComStackEnable = 'true'"!]
                  <CALL-POINTS>
                    <BSW-DIRECT-CALL-POINT>
                      <SHORT-NAME>PduR_Cdd_Ipc_RxIndication</SHORT-NAME>
                      <CALLED-ENTRY-REF DEST="BSW-MODULE-ENTRY">/AUTOSAR_PduR/BSWModuleEntry/PduR_Cdd_Ipc_RxIndication</CALLED-ENTRY-REF>
                    </BSW-DIRECT-CALL-POINT>
                  </CALL-POINTS>
                  [!ENDIF!]
                  <IMPLEMENTED-ENTRY-REF DEST="BSW-MODULE-ENTRY">/Cdd_Ipc_TI_F29H85x/BSWModuleEntry/Cdd_Ipc_CPU1_L_CPU3_R_INST0_ISR</IMPLEMENTED-ENTRY-REF>
                  [!IF "node:value(CddIpcInteruptType) = 'ISR_CAT2_INT'"!]
                  <INTERRUPT-CATEGORY>CAT-2</INTERRUPT-CATEGORY>
                  [!ELSE!]
                  <INTERRUPT-CATEGORY>CAT-1</INTERRUPT-CATEGORY>
                  [!ENDIF!]
                </BSW-INTERRUPT-ENTITY>
                [!ELSEIF "node:value(CddIpcRxInstance) = 'CDD_IPC_CPU1_L_CPU3_R_INST1'"!]
                <BSW-INTERRUPT-ENTITY UUID="866598a0-602e-44cc-aa13-8ee3226eab41">
                  <SHORT-NAME>Cdd_Ipc_CPU1_L_CPU3_R_INST1_ISR</SHORT-NAME>
                  <REENTRANCY-LEVEL>NON-REENTRANT</REENTRANCY-LEVEL>
                  [!IF "as:modconf('Cdd_Ipc/Cdd')[as:path(node:dtos(.))='/TI_F29H85x/Cdd_Ipc/Cdd']/CddIpcGeneral/CddIpcIntegrationWithAsrComStackEnable = 'true'"!]
                  <CALL-POINTS>
                    <BSW-DIRECT-CALL-POINT>
                      <SHORT-NAME>PduR_Cdd_Ipc_RxIndication</SHORT-NAME>
                      <CALLED-ENTRY-REF DEST="BSW-MODULE-ENTRY">/AUTOSAR_PduR/BSWModuleEntry/PduR_Cdd_Ipc_RxIndication</CALLED-ENTRY-REF>
                    </BSW-DIRECT-CALL-POINT>
                  </CALL-POINTS>
                  [!ENDIF!]
                  <IMPLEMENTED-ENTRY-REF DEST="BSW-MODULE-ENTRY">/Cdd_Ipc_TI_F29H85x/BSWModuleEntry/Cdd_Ipc_CPU1_L_CPU3_R_INST1_ISR</IMPLEMENTED-ENTRY-REF>
                  [!IF "node:value(CddIpcInteruptType) = 'ISR_CAT2_INT'"!]
                  <INTERRUPT-CATEGORY>CAT-2</INTERRUPT-CATEGORY>
                  [!ELSE!]
                  <INTERRUPT-CATEGORY>CAT-1</INTERRUPT-CATEGORY>
                  [!ENDIF!]
                </BSW-INTERRUPT-ENTITY>
                [!ELSEIF "node:value(CddIpcRxInstance) = 'CDD_IPC_CPU1_L_CPU3_R_INST2'"!]
                <BSW-INTERRUPT-ENTITY UUID="16eb2704-2430-49ab-a787-59b6a2410b7d">
                  <SHORT-NAME>Cdd_Ipc_CPU1_L_CPU3_R_INST2_ISR</SHORT-NAME>
                  <REENTRANCY-LEVEL>NON-REENTRANT</REENTRANCY-LEVEL>
                  [!IF "as:modconf('Cdd_Ipc/Cdd')[as:path(node:dtos(.))='/TI_F29H85x/Cdd_Ipc/Cdd']/CddIpcGeneral/CddIpcIntegrationWithAsrComStackEnable = 'true'"!]
                  <CALL-POINTS>
                    <BSW-DIRECT-CALL-POINT>
                      <SHORT-NAME>PduR_Cdd_Ipc_RxIndication</SHORT-NAME>
                      <CALLED-ENTRY-REF DEST="BSW-MODULE-ENTRY">/AUTOSAR_PduR/BSWModuleEntry/PduR_Cdd_Ipc_RxIndication</CALLED-ENTRY-REF>
                    </BSW-DIRECT-CALL-POINT>
                  </CALL-POINTS>
                  [!ENDIF!]
                  <IMPLEMENTED-ENTRY-REF DEST="BSW-MODULE-ENTRY">/Cdd_Ipc_TI_F29H85x/BSWModuleEntry/Cdd_Ipc_CPU1_L_CPU3_R_INST2_ISR</IMPLEMENTED-ENTRY-REF>
                  [!IF "node:value(CddIpcInteruptType) = 'ISR_CAT2_INT'"!]
                  <INTERRUPT-CATEGORY>CAT-2</INTERRUPT-CATEGORY>
                  [!ELSE!]
                  <INTERRUPT-CATEGORY>CAT-1</INTERRUPT-CATEGORY>
                  [!ENDIF!]
                </BSW-INTERRUPT-ENTITY>
                [!ELSEIF "node:value(CddIpcRxInstance) = 'CDD_IPC_CPU1_L_CPU3_R_INST3'"!]
                <BSW-INTERRUPT-ENTITY UUID="d7c0a757-1fb8-42b9-b656-3c1c57043fab">
                  <SHORT-NAME>Cdd_Ipc_CPU1_L_CPU3_R_INST3_ISR</SHORT-NAME>
                  <REENTRANCY-LEVEL>NON-REENTRANT</REENTRANCY-LEVEL>
                  [!IF "as:modconf('Cdd_Ipc/Cdd')[as:path(node:dtos(.))='/TI_F29H85x/Cdd_Ipc/Cdd']/CddIpcGeneral/CddIpcIntegrationWithAsrComStackEnable = 'true'"!]
                  <CALL-POINTS>
                    <BSW-DIRECT-CALL-POINT>
                      <SHORT-NAME>PduR_Cdd_Ipc_RxIndication</SHORT-NAME>
                      <CALLED-ENTRY-REF DEST="BSW-MODULE-ENTRY">/AUTOSAR_PduR/BSWModuleEntry/PduR_Cdd_Ipc_RxIndication</CALLED-ENTRY-REF>
                    </BSW-DIRECT-CALL-POINT>
                  </CALL-POINTS>
                  [!ENDIF!]
                  <IMPLEMENTED-ENTRY-REF DEST="BSW-MODULE-ENTRY">/Cdd_Ipc_TI_F29H85x/BSWModuleEntry/Cdd_Ipc_CPU1_L_CPU3_R_INST3_ISR</IMPLEMENTED-ENTRY-REF>
                  [!IF "node:value(CddIpcInteruptType) = 'ISR_CAT2_INT'"!]
                  <INTERRUPT-CATEGORY>CAT-2</INTERRUPT-CATEGORY>
                  [!ELSE!]
                  <INTERRUPT-CATEGORY>CAT-1</INTERRUPT-CATEGORY>
                  [!ENDIF!]
                </BSW-INTERRUPT-ENTITY>
                [!ELSEIF "node:value(CddIpcRxInstance) = 'CDD_IPC_CPU2_L_CPU1_R_INST0'"!]
                <BSW-INTERRUPT-ENTITY UUID="822d70bd-b472-44b4-88a6-0383ab44af3f">
                  <SHORT-NAME>Cdd_Ipc_CPU2_L_CPU1_R_INST0_ISR</SHORT-NAME>
                  <REENTRANCY-LEVEL>NON-REENTRANT</REENTRANCY-LEVEL>
                  [!IF "as:modconf('Cdd_Ipc/Cdd')[as:path(node:dtos(.))='/TI_F29H85x/Cdd_Ipc/Cdd']/CddIpcGeneral/CddIpcIntegrationWithAsrComStackEnable = 'true'"!]
                  <CALL-POINTS>
                    <BSW-DIRECT-CALL-POINT>
                      <SHORT-NAME>PduR_Cdd_Ipc_RxIndication</SHORT-NAME>
                      <CALLED-ENTRY-REF DEST="BSW-MODULE-ENTRY">/AUTOSAR_PduR/BSWModuleEntry/PduR_Cdd_Ipc_RxIndication</CALLED-ENTRY-REF>
                    </BSW-DIRECT-CALL-POINT>
                  </CALL-POINTS>
                  [!ENDIF!]
                  <IMPLEMENTED-ENTRY-REF DEST="BSW-MODULE-ENTRY">/Cdd_Ipc_TI_F29H85x/BSWModuleEntry/Cdd_Ipc_CPU2_L_CPU1_R_INST0_ISR</IMPLEMENTED-ENTRY-REF>
                  [!IF "node:value(CddIpcInteruptType) = 'ISR_CAT2_INT'"!]
                  <INTERRUPT-CATEGORY>CAT-2</INTERRUPT-CATEGORY>
                  [!ELSE!]
                  <INTERRUPT-CATEGORY>CAT-1</INTERRUPT-CATEGORY>
                  [!ENDIF!]
                </BSW-INTERRUPT-ENTITY>
                [!ELSEIF "node:value(CddIpcRxInstance) = 'CDD_IPC_CPU2_L_CPU1_R_INST1'"!]
                <BSW-INTERRUPT-ENTITY UUID="33255482-88ff-4ee9-b231-8b9fa1876757">
                  <SHORT-NAME>Cdd_Ipc_CPU2_L_CPU1_R_INST1_ISR</SHORT-NAME>
                  <REENTRANCY-LEVEL>NON-REENTRANT</REENTRANCY-LEVEL>
                  [!IF "as:modconf('Cdd_Ipc/Cdd')[as:path(node:dtos(.))='/TI_F29H85x/Cdd_Ipc/Cdd']/CddIpcGeneral/CddIpcIntegrationWithAsrComStackEnable = 'true'"!]
                  <CALL-POINTS>
                    <BSW-DIRECT-CALL-POINT>
                      <SHORT-NAME>PduR_Cdd_Ipc_RxIndication</SHORT-NAME>
                      <CALLED-ENTRY-REF DEST="BSW-MODULE-ENTRY">/AUTOSAR_PduR/BSWModuleEntry/PduR_Cdd_Ipc_RxIndication</CALLED-ENTRY-REF>
                    </BSW-DIRECT-CALL-POINT>
                  </CALL-POINTS>
                  [!ENDIF!]
                  <IMPLEMENTED-ENTRY-REF DEST="BSW-MODULE-ENTRY">/Cdd_Ipc_TI_F29H85x/BSWModuleEntry/Cdd_Ipc_CPU2_L_CPU1_R_INST1_ISR</IMPLEMENTED-ENTRY-REF>
                  [!IF "node:value(CddIpcInteruptType) = 'ISR_CAT2_INT'"!]
                  <INTERRUPT-CATEGORY>CAT-2</INTERRUPT-CATEGORY>
                  [!ELSE!]
                  <INTERRUPT-CATEGORY>CAT-1</INTERRUPT-CATEGORY>
                  [!ENDIF!]
                </BSW-INTERRUPT-ENTITY>
                [!ELSEIF "node:value(CddIpcRxInstance) = 'CDD_IPC_CPU2_L_CPU1_R_INST2'"!]
                <BSW-INTERRUPT-ENTITY UUID="e78728b2-5dc3-47ec-967b-10850918214b">
                  <SHORT-NAME>Cdd_Ipc_CPU2_L_CPU1_R_INST2_ISR</SHORT-NAME>
                  <REENTRANCY-LEVEL>NON-REENTRANT</REENTRANCY-LEVEL>
                  [!IF "as:modconf('Cdd_Ipc/Cdd')[as:path(node:dtos(.))='/TI_F29H85x/Cdd_Ipc/Cdd']/CddIpcGeneral/CddIpcIntegrationWithAsrComStackEnable = 'true'"!]
                  <CALL-POINTS>
                    <BSW-DIRECT-CALL-POINT>
                      <SHORT-NAME>PduR_Cdd_Ipc_RxIndication</SHORT-NAME>
                      <CALLED-ENTRY-REF DEST="BSW-MODULE-ENTRY">/AUTOSAR_PduR/BSWModuleEntry/PduR_Cdd_Ipc_RxIndication</CALLED-ENTRY-REF>
                    </BSW-DIRECT-CALL-POINT>
                  </CALL-POINTS>
                  [!ENDIF!]
                  <IMPLEMENTED-ENTRY-REF DEST="BSW-MODULE-ENTRY">/Cdd_Ipc_TI_F29H85x/BSWModuleEntry/Cdd_Ipc_CPU2_L_CPU1_R_INST2_ISR</IMPLEMENTED-ENTRY-REF>
                  [!IF "node:value(CddIpcInteruptType) = 'ISR_CAT2_INT'"!]
                  <INTERRUPT-CATEGORY>CAT-2</INTERRUPT-CATEGORY>
                  [!ELSE!]
                  <INTERRUPT-CATEGORY>CAT-1</INTERRUPT-CATEGORY>
                  [!ENDIF!]
                </BSW-INTERRUPT-ENTITY>
                [!ELSEIF "node:value(CddIpcRxInstance) = 'CDD_IPC_CPU2_L_CPU1_R_INST3'"!]
                <BSW-INTERRUPT-ENTITY UUID="8ed2cb3b-0670-42df-bbb5-a089b50b3088">
                  <SHORT-NAME>Cdd_Ipc_CPU2_L_CPU1_R_INST3_ISR</SHORT-NAME>
                  <REENTRANCY-LEVEL>NON-REENTRANT</REENTRANCY-LEVEL>
                  [!IF "as:modconf('Cdd_Ipc/Cdd')[as:path(node:dtos(.))='/TI_F29H85x/Cdd_Ipc/Cdd']/CddIpcGeneral/CddIpcIntegrationWithAsrComStackEnable = 'true'"!]
                  <CALL-POINTS>
                    <BSW-DIRECT-CALL-POINT>
                      <SHORT-NAME>PduR_Cdd_Ipc_RxIndication</SHORT-NAME>
                      <CALLED-ENTRY-REF DEST="BSW-MODULE-ENTRY">/AUTOSAR_PduR/BSWModuleEntry/PduR_Cdd_Ipc_RxIndication</CALLED-ENTRY-REF>
                    </BSW-DIRECT-CALL-POINT>
                  </CALL-POINTS>
                  [!ENDIF!]
                  <IMPLEMENTED-ENTRY-REF DEST="BSW-MODULE-ENTRY">/Cdd_Ipc_TI_F29H85x/BSWModuleEntry/Cdd_Ipc_CPU2_L_CPU1_R_INST3_ISR</IMPLEMENTED-ENTRY-REF>
                  [!IF "node:value(CddIpcInteruptType) = 'ISR_CAT2_INT'"!]
                  <INTERRUPT-CATEGORY>CAT-2</INTERRUPT-CATEGORY>
                  [!ELSE!]
                  <INTERRUPT-CATEGORY>CAT-1</INTERRUPT-CATEGORY>
                  [!ENDIF!]
                </BSW-INTERRUPT-ENTITY>
                [!ELSEIF "node:value(CddIpcRxInstance) = 'CDD_IPC_CPU2_L_CPU3_R_INST0'"!]
                <BSW-INTERRUPT-ENTITY UUID="85afffeb-96c8-433e-857b-3d5cdd75d707">
                  <SHORT-NAME>Cdd_Ipc_CPU2_L_CPU3_R_INST0_ISR</SHORT-NAME>
                  <REENTRANCY-LEVEL>NON-REENTRANT</REENTRANCY-LEVEL>
                  [!IF "as:modconf('Cdd_Ipc/Cdd')[as:path(node:dtos(.))='/TI_F29H85x/Cdd_Ipc/Cdd']/CddIpcGeneral/CddIpcIntegrationWithAsrComStackEnable = 'true'"!]
                  <CALL-POINTS>
                    <BSW-DIRECT-CALL-POINT>
                      <SHORT-NAME>PduR_Cdd_Ipc_RxIndication</SHORT-NAME>
                      <CALLED-ENTRY-REF DEST="BSW-MODULE-ENTRY">/AUTOSAR_PduR/BSWModuleEntry/PduR_Cdd_Ipc_RxIndication</CALLED-ENTRY-REF>
                    </BSW-DIRECT-CALL-POINT>
                  </CALL-POINTS>
                  [!ENDIF!]
                  <IMPLEMENTED-ENTRY-REF DEST="BSW-MODULE-ENTRY">/Cdd_Ipc_TI_F29H85x/BSWModuleEntry/Cdd_Ipc_CPU2_L_CPU3_R_INST0_ISR</IMPLEMENTED-ENTRY-REF>
                  [!IF "node:value(CddIpcInteruptType) = 'ISR_CAT2_INT'"!]
                  <INTERRUPT-CATEGORY>CAT-2</INTERRUPT-CATEGORY>
                  [!ELSE!]
                  <INTERRUPT-CATEGORY>CAT-1</INTERRUPT-CATEGORY>
                  [!ENDIF!]
                </BSW-INTERRUPT-ENTITY>
                [!ELSEIF "node:value(CddIpcRxInstance) = 'CDD_IPC_CPU2_L_CPU3_R_INST1'"!]
                <BSW-INTERRUPT-ENTITY UUID="f3c814c7-2273-4205-b5e7-25d2a5cc7df3">
                  <SHORT-NAME>Cdd_Ipc_CPU2_L_CPU3_R_INST1_ISR</SHORT-NAME>
                  <REENTRANCY-LEVEL>NON-REENTRANT</REENTRANCY-LEVEL>
                  [!IF "as:modconf('Cdd_Ipc/Cdd')[as:path(node:dtos(.))='/TI_F29H85x/Cdd_Ipc/Cdd']/CddIpcGeneral/CddIpcIntegrationWithAsrComStackEnable = 'true'"!]
                  <CALL-POINTS>
                    <BSW-DIRECT-CALL-POINT>
                      <SHORT-NAME>PduR_Cdd_Ipc_RxIndication</SHORT-NAME>
                      <CALLED-ENTRY-REF DEST="BSW-MODULE-ENTRY">/AUTOSAR_PduR/BSWModuleEntry/PduR_Cdd_Ipc_RxIndication</CALLED-ENTRY-REF>
                    </BSW-DIRECT-CALL-POINT>
                  </CALL-POINTS>
                  [!ENDIF!]
                  <IMPLEMENTED-ENTRY-REF DEST="BSW-MODULE-ENTRY">/Cdd_Ipc_TI_F29H85x/BSWModuleEntry/Cdd_Ipc_CPU2_L_CPU3_R_INST1_ISR</IMPLEMENTED-ENTRY-REF>
                  [!IF "node:value(CddIpcInteruptType) = 'ISR_CAT2_INT'"!]
                  <INTERRUPT-CATEGORY>CAT-2</INTERRUPT-CATEGORY>
                  [!ELSE!]
                  <INTERRUPT-CATEGORY>CAT-1</INTERRUPT-CATEGORY>
                  [!ENDIF!]
                </BSW-INTERRUPT-ENTITY>
                [!ELSEIF "node:value(CddIpcRxInstance) = 'CDD_IPC_CPU2_L_CPU3_R_INST2'"!]
                <BSW-INTERRUPT-ENTITY UUID="536c71c8-a4b7-4385-9b83-fd76c0d29c1e">
                  <SHORT-NAME>Cdd_Ipc_CPU2_L_CPU3_R_INST2_ISR</SHORT-NAME>
                  <REENTRANCY-LEVEL>NON-REENTRANT</REENTRANCY-LEVEL>
                  [!IF "as:modconf('Cdd_Ipc/Cdd')[as:path(node:dtos(.))='/TI_F29H85x/Cdd_Ipc/Cdd']/CddIpcGeneral/CddIpcIntegrationWithAsrComStackEnable = 'true'"!]
                  <CALL-POINTS>
                    <BSW-DIRECT-CALL-POINT>
                      <SHORT-NAME>PduR_Cdd_Ipc_RxIndication</SHORT-NAME>
                      <CALLED-ENTRY-REF DEST="BSW-MODULE-ENTRY">/AUTOSAR_PduR/BSWModuleEntry/PduR_Cdd_Ipc_RxIndication</CALLED-ENTRY-REF>
                    </BSW-DIRECT-CALL-POINT>
                  </CALL-POINTS>
                  [!ENDIF!]
                  <IMPLEMENTED-ENTRY-REF DEST="BSW-MODULE-ENTRY">/Cdd_Ipc_TI_F29H85x/BSWModuleEntry/Cdd_Ipc_CPU2_L_CPU3_R_INST2_ISR</IMPLEMENTED-ENTRY-REF>
                  [!IF "node:value(CddIpcInteruptType) = 'ISR_CAT2_INT'"!]
                  <INTERRUPT-CATEGORY>CAT-2</INTERRUPT-CATEGORY>
                  [!ELSE!]
                  <INTERRUPT-CATEGORY>CAT-1</INTERRUPT-CATEGORY>
                  [!ENDIF!]
                </BSW-INTERRUPT-ENTITY>
                [!ELSEIF "node:value(CddIpcRxInstance) = 'CDD_IPC_CPU2_L_CPU3_R_INST3'"!]
                <BSW-INTERRUPT-ENTITY UUID="5465dfaf-91ae-45fd-a644-07e15dbd8b5b">
                  <SHORT-NAME>Cdd_Ipc_CPU2_L_CPU3_R_INST3_ISR</SHORT-NAME>
                  <REENTRANCY-LEVEL>NON-REENTRANT</REENTRANCY-LEVEL>
                  [!IF "as:modconf('Cdd_Ipc/Cdd')[as:path(node:dtos(.))='/TI_F29H85x/Cdd_Ipc/Cdd']/CddIpcGeneral/CddIpcIntegrationWithAsrComStackEnable = 'true'"!]
                  <CALL-POINTS>
                    <BSW-DIRECT-CALL-POINT>
                      <SHORT-NAME>PduR_Cdd_Ipc_RxIndication</SHORT-NAME>
                      <CALLED-ENTRY-REF DEST="BSW-MODULE-ENTRY">/AUTOSAR_PduR/BSWModuleEntry/PduR_Cdd_Ipc_RxIndication</CALLED-ENTRY-REF>
                    </BSW-DIRECT-CALL-POINT>
                  </CALL-POINTS>
                  [!ENDIF!]
                  <IMPLEMENTED-ENTRY-REF DEST="BSW-MODULE-ENTRY">/Cdd_Ipc_TI_F29H85x/BSWModuleEntry/Cdd_Ipc_CPU2_L_CPU3_R_INST3_ISR</IMPLEMENTED-ENTRY-REF>
                  [!IF "node:value(CddIpcInteruptType) = 'ISR_CAT2_INT'"!]
                  <INTERRUPT-CATEGORY>CAT-2</INTERRUPT-CATEGORY>
                  [!ELSE!]
                  <INTERRUPT-CATEGORY>CAT-1</INTERRUPT-CATEGORY>
                  [!ENDIF!]
                </BSW-INTERRUPT-ENTITY>
                [!ELSEIF "node:value(CddIpcRxInstance) = 'CDD_IPC_CPU3_L_CPU1_R_INST0'"!]
                <BSW-INTERRUPT-ENTITY UUID="433caf71-9998-4dd1-b282-8ce54b7219c9">
                  <SHORT-NAME>Cdd_Ipc_CPU3_L_CPU1_R_INST0_ISR</SHORT-NAME>
                  <REENTRANCY-LEVEL>NON-REENTRANT</REENTRANCY-LEVEL>
                  [!IF "as:modconf('Cdd_Ipc/Cdd')[as:path(node:dtos(.))='/TI_F29H85x/Cdd_Ipc/Cdd']/CddIpcGeneral/CddIpcIntegrationWithAsrComStackEnable = 'true'"!]
                  <CALL-POINTS>
                    <BSW-DIRECT-CALL-POINT>
                      <SHORT-NAME>PduR_Cdd_Ipc_RxIndication</SHORT-NAME>
                      <CALLED-ENTRY-REF DEST="BSW-MODULE-ENTRY">/AUTOSAR_PduR/BSWModuleEntry/PduR_Cdd_Ipc_RxIndication</CALLED-ENTRY-REF>
                    </BSW-DIRECT-CALL-POINT>
                  </CALL-POINTS>
                  [!ENDIF!]
                  <IMPLEMENTED-ENTRY-REF DEST="BSW-MODULE-ENTRY">/Cdd_Ipc_TI_F29H85x/BSWModuleEntry/Cdd_Ipc_CPU3_L_CPU1_R_INST0_ISR</IMPLEMENTED-ENTRY-REF>
                  [!IF "node:value(CddIpcInteruptType) = 'ISR_CAT2_INT'"!]
                  <INTERRUPT-CATEGORY>CAT-2</INTERRUPT-CATEGORY>
                  [!ELSE!]
                  <INTERRUPT-CATEGORY>CAT-1</INTERRUPT-CATEGORY>
                  [!ENDIF!]
                </BSW-INTERRUPT-ENTITY>
                [!ELSEIF "node:value(CddIpcRxInstance) = 'CDD_IPC_CPU3_L_CPU1_R_INST1'"!]
                <BSW-INTERRUPT-ENTITY UUID="d83b72bd-73cb-4d25-8f69-bccc90432f57">
                  <SHORT-NAME>Cdd_Ipc_CPU3_L_CPU1_R_INST1_ISR</SHORT-NAME>
                  <REENTRANCY-LEVEL>NON-REENTRANT</REENTRANCY-LEVEL>
                  [!IF "as:modconf('Cdd_Ipc/Cdd')[as:path(node:dtos(.))='/TI_F29H85x/Cdd_Ipc/Cdd']/CddIpcGeneral/CddIpcIntegrationWithAsrComStackEnable = 'true'"!]
                  <CALL-POINTS>
                    <BSW-DIRECT-CALL-POINT>
                      <SHORT-NAME>PduR_Cdd_Ipc_RxIndication</SHORT-NAME>
                      <CALLED-ENTRY-REF DEST="BSW-MODULE-ENTRY">/AUTOSAR_PduR/BSWModuleEntry/PduR_Cdd_Ipc_RxIndication</CALLED-ENTRY-REF>
                    </BSW-DIRECT-CALL-POINT>
                  </CALL-POINTS>
                  [!ENDIF!]
                  <IMPLEMENTED-ENTRY-REF DEST="BSW-MODULE-ENTRY">/Cdd_Ipc_TI_F29H85x/BSWModuleEntry/Cdd_Ipc_CPU3_L_CPU1_R_INST1_ISR</IMPLEMENTED-ENTRY-REF>
                  [!IF "node:value(CddIpcInteruptType) = 'ISR_CAT2_INT'"!]
                  <INTERRUPT-CATEGORY>CAT-2</INTERRUPT-CATEGORY>
                  [!ELSE!]
                  <INTERRUPT-CATEGORY>CAT-1</INTERRUPT-CATEGORY>
                  [!ENDIF!]
                </BSW-INTERRUPT-ENTITY>
                [!ELSEIF "node:value(CddIpcRxInstance) = 'CDD_IPC_CPU3_L_CPU1_R_INST2'"!]
                <BSW-INTERRUPT-ENTITY UUID="050bf744-fa45-4bd8-be0a-b06e38f6c8cb">
                  <SHORT-NAME>Cdd_Ipc_CPU3_L_CPU1_R_INST2_ISR</SHORT-NAME>
                  <REENTRANCY-LEVEL>NON-REENTRANT</REENTRANCY-LEVEL>
                  [!IF "as:modconf('Cdd_Ipc/Cdd')[as:path(node:dtos(.))='/TI_F29H85x/Cdd_Ipc/Cdd']/CddIpcGeneral/CddIpcIntegrationWithAsrComStackEnable = 'true'"!]
                  <CALL-POINTS>
                    <BSW-DIRECT-CALL-POINT>
                      <SHORT-NAME>PduR_Cdd_Ipc_RxIndication</SHORT-NAME>
                      <CALLED-ENTRY-REF DEST="BSW-MODULE-ENTRY">/AUTOSAR_PduR/BSWModuleEntry/PduR_Cdd_Ipc_RxIndication</CALLED-ENTRY-REF>
                    </BSW-DIRECT-CALL-POINT>
                  </CALL-POINTS>
                  [!ENDIF!]
                  <IMPLEMENTED-ENTRY-REF DEST="BSW-MODULE-ENTRY">/Cdd_Ipc_TI_F29H85x/BSWModuleEntry/Cdd_Ipc_CPU3_L_CPU1_R_INST2_ISR</IMPLEMENTED-ENTRY-REF>
                  [!IF "node:value(CddIpcInteruptType) = 'ISR_CAT2_INT'"!]
                  <INTERRUPT-CATEGORY>CAT-2</INTERRUPT-CATEGORY>
                  [!ELSE!]
                  <INTERRUPT-CATEGORY>CAT-1</INTERRUPT-CATEGORY>
                  [!ENDIF!]
                </BSW-INTERRUPT-ENTITY>
                [!ELSEIF "node:value(CddIpcRxInstance) = 'CDD_IPC_CPU3_L_CPU1_R_INST3'"!]
                <BSW-INTERRUPT-ENTITY UUID="a9b50479-9b12-4a4a-b54a-0727f2ac3599">
                  <SHORT-NAME>Cdd_Ipc_CPU3_L_CPU1_R_INST3_ISR</SHORT-NAME>
                  <REENTRANCY-LEVEL>NON-REENTRANT</REENTRANCY-LEVEL>
                  [!IF "as:modconf('Cdd_Ipc/Cdd')[as:path(node:dtos(.))='/TI_F29H85x/Cdd_Ipc/Cdd']/CddIpcGeneral/CddIpcIntegrationWithAsrComStackEnable = 'true'"!]
                  <CALL-POINTS>
                    <BSW-DIRECT-CALL-POINT>
                      <SHORT-NAME>PduR_Cdd_Ipc_RxIndication</SHORT-NAME>
                      <CALLED-ENTRY-REF DEST="BSW-MODULE-ENTRY">/AUTOSAR_PduR/BSWModuleEntry/PduR_Cdd_Ipc_RxIndication</CALLED-ENTRY-REF>
                    </BSW-DIRECT-CALL-POINT>
                  </CALL-POINTS>
                  [!ENDIF!]
                  <IMPLEMENTED-ENTRY-REF DEST="BSW-MODULE-ENTRY">/Cdd_Ipc_TI_F29H85x/BSWModuleEntry/Cdd_Ipc_CPU3_L_CPU1_R_INST3_ISR</IMPLEMENTED-ENTRY-REF>
                  [!IF "node:value(CddIpcInteruptType) = 'ISR_CAT2_INT'"!]
                  <INTERRUPT-CATEGORY>CAT-2</INTERRUPT-CATEGORY>
                  [!ELSE!]
                  <INTERRUPT-CATEGORY>CAT-1</INTERRUPT-CATEGORY>
                  [!ENDIF!]
                </BSW-INTERRUPT-ENTITY>
                [!ELSEIF "node:value(CddIpcRxInstance) = 'CDD_IPC_CPU3_L_CPU2_R_INST0'"!]
                <BSW-INTERRUPT-ENTITY UUID="457c341e-d9d2-41f3-8d82-d8b0aac2cd7a">
                  <SHORT-NAME>Cdd_Ipc_CPU3_L_CPU2_R_INST0_ISR</SHORT-NAME>
                  <REENTRANCY-LEVEL>NON-REENTRANT</REENTRANCY-LEVEL>
                  [!IF "as:modconf('Cdd_Ipc/Cdd')[as:path(node:dtos(.))='/TI_F29H85x/Cdd_Ipc/Cdd']/CddIpcGeneral/CddIpcIntegrationWithAsrComStackEnable = 'true'"!]
                  <CALL-POINTS>
                    <BSW-DIRECT-CALL-POINT>
                      <SHORT-NAME>PduR_Cdd_Ipc_RxIndication</SHORT-NAME>
                      <CALLED-ENTRY-REF DEST="BSW-MODULE-ENTRY">/AUTOSAR_PduR/BSWModuleEntry/PduR_Cdd_Ipc_RxIndication</CALLED-ENTRY-REF>
                    </BSW-DIRECT-CALL-POINT>
                  </CALL-POINTS>
                  [!ENDIF!]
                  <IMPLEMENTED-ENTRY-REF DEST="BSW-MODULE-ENTRY">/Cdd_Ipc_TI_F29H85x/BSWModuleEntry/Cdd_Ipc_CPU3_L_CPU2_R_INST0_ISR</IMPLEMENTED-ENTRY-REF>
                  [!IF "node:value(CddIpcInteruptType) = 'ISR_CAT2_INT'"!]
                  <INTERRUPT-CATEGORY>CAT-2</INTERRUPT-CATEGORY>
                  [!ELSE!]
                  <INTERRUPT-CATEGORY>CAT-1</INTERRUPT-CATEGORY>
                  [!ENDIF!]
                </BSW-INTERRUPT-ENTITY>
                [!ELSEIF "node:value(CddIpcRxInstance) = 'CDD_IPC_CPU3_L_CPU2_R_INST1'"!]
                <BSW-INTERRUPT-ENTITY UUID="582dc2cd-01b0-4a76-aa10-04e8d4d75095">
                  <SHORT-NAME>Cdd_Ipc_CPU3_L_CPU2_R_INST1_ISR</SHORT-NAME>
                  <REENTRANCY-LEVEL>NON-REENTRANT</REENTRANCY-LEVEL>
                  [!IF "as:modconf('Cdd_Ipc/Cdd')[as:path(node:dtos(.))='/TI_F29H85x/Cdd_Ipc/Cdd']/CddIpcGeneral/CddIpcIntegrationWithAsrComStackEnable = 'true'"!]
                  <CALL-POINTS>
                    <BSW-DIRECT-CALL-POINT>
                      <SHORT-NAME>PduR_Cdd_Ipc_RxIndication</SHORT-NAME>
                      <CALLED-ENTRY-REF DEST="BSW-MODULE-ENTRY">/AUTOSAR_PduR/BSWModuleEntry/PduR_Cdd_Ipc_RxIndication</CALLED-ENTRY-REF>
                    </BSW-DIRECT-CALL-POINT>
                  </CALL-POINTS>
                  [!ENDIF!]
                  <IMPLEMENTED-ENTRY-REF DEST="BSW-MODULE-ENTRY">/Cdd_Ipc_TI_F29H85x/BSWModuleEntry/Cdd_Ipc_CPU3_L_CPU2_R_INST1_ISR</IMPLEMENTED-ENTRY-REF>
                  [!IF "node:value(CddIpcInteruptType) = 'ISR_CAT2_INT'"!]
                  <INTERRUPT-CATEGORY>CAT-2</INTERRUPT-CATEGORY>
                  [!ELSE!]
                  <INTERRUPT-CATEGORY>CAT-1</INTERRUPT-CATEGORY>
                  [!ENDIF!]
                </BSW-INTERRUPT-ENTITY>
                [!ELSEIF "node:value(CddIpcRxInstance) = 'CDD_IPC_CPU3_L_CPU2_R_INST2'"!]
                <BSW-INTERRUPT-ENTITY UUID="883e8d10-c7fc-4f01-9883-e4b4ebec11ee">
                  <SHORT-NAME>Cdd_Ipc_CPU3_L_CPU2_R_INST2_ISR</SHORT-NAME>
                  <REENTRANCY-LEVEL>NON-REENTRANT</REENTRANCY-LEVEL>
                  [!IF "as:modconf('Cdd_Ipc/Cdd')[as:path(node:dtos(.))='/TI_F29H85x/Cdd_Ipc/Cdd']/CddIpcGeneral/CddIpcIntegrationWithAsrComStackEnable = 'true'"!]
                  <CALL-POINTS>
                    <BSW-DIRECT-CALL-POINT>
                      <SHORT-NAME>PduR_Cdd_Ipc_RxIndication</SHORT-NAME>
                      <CALLED-ENTRY-REF DEST="BSW-MODULE-ENTRY">/AUTOSAR_PduR/BSWModuleEntry/PduR_Cdd_Ipc_RxIndication</CALLED-ENTRY-REF>
                    </BSW-DIRECT-CALL-POINT>
                  </CALL-POINTS>
                  [!ENDIF!]
                  <IMPLEMENTED-ENTRY-REF DEST="BSW-MODULE-ENTRY">/Cdd_Ipc_TI_F29H85x/BSWModuleEntry/Cdd_Ipc_CPU3_L_CPU2_R_INST2_ISR</IMPLEMENTED-ENTRY-REF>
                  [!IF "node:value(CddIpcInteruptType) = 'ISR_CAT2_INT'"!]
                  <INTERRUPT-CATEGORY>CAT-2</INTERRUPT-CATEGORY>
                  [!ELSE!]
                  <INTERRUPT-CATEGORY>CAT-1</INTERRUPT-CATEGORY>
                  [!ENDIF!]
                </BSW-INTERRUPT-ENTITY>
                [!ELSEIF "node:value(CddIpcRxInstance) = 'CDD_IPC_CPU3_L_CPU2_R_INST3'"!]
                <BSW-INTERRUPT-ENTITY UUID="9d2f43f1-cc52-48be-b2db-f83b8305c8f6">
                  <SHORT-NAME>Cdd_Ipc_CPU3_L_CPU2_R_INST3_ISR</SHORT-NAME>
                  <REENTRANCY-LEVEL>NON-REENTRANT</REENTRANCY-LEVEL>
                  [!IF "as:modconf('Cdd_Ipc/Cdd')[as:path(node:dtos(.))='/TI_F29H85x/Cdd_Ipc/Cdd']/CddIpcGeneral/CddIpcIntegrationWithAsrComStackEnable = 'true'"!]
                  <CALL-POINTS>
                    <BSW-DIRECT-CALL-POINT>
                      <SHORT-NAME>PduR_Cdd_Ipc_RxIndication</SHORT-NAME>
                      <CALLED-ENTRY-REF DEST="BSW-MODULE-ENTRY">/AUTOSAR_PduR/BSWModuleEntry/PduR_Cdd_Ipc_RxIndication</CALLED-ENTRY-REF>
                    </BSW-DIRECT-CALL-POINT>
                  </CALL-POINTS>
                  [!ENDIF!]
                  <IMPLEMENTED-ENTRY-REF DEST="BSW-MODULE-ENTRY">/Cdd_Ipc_TI_F29H85x/BSWModuleEntry/Cdd_Ipc_CPU3_L_CPU2_R_INST3_ISR</IMPLEMENTED-ENTRY-REF>
                  [!IF "node:value(CddIpcInteruptType) = 'ISR_CAT2_INT'"!]
                  <INTERRUPT-CATEGORY>CAT-2</INTERRUPT-CATEGORY>
                  [!ELSE!]
                  <INTERRUPT-CATEGORY>CAT-1</INTERRUPT-CATEGORY>
                  [!ENDIF!]
                </BSW-INTERRUPT-ENTITY>
                [!ENDIF!]
                [!ENDLOOP!]
                <BSW-CALLED-ENTITY UUID="697187f9-6152-44c5-94e6-ab973b939569">
                  <SHORT-NAME>Cdd_Ipc_GetCounter</SHORT-NAME>
                  <MINIMUM-START-INTERVAL>0.0</MINIMUM-START-INTERVAL>
                  <REENTRANCY-LEVEL>SINGLE-CORE-REENTRANT</REENTRANCY-LEVEL>
                  <IMPLEMENTED-ENTRY-REF DEST="BSW-MODULE-ENTRY">/Cdd_Ipc_TI_F29H85x/BSWModuleEntry/Cdd_Ipc_GetCounter</IMPLEMENTED-ENTRY-REF>
                </BSW-CALLED-ENTITY>
                [!IF "CddIpcGeneral/CddIpcVersionInfoApi = 'true'"!]
                <BSW-CALLED-ENTITY UUID="c0d5b842-da37-4456-9b0d-c7cc55a7d5df">
                  <SHORT-NAME>Cdd_Ipc_GetVersionInfo</SHORT-NAME>
                  <MINIMUM-START-INTERVAL>0.0</MINIMUM-START-INTERVAL>
                  <REENTRANCY-LEVEL>SINGLE-CORE-REENTRANT</REENTRANCY-LEVEL>
                  [!IF "CddIpcGeneral/CddIpcDevErrorDetect"!]
                  <CALL-POINTS>
                    <BSW-DIRECT-CALL-POINT>
                      <SHORT-NAME>Det_ReportError</SHORT-NAME>
                      <CALLED-ENTRY-REF DEST="BSW-MODULE-ENTRY">/AUTOSAR_Det/BSWModuleEntry/Det_ReportError</CALLED-ENTRY-REF>
                    </BSW-DIRECT-CALL-POINT>
                  </CALL-POINTS>
                  [!ENDIF!]
                  <IMPLEMENTED-ENTRY-REF DEST="BSW-MODULE-ENTRY">/Cdd_Ipc_TI_F29H85x/BSWModuleEntry/Cdd_Ipc_GetVersionInfo</IMPLEMENTED-ENTRY-REF>
                </BSW-CALLED-ENTITY>
                [!ENDIF!]
                <BSW-CALLED-ENTITY UUID="d8235e7d-8323-4046-80dd-e914d4a3cd84">
                  <SHORT-NAME>Cdd_Ipc_Init</SHORT-NAME>
                  <MINIMUM-START-INTERVAL>0.0</MINIMUM-START-INTERVAL>
                  <REENTRANCY-LEVEL>NON-REENTRANT</REENTRANCY-LEVEL>
                  [!IF "CddIpcGeneral/CddIpcDevErrorDetect"!]
                  <CALL-POINTS>
                    <BSW-DIRECT-CALL-POINT>
                      <SHORT-NAME>Det_ReportError</SHORT-NAME>
                      <CALLED-ENTRY-REF DEST="BSW-MODULE-ENTRY">/AUTOSAR_Det/BSWModuleEntry/Det_ReportError</CALLED-ENTRY-REF>
                    </BSW-DIRECT-CALL-POINT>
                  </CALL-POINTS>
                  [!ENDIF!]
                  <IMPLEMENTED-ENTRY-REF DEST="BSW-MODULE-ENTRY">/Cdd_Ipc_TI_F29H85x/BSWModuleEntry/Cdd_Ipc_Init</IMPLEMENTED-ENTRY-REF>
                </BSW-CALLED-ENTITY>
                <BSW-CALLED-ENTITY UUID="1f4715b5-787a-4b50-9c17-ce24040f67b6">
                  <SHORT-NAME>Cdd_Ipc_IsTxInstanceFree</SHORT-NAME>
                  <MINIMUM-START-INTERVAL>0.0</MINIMUM-START-INTERVAL>
                  <REENTRANCY-LEVEL>SINGLE-CORE-REENTRANT</REENTRANCY-LEVEL>
                  [!IF "CddIpcGeneral/CddIpcDevErrorDetect"!]
                  <CALL-POINTS>
                    <BSW-DIRECT-CALL-POINT>
                      <SHORT-NAME>Det_ReportError</SHORT-NAME>
                      <CALLED-ENTRY-REF DEST="BSW-MODULE-ENTRY">/AUTOSAR_Det/BSWModuleEntry/Det_ReportError</CALLED-ENTRY-REF>
                    </BSW-DIRECT-CALL-POINT>
                  </CALL-POINTS>
                  [!ENDIF!]
                  <IMPLEMENTED-ENTRY-REF DEST="BSW-MODULE-ENTRY">/Cdd_Ipc_TI_F29H85x/BSWModuleEntry/Cdd_Ipc_IsTxInstanceFree</IMPLEMENTED-ENTRY-REF>
                </BSW-CALLED-ENTITY>
                <BSW-SCHEDULABLE-ENTITY UUID="0a2ee4e6-1098-4061-b034-f5ab36b433af">
                  <SHORT-NAME>Cdd_Ipc_MainFunction_Read</SHORT-NAME>
                  <CAN-ENTER-EXCLUSIVE-AREA-REFS>
                    <CAN-ENTER-EXCLUSIVE-AREA-REF DEST="EXCLUSIVE-AREA">/Cdd_Ipc_TI_F29H85x/Cdd_Ipc/Cdd_Ipc_Behavior/CDD_IPC_EXCLUSIVE_AREA_1</CAN-ENTER-EXCLUSIVE-AREA-REF>
                  </CAN-ENTER-EXCLUSIVE-AREA-REFS>
                  <REENTRANCY-LEVEL>SINGLE-CORE-REENTRANT</REENTRANCY-LEVEL>
                  [!IF "CddIpcGeneral/CddIpcIntegrationWithAsrComStackEnable = 'true'"!]
                  <CALL-POINTS>
                    <BSW-DIRECT-CALL-POINT>
                      <SHORT-NAME>PduR_Cdd_Ipc_RxIndication</SHORT-NAME>
                      <CALLED-ENTRY-REF DEST="BSW-MODULE-ENTRY">/AUTOSAR_PduR/BSWModuleEntry/PduR_Cdd_Ipc_RxIndication</CALLED-ENTRY-REF>
                    </BSW-DIRECT-CALL-POINT>
                  </CALL-POINTS>
                  [!ENDIF!]
                  <IMPLEMENTED-ENTRY-REF DEST="BSW-MODULE-ENTRY">/Cdd_Ipc_TI_F29H85x/BSWModuleEntry/Cdd_Ipc_MainFunction_Read</IMPLEMENTED-ENTRY-REF>
                </BSW-SCHEDULABLE-ENTITY>
                <BSW-CALLED-ENTITY UUID="8d031dd6-f8b9-40d9-8c63-c215317903fb">
                  <SHORT-NAME>Cdd_Ipc_Sync</SHORT-NAME>
                  <MINIMUM-START-INTERVAL>0.0</MINIMUM-START-INTERVAL>
                  <REENTRANCY-LEVEL>NON-REENTRANT</REENTRANCY-LEVEL>
                  [!IF "CddIpcGeneral/CddIpcDevErrorDetect"!]
                  <CALL-POINTS>
                    <BSW-DIRECT-CALL-POINT>
                      <SHORT-NAME>Det_ReportError</SHORT-NAME>
                      <CALLED-ENTRY-REF DEST="BSW-MODULE-ENTRY">/AUTOSAR_Det/BSWModuleEntry/Det_ReportError</CALLED-ENTRY-REF>
                    </BSW-DIRECT-CALL-POINT>
                  </CALL-POINTS>
                  [!ENDIF!]
                  <IMPLEMENTED-ENTRY-REF DEST="BSW-MODULE-ENTRY">/Cdd_Ipc_TI_F29H85x/BSWModuleEntry/Cdd_Ipc_Sync</IMPLEMENTED-ENTRY-REF>
                </BSW-CALLED-ENTITY>
                <BSW-CALLED-ENTITY UUID="05f5e7f5-82a6-4a01-91af-f9a55fa965b8">
                  <SHORT-NAME>Cdd_Ipc_Transmit</SHORT-NAME>
                  <CAN-ENTER-EXCLUSIVE-AREA-REFS>
                    <CAN-ENTER-EXCLUSIVE-AREA-REF DEST="EXCLUSIVE-AREA">/Cdd_Ipc_TI_F29H85x/Cdd_Ipc/Cdd_Ipc_Behavior/CDD_IPC_EXCLUSIVE_AREA_0</CAN-ENTER-EXCLUSIVE-AREA-REF>
                  </CAN-ENTER-EXCLUSIVE-AREA-REFS>
                  <MINIMUM-START-INTERVAL>0.0</MINIMUM-START-INTERVAL>
                  <REENTRANCY-LEVEL>SINGLE-CORE-REENTRANT</REENTRANCY-LEVEL>
                  [!IF "CddIpcGeneral/CddIpcDevErrorDetect"!]
                  <CALL-POINTS>
                    <BSW-DIRECT-CALL-POINT>
                      <SHORT-NAME>Det_ReportError</SHORT-NAME>
                      <CALLED-ENTRY-REF DEST="BSW-MODULE-ENTRY">/AUTOSAR_Det/BSWModuleEntry/Det_ReportError</CALLED-ENTRY-REF>
                    </BSW-DIRECT-CALL-POINT>
                  </CALL-POINTS>
                  [!ENDIF!]
                  <IMPLEMENTED-ENTRY-REF DEST="BSW-MODULE-ENTRY">/Cdd_Ipc_TI_F29H85x/BSWModuleEntry/Cdd_Ipc_Transmit</IMPLEMENTED-ENTRY-REF>
                </BSW-CALLED-ENTITY>
              </ENTITYS>
              <EVENTS>
                <BSW-TIMING-EVENT UUID="35ea8b2e-e764-4486-adeb-56757b7be741">
                  <SHORT-NAME>Cdd_Ipc_MainFunctionTimingEvent_Read</SHORT-NAME>
                  <STARTS-ON-EVENT-REF DEST="BSW-SCHEDULABLE-ENTITY">/Cdd_Ipc_TI_F29H85x/Cdd_Ipc/Cdd_Ipc_Behavior/Cdd_Ipc_MainFunction_Read</STARTS-ON-EVENT-REF>
                  <PERIOD>[!"as:modconf('Cdd_Ipc/Cdd')[as:path(node:dtos(.))='/TI_F29H85x/Cdd_Ipc/Cdd']/CddIpcGeneral/CddIpcMainFunctionReadPeriod"!]</PERIOD>
                </BSW-TIMING-EVENT>
              </EVENTS>
            </BSW-INTERNAL-BEHAVIOR>
          </INTERNAL-BEHAVIORS>
        </BSW-MODULE-DESCRIPTION>
        <BSW-IMPLEMENTATION UUID="666784fe-7d94-4f1b-85ca-1aeab107d4c4">
          <SHORT-NAME>Cdd_Ipc_Impl</SHORT-NAME>
          <CODE-DESCRIPTORS>
            <CODE UUID="783b85b8-42ae-4d6d-958e-572cf2ffa353">
              <SHORT-NAME>Files</SHORT-NAME>
              <ARTIFACT-DESCRIPTORS>
                <AUTOSAR-ENGINEERING-OBJECT>
                  <SHORT-LABEL>generate::include::Cdd_Ipc_Cfg.h</SHORT-LABEL>
                  <CATEGORY>SWHDR</CATEGORY>
                </AUTOSAR-ENGINEERING-OBJECT>
                <AUTOSAR-ENGINEERING-OBJECT>
                  <SHORT-LABEL>generate::src::Cdd_Ipc_Cfg.c</SHORT-LABEL>
                  <CATEGORY>SWSRC</CATEGORY>
                </AUTOSAR-ENGINEERING-OBJECT>
                <AUTOSAR-ENGINEERING-OBJECT>
                  <SHORT-LABEL>include::Cdd_Ipc.h</SHORT-LABEL>
                  <CATEGORY>SWHDR</CATEGORY>
                </AUTOSAR-ENGINEERING-OBJECT>
                <AUTOSAR-ENGINEERING-OBJECT>
                  <SHORT-LABEL>include::Cdd_Ipc_Priv.h</SHORT-LABEL>
                  <CATEGORY>SWHDR</CATEGORY>
                </AUTOSAR-ENGINEERING-OBJECT>
                <AUTOSAR-ENGINEERING-OBJECT>
                  <SHORT-LABEL>src::Cdd_Ipc.c</SHORT-LABEL>
                  <CATEGORY>SWSRC</CATEGORY>
                </AUTOSAR-ENGINEERING-OBJECT>
                <AUTOSAR-ENGINEERING-OBJECT>
                  <SHORT-LABEL>src::Cdd_Ipc_Irq.c</SHORT-LABEL>
                  <CATEGORY>SWSRC</CATEGORY>
                </AUTOSAR-ENGINEERING-OBJECT>
                <AUTOSAR-ENGINEERING-OBJECT>
                  <SHORT-LABEL>src::Cdd_Ipc_Priv.c</SHORT-LABEL>
                  <CATEGORY>SWSRC</CATEGORY>
                </AUTOSAR-ENGINEERING-OBJECT>
              </ARTIFACT-DESCRIPTORS>
            </CODE>
          </CODE-DESCRIPTORS>
          <COMPILERS>
            <COMPILER UUID="475f8cc2-a3f5-4054-a8e4-e13fec941460">
              <SHORT-NAME>c29clang</SHORT-NAME>
              <NAME>TI C29 Clang Compiler</NAME>
              <VENDOR>Texas Instruments</VENDOR>
              <VERSION>2.0.0</VERSION>
            </COMPILER>
          </COMPILERS>
          <LINKERS>
            <LINKER UUID="4fe275e4-a28e-4d29-8018-8b1fdd4ad6f3">
              <SHORT-NAME>c29lnk</SHORT-NAME>
              <NAME>TI C29 Linker</NAME>
              <VENDOR>Texas Instruments</VENDOR>
              <VERSION>2.0.0</VERSION>
            </LINKER>
          </LINKERS>
          <PROGRAMMING-LANGUAGE>C</PROGRAMMING-LANGUAGE>
          <RESOURCE-CONSUMPTION UUID="43339566-64e1-4b7b-8ae2-3b50c2d7c8d9">
            <SHORT-NAME>ResourceConsumption</SHORT-NAME>
            <MEMORY-SECTIONS>
              <MEMORY-SECTION UUID="ca9c16fb-ec2e-4bd3-b6c1-05669f4609ca">
                <SHORT-NAME>CDD_IPC_CODE</SHORT-NAME>
                <ALIGNMENT>UNSPECIFIED</ALIGNMENT>
                <SW-ADDRMETHOD-REF DEST="SW-ADDR-METHOD">/AUTOSAR_MemMap/SwAddrMethods/CODE</SW-ADDRMETHOD-REF>
                <SYMBOL>CODE</SYMBOL>
              </MEMORY-SECTION>
              <MEMORY-SECTION UUID="f18248a4-feb6-43e6-8bf9-a05c5ff81b10">
                <SHORT-NAME>CDD_IPC_CONFIG_DATA</SHORT-NAME>
                <ALIGNMENT>UNSPECIFIED</ALIGNMENT>
                <SW-ADDRMETHOD-REF DEST="SW-ADDR-METHOD">/AUTOSAR_MemMap/SwAddrMethods/CONST_PBCFG</SW-ADDRMETHOD-REF>
                <SYMBOL>CONFIG_DATA</SYMBOL>
              </MEMORY-SECTION>
              <MEMORY-SECTION UUID="c41d032a-ccf3-4bf2-9a7b-914365466257">
                <SHORT-NAME>CDD_IPC_CONST_32</SHORT-NAME>
                <ALIGNMENT>8</ALIGNMENT>
                <SW-ADDRMETHOD-REF DEST="SW-ADDR-METHOD">/AUTOSAR_MemMap/SwAddrMethods/CONST_32</SW-ADDRMETHOD-REF>
                <SYMBOL>CONST_32</SYMBOL>
              </MEMORY-SECTION>
              <MEMORY-SECTION UUID="c1acd713-3f2a-449b-88c7-cb70dd9a0e85">
                <SHORT-NAME>CDD_IPC_ISR_CODE</SHORT-NAME>
                <ALIGNMENT>UNSPECIFIED</ALIGNMENT>
                <SW-ADDRMETHOD-REF DEST="SW-ADDR-METHOD">/AUTOSAR_MemMap/SwAddrMethods/CODE</SW-ADDRMETHOD-REF>
                <SYMBOL>ISR_CODE</SYMBOL>
              </MEMORY-SECTION>
              <MEMORY-SECTION UUID="28ec50e8-cd0e-49e6-a0e5-edc39a58a06b">
                <SHORT-NAME>CDD_IPC_VAR_INIT_BOOLEAN</SHORT-NAME>
                <ALIGNMENT>8</ALIGNMENT>
                <SW-ADDRMETHOD-REF DEST="SW-ADDR-METHOD">/AUTOSAR_MemMap/SwAddrMethods/VAR_INIT</SW-ADDRMETHOD-REF>
                <SYMBOL>VAR_INIT_BOOLEAN</SYMBOL>
              </MEMORY-SECTION>
              <MEMORY-SECTION UUID="715ad91a-3473-4f26-be21-1ad003555db7">
                <SHORT-NAME>CDD_IPC_VAR_INIT_PTR</SHORT-NAME>
                <ALIGNMENT>UNSPECIFIED</ALIGNMENT>
                <SW-ADDRMETHOD-REF DEST="SW-ADDR-METHOD">/AUTOSAR_MemMap/SwAddrMethods/VAR_INIT</SW-ADDRMETHOD-REF>
                <SYMBOL>VAR_INIT_PTR</SYMBOL>
              </MEMORY-SECTION>
            </MEMORY-SECTIONS>
          </RESOURCE-CONSUMPTION>
          <SW-VERSION>[!"$moduleSoftwareVer"!]</SW-VERSION>
          <VENDOR-ID>44</VENDOR-ID>
          <AR-RELEASE-VERSION>[!"substring-after($moduleReleaseVer, 'AUTOSAR ')"!]</AR-RELEASE-VERSION>
          <BEHAVIOR-REF DEST="BSW-INTERNAL-BEHAVIOR">/Cdd_Ipc_TI_F29H85x/Cdd_Ipc/Cdd_Ipc_Behavior</BEHAVIOR-REF>
          <VENDOR-SPECIFIC-MODULE-DEF-REFS>
            <VENDOR-SPECIFIC-MODULE-DEF-REF DEST="ECUC-MODULE-DEF">/TI_F29H85x/Cdd_Ipc/Cdd</VENDOR-SPECIFIC-MODULE-DEF-REF>
          </VENDOR-SPECIFIC-MODULE-DEF-REFS>
        </BSW-IMPLEMENTATION>
      </ELEMENTS>
      <AR-PACKAGES>
        <AR-PACKAGE UUID="3a9c1564-c7e3-40de-9cf5-cfc294740f3a">
          <SHORT-NAME>BSWModuleEntry</SHORT-NAME>
          <ELEMENTS>
            <BSW-MODULE-ENTRY UUID="44431d29-ba0d-41d0-a391-dc276e5c328f">
              <SHORT-NAME>Cdd_Ipc_CPU1_L_CPU2_R_INST0_ISR</SHORT-NAME>
              <IS-REENTRANT>false</IS-REENTRANT>
              <IS-SYNCHRONOUS>true</IS-SYNCHRONOUS>
              <CALL-TYPE>INTERRUPT</CALL-TYPE>
[!IF "$Cdd_Ipc_CPU1_L_CPU2_R_INST0_ISR_cat = 2"!][!//
              <EXECUTION-CONTEXT>INTERRUPT-CAT-2</EXECUTION-CONTEXT>
[!ELSE!][!//
              <EXECUTION-CONTEXT>INTERRUPT-CAT-1</EXECUTION-CONTEXT>
[!ENDIF!]
              <SW-SERVICE-IMPL-POLICY>STANDARD</SW-SERVICE-IMPL-POLICY>
              <BSW-ENTRY-KIND>CONCRETE</BSW-ENTRY-KIND>
            </BSW-MODULE-ENTRY>
            <BSW-MODULE-ENTRY UUID="880d8a68-a5fc-4f60-9a56-f8359f7cead5">
              <SHORT-NAME>Cdd_Ipc_CPU1_L_CPU2_R_INST1_ISR</SHORT-NAME>
              <IS-REENTRANT>false</IS-REENTRANT>
              <IS-SYNCHRONOUS>true</IS-SYNCHRONOUS>
              <CALL-TYPE>INTERRUPT</CALL-TYPE>
[!IF "$Cdd_Ipc_CPU1_L_CPU2_R_INST1_ISR_cat = 2"!][!//
              <EXECUTION-CONTEXT>INTERRUPT-CAT-2</EXECUTION-CONTEXT>
[!ELSE!][!//
              <EXECUTION-CONTEXT>INTERRUPT-CAT-1</EXECUTION-CONTEXT>
[!ENDIF!]
              <SW-SERVICE-IMPL-POLICY>STANDARD</SW-SERVICE-IMPL-POLICY>
              <BSW-ENTRY-KIND>CONCRETE</BSW-ENTRY-KIND>
            </BSW-MODULE-ENTRY>
            <BSW-MODULE-ENTRY UUID="5db71597-bb3f-4419-bcd0-54ef4b2fe1a5">
              <SHORT-NAME>Cdd_Ipc_CPU1_L_CPU2_R_INST2_ISR</SHORT-NAME>
              <IS-REENTRANT>false</IS-REENTRANT>
              <IS-SYNCHRONOUS>true</IS-SYNCHRONOUS>
              <CALL-TYPE>INTERRUPT</CALL-TYPE>
[!IF "$Cdd_Ipc_CPU1_L_CPU2_R_INST2_ISR_cat = 2"!][!//
              <EXECUTION-CONTEXT>INTERRUPT-CAT-2</EXECUTION-CONTEXT>
[!ELSE!][!//
              <EXECUTION-CONTEXT>INTERRUPT-CAT-1</EXECUTION-CONTEXT>
[!ENDIF!]
              <SW-SERVICE-IMPL-POLICY>STANDARD</SW-SERVICE-IMPL-POLICY>
              <BSW-ENTRY-KIND>CONCRETE</BSW-ENTRY-KIND>
            </BSW-MODULE-ENTRY>
            <BSW-MODULE-ENTRY UUID="00c8ac80-fa85-46c6-84d0-baaeb0d17616">
              <SHORT-NAME>Cdd_Ipc_CPU1_L_CPU2_R_INST3_ISR</SHORT-NAME>
              <IS-REENTRANT>false</IS-REENTRANT>
              <IS-SYNCHRONOUS>true</IS-SYNCHRONOUS>
              <CALL-TYPE>INTERRUPT</CALL-TYPE>
[!IF "$Cdd_Ipc_CPU1_L_CPU2_R_INST3_ISR_cat = 2"!][!//
              <EXECUTION-CONTEXT>INTERRUPT-CAT-2</EXECUTION-CONTEXT>
[!ELSE!][!//
              <EXECUTION-CONTEXT>INTERRUPT-CAT-1</EXECUTION-CONTEXT>
[!ENDIF!]
              <SW-SERVICE-IMPL-POLICY>STANDARD</SW-SERVICE-IMPL-POLICY>
              <BSW-ENTRY-KIND>CONCRETE</BSW-ENTRY-KIND>
            </BSW-MODULE-ENTRY>
            <BSW-MODULE-ENTRY UUID="4b2e0002-0587-4470-bb9b-1ab4202f1055">
              <SHORT-NAME>Cdd_Ipc_CPU1_L_CPU3_R_INST0_ISR</SHORT-NAME>
              <IS-REENTRANT>false</IS-REENTRANT>
              <IS-SYNCHRONOUS>true</IS-SYNCHRONOUS>
              <CALL-TYPE>INTERRUPT</CALL-TYPE>
[!IF "$Cdd_Ipc_CPU1_L_CPU3_R_INST0_ISR_cat = 2"!][!//
              <EXECUTION-CONTEXT>INTERRUPT-CAT-2</EXECUTION-CONTEXT>
[!ELSE!][!//
              <EXECUTION-CONTEXT>INTERRUPT-CAT-1</EXECUTION-CONTEXT>
[!ENDIF!]
              <SW-SERVICE-IMPL-POLICY>STANDARD</SW-SERVICE-IMPL-POLICY>
              <BSW-ENTRY-KIND>CONCRETE</BSW-ENTRY-KIND>
            </BSW-MODULE-ENTRY>
            <BSW-MODULE-ENTRY UUID="67ba9384-14b2-42ca-82e3-fe7244cec549">
              <SHORT-NAME>Cdd_Ipc_CPU1_L_CPU3_R_INST1_ISR</SHORT-NAME>
              <IS-REENTRANT>false</IS-REENTRANT>
              <IS-SYNCHRONOUS>true</IS-SYNCHRONOUS>
              <CALL-TYPE>INTERRUPT</CALL-TYPE>
[!IF "$Cdd_Ipc_CPU1_L_CPU3_R_INST1_ISR_cat = 2"!][!//
              <EXECUTION-CONTEXT>INTERRUPT-CAT-2</EXECUTION-CONTEXT>
[!ELSE!][!//
              <EXECUTION-CONTEXT>INTERRUPT-CAT-1</EXECUTION-CONTEXT>
[!ENDIF!]
              <SW-SERVICE-IMPL-POLICY>STANDARD</SW-SERVICE-IMPL-POLICY>
              <BSW-ENTRY-KIND>CONCRETE</BSW-ENTRY-KIND>
            </BSW-MODULE-ENTRY>
            <BSW-MODULE-ENTRY UUID="5a0d327d-1547-4b51-b9cc-e7d296876174">
              <SHORT-NAME>Cdd_Ipc_CPU1_L_CPU3_R_INST2_ISR</SHORT-NAME>
              <IS-REENTRANT>false</IS-REENTRANT>
              <IS-SYNCHRONOUS>true</IS-SYNCHRONOUS>
              <CALL-TYPE>INTERRUPT</CALL-TYPE>
[!IF "$Cdd_Ipc_CPU1_L_CPU3_R_INST2_ISR_cat = 2"!][!//
              <EXECUTION-CONTEXT>INTERRUPT-CAT-2</EXECUTION-CONTEXT>
[!ELSE!][!//
              <EXECUTION-CONTEXT>INTERRUPT-CAT-1</EXECUTION-CONTEXT>
[!ENDIF!]
              <SW-SERVICE-IMPL-POLICY>STANDARD</SW-SERVICE-IMPL-POLICY>
              <BSW-ENTRY-KIND>CONCRETE</BSW-ENTRY-KIND>
            </BSW-MODULE-ENTRY>
            <BSW-MODULE-ENTRY UUID="85246a67-a2a4-4546-9fb2-40d27fc57892">
              <SHORT-NAME>Cdd_Ipc_CPU1_L_CPU3_R_INST3_ISR</SHORT-NAME>
              <IS-REENTRANT>false</IS-REENTRANT>
              <IS-SYNCHRONOUS>true</IS-SYNCHRONOUS>
              <CALL-TYPE>INTERRUPT</CALL-TYPE>
[!IF "$Cdd_Ipc_CPU1_L_CPU3_R_INST3_ISR_cat = 2"!][!//
              <EXECUTION-CONTEXT>INTERRUPT-CAT-2</EXECUTION-CONTEXT>
[!ELSE!][!//
              <EXECUTION-CONTEXT>INTERRUPT-CAT-1</EXECUTION-CONTEXT>
[!ENDIF!]
              <SW-SERVICE-IMPL-POLICY>STANDARD</SW-SERVICE-IMPL-POLICY>
              <BSW-ENTRY-KIND>CONCRETE</BSW-ENTRY-KIND>
            </BSW-MODULE-ENTRY>
            <BSW-MODULE-ENTRY UUID="1ded7cd1-4524-48e3-a413-2a52785adb2b">
              <SHORT-NAME>Cdd_Ipc_CPU2_L_CPU1_R_INST0_ISR</SHORT-NAME>
              <IS-REENTRANT>false</IS-REENTRANT>
              <IS-SYNCHRONOUS>true</IS-SYNCHRONOUS>
              <CALL-TYPE>INTERRUPT</CALL-TYPE>
[!IF "$Cdd_Ipc_CPU2_L_CPU1_R_INST0_ISR_cat = 2"!][!//
              <EXECUTION-CONTEXT>INTERRUPT-CAT-2</EXECUTION-CONTEXT>
[!ELSE!][!//
              <EXECUTION-CONTEXT>INTERRUPT-CAT-1</EXECUTION-CONTEXT>
[!ENDIF!]
              <SW-SERVICE-IMPL-POLICY>STANDARD</SW-SERVICE-IMPL-POLICY>
              <BSW-ENTRY-KIND>CONCRETE</BSW-ENTRY-KIND>
            </BSW-MODULE-ENTRY>
            <BSW-MODULE-ENTRY UUID="e841db5d-3c53-4428-bb44-ec9dfc76f5ad">
              <SHORT-NAME>Cdd_Ipc_CPU2_L_CPU1_R_INST1_ISR</SHORT-NAME>
              <IS-REENTRANT>false</IS-REENTRANT>
              <IS-SYNCHRONOUS>true</IS-SYNCHRONOUS>
              <CALL-TYPE>INTERRUPT</CALL-TYPE>
[!IF "$Cdd_Ipc_CPU2_L_CPU1_R_INST1_ISR_cat = 2"!][!//
              <EXECUTION-CONTEXT>INTERRUPT-CAT-2</EXECUTION-CONTEXT>
[!ELSE!][!//
              <EXECUTION-CONTEXT>INTERRUPT-CAT-1</EXECUTION-CONTEXT>
[!ENDIF!]
              <SW-SERVICE-IMPL-POLICY>STANDARD</SW-SERVICE-IMPL-POLICY>
              <BSW-ENTRY-KIND>CONCRETE</BSW-ENTRY-KIND>
            </BSW-MODULE-ENTRY>
            <BSW-MODULE-ENTRY UUID="54a402c6-7521-49db-bf8e-73ab844757be">
              <SHORT-NAME>Cdd_Ipc_CPU2_L_CPU1_R_INST2_ISR</SHORT-NAME>
              <IS-REENTRANT>false</IS-REENTRANT>
              <IS-SYNCHRONOUS>true</IS-SYNCHRONOUS>
              <CALL-TYPE>INTERRUPT</CALL-TYPE>
[!IF "$Cdd_Ipc_CPU2_L_CPU1_R_INST2_ISR_cat = 2"!][!//
              <EXECUTION-CONTEXT>INTERRUPT-CAT-2</EXECUTION-CONTEXT>
[!ELSE!][!//
              <EXECUTION-CONTEXT>INTERRUPT-CAT-1</EXECUTION-CONTEXT>
[!ENDIF!]
              <SW-SERVICE-IMPL-POLICY>STANDARD</SW-SERVICE-IMPL-POLICY>
              <BSW-ENTRY-KIND>CONCRETE</BSW-ENTRY-KIND>
            </BSW-MODULE-ENTRY>
            <BSW-MODULE-ENTRY UUID="eaa7cb10-867e-435c-9080-53f6a6a4525f">
              <SHORT-NAME>Cdd_Ipc_CPU2_L_CPU1_R_INST3_ISR</SHORT-NAME>
              <IS-REENTRANT>false</IS-REENTRANT>
              <IS-SYNCHRONOUS>true</IS-SYNCHRONOUS>
              <CALL-TYPE>INTERRUPT</CALL-TYPE>
[!IF "$Cdd_Ipc_CPU2_L_CPU1_R_INST3_ISR_cat = 2"!][!//
              <EXECUTION-CONTEXT>INTERRUPT-CAT-2</EXECUTION-CONTEXT>
[!ELSE!][!//
              <EXECUTION-CONTEXT>INTERRUPT-CAT-1</EXECUTION-CONTEXT>
[!ENDIF!]
              <SW-SERVICE-IMPL-POLICY>STANDARD</SW-SERVICE-IMPL-POLICY>
              <BSW-ENTRY-KIND>CONCRETE</BSW-ENTRY-KIND>
            </BSW-MODULE-ENTRY>
            <BSW-MODULE-ENTRY UUID="7fc0f92a-98ec-4b9d-a37b-06da7f622212">
              <SHORT-NAME>Cdd_Ipc_CPU2_L_CPU3_R_INST0_ISR</SHORT-NAME>
              <IS-REENTRANT>false</IS-REENTRANT>
              <IS-SYNCHRONOUS>true</IS-SYNCHRONOUS>
              <CALL-TYPE>INTERRUPT</CALL-TYPE>
[!IF "$Cdd_Ipc_CPU2_L_CPU3_R_INST0_ISR_cat = 2"!][!//
              <EXECUTION-CONTEXT>INTERRUPT-CAT-2</EXECUTION-CONTEXT>
[!ELSE!][!//
              <EXECUTION-CONTEXT>INTERRUPT-CAT-1</EXECUTION-CONTEXT>
[!ENDIF!]
              <SW-SERVICE-IMPL-POLICY>STANDARD</SW-SERVICE-IMPL-POLICY>
              <BSW-ENTRY-KIND>CONCRETE</BSW-ENTRY-KIND>
            </BSW-MODULE-ENTRY>
            <BSW-MODULE-ENTRY UUID="81d02ffa-74ac-4c14-aac6-daec668ff743">
              <SHORT-NAME>Cdd_Ipc_CPU2_L_CPU3_R_INST1_ISR</SHORT-NAME>
              <IS-REENTRANT>false</IS-REENTRANT>
              <IS-SYNCHRONOUS>true</IS-SYNCHRONOUS>
              <CALL-TYPE>INTERRUPT</CALL-TYPE>
[!IF "$Cdd_Ipc_CPU2_L_CPU3_R_INST1_ISR_cat = 2"!][!//
              <EXECUTION-CONTEXT>INTERRUPT-CAT-2</EXECUTION-CONTEXT>
[!ELSE!][!//
              <EXECUTION-CONTEXT>INTERRUPT-CAT-1</EXECUTION-CONTEXT>
[!ENDIF!]
              <SW-SERVICE-IMPL-POLICY>STANDARD</SW-SERVICE-IMPL-POLICY>
              <BSW-ENTRY-KIND>CONCRETE</BSW-ENTRY-KIND>
            </BSW-MODULE-ENTRY>
            <BSW-MODULE-ENTRY UUID="3aa93b16-da82-4fe1-9c22-a9f64c6d67fc">
              <SHORT-NAME>Cdd_Ipc_CPU2_L_CPU3_R_INST2_ISR</SHORT-NAME>
              <IS-REENTRANT>false</IS-REENTRANT>
              <IS-SYNCHRONOUS>true</IS-SYNCHRONOUS>
              <CALL-TYPE>INTERRUPT</CALL-TYPE>
[!IF "$Cdd_Ipc_CPU2_L_CPU3_R_INST2_ISR_cat = 2"!][!//
              <EXECUTION-CONTEXT>INTERRUPT-CAT-2</EXECUTION-CONTEXT>
[!ELSE!][!//
              <EXECUTION-CONTEXT>INTERRUPT-CAT-1</EXECUTION-CONTEXT>
[!ENDIF!]
              <SW-SERVICE-IMPL-POLICY>STANDARD</SW-SERVICE-IMPL-POLICY>
              <BSW-ENTRY-KIND>CONCRETE</BSW-ENTRY-KIND>
            </BSW-MODULE-ENTRY>
            <BSW-MODULE-ENTRY UUID="60cc6b5d-8753-4cbe-aac5-050a065a49f4">
              <SHORT-NAME>Cdd_Ipc_CPU2_L_CPU3_R_INST3_ISR</SHORT-NAME>
              <IS-REENTRANT>false</IS-REENTRANT>
              <IS-SYNCHRONOUS>true</IS-SYNCHRONOUS>
              <CALL-TYPE>INTERRUPT</CALL-TYPE>
[!IF "$Cdd_Ipc_CPU2_L_CPU3_R_INST3_ISR_cat = 2"!][!//
              <EXECUTION-CONTEXT>INTERRUPT-CAT-2</EXECUTION-CONTEXT>
[!ELSE!][!//
              <EXECUTION-CONTEXT>INTERRUPT-CAT-1</EXECUTION-CONTEXT>
[!ENDIF!]
              <SW-SERVICE-IMPL-POLICY>STANDARD</SW-SERVICE-IMPL-POLICY>
              <BSW-ENTRY-KIND>CONCRETE</BSW-ENTRY-KIND>
            </BSW-MODULE-ENTRY>
            <BSW-MODULE-ENTRY UUID="7f0ee0c8-9b0b-4a66-89d4-ad97f2b9c554">
              <SHORT-NAME>Cdd_Ipc_CPU3_L_CPU1_R_INST0_ISR</SHORT-NAME>
              <IS-REENTRANT>false</IS-REENTRANT>
              <IS-SYNCHRONOUS>true</IS-SYNCHRONOUS>
              <CALL-TYPE>INTERRUPT</CALL-TYPE>
[!IF "$Cdd_Ipc_CPU3_L_CPU1_R_INST0_ISR_cat = 2"!][!//
              <EXECUTION-CONTEXT>INTERRUPT-CAT-2</EXECUTION-CONTEXT>
[!ELSE!][!//
              <EXECUTION-CONTEXT>INTERRUPT-CAT-1</EXECUTION-CONTEXT>
[!ENDIF!]
              <SW-SERVICE-IMPL-POLICY>STANDARD</SW-SERVICE-IMPL-POLICY>
              <BSW-ENTRY-KIND>CONCRETE</BSW-ENTRY-KIND>
            </BSW-MODULE-ENTRY>
            <BSW-MODULE-ENTRY UUID="9aff145a-6fb0-4cfd-b9b3-3bec74f76b34">
              <SHORT-NAME>Cdd_Ipc_CPU3_L_CPU1_R_INST1_ISR</SHORT-NAME>
              <IS-REENTRANT>false</IS-REENTRANT>
              <IS-SYNCHRONOUS>true</IS-SYNCHRONOUS>
              <CALL-TYPE>INTERRUPT</CALL-TYPE>
[!IF "$Cdd_Ipc_CPU3_L_CPU1_R_INST1_ISR_cat = 2"!][!//
              <EXECUTION-CONTEXT>INTERRUPT-CAT-2</EXECUTION-CONTEXT>
[!ELSE!][!//
              <EXECUTION-CONTEXT>INTERRUPT-CAT-1</EXECUTION-CONTEXT>
[!ENDIF!]
              <SW-SERVICE-IMPL-POLICY>STANDARD</SW-SERVICE-IMPL-POLICY>
              <BSW-ENTRY-KIND>CONCRETE</BSW-ENTRY-KIND>
            </BSW-MODULE-ENTRY>
            <BSW-MODULE-ENTRY UUID="e466166c-e15d-4906-a7bf-da0fa28a078b">
              <SHORT-NAME>Cdd_Ipc_CPU3_L_CPU1_R_INST2_ISR</SHORT-NAME>
              <IS-REENTRANT>false</IS-REENTRANT>
              <IS-SYNCHRONOUS>true</IS-SYNCHRONOUS>
              <CALL-TYPE>INTERRUPT</CALL-TYPE>
[!IF "$Cdd_Ipc_CPU3_L_CPU1_R_INST2_ISR_cat = 2"!][!//
              <EXECUTION-CONTEXT>INTERRUPT-CAT-2</EXECUTION-CONTEXT>
[!ELSE!][!//
              <EXECUTION-CONTEXT>INTERRUPT-CAT-1</EXECUTION-CONTEXT>
[!ENDIF!]
              <SW-SERVICE-IMPL-POLICY>STANDARD</SW-SERVICE-IMPL-POLICY>
              <BSW-ENTRY-KIND>CONCRETE</BSW-ENTRY-KIND>
            </BSW-MODULE-ENTRY>
            <BSW-MODULE-ENTRY UUID="bc50f429-f763-4b19-af72-f66835004d01">
              <SHORT-NAME>Cdd_Ipc_CPU3_L_CPU1_R_INST3_ISR</SHORT-NAME>
              <IS-REENTRANT>false</IS-REENTRANT>
              <IS-SYNCHRONOUS>true</IS-SYNCHRONOUS>
              <CALL-TYPE>INTERRUPT</CALL-TYPE>
[!IF "$Cdd_Ipc_CPU3_L_CPU1_R_INST3_ISR_cat = 2"!][!//
              <EXECUTION-CONTEXT>INTERRUPT-CAT-2</EXECUTION-CONTEXT>
[!ELSE!][!//
              <EXECUTION-CONTEXT>INTERRUPT-CAT-1</EXECUTION-CONTEXT>
[!ENDIF!]
              <SW-SERVICE-IMPL-POLICY>STANDARD</SW-SERVICE-IMPL-POLICY>
              <BSW-ENTRY-KIND>CONCRETE</BSW-ENTRY-KIND>
            </BSW-MODULE-ENTRY>
            <BSW-MODULE-ENTRY UUID="465a6216-a8f1-4011-a529-ebf3afc576ae">
              <SHORT-NAME>Cdd_Ipc_CPU3_L_CPU2_R_INST0_ISR</SHORT-NAME>
              <IS-REENTRANT>false</IS-REENTRANT>
              <IS-SYNCHRONOUS>true</IS-SYNCHRONOUS>
              <CALL-TYPE>INTERRUPT</CALL-TYPE>
[!IF "$Cdd_Ipc_CPU3_L_CPU2_R_INST0_ISR_cat = 2"!][!//
              <EXECUTION-CONTEXT>INTERRUPT-CAT-2</EXECUTION-CONTEXT>
[!ELSE!][!//
              <EXECUTION-CONTEXT>INTERRUPT-CAT-1</EXECUTION-CONTEXT>
[!ENDIF!]
              <SW-SERVICE-IMPL-POLICY>STANDARD</SW-SERVICE-IMPL-POLICY>
              <BSW-ENTRY-KIND>CONCRETE</BSW-ENTRY-KIND>
            </BSW-MODULE-ENTRY>
            <BSW-MODULE-ENTRY UUID="103e36a6-5324-40ed-a343-cf7dd8664b54">
              <SHORT-NAME>Cdd_Ipc_CPU3_L_CPU2_R_INST1_ISR</SHORT-NAME>
              <IS-REENTRANT>false</IS-REENTRANT>
              <IS-SYNCHRONOUS>true</IS-SYNCHRONOUS>
              <CALL-TYPE>INTERRUPT</CALL-TYPE>
[!IF "$Cdd_Ipc_CPU3_L_CPU2_R_INST1_ISR_cat = 2"!][!//
              <EXECUTION-CONTEXT>INTERRUPT-CAT-2</EXECUTION-CONTEXT>
[!ELSE!][!//
              <EXECUTION-CONTEXT>INTERRUPT-CAT-1</EXECUTION-CONTEXT>
[!ENDIF!]
              <SW-SERVICE-IMPL-POLICY>STANDARD</SW-SERVICE-IMPL-POLICY>
              <BSW-ENTRY-KIND>CONCRETE</BSW-ENTRY-KIND>
            </BSW-MODULE-ENTRY>
            <BSW-MODULE-ENTRY UUID="5b26fcaf-5cae-430e-9e97-927f7ad1a438">
              <SHORT-NAME>Cdd_Ipc_CPU3_L_CPU2_R_INST2_ISR</SHORT-NAME>
              <IS-REENTRANT>false</IS-REENTRANT>
              <IS-SYNCHRONOUS>true</IS-SYNCHRONOUS>
              <CALL-TYPE>INTERRUPT</CALL-TYPE>
[!IF "$Cdd_Ipc_CPU3_L_CPU2_R_INST2_ISR_cat = 2"!][!//
              <EXECUTION-CONTEXT>INTERRUPT-CAT-2</EXECUTION-CONTEXT>
[!ELSE!][!//
              <EXECUTION-CONTEXT>INTERRUPT-CAT-1</EXECUTION-CONTEXT>
[!ENDIF!]
              <SW-SERVICE-IMPL-POLICY>STANDARD</SW-SERVICE-IMPL-POLICY>
              <BSW-ENTRY-KIND>CONCRETE</BSW-ENTRY-KIND>
            </BSW-MODULE-ENTRY>
            <BSW-MODULE-ENTRY UUID="d724ff28-05b3-43de-868e-479faf3a1118">
              <SHORT-NAME>Cdd_Ipc_CPU3_L_CPU2_R_INST3_ISR</SHORT-NAME>
              <IS-REENTRANT>false</IS-REENTRANT>
              <IS-SYNCHRONOUS>true</IS-SYNCHRONOUS>
              <CALL-TYPE>INTERRUPT</CALL-TYPE>
[!IF "$Cdd_Ipc_CPU3_L_CPU2_R_INST3_ISR_cat = 2"!][!//
              <EXECUTION-CONTEXT>INTERRUPT-CAT-2</EXECUTION-CONTEXT>
[!ELSE!][!//
              <EXECUTION-CONTEXT>INTERRUPT-CAT-1</EXECUTION-CONTEXT>
[!ENDIF!][!//
              <SW-SERVICE-IMPL-POLICY>STANDARD</SW-SERVICE-IMPL-POLICY>
              <BSW-ENTRY-KIND>CONCRETE</BSW-ENTRY-KIND>
            </BSW-MODULE-ENTRY>
            <BSW-MODULE-ENTRY UUID="aa35d5ab-4cd6-4e1e-88a3-deaca62c91ce">
              <SHORT-NAME>Cdd_Ipc_GetCounter</SHORT-NAME>
              <SERVICE-ID>6</SERVICE-ID>
              <IS-REENTRANT>true</IS-REENTRANT>
              <IS-SYNCHRONOUS>true</IS-SYNCHRONOUS>
              <CALL-TYPE>REGULAR</CALL-TYPE>
              <EXECUTION-CONTEXT>UNSPECIFIED</EXECUTION-CONTEXT>
              <SW-SERVICE-IMPL-POLICY>STANDARD</SW-SERVICE-IMPL-POLICY>
              <BSW-ENTRY-KIND>CONCRETE</BSW-ENTRY-KIND>
            </BSW-MODULE-ENTRY>
            <BSW-MODULE-ENTRY UUID="e5758116-f360-46ff-82af-dc246df68cfa">
              <SHORT-NAME>Cdd_Ipc_GetVersionInfo</SHORT-NAME>
              <SERVICE-ID>0</SERVICE-ID>
              <IS-REENTRANT>true</IS-REENTRANT>
              <IS-SYNCHRONOUS>true</IS-SYNCHRONOUS>
              <CALL-TYPE>REGULAR</CALL-TYPE>
              <EXECUTION-CONTEXT>UNSPECIFIED</EXECUTION-CONTEXT>
              <SW-SERVICE-IMPL-POLICY>STANDARD</SW-SERVICE-IMPL-POLICY>
              <BSW-ENTRY-KIND>CONCRETE</BSW-ENTRY-KIND>
            </BSW-MODULE-ENTRY>
            <BSW-MODULE-ENTRY UUID="6e65a7fe-b2c7-470b-9f66-b338fc149220">
              <SHORT-NAME>Cdd_Ipc_Init</SHORT-NAME>
              <SERVICE-ID>1</SERVICE-ID>
              <IS-REENTRANT>false</IS-REENTRANT>
              <IS-SYNCHRONOUS>true</IS-SYNCHRONOUS>
              <CALL-TYPE>REGULAR</CALL-TYPE>
              <EXECUTION-CONTEXT>UNSPECIFIED</EXECUTION-CONTEXT>
              <SW-SERVICE-IMPL-POLICY>STANDARD</SW-SERVICE-IMPL-POLICY>
              <BSW-ENTRY-KIND>CONCRETE</BSW-ENTRY-KIND>
            </BSW-MODULE-ENTRY>
            <BSW-MODULE-ENTRY UUID="a439b6b5-b3ac-4208-a79a-090a436f772d">
              <SHORT-NAME>Cdd_Ipc_IsTxInstanceFree</SHORT-NAME>
              <SERVICE-ID>5</SERVICE-ID>
              <IS-REENTRANT>true</IS-REENTRANT>
              <IS-SYNCHRONOUS>true</IS-SYNCHRONOUS>
              <CALL-TYPE>REGULAR</CALL-TYPE>
              <EXECUTION-CONTEXT>UNSPECIFIED</EXECUTION-CONTEXT>
              <SW-SERVICE-IMPL-POLICY>STANDARD</SW-SERVICE-IMPL-POLICY>
              <BSW-ENTRY-KIND>CONCRETE</BSW-ENTRY-KIND>
            </BSW-MODULE-ENTRY>
            <BSW-MODULE-ENTRY UUID="34463f04-6c5f-4a7c-ac74-af30a31bb88e">
              <SHORT-NAME>Cdd_Ipc_MainFunction_Read</SHORT-NAME>
              <SERVICE-ID>4</SERVICE-ID>
              <IS-REENTRANT>true</IS-REENTRANT>
              <IS-SYNCHRONOUS>true</IS-SYNCHRONOUS>
              <CALL-TYPE>SCHEDULED</CALL-TYPE>
              <EXECUTION-CONTEXT>UNSPECIFIED</EXECUTION-CONTEXT>
              <SW-SERVICE-IMPL-POLICY>STANDARD</SW-SERVICE-IMPL-POLICY>
              <BSW-ENTRY-KIND>CONCRETE</BSW-ENTRY-KIND>
            </BSW-MODULE-ENTRY>
            <BSW-MODULE-ENTRY UUID="44754a28-14cb-4986-9f84-1adf1cc818fc">
              <SHORT-NAME>Cdd_Ipc_Sync</SHORT-NAME>
              <SERVICE-ID>2</SERVICE-ID>
              <IS-REENTRANT>false</IS-REENTRANT>
              <IS-SYNCHRONOUS>true</IS-SYNCHRONOUS>
              <CALL-TYPE>REGULAR</CALL-TYPE>
              <EXECUTION-CONTEXT>UNSPECIFIED</EXECUTION-CONTEXT>
              <SW-SERVICE-IMPL-POLICY>STANDARD</SW-SERVICE-IMPL-POLICY>
              <BSW-ENTRY-KIND>CONCRETE</BSW-ENTRY-KIND>
            </BSW-MODULE-ENTRY>
            <BSW-MODULE-ENTRY UUID="86e41087-e005-47c8-af0f-1894d5eb809a">
              <SHORT-NAME>Cdd_Ipc_Transmit</SHORT-NAME>
              <SERVICE-ID>3</SERVICE-ID>
              <IS-REENTRANT>true</IS-REENTRANT>
              <IS-SYNCHRONOUS>false</IS-SYNCHRONOUS>
              <CALL-TYPE>REGULAR</CALL-TYPE>
              <EXECUTION-CONTEXT>UNSPECIFIED</EXECUTION-CONTEXT>
              <SW-SERVICE-IMPL-POLICY>STANDARD</SW-SERVICE-IMPL-POLICY>
              <BSW-ENTRY-KIND>CONCRETE</BSW-ENTRY-KIND>
            </BSW-MODULE-ENTRY>
          </ELEMENTS>
        </AR-PACKAGE>
      </AR-PACKAGES>
    </AR-PACKAGE>
  </AR-PACKAGES>
</AUTOSAR>
[!ENDSELECT!]
