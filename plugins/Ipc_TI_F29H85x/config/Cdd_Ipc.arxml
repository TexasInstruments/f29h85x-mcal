AUTOSAR XML (schema 00044)
package /TI_F29H85x/Cdd_Ipc
  ecuc definition collection myEcuParameterDefinition: module=Cdd
  module definition Cdd: api-service-prefix=Cdd_Ipc, refined-module-def=Cdd, variants pre-compile  # Configuration of the CddIpc module.
    container CddIpcConfig  # This container contains the configuration parameters and sub containers of the Cdd_Ipc module.
      container CddIpcRemoteCoreConfig [0..2]  # This container contains the configuration parameters of the remote cores.
        enumeration CddIpcRemoteCore: {CDD_IPC_CPU1, CDD_IPC_CPU2, CDD_IPC_CPU3}, origin=Texas Instruments, set at pre-compile, default-value=CDD_IPC_CPU1  # Selects the Cdd Ipc remote cores.
        container CddIpcTxInstanceConfig [0..4]  # This container contains the configuration parameters of the CddIpc Instances.
          enumeration CddIpcTxInstance: {CDD_IPC_CPU1_L_CPU2_R_INST0, CDD_IPC_CPU1_L_CPU2_R_INST1, CDD_IPC_CPU1_L_CPU2_R_INST2, CDD_IPC_CPU1_L_CPU2_R_INST3, CDD_IPC_CPU1_L_CPU3_R_INST0, CDD_IPC_CPU1_L_CPU3_R_INST1, CDD_IPC_CPU1_L_CPU3_R_INST2, CDD_IPC_CPU1_L_CPU3_R_INST3, CDD_IPC_CPU2_L_CPU1_R_INST0, CDD_IPC_CPU2_L_CPU1_R_INST1, CDD_IPC_CPU2_L_CPU1_R_INST2, CDD_IPC_CPU2_L_CPU1_R_INST3, CDD_IPC_CPU2_L_CPU3_R_INST0, CDD_IPC_CPU2_L_CPU3_R_INST1, CDD_IPC_CPU2_L_CPU3_R_INST2, CDD_IPC_CPU2_L_CPU3_R_INST3, CDD_IPC_CPU3_L_CPU1_R_INST0, CDD_IPC_CPU3_L_CPU1_R_INST1, CDD_IPC_CPU3_L_CPU1_R_INST2, CDD_IPC_CPU3_L_CPU1_R_INST3, CDD_IPC_CPU3_L_CPU2_R_INST0, CDD_IPC_CPU3_L_CPU2_R_INST1, CDD_IPC_CPU3_L_CPU2_R_INST2, CDD_IPC_CPU3_L_CPU2_R_INST3}, origin=Texas Instruments, set at pre-compile, default-value=CDD_IPC_CPU1_L_CPU2_R_INST0  # Selects CddIpc Instance.
          container CddIpcTxChannelConfig [1..255]  # This container contains the configuration parameters of the CddIpc channels.
            integer CddIpcTxChannelId: 1..255, origin=Texas Instruments, set at pre-compile, default-value=1  # Channel ID specific to the selected instance, channels configured in the selected instance should have unique values. An instance can have 255 channels ranging from 1-255.
            enumeration CddIpcTxProcessing: {CDD_IPC_INTERRUPT, CDD_IPC_POLLING}, origin=Texas Instruments, set at pre-compile, default-value=CDD_IPC_INTERRUPT  # Selects the Tx processing type. If CddIpcTxProcessing is selected as CDD_IPC_INTERRUPT, the transmit request triggers an interrupt on the other core. If CddIpcTxProcessing is selected as CDD_IPC_POLLING, the transmit request doesn't trigger any interrupts on the other core.
            integer CddIpcTxGlobalChannelId [0..1]: -9223372036854775808..9223372036854775807, origin=Texas Instruments, set at pre-compile, default-value=0  # This parameter will be used when CddIpcIntegrationWithAsrComStackEnable is disabled. This channel identifier will be used in transmit function to address the respective channel.
            reference CddIpcTxPduID [0..1]: origin=Texas Instruments, set at pre-compile, destination=CddPduRLowerLayerTxPdu  # Reference to PduId. This parameter will be used when CddIpcIntegrationWithAsrComStackEnable is enabled. This Pdu identifier will be used in transmit function to address the respective channel.
        container CddIpcRxInstanceConfig [0..4]  # This container contains the configuration parameters of the CddIpc Instances.
          enumeration CddIpcRxInstance: {CDD_IPC_CPU1_L_CPU2_R_INST0, CDD_IPC_CPU1_L_CPU2_R_INST1, CDD_IPC_CPU1_L_CPU2_R_INST2, CDD_IPC_CPU1_L_CPU2_R_INST3, CDD_IPC_CPU1_L_CPU3_R_INST0, CDD_IPC_CPU1_L_CPU3_R_INST1, CDD_IPC_CPU1_L_CPU3_R_INST2, CDD_IPC_CPU1_L_CPU3_R_INST3, CDD_IPC_CPU2_L_CPU1_R_INST0, CDD_IPC_CPU2_L_CPU1_R_INST1, CDD_IPC_CPU2_L_CPU1_R_INST2, CDD_IPC_CPU2_L_CPU1_R_INST3, CDD_IPC_CPU2_L_CPU3_R_INST0, CDD_IPC_CPU2_L_CPU3_R_INST1, CDD_IPC_CPU2_L_CPU3_R_INST2, CDD_IPC_CPU2_L_CPU3_R_INST3, CDD_IPC_CPU3_L_CPU1_R_INST0, CDD_IPC_CPU3_L_CPU1_R_INST1, CDD_IPC_CPU3_L_CPU1_R_INST2, CDD_IPC_CPU3_L_CPU1_R_INST3, CDD_IPC_CPU3_L_CPU2_R_INST0, CDD_IPC_CPU3_L_CPU2_R_INST1, CDD_IPC_CPU3_L_CPU2_R_INST2, CDD_IPC_CPU3_L_CPU2_R_INST3}, origin=Texas Instruments, set at pre-compile, default-value=CDD_IPC_CPU1_L_CPU2_R_INST0  # Selects CddIpc Instance.
          enumeration CddIpcInteruptType: {ISR_CAT1_RTINT, ISR_CAT1_INT, ISR_CAT2_INT}, origin=Texas Instruments, set at pre-compile, default-value=ISR_CAT2_INT  # Defines the interrupt type for the specific instance.
          container CddIpcRxChannelConfig [1..255]  # This container contains the configuration parameters of the CddIpc channels.
            integer CddIpcRxChannelId: 1..255, origin=Texas Instruments, set at pre-compile, default-value=1  # Channel ID specific to the selected instance, channels configured in the selected instance should have unique values. An instance can have 255 channels ranging from 1-255.
            function name CddIpcUserCallbackFunction [0..1]: origin=Texas Instruments, set at pre-compile, default-value=NULL_PTR  # Call back function for the data during reception
            integer CddIpcRxGlobalChannelId [0..1]: -9223372036854775808..9223372036854775807, origin=Texas Instruments, set at pre-compile, default-value=0  # This parameter will be used when CddIpcIntegrationWithAsrComStackEnable is disabled. This channel object identifier will be used in configured receive callback function to address the received message from respective channel.
            reference CddIpcRxPduID [0..1]: origin=Texas Instruments, set at pre-compile, destination=CddPduRLowerLayerRxPdu  # Reference to Pduid. This parameter will be used when CddIpcIntegrationWithAsrComStackEnable is enabled. This Pdu identifier will be used in receive function callback to PduR to address the received Pdu from respective channel.
    container CddComStackContribution [0..1]  # Contribution of COM Stack modules.
      container CddPduRLowerLayerContribution [0..1]  # Parameters that are necessary for the configuration of a Complex Driver that serves as the LowerLayer of the Pdu Router module.
        container CddPduRLowerLayerRxPdu [0..*]  # This container specifies Rx PDUs that are exchanged between the CDD and the standardized BSW module.
          enumeration CddPduRApiType [0..1]: {IF}, default-value=IF  # This parameter configures the type of the CDD interface (IF/TP)
          integer CddPduRLowerLayerHandleId [0..1]: 0..65535, symbolic-name-value=true, default-value=0  # ECU wide unique, symbolic handle for the Pdu.
          string CddIpcPduRHandle [0..1]: origin=Texas Instruments, set at pre-compile, default-value=NULL  # CddIpcPduRHandle is a symbolic name of the Pdu with which Cdd_Ipc module invokes the receive indication for upper layer. User can modify this parameter to match with the symbolic name used by upper layer.
          reference CddPduRLowerLayerPduRef: destination=Pdu  # Reference to the "global" Pdu structure to allow harmonization of handle IDs in the COM-Stack.
        container CddPduRLowerLayerTxPdu [0..*]  # This container specifies Tx PDUs that are exchanged between the CDD and the standardized BSW module.
          enumeration CddPduRApiType [0..1]: {IF}, default-value=IF  # This parameter configures the type of the CDD interface (IF/TP)
          integer CddPduRLowerLayerHandleId [0..1]: 0..65535, symbolic-name-value=true, default-value=0  # ECU wide unique, symbolic handle for the Pdu.
          reference CddPduRLowerLayerPduRef: destination=Pdu  # Reference to the "global" Pdu structure to allow harmonization of handle IDs in the COM-Stack.
    container CddIpcGeneral  # Contains the general configuration parameters of the module.
      boolean CddIpcDevErrorDetect: origin=Texas Instruments, set at pre-compile, default-value=false  # Switches the development error detection and notification on or off.
      boolean CddIpcVersionInfoApi: origin=Texas Instruments, set at pre-compile, default-value=false  # Adds / removes the service Cdd_Ipc_GetVersionInfo() from the code.
      boolean CddIpcIntegrationWithAsrComStackEnable: origin=Texas Instruments, set at pre-compile, default-value=false  # This parameter is used to enable the integration of Cdd Ipc module with Autosar Com Stack. 0: Cdd Ipc module is not integrated with Autosar Com stack. Transmission and Reception will be handled by another BSW component (Ex: IoHwAb or CDD). 1: Cdd Ipc module is integrated as lower module to PduR in Autosar Com stack. Transmission and Reception will be handled via Com Stack i.e. to and from PduR.
      integer CddIpcReservedInstances: 0..3, origin=Texas Instruments, set at pre-compile, default-value=0  # Number of reserved instances.The reserved instances won't be available as channels in CDD IPC
      float CddIpcMainFunctionReadPeriod: 1.0E-6..INF, origin=Texas Instruments, set at pre-compile, default-value=0.01  # This parameter describes the period for cyclic call to Cdd_Ipc_MainFunction_Read. Unit is seconds.
      float CddIpcTimeoutDuration: 1.0E-6..INF, origin=Texas Instruments, set at pre-compile, default-value=0.1  # Timeout value for synchronization of cores in seconds, if synchronization didn't happen within this time frame, Cdd_Ipc_Sync will abort and returns E_NOT_OK
      reference CddIpcCounterClockRef: origin=Texas Instruments, set at pre-compile, destination=McuClockReferencePoint  # This parameter contains a reference to the sysClock to calculate clock cycles for IPC free run counter, which is used by the CDD IPC driver.
