AUTOSAR XML (schema 00044)
package /TI_F29H85x
  ecuc definition collection myEcuParameterDefinition: module=Dio
  module definition Dio: refined-module-def=Dio, variants link-time/pre-compile  # Configuration of the Dio (Digital IO) module.
    container DioConfig  # This container contains the configuration parameters and sub containers of the AUTOSAR DIO module.
      container DioPort [1..8]  # Configuration of individual DIO ports, consisting of channels and possible channel groups.
        integer DioPortId: 0..7, scope=ECU, set at pre-compile, symbolic-name-value=true, default-value=0  # Numeric identifier of the DIO port. Not all MCU ports may be used for DIO, thus there may be "gaps" in the list of all IDs. This value will be
        container DioChannel [0..256]  # Configuration of an individual DIO channel.
          integer DioChannelId: 0..255, scope=ECU, set at pre-compile, symbolic-name-value=true, default-value=0  # Channel Id of the DIO channel. This value will be assigned to the symbolic names.
          reference DioPinNumRef: origin=Texas Instruments, set at pre-compile, destination=PortPin  # Reference to the Port Pin configuration, which is set in the PORT driver configuration
        container DioChannelGroup [0..*]  # Definition and configuration of DIO channel groups. A channel group represents several adjoining DIO channels represented by a logical group.
          string DioChannelGroupIdentification: scope=ECU, set at pre-compile, symbolic-name-value=true, default-value=Dio_ChannelGroup  # The DIO channel group is identified in DIO API by a pointer to a data structure (of type Dio_ChannelGroupType). That data structure contains the channel group information.
          integer DioPortMask: 0..4294967295, set at link in variant link-time / pre-compile in variant pre-compile, default-value=4294967295  # This shall be the mask which defines the positions of the channel
          integer DioPortOffset: 0..31, set at link in variant link-time / pre-compile in variant pre-compile, default-value=0  # The position of the Channel Group on the port, counted
    container DioGeneral  # General DIO module configuration parameters.
      boolean DioDevErrorDetect: set at pre-compile, default-value=false  # Switches the development error detection and notification on or off.
      boolean DioFlipChannelApi: set at pre-compile, default-value=true  # Adds / removes the service Dio_FlipChannel() from the code.
      boolean DioVersionInfoApi: set at pre-compile, default-value=false  # Adds / removes the service Dio_ GetVersionInfo() from the code.
