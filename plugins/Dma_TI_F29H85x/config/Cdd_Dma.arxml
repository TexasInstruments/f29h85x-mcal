AUTOSAR XML (schema 00044)
package /TI_F29H85x/Cdd_Dma
  ecuc definition collection myEcuParameterDefinition: module=Cdd
  module definition Cdd: api-service-prefix=Cdd_Dma, refined-module-def=Cdd, variants pre-compile  # Configuration of the CDD(Complex Device Driver) Dma(Direct Memory Access) module.
    container CddDmaGeneral  # Contains the general configuration parameters of the CDD DMA module.
      boolean CddDmaLockConfigurations: origin=Texas Instruments, set at pre-compile, default-value=false  # Enables locking of DMA configuration registers to prevent accidental modification during runtime. When enabled (true), the DMA configuration registers are write-protected after initialization.
      boolean CddDmaDevErrorDetect: origin=Texas Instruments, set at pre-compile, default-value=false  # Switches the development error detection and notification on or off.
      boolean CddDmaVersionInfoApi: origin=Texas Instruments, set at pre-compile, default-value=false  # Enables or disables the Cdd_Dma_GetVersionInfo() API.
    container CddDmaConfig  # This container contains the configuration parameters and sub containers of the Cdd_Dma module.
      container CddDmaChannel [0..20]: multiplicity set at pre-compile  # This container contains the driver configuration for the DMA channel.
        enumeration CddDmaInstance: {RTDMA1, RTDMA2}, origin=Texas Instruments, set at pre-compile, default-value=RTDMA1  # DMA instance ID derived from the selected channel reference. This is a non-editable parameter automatically populated based on CddDmaChannelRef.
        enumeration CddDmaChannel: {CH1, CH2, CH3, CH4, CH5, CH6, CH7, CH8, CH9, CH10}, origin=Texas Instruments, set at pre-compile, default-value=CH1  # DMA channel ID derived from the selected channel reference. This is a non-editable parameter automatically populated based on CddDmaChannelRef.
        enumeration CddDmaInterruptCategory: {ISR_CAT1_INT, ISR_CAT1_RTINT, ISR_CAT2_INT}, origin=Texas Instruments, set at pre-compile, default-value=ISR_CAT1_RTINT  # This parameters defines the category of the interrupt.
        function name CddDmaChIntNotification [0..1]: multiplicity set at pre-compile, origin=Texas Instruments, set at pre-compile, default-value=NULL_PTR  # Interrupt notification function for transfer
        function name CddDmaOverflowIntNotification [0..1]: multiplicity set at pre-compile, origin=Texas Instruments, set at pre-compile, default-value=NULL_PTR  # Overflow Interrupt notification function
        reference CddDmaChannelRef: origin=Texas Instruments, set at pre-compile, destination=CddDmaAllocatedChannel  # Reference to the RTDMA channel from the Resource Allocator. This links the configuration to a specific DMA channel available on the device.
