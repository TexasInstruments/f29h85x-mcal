AUTOSAR XML (schema 00044)
package /TI_F29H85x/Cdd_Uart
  ecuc definition collection myEcuParameterDefinition: module=Cdd_Uart
  module definition Cdd: api-service-prefix=Cdd_Uart, refined-module-def=Cdd, variants pre-compile  # Configuration of the CddUart module.
    container CddUartConfigSet  # This container contains the configuration parameters and sub containers of the CddUart module.
      container CddUartConfig [0..6]: multiplicity set at pre-compile  # This container contains the configuration parameters of the CddUart HW units.
        string CddUartBaseAddress: origin=Texas Instruments, set at pre-compile, default-value=UARTA_BASE_FRAME(0)  # Specifies the CddUart HW unit base address.
        integer CddUartHWUnitId: 0..5, scope=ECU, origin=Texas Instruments, set at pre-compile, symbolic-name-value=true, default-value=0  # This parameter provides the HW unit ID which is unique in a given CddUart Driver. The value for this parameter starts with 0 and continue without any gaps.
        integer CddUartBaudRate: 300..25000000, scope=ECU, origin=Texas Instruments, set at pre-compile, default-value=115200  # This parameter takes the input value of Baud Rate for both the channel (Write/Read)
        enumeration CddUartProcessingMode: {CDD_UART_MODE_POLLING, CDD_UART_MODE_INTERRUPT}, origin=Texas Instruments, set at pre-compile, default-value=CDD_UART_MODE_INTERRUPT  # Defines the Uart Processing mode.
        boolean CddUartFIFOModeEnable: origin=Texas Instruments, set at pre-compile, default-value=false  # Enable/Disable FIFO Mode.
        enumeration CddUartInteruptType [0..1]: {CDD_UART_ISR_CAT1_RTINT, CDD_UART_ISR_CAT1_INT, CDD_UART_ISR_CAT2}, multiplicity set at pre-compile, origin=Texas Instruments, set at pre-compile, default-value=CDD_UART_ISR_CAT1_INT  # This parameter specifies the category of Interrupt Request for callbacks.
        boolean CddUartParityModeEnable: origin=Texas Instruments, set at pre-compile, default-value=false  # Enable/Disable Parity mode.
        enumeration CddUartParityBit [0..1]: {CDD_UART_PARITY_EVEN, CDD_UART_PARITY_ODD}, multiplicity set at pre-compile, origin=Texas Instruments, set at pre-compile, default-value=CDD_UART_PARITY_EVEN  # type of parity bit in the frame
        enumeration CddUartStopBit: {CDD_UART_STOP_BITS_1, CDD_UART_STOP_BITS_2}, origin=Texas Instruments, set at pre-compile, default-value=CDD_UART_STOP_BITS_1  # number of stop bits in the frame
        enumeration CddUartWordLength: {CDD_UART_WORD_LENGTH_8, CDD_UART_WORD_LENGTH_7, CDD_UART_WORD_LENGTH_6, CDD_UART_WORD_LENGTH_5}, origin=Texas Instruments, set at pre-compile, default-value=CDD_UART_WORD_LENGTH_8  # word length of a frame
        boolean CddUartEnableWrite: origin=Texas Instruments, set at pre-compile, default-value=true  # Enable/Disable Write Mode.
        boolean CddUartEnableRead: origin=Texas Instruments, set at pre-compile, default-value=true  # Enable/Disable Read Mode.
        boolean CddUartLoopBackModeEnable: origin=Texas Instruments, set at pre-compile, default-value=false  # Enable/Disable Loop Back Mode.
        reference CddUartInstance: origin=Texas Instruments, set at pre-compile, destination=Cdd_UartAllocatedInstance  # Reference to the Cdd_Uart Instance.
        reference CddUartClockFreq: scope=ECU, origin=Texas Instruments, set at pre-compile, destination=McuClockReferencePoint  # This parameter takes the input value of clock frequency
        container CddUartWriteConfig [0..1]: multiplicity set at pre-compile  # This container contains the configuration parameters of the CddUart Write
          function name CddUartWriteNotificationHandler [0..1]: multiplicity set at pre-compile, origin=Texas Instruments, set at pre-compile, default-value=NULL_PTR  # This parameter is a write notification handler function.
          enumeration CddUartTriggerLevelWriteFIFO [0..1]: {CDD_UART_FIFO_LEVEL_1_8, CDD_UART_FIFO_LEVEL_1_4, CDD_UART_FIFO_LEVEL_1_2, CDD_UART_FIFO_LEVEL_3_4, CDD_UART_FIFO_LEVEL_7_8}, multiplicity set at pre-compile, origin=Texas Instruments, set at pre-compile, default-value=CDD_UART_FIFO_LEVEL_1_2  # set interrupt trigger level of Write FIFO
        container CddUartReadConfig [0..1]: multiplicity set at pre-compile  # This container contains the configuration parameters of the CddUart Read
          function name CddUartReadNotificationHandler [0..1]: multiplicity set at pre-compile, origin=Texas Instruments, set at pre-compile, default-value=NULL_PTR  # This parameter is a read notification handler function.
          function name CddUartErrorNotificationHandler [0..1]: multiplicity set at pre-compile, origin=Texas Instruments, set at pre-compile, default-value=NULL_PTR  # This parameter is a error notification handler function.
          enumeration CddUartTriggerLevelReadFIFO [0..1]: {CDD_UART_FIFO_LEVEL_1_8, CDD_UART_FIFO_LEVEL_1_4, CDD_UART_FIFO_LEVEL_1_2, CDD_UART_FIFO_LEVEL_3_4, CDD_UART_FIFO_LEVEL_7_8}, multiplicity set at pre-compile, origin=Texas Instruments, set at pre-compile, default-value=CDD_UART_FIFO_LEVEL_1_2  # set interrupt trigger level of Read FIFO
    container CddUartGeneral  # General CddUart` module configuration parameters.
      float CddUartMainFunctionWritePeriod: 1.0E-6..INF, origin=Texas Instruments, set at pre-compile, default-value=0.01  # This parameter describes the period for cyclic call to Cdd_Uart_MainFunction_Write. Unit is seconds.
      boolean CddUartDevErrorDetect: origin=Texas Instruments, set at pre-compile, default-value=true  # Switches the development error detection and notification on or off.
      boolean CddUartVersionInfoApi: origin=Texas Instruments, set at pre-compile, default-value=true  # Adds / removes the service CddUart_ GetVersionInfo() from the code.
