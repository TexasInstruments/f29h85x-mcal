<?xml version="1.0" encoding="UTF-8"?>
<AUTOSAR xmlns="http://autosar.org/schema/r4.0" xmlns:xsi="http://www.w3.org/2001/XMLSchema-instance" xsi:schemaLocation="http://autosar.org/schema/r4.0 AUTOSAR_00044.xsd">
[!SELECT "as:modconf('Gpt')[as:path(node:dtos(.))='/TI_F29H85x/Gpt']"!]
[!AUTOSPACING!][!//
[!VAR "GptDevErrorDetect_Enable"="GptDriverConfiguration/GptDevErrorDetect = 'true'"!][!//
[!VAR "GptDeinitApi_Enable"="GptConfigurationOfOptApiServices/GptDeinitApi = 'true'"!][!//
[!VAR "GptEnableDisableNotificationApi_Enable"="GptConfigurationOfOptApiServices/GptEnableDisableNotificationApi = 'true'"!][!//
[!VAR "GptTimeElapsedApi_Enable"="GptConfigurationOfOptApiServices/GptTimeElapsedApi  = 'true'"!][!//
[!VAR "GptTimeRemainingApi_Enable"="GptConfigurationOfOptApiServices/GptTimeRemainingApi  = 'true'"!][!//
[!VAR "GptVersionInfoApi_Enable"="GptConfigurationOfOptApiServices/GptVersionInfoApi   = 'true'"!][!//
[!VAR "GptWakeupFunctionalityApi_Enable"="GptConfigurationOfOptApiServices/GptWakeupFunctionalityApi   = 'true'"!][!//
  <AR-PACKAGES>
    <AR-PACKAGE UUID="c60e0633-c952-4be0-b7dd-1bc2886b0829">
      <SHORT-NAME>Gpt_TI_F29H85x</SHORT-NAME>
      <ELEMENTS>
        <BSW-MODULE-DESCRIPTION UUID="edbf08b9-f671-4820-ba58-a331de7164dd">
          <SHORT-NAME>Gpt</SHORT-NAME>
          <IMPLEMENTED-ENTRYS>
[!LOOP "GptChannelConfigSet/GptChannelConfiguration/*"!]
[!IF "GptChannelId = '0'"!][!//
            <BSW-MODULE-ENTRY-REF-CONDITIONAL>
              <BSW-MODULE-ENTRY-REF DEST="BSW-MODULE-ENTRY">/Gpt_TI_F29H85x/Gpt_ModuleEntry/Gpt_Ch0Isr</BSW-MODULE-ENTRY-REF>
            </BSW-MODULE-ENTRY-REF-CONDITIONAL>
[!ENDIF!][!//
[!IF "GptChannelId = '1'"!][!//
            <BSW-MODULE-ENTRY-REF-CONDITIONAL>
              <BSW-MODULE-ENTRY-REF DEST="BSW-MODULE-ENTRY">/Gpt_TI_F29H85x/Gpt_ModuleEntry/Gpt_Ch1Isr</BSW-MODULE-ENTRY-REF>
            </BSW-MODULE-ENTRY-REF-CONDITIONAL>
[!ENDIF!][!//
[!IF "GptChannelId = '2'"!][!//
            <BSW-MODULE-ENTRY-REF-CONDITIONAL>
              <BSW-MODULE-ENTRY-REF DEST="BSW-MODULE-ENTRY">/Gpt_TI_F29H85x/Gpt_ModuleEntry/Gpt_Ch2Isr</BSW-MODULE-ENTRY-REF>
            </BSW-MODULE-ENTRY-REF-CONDITIONAL>
[!ENDIF!][!//
[!ENDLOOP!][!//
[!IF "$GptDeinitApi_Enable = 'true'"!][!//
            <BSW-MODULE-ENTRY-REF-CONDITIONAL>
              <BSW-MODULE-ENTRY-REF DEST="BSW-MODULE-ENTRY">/Gpt_TI_F29H85x/Gpt_ModuleEntry/Gpt_DeInit</BSW-MODULE-ENTRY-REF>
            </BSW-MODULE-ENTRY-REF-CONDITIONAL>
[!ENDIF!][!//
[!IF "$GptEnableDisableNotificationApi_Enable = 'true'"!][!//
            <BSW-MODULE-ENTRY-REF-CONDITIONAL>
              <BSW-MODULE-ENTRY-REF DEST="BSW-MODULE-ENTRY">/Gpt_TI_F29H85x/Gpt_ModuleEntry/Gpt_DisableNotification</BSW-MODULE-ENTRY-REF>
            </BSW-MODULE-ENTRY-REF-CONDITIONAL>
            <BSW-MODULE-ENTRY-REF-CONDITIONAL>
              <BSW-MODULE-ENTRY-REF DEST="BSW-MODULE-ENTRY">/Gpt_TI_F29H85x/Gpt_ModuleEntry/Gpt_EnableNotification</BSW-MODULE-ENTRY-REF>
            </BSW-MODULE-ENTRY-REF-CONDITIONAL>
[!ENDIF!][!//
[!IF "$GptWakeupFunctionalityApi_Enable = 'true'"!][!//
            <BSW-MODULE-ENTRY-REF-CONDITIONAL>
              <BSW-MODULE-ENTRY-REF DEST="BSW-MODULE-ENTRY">/Gpt_TI_F29H85x/Gpt_ModuleEntry/Gpt_CheckWakeup</BSW-MODULE-ENTRY-REF>
            </BSW-MODULE-ENTRY-REF-CONDITIONAL>
            <BSW-MODULE-ENTRY-REF-CONDITIONAL>
              <BSW-MODULE-ENTRY-REF DEST="BSW-MODULE-ENTRY">/Gpt_TI_F29H85x/Gpt_ModuleEntry/Gpt_DisableWakeup</BSW-MODULE-ENTRY-REF>
            </BSW-MODULE-ENTRY-REF-CONDITIONAL>
            <BSW-MODULE-ENTRY-REF-CONDITIONAL>
              <BSW-MODULE-ENTRY-REF DEST="BSW-MODULE-ENTRY">/Gpt_TI_F29H85x/Gpt_ModuleEntry/Gpt_EnableWakeup</BSW-MODULE-ENTRY-REF>
            </BSW-MODULE-ENTRY-REF-CONDITIONAL>
            <BSW-MODULE-ENTRY-REF-CONDITIONAL>
              <BSW-MODULE-ENTRY-REF DEST="BSW-MODULE-ENTRY">/Gpt_TI_F29H85x/Gpt_ModuleEntry/Gpt_GetPredefTimerValue</BSW-MODULE-ENTRY-REF>
            </BSW-MODULE-ENTRY-REF-CONDITIONAL>
            <BSW-MODULE-ENTRY-REF-CONDITIONAL>
              <BSW-MODULE-ENTRY-REF DEST="BSW-MODULE-ENTRY">/Gpt_TI_F29H85x/Gpt_ModuleEntry/Gpt_SetMode</BSW-MODULE-ENTRY-REF>
            </BSW-MODULE-ENTRY-REF-CONDITIONAL>
[!ENDIF!][!//
[!IF "$GptTimeElapsedApi_Enable = 'true'"!][!//
            <BSW-MODULE-ENTRY-REF-CONDITIONAL>
              <BSW-MODULE-ENTRY-REF DEST="BSW-MODULE-ENTRY">/Gpt_TI_F29H85x/Gpt_ModuleEntry/Gpt_GetTimeElapsed</BSW-MODULE-ENTRY-REF>
            </BSW-MODULE-ENTRY-REF-CONDITIONAL>
[!ENDIF!][!//
[!IF "$GptTimeRemainingApi_Enable = 'true'"!][!//
            <BSW-MODULE-ENTRY-REF-CONDITIONAL>
              <BSW-MODULE-ENTRY-REF DEST="BSW-MODULE-ENTRY">/Gpt_TI_F29H85x/Gpt_ModuleEntry/Gpt_GetTimeRemaining</BSW-MODULE-ENTRY-REF>
            </BSW-MODULE-ENTRY-REF-CONDITIONAL>
[!ENDIF!][!//
[!IF "$GptVersionInfoApi_Enable = 'true'"!][!//
            <BSW-MODULE-ENTRY-REF-CONDITIONAL>
              <BSW-MODULE-ENTRY-REF DEST="BSW-MODULE-ENTRY">/Gpt_TI_F29H85x/Gpt_ModuleEntry/Gpt_GetVersionInfo</BSW-MODULE-ENTRY-REF>
            </BSW-MODULE-ENTRY-REF-CONDITIONAL>
[!ENDIF!][!//
            <BSW-MODULE-ENTRY-REF-CONDITIONAL>
              <BSW-MODULE-ENTRY-REF DEST="BSW-MODULE-ENTRY">/Gpt_TI_F29H85x/Gpt_ModuleEntry/Gpt_Init</BSW-MODULE-ENTRY-REF>
            </BSW-MODULE-ENTRY-REF-CONDITIONAL>
            <BSW-MODULE-ENTRY-REF-CONDITIONAL>
              <BSW-MODULE-ENTRY-REF DEST="BSW-MODULE-ENTRY">/Gpt_TI_F29H85x/Gpt_ModuleEntry/Gpt_StartTimer</BSW-MODULE-ENTRY-REF>
            </BSW-MODULE-ENTRY-REF-CONDITIONAL>
            <BSW-MODULE-ENTRY-REF-CONDITIONAL>
              <BSW-MODULE-ENTRY-REF DEST="BSW-MODULE-ENTRY">/Gpt_TI_F29H85x/Gpt_ModuleEntry/Gpt_StopTimer</BSW-MODULE-ENTRY-REF>
            </BSW-MODULE-ENTRY-REF-CONDITIONAL>
          </IMPLEMENTED-ENTRYS>
          <MODULE-ID>100</MODULE-ID>
          <BSW-MODULE-DEPENDENCYS>
            <BSW-MODULE-DEPENDENCY UUID="6d959914-f2b6-48d7-ad60-aeda36c4c5fd">
              <SHORT-NAME>Det</SHORT-NAME>
              <TARGET-MODULE-ID>15</TARGET-MODULE-ID>
              <TARGET-MODULE-REFS>
                <BSW-MODULE-DESCRIPTION-REF-CONDITIONAL>
                  <BSW-MODULE-DESCRIPTION-REF DEST="BSW-MODULE-DESCRIPTION">/AUTOSAR_Det/Det</BSW-MODULE-DESCRIPTION-REF>
                </BSW-MODULE-DESCRIPTION-REF-CONDITIONAL>
              </TARGET-MODULE-REFS>
            </BSW-MODULE-DEPENDENCY>
          </BSW-MODULE-DEPENDENCYS>
          <INTERNAL-BEHAVIORS>
            <BSW-INTERNAL-BEHAVIOR UUID="3ef1d95e-8f01-40e5-b294-a3835f07da7a">
              <SHORT-NAME>Gpt_Behaviour</SHORT-NAME>
              <EXCLUSIVE-AREAS>
                <EXCLUSIVE-AREA UUID="3f67493c-dfcf-4437-91be-819b5a82e8fe">
                  <SHORT-NAME>GPT_EXCLUSIVE_AREA_0</SHORT-NAME>
                </EXCLUSIVE-AREA>
              </EXCLUSIVE-AREAS>
              <ENTITYS>
[!LOOP "GptChannelConfigSet/GptChannelConfiguration/*"!]
[!IF "GptChannelId = '0'"!][!//
                <BSW-INTERRUPT-ENTITY UUID="232cd37d-6164-4e91-a3ce-c870b965ac75">
                  <SHORT-NAME>Gpt_Ch0Isr</SHORT-NAME>
                  <REENTRANCY-LEVEL>NON-REENTRANT</REENTRANCY-LEVEL>
                  <IMPLEMENTED-ENTRY-REF DEST="BSW-MODULE-ENTRY">/Gpt_TI_F29H85x/Gpt_ModuleEntry/Gpt_Ch0Isr</IMPLEMENTED-ENTRY-REF>
[!IF "GptTypeofInterrupt   = 'GPT_ISR_CAT2'"!][!//
                  <INTERRUPT-CATEGORY>CAT-2</INTERRUPT-CATEGORY>
[!ELSE!][!//
                <INTERRUPT-CATEGORY>CAT-1</INTERRUPT-CATEGORY>
[!ENDIF!][!//
                </BSW-INTERRUPT-ENTITY>
[!ENDIF!][!//
[!IF "GptChannelId = '1'"!][!//
                <BSW-INTERRUPT-ENTITY UUID="d44f0af9-4b6c-46db-9f60-902ff3d63eeb">
                  <SHORT-NAME>Gpt_Ch1Isr</SHORT-NAME>
                  <REENTRANCY-LEVEL>NON-REENTRANT</REENTRANCY-LEVEL>
                  <IMPLEMENTED-ENTRY-REF DEST="BSW-MODULE-ENTRY">/Gpt_TI_F29H85x/Gpt_ModuleEntry/Gpt_Ch1Isr</IMPLEMENTED-ENTRY-REF>
[!IF "GptTypeofInterrupt   = 'GPT_ISR_CAT2'"!][!//
                  <INTERRUPT-CATEGORY>CAT-2</INTERRUPT-CATEGORY>
[!ELSE!][!//
                <INTERRUPT-CATEGORY>CAT-1</INTERRUPT-CATEGORY>
[!ENDIF!][!//
                </BSW-INTERRUPT-ENTITY>
[!ENDIF!][!//
[!IF "GptChannelId = '1'"!][!//
                <BSW-INTERRUPT-ENTITY UUID="a9a11b08-b550-459b-86c7-4316ace2001a">
                  <SHORT-NAME>Gpt_Ch2Isr</SHORT-NAME>
                  <REENTRANCY-LEVEL>NON-REENTRANT</REENTRANCY-LEVEL>
                  <IMPLEMENTED-ENTRY-REF DEST="BSW-MODULE-ENTRY">/Gpt_TI_F29H85x/Gpt_ModuleEntry/Gpt_Ch2Isr</IMPLEMENTED-ENTRY-REF>
[!IF "GptTypeofInterrupt   = 'GPT_ISR_CAT2'"!][!//
                  <INTERRUPT-CATEGORY>CAT-2</INTERRUPT-CATEGORY>
[!ELSE!][!//
                <INTERRUPT-CATEGORY>CAT-1</INTERRUPT-CATEGORY>
[!ENDIF!][!//
                </BSW-INTERRUPT-ENTITY>
[!ENDIF!][!//
[!ENDLOOP!][!//
[!IF "$GptWakeupFunctionalityApi_Enable = 'true'"!][!//
                <BSW-CALLED-ENTITY UUID="7d5cded7-592c-49ca-badb-69ec2c61cfea">
                  <SHORT-NAME>Gpt_CheckWakeup</SHORT-NAME>
                  <REENTRANCY-LEVEL>SINGLE-CORE-REENTRANT</REENTRANCY-LEVEL>
                  <IMPLEMENTED-ENTRY-REF DEST="BSW-MODULE-ENTRY">/Gpt_TI_F29H85x/Gpt_ModuleEntry/Gpt_CheckWakeup</IMPLEMENTED-ENTRY-REF>
                </BSW-CALLED-ENTITY>
                <BSW-CALLED-ENTITY UUID="3de50e4b-7642-4386-8a55-b212722c0a55">
                  <SHORT-NAME>Gpt_DisableWakeup</SHORT-NAME>
                  <REENTRANCY-LEVEL>SINGLE-CORE-REENTRANT</REENTRANCY-LEVEL>
                  <IMPLEMENTED-ENTRY-REF DEST="BSW-MODULE-ENTRY">/Gpt_TI_F29H85x/Gpt_ModuleEntry/Gpt_DisableWakeup</IMPLEMENTED-ENTRY-REF>
                </BSW-CALLED-ENTITY>
                <BSW-CALLED-ENTITY UUID="3480311e-62c9-4e93-a0a7-88a6a410a01b">
                  <SHORT-NAME>Gpt_EnableWakeup</SHORT-NAME>
                  <REENTRANCY-LEVEL>SINGLE-CORE-REENTRANT</REENTRANCY-LEVEL>
                  <IMPLEMENTED-ENTRY-REF DEST="BSW-MODULE-ENTRY">/Gpt_TI_F29H85x/Gpt_ModuleEntry/Gpt_EnableWakeup</IMPLEMENTED-ENTRY-REF>
                </BSW-CALLED-ENTITY>
                <BSW-CALLED-ENTITY UUID="32b84f6e-ad5e-4795-8273-c89db1eba648">
                  <SHORT-NAME>Gpt_GetPredefTimerValue</SHORT-NAME>
                  <REENTRANCY-LEVEL>SINGLE-CORE-REENTRANT</REENTRANCY-LEVEL>
                  <IMPLEMENTED-ENTRY-REF DEST="BSW-MODULE-ENTRY">/Gpt_TI_F29H85x/Gpt_ModuleEntry/Gpt_GetPredefTimerValue</IMPLEMENTED-ENTRY-REF>
                </BSW-CALLED-ENTITY>
                <BSW-CALLED-ENTITY UUID="f9de0c5f-cdbb-4fb0-aa5c-0b2d2f2918da">
                  <SHORT-NAME>Gpt_SetMode</SHORT-NAME>
                  <REENTRANCY-LEVEL>NON-REENTRANT</REENTRANCY-LEVEL>
                  <IMPLEMENTED-ENTRY-REF DEST="BSW-MODULE-ENTRY">/Gpt_TI_F29H85x/Gpt_ModuleEntry/Gpt_SetMode</IMPLEMENTED-ENTRY-REF>
                </BSW-CALLED-ENTITY>
[!ENDIF!][!//
[!IF "$GptDeinitApi_Enable = 'true'"!][!//
                <BSW-CALLED-ENTITY UUID="3957878b-26dd-4d32-8b65-31491c132ac5">
                  <SHORT-NAME>Gpt_DeInit</SHORT-NAME>
                  <REENTRANCY-LEVEL>NON-REENTRANT</REENTRANCY-LEVEL>
                  <CALL-POINTS>
                    <BSW-DIRECT-CALL-POINT>
                      <SHORT-NAME>Det_ReportError</SHORT-NAME>
                      <CALLED-ENTRY-REF DEST="BSW-MODULE-ENTRY">/AUTOSAR_Det/BSWModuleEntry/Det_ReportError</CALLED-ENTRY-REF>
                    </BSW-DIRECT-CALL-POINT>
                    <BSW-DIRECT-CALL-POINT>
                      <SHORT-NAME>Det_ReportRuntimeError</SHORT-NAME>
                      <CALLED-ENTRY-REF DEST="BSW-MODULE-ENTRY">/AUTOSAR_Det/BSWModuleEntry/Det_ReportRuntimeError</CALLED-ENTRY-REF>
                    </BSW-DIRECT-CALL-POINT>
                  </CALL-POINTS>
                  <IMPLEMENTED-ENTRY-REF DEST="BSW-MODULE-ENTRY">/Gpt_TI_F29H85x/Gpt_ModuleEntry/Gpt_DeInit</IMPLEMENTED-ENTRY-REF>
                </BSW-CALLED-ENTITY>
[!ENDIF!][!//
[!IF "$GptEnableDisableNotificationApi_Enable = 'true'"!][!//
                <BSW-CALLED-ENTITY UUID="a886ff9c-7c26-4c7f-a8f7-57a0c7d88b84">
                  <SHORT-NAME>Gpt_DisableNotification</SHORT-NAME>
                  <CAN-ENTER-EXCLUSIVE-AREA-REFS>
                    <CAN-ENTER-EXCLUSIVE-AREA-REF DEST="EXCLUSIVE-AREA">/Gpt_TI_F29H85x/Gpt/Gpt_Behaviour/GPT_EXCLUSIVE_AREA_0</CAN-ENTER-EXCLUSIVE-AREA-REF>
                  </CAN-ENTER-EXCLUSIVE-AREA-REFS>
                  <REENTRANCY-LEVEL>SINGLE-CORE-REENTRANT</REENTRANCY-LEVEL>
                  <CALL-POINTS>
[!IF "$GptDevErrorDetect_Enable = 'true'"!][!//
                    <BSW-DIRECT-CALL-POINT>
                      <SHORT-NAME>Det_ReportError</SHORT-NAME>
                      <CALLED-ENTRY-REF DEST="BSW-MODULE-ENTRY">/AUTOSAR_Det/BSWModuleEntry/Det_ReportError</CALLED-ENTRY-REF>
                    </BSW-DIRECT-CALL-POINT>
[!ENDIF!][!//
                  </CALL-POINTS>
                  <IMPLEMENTED-ENTRY-REF DEST="BSW-MODULE-ENTRY">/Gpt_TI_F29H85x/Gpt_ModuleEntry/Gpt_DisableNotification</IMPLEMENTED-ENTRY-REF>
                </BSW-CALLED-ENTITY>
                <BSW-CALLED-ENTITY UUID="c4b820aa-9c06-40cd-860d-cc5fda48261a">
                  <SHORT-NAME>Gpt_EnableNotification</SHORT-NAME>
                  <CAN-ENTER-EXCLUSIVE-AREA-REFS>
                    <CAN-ENTER-EXCLUSIVE-AREA-REF DEST="EXCLUSIVE-AREA">/Gpt_TI_F29H85x/Gpt/Gpt_Behaviour/GPT_EXCLUSIVE_AREA_0</CAN-ENTER-EXCLUSIVE-AREA-REF>
                  </CAN-ENTER-EXCLUSIVE-AREA-REFS>
                  <REENTRANCY-LEVEL>SINGLE-CORE-REENTRANT</REENTRANCY-LEVEL>
                  <CALL-POINTS>
[!IF "$GptDevErrorDetect_Enable = 'true'"!][!//               
                    <BSW-DIRECT-CALL-POINT>
                      <SHORT-NAME>Det_ReportError</SHORT-NAME>
                      <CALLED-ENTRY-REF DEST="BSW-MODULE-ENTRY">/AUTOSAR_Det/BSWModuleEntry/Det_ReportError</CALLED-ENTRY-REF>
                    </BSW-DIRECT-CALL-POINT>
[!ENDIF!][!//
                  </CALL-POINTS>
                  <IMPLEMENTED-ENTRY-REF DEST="BSW-MODULE-ENTRY">/Gpt_TI_F29H85x/Gpt_ModuleEntry/Gpt_EnableNotification</IMPLEMENTED-ENTRY-REF>
                </BSW-CALLED-ENTITY>
[!ENDIF!][!//
[!IF "$GptTimeElapsedApi_Enable = 'true'"!][!//
                <BSW-CALLED-ENTITY UUID="9471eef3-9925-4fa4-a919-411774170a9d">
                  <SHORT-NAME>Gpt_GetTimeElapsed</SHORT-NAME>
                  <REENTRANCY-LEVEL>SINGLE-CORE-REENTRANT</REENTRANCY-LEVEL>
                  <CALL-POINTS>
[!IF "$GptDevErrorDetect_Enable = 'true'"!][!//                 
                    <BSW-DIRECT-CALL-POINT>
                      <SHORT-NAME>Det_ReportError</SHORT-NAME>
                      <CALLED-ENTRY-REF DEST="BSW-MODULE-ENTRY">/AUTOSAR_Det/BSWModuleEntry/Det_ReportError</CALLED-ENTRY-REF>
                    </BSW-DIRECT-CALL-POINT>
[!ENDIF!][!//                  
                  </CALL-POINTS>
                  <IMPLEMENTED-ENTRY-REF DEST="BSW-MODULE-ENTRY">/Gpt_TI_F29H85x/Gpt_ModuleEntry/Gpt_GetTimeElapsed</IMPLEMENTED-ENTRY-REF>
                </BSW-CALLED-ENTITY>
[!ENDIF!][!//
[!IF "$GptTimeRemainingApi_Enable = 'true'"!][!//
                <BSW-CALLED-ENTITY UUID="aeff5cd7-bed7-49b6-8691-008cb8e85d34">
                  <SHORT-NAME>Gpt_GetTimeRemaining</SHORT-NAME>
                  <REENTRANCY-LEVEL>SINGLE-CORE-REENTRANT</REENTRANCY-LEVEL>
                  <CALL-POINTS>
[!IF "$GptDevErrorDetect_Enable = 'true'"!][!//                    
                    <BSW-DIRECT-CALL-POINT>
                      <SHORT-NAME>Det_ReportError</SHORT-NAME>
                      <CALLED-ENTRY-REF DEST="BSW-MODULE-ENTRY">/AUTOSAR_Det/BSWModuleEntry/Det_ReportError</CALLED-ENTRY-REF>
                    </BSW-DIRECT-CALL-POINT>
[!ENDIF!][!//                    
                  </CALL-POINTS>
                  <IMPLEMENTED-ENTRY-REF DEST="BSW-MODULE-ENTRY">/Gpt_TI_F29H85x/Gpt_ModuleEntry/Gpt_GetTimeRemaining</IMPLEMENTED-ENTRY-REF>
                </BSW-CALLED-ENTITY>
[!ENDIF!][!//
[!IF "$GptVersionInfoApi_Enable = 'true'"!][!//
                <BSW-CALLED-ENTITY UUID="d1619a48-e66b-4ff9-90e6-e7e0d5068082">
                  <SHORT-NAME>Gpt_GetVersionInfo</SHORT-NAME>
                  <REENTRANCY-LEVEL>SINGLE-CORE-REENTRANT</REENTRANCY-LEVEL>
                  <CALL-POINTS>
[!IF "$GptDevErrorDetect_Enable = 'true'"!][!//                 
                    <BSW-DIRECT-CALL-POINT>
                      <SHORT-NAME>Det_ReportError</SHORT-NAME>
                      <CALLED-ENTRY-REF DEST="BSW-MODULE-ENTRY">/AUTOSAR_Det/BSWModuleEntry/Det_ReportError</CALLED-ENTRY-REF>
                    </BSW-DIRECT-CALL-POINT>
[!ENDIF!][!//                    
                  </CALL-POINTS>
                  <IMPLEMENTED-ENTRY-REF DEST="BSW-MODULE-ENTRY">/Gpt_TI_F29H85x/Gpt_ModuleEntry/Gpt_GetVersionInfo</IMPLEMENTED-ENTRY-REF>
                </BSW-CALLED-ENTITY>
[!ENDIF!][!//
                <BSW-CALLED-ENTITY UUID="18850e69-4bc3-431c-aead-5072ca755dc7">
                  <SHORT-NAME>Gpt_Init</SHORT-NAME>
                  <REENTRANCY-LEVEL>NON-REENTRANT</REENTRANCY-LEVEL>
                  <CALL-POINTS>
[!IF "$GptDevErrorDetect_Enable = 'true'"!][!//                    
                    <BSW-DIRECT-CALL-POINT>
                      <SHORT-NAME>Det_ReportError</SHORT-NAME>
                    </BSW-DIRECT-CALL-POINT>
[!ENDIF!][!//                     
                  </CALL-POINTS>
                  <IMPLEMENTED-ENTRY-REF DEST="BSW-MODULE-ENTRY">/Gpt_TI_F29H85x/Gpt_ModuleEntry/Gpt_Init</IMPLEMENTED-ENTRY-REF>
                </BSW-CALLED-ENTITY>
                <BSW-CALLED-ENTITY UUID="33994090-1587-4856-8192-93df7231f3df">
                  <SHORT-NAME>Gpt_StartTimer</SHORT-NAME>
                  <CAN-ENTER-EXCLUSIVE-AREA-REFS>
                    <CAN-ENTER-EXCLUSIVE-AREA-REF DEST="EXCLUSIVE-AREA">/Gpt_TI_F29H85x/Gpt/Gpt_Behaviour/GPT_EXCLUSIVE_AREA_0</CAN-ENTER-EXCLUSIVE-AREA-REF>
                  </CAN-ENTER-EXCLUSIVE-AREA-REFS>
                  <REENTRANCY-LEVEL>SINGLE-CORE-REENTRANT</REENTRANCY-LEVEL>
                  <CALL-POINTS>
                    <BSW-DIRECT-CALL-POINT>
                      <SHORT-NAME>Det_ReportError</SHORT-NAME>
                      <CALLED-ENTRY-REF DEST="BSW-MODULE-ENTRY">/AUTOSAR_Det/BSWModuleEntry/Det_ReportError</CALLED-ENTRY-REF>
                    </BSW-DIRECT-CALL-POINT>
                    <BSW-DIRECT-CALL-POINT>
                      <SHORT-NAME>Det_ReportRuntimeError</SHORT-NAME>
                      <CALLED-ENTRY-REF DEST="BSW-MODULE-ENTRY">/AUTOSAR_Det/BSWModuleEntry/Det_ReportRuntimeError</CALLED-ENTRY-REF>
                    </BSW-DIRECT-CALL-POINT>
                  </CALL-POINTS>
                  <IMPLEMENTED-ENTRY-REF DEST="BSW-MODULE-ENTRY">/Gpt_TI_F29H85x/Gpt_ModuleEntry/Gpt_StartTimer</IMPLEMENTED-ENTRY-REF>
                </BSW-CALLED-ENTITY>
                <BSW-CALLED-ENTITY UUID="fec275ef-99eb-46ff-b3df-d6482ca279da">
                  <SHORT-NAME>Gpt_StopTimer</SHORT-NAME>
                  <CAN-ENTER-EXCLUSIVE-AREA-REFS>
                    <CAN-ENTER-EXCLUSIVE-AREA-REF DEST="EXCLUSIVE-AREA">/Gpt_TI_F29H85x/Gpt/Gpt_Behaviour/GPT_EXCLUSIVE_AREA_0</CAN-ENTER-EXCLUSIVE-AREA-REF>
                  </CAN-ENTER-EXCLUSIVE-AREA-REFS>
                  <REENTRANCY-LEVEL>SINGLE-CORE-REENTRANT</REENTRANCY-LEVEL>
                  <CALL-POINTS>
[!IF "$GptDevErrorDetect_Enable = 'true'"!][!//                  
                    <BSW-DIRECT-CALL-POINT>
                      <SHORT-NAME>Det_ReportError</SHORT-NAME>
                      <CALLED-ENTRY-REF DEST="BSW-MODULE-ENTRY">/AUTOSAR_Det/BSWModuleEntry/Det_ReportError</CALLED-ENTRY-REF>
                    </BSW-DIRECT-CALL-POINT>
[!ENDIF!][!//                    
                  </CALL-POINTS>
                  <IMPLEMENTED-ENTRY-REF DEST="BSW-MODULE-ENTRY">/Gpt_TI_F29H85x/Gpt_ModuleEntry/Gpt_StopTimer</IMPLEMENTED-ENTRY-REF>
                </BSW-CALLED-ENTITY>
              </ENTITYS>
            </BSW-INTERNAL-BEHAVIOR>
          </INTERNAL-BEHAVIORS>
        </BSW-MODULE-DESCRIPTION>       
        <BSW-IMPLEMENTATION UUID="1112fffb-5837-425c-8b0b-180dbffc50c4">
          <SHORT-NAME>Gpt_impl</SHORT-NAME>
          <CODE-DESCRIPTORS>
            <CODE UUID="58547aee-e9b1-4467-aaf2-c2d1357fa970">
              <SHORT-NAME>Files</SHORT-NAME>
              <ARTIFACT-DESCRIPTORS>
                <AUTOSAR-ENGINEERING-OBJECT>
                  <SHORT-LABEL>generate::Gpt_Cfg.h</SHORT-LABEL>
                  <CATEGORY>SWHDR</CATEGORY>
                </AUTOSAR-ENGINEERING-OBJECT>
                <AUTOSAR-ENGINEERING-OBJECT>
                  <SHORT-LABEL>generate::src::Gpt_Cfg.c</SHORT-LABEL>
                  <CATEGORY>SWSRC</CATEGORY>
                </AUTOSAR-ENGINEERING-OBJECT>
                <AUTOSAR-ENGINEERING-OBJECT>
                  <SHORT-LABEL>generate::src::Gpt_PBcfg.c</SHORT-LABEL>
                  <CATEGORY>SWSRC</CATEGORY>
                </AUTOSAR-ENGINEERING-OBJECT>
                <AUTOSAR-ENGINEERING-OBJECT>
                  <SHORT-LABEL>include::Gpt.h</SHORT-LABEL>
                  <CATEGORY>SWHDR</CATEGORY>
                </AUTOSAR-ENGINEERING-OBJECT>
                <AUTOSAR-ENGINEERING-OBJECT>
                  <SHORT-LABEL>include::Gpt_Priv.h</SHORT-LABEL>
                  <CATEGORY>SWHDR</CATEGORY>
                </AUTOSAR-ENGINEERING-OBJECT>
                <AUTOSAR-ENGINEERING-OBJECT>
                  <SHORT-LABEL>src::Gpt.c</SHORT-LABEL>
                  <CATEGORY>SWSRC</CATEGORY>
                </AUTOSAR-ENGINEERING-OBJECT>
                <AUTOSAR-ENGINEERING-OBJECT>
                  <SHORT-LABEL>src::Gpt_Irq.c</SHORT-LABEL>
                  <CATEGORY>SWSRC</CATEGORY>
                </AUTOSAR-ENGINEERING-OBJECT>
                <AUTOSAR-ENGINEERING-OBJECT>
                  <SHORT-LABEL>src::Gpt_Priv.c</SHORT-LABEL>
                  <CATEGORY>SWSRC</CATEGORY>
                </AUTOSAR-ENGINEERING-OBJECT>
              </ARTIFACT-DESCRIPTORS>
            </CODE>
          </CODE-DESCRIPTORS>
          <COMPILERS>
            <COMPILER UUID="9ea0a548-c89f-460d-b98d-92a278701b2e">
              <SHORT-NAME>TI_C29Clang</SHORT-NAME>
              <NAME>TI_C29Clang</NAME>
              <VENDOR>Texas Instruments</VENDOR>
              <VERSION>2.2.0</VERSION>
            </COMPILER>
          </COMPILERS>
          <LINKERS>
            <LINKER UUID="63847d72-887f-40d9-86fc-ace71c464814">
              <SHORT-NAME>TI_C29Linker</SHORT-NAME>
              <NAME>TI_C29Linker</NAME>
              <VENDOR>Texas Instruments</VENDOR>
              <VERSION>2.2.0</VERSION>
            </LINKER>
          </LINKERS>
          <RESOURCE-CONSUMPTION UUID="65497ad7-cff2-40ce-9e8c-701d5182687d">
            <SHORT-NAME>ResourceConsumption</SHORT-NAME>
            <MEMORY-SECTIONS>
              <MEMORY-SECTION UUID="a35aea31-db95-454d-b4e6-83f4125d5103">
                <SHORT-NAME>GPT_CODE</SHORT-NAME>
                <ALIGNMENT>UNSPECIFIED</ALIGNMENT>
                <SW-ADDRMETHOD-REF DEST="SW-ADDR-METHOD">/AUTOSAR_MemMap/SwAddrMethods/CODE</SW-ADDRMETHOD-REF>
                <SYMBOL>CODE</SYMBOL>
              </MEMORY-SECTION>
              <MEMORY-SECTION UUID="a17d2198-29d3-49fd-8782-23706522a60b">
                <SHORT-NAME>GPT_CONFIG_DATA</SHORT-NAME>
                <ALIGNMENT>UNSPECIFIED</ALIGNMENT>
                <SW-ADDRMETHOD-REF DEST="SW-ADDR-METHOD">/AUTOSAR_MemMap/SwAddrMethods/CONST_PBCFG</SW-ADDRMETHOD-REF>
                <SYMBOL>CONFIG_DATA</SYMBOL>
              </MEMORY-SECTION>
              <MEMORY-SECTION UUID="b3d6b3c7-8d63-40ed-8310-e8475cda71fd">
                <SHORT-NAME>GPT_ISR_CODE</SHORT-NAME>
                <ALIGNMENT>UNSPECIFIED</ALIGNMENT>
                <SW-ADDRMETHOD-REF DEST="SW-ADDR-METHOD">/AUTOSAR_MemMap/SwAddrMethods/CODE</SW-ADDRMETHOD-REF>
                <SYMBOL>ISR_CODE</SYMBOL>
              </MEMORY-SECTION>
              <MEMORY-SECTION UUID="4847f948-283f-4ff2-8979-a546ec0f63ec">
                <SHORT-NAME>GPT_VAR_INIT_BOOLEAN</SHORT-NAME>
                <ALIGNMENT>BOOLEAN</ALIGNMENT>
                <SW-ADDRMETHOD-REF DEST="SW-ADDR-METHOD">/AUTOSAR_MemMap/SwAddrMethods/VAR_INIT</SW-ADDRMETHOD-REF>
                <SYMBOL>VAR_INIT_BOOLEAN</SYMBOL>
              </MEMORY-SECTION>
              <MEMORY-SECTION UUID="4847f948-243f-4ff2-8674-a546ec0f64ec">
                <SHORT-NAME>GPT_VAR_NO_INIT_UNSPECIFIED</SHORT-NAME>
                <ALIGNMENT>UNSPECIFIED</ALIGNMENT>
                <SW-ADDRMETHOD-REF DEST="SW-ADDR-METHOD">/AUTOSAR_MemMap/SwAddrMethods/VAR_NO_INIT</SW-ADDRMETHOD-REF>
                <SYMBOL>VAR_NO_INIT_UNSPECIFIED</SYMBOL>
              </MEMORY-SECTION>
              <MEMORY-SECTION UUID="4557f848-233f-4ff3-8679-a546ec0f64ec">
                <SHORT-NAME>GPT_VAR_INIT_UNSPECIFIED</SHORT-NAME>
                <ALIGNMENT>UNSPECIFIED</ALIGNMENT>
                <SW-ADDRMETHOD-REF DEST="SW-ADDR-METHOD">/AUTOSAR_MemMap/SwAddrMethods/VAR_INIT</SW-ADDRMETHOD-REF>
                <SYMBOL>VAR_INIT_UNSPECIFIED</SYMBOL>
              </MEMORY-SECTION>
            </MEMORY-SECTIONS>
          </RESOURCE-CONSUMPTION>
          <SW-VERSION>[!"$moduleSoftwareVer"!]</SW-VERSION>
          <VENDOR-ID>44</VENDOR-ID>
          <AR-RELEASE-VERSION>[!"substring-after($moduleReleaseVer, 'AUTOSAR ')"!]</AR-RELEASE-VERSION>
          <BEHAVIOR-REF DEST="BSW-INTERNAL-BEHAVIOR">/Gpt_TI_F29H85x/Gpt/Gpt_Behaviour</BEHAVIOR-REF>
          <VENDOR-SPECIFIC-MODULE-DEF-REFS>
            <VENDOR-SPECIFIC-MODULE-DEF-REF DEST="ECUC-MODULE-DEF">/TI_F29H85x/Gpt</VENDOR-SPECIFIC-MODULE-DEF-REF>
          </VENDOR-SPECIFIC-MODULE-DEF-REFS>
        </BSW-IMPLEMENTATION>
      </ELEMENTS>
      <AR-PACKAGES>
        <AR-PACKAGE UUID="49d0d501-784c-467b-be70-c3ba92e3cefe">
          <SHORT-NAME>Gpt_ModuleEntry</SHORT-NAME>
          <ELEMENTS>
            <BSW-MODULE-ENTRY UUID="a50a2035-f8a4-4289-acac-2e972d80b870">
              <SHORT-NAME>Gpt_Ch0Isr</SHORT-NAME>
              <IS-REENTRANT>false</IS-REENTRANT>
              <IS-SYNCHRONOUS>true</IS-SYNCHRONOUS>
              <CALL-TYPE>INTERRUPT</CALL-TYPE>
[!IF "GptTypeofInterrupt   = 'GPT_ISR_CAT2'"!][!//
              <EXECUTION-CONTEXT>INTERRUPT-CAT-2</EXECUTION-CONTEXT>
[!ELSE!][!//
              <EXECUTION-CONTEXT>INTERRUPT-CAT-1</EXECUTION-CONTEXT>
[!ENDIF!][!//
              <SW-SERVICE-IMPL-POLICY>STANDARD</SW-SERVICE-IMPL-POLICY>
              <BSW-ENTRY-KIND>CONCRETE</BSW-ENTRY-KIND>
            </BSW-MODULE-ENTRY>
            <BSW-MODULE-ENTRY UUID="56432ba8-a291-44d1-9f56-1a1c1ed8245c">
              <SHORT-NAME>Gpt_Ch1Isr</SHORT-NAME>
              <IS-REENTRANT>false</IS-REENTRANT>
              <IS-SYNCHRONOUS>true</IS-SYNCHRONOUS>
              <CALL-TYPE>INTERRUPT</CALL-TYPE>
[!IF "GptTypeofInterrupt   = 'GPT_ISR_CAT2'"!][!//            
              <EXECUTION-CONTEXT>INTERRUPT-CAT-2</EXECUTION-CONTEXT>
[!ELSE!][!//
              <EXECUTION-CONTEXT>INTERRUPT-CAT-1</EXECUTION-CONTEXT>
[!ENDIF!][!//              
              <SW-SERVICE-IMPL-POLICY>STANDARD</SW-SERVICE-IMPL-POLICY>
              <BSW-ENTRY-KIND>CONCRETE</BSW-ENTRY-KIND>
            </BSW-MODULE-ENTRY>
            <BSW-MODULE-ENTRY UUID="454ea6f4-7268-4289-98ba-6a7178b000ce">
              <SHORT-NAME>Gpt_Ch2Isr</SHORT-NAME>
              <IS-REENTRANT>false</IS-REENTRANT>
              <IS-SYNCHRONOUS>true</IS-SYNCHRONOUS>
              <CALL-TYPE>INTERRUPT</CALL-TYPE>
[!IF "GptTypeofInterrupt   = 'GPT_ISR_CAT2'"!][!//            
              <EXECUTION-CONTEXT>INTERRUPT-CAT-2</EXECUTION-CONTEXT>
[!ELSE!][!//
              <EXECUTION-CONTEXT>INTERRUPT-CAT-1</EXECUTION-CONTEXT>
[!ENDIF!][!// 
              <SW-SERVICE-IMPL-POLICY>STANDARD</SW-SERVICE-IMPL-POLICY>
              <BSW-ENTRY-KIND>CONCRETE</BSW-ENTRY-KIND>
            </BSW-MODULE-ENTRY>
            <BSW-MODULE-ENTRY UUID="9907f151-fcb1-4277-9b57-ddddb199c3fd">
              <SHORT-NAME>Gpt_CheckWakeup</SHORT-NAME>
              <SERVICE-ID>12</SERVICE-ID>
              <IS-REENTRANT>true</IS-REENTRANT>
              <IS-SYNCHRONOUS>true</IS-SYNCHRONOUS>
              <CALL-TYPE>REGULAR</CALL-TYPE>
              <EXECUTION-CONTEXT>UNSPECIFIED</EXECUTION-CONTEXT>
              <SW-SERVICE-IMPL-POLICY>STANDARD</SW-SERVICE-IMPL-POLICY>
              <BSW-ENTRY-KIND>CONCRETE</BSW-ENTRY-KIND>
            </BSW-MODULE-ENTRY>
            <BSW-MODULE-ENTRY UUID="f76b4d11-f58f-4081-ba20-983320675f54">
              <SHORT-NAME>Gpt_DeInit</SHORT-NAME>
              <SERVICE-ID>2</SERVICE-ID>
              <IS-REENTRANT>false</IS-REENTRANT>
              <IS-SYNCHRONOUS>true</IS-SYNCHRONOUS>
              <CALL-TYPE>REGULAR</CALL-TYPE>
              <EXECUTION-CONTEXT>UNSPECIFIED</EXECUTION-CONTEXT>
              <SW-SERVICE-IMPL-POLICY>STANDARD</SW-SERVICE-IMPL-POLICY>
              <BSW-ENTRY-KIND>CONCRETE</BSW-ENTRY-KIND>
            </BSW-MODULE-ENTRY>
            <BSW-MODULE-ENTRY UUID="bc336eb3-5ad2-40aa-9e47-5213e821499e">
              <SHORT-NAME>Gpt_DisableNotification</SHORT-NAME>
              <SERVICE-ID>8</SERVICE-ID>
              <IS-REENTRANT>true</IS-REENTRANT>
              <IS-SYNCHRONOUS>true</IS-SYNCHRONOUS>
              <CALL-TYPE>REGULAR</CALL-TYPE>
              <EXECUTION-CONTEXT>UNSPECIFIED</EXECUTION-CONTEXT>
              <SW-SERVICE-IMPL-POLICY>STANDARD</SW-SERVICE-IMPL-POLICY>
              <BSW-ENTRY-KIND>CONCRETE</BSW-ENTRY-KIND>
            </BSW-MODULE-ENTRY>
            <BSW-MODULE-ENTRY UUID="837879b2-128e-44f0-b7ef-cab18061087a">
              <SHORT-NAME>Gpt_DisableWakeup</SHORT-NAME>
              <SERVICE-ID>10</SERVICE-ID>
              <IS-REENTRANT>true</IS-REENTRANT>
              <IS-SYNCHRONOUS>true</IS-SYNCHRONOUS>
              <CALL-TYPE>REGULAR</CALL-TYPE>
              <EXECUTION-CONTEXT>UNSPECIFIED</EXECUTION-CONTEXT>
              <SW-SERVICE-IMPL-POLICY>STANDARD</SW-SERVICE-IMPL-POLICY>
              <BSW-ENTRY-KIND>CONCRETE</BSW-ENTRY-KIND>
            </BSW-MODULE-ENTRY>
            <BSW-MODULE-ENTRY UUID="ccf24e2e-2bc9-4bde-9f69-cc495f51a0c6">
              <SHORT-NAME>Gpt_EnableNotification</SHORT-NAME>
              <SERVICE-ID>7</SERVICE-ID>
              <IS-REENTRANT>true</IS-REENTRANT>
              <IS-SYNCHRONOUS>true</IS-SYNCHRONOUS>
              <CALL-TYPE>REGULAR</CALL-TYPE>
              <EXECUTION-CONTEXT>UNSPECIFIED</EXECUTION-CONTEXT>
              <SW-SERVICE-IMPL-POLICY>STANDARD</SW-SERVICE-IMPL-POLICY>
              <BSW-ENTRY-KIND>CONCRETE</BSW-ENTRY-KIND>
            </BSW-MODULE-ENTRY>
            <BSW-MODULE-ENTRY UUID="87dd1092-a436-4ef5-a3d6-16de622ec74f">
              <SHORT-NAME>Gpt_EnableWakeup</SHORT-NAME>
              <SERVICE-ID>11</SERVICE-ID>
              <IS-REENTRANT>true</IS-REENTRANT>
              <IS-SYNCHRONOUS>true</IS-SYNCHRONOUS>
              <CALL-TYPE>REGULAR</CALL-TYPE>
              <EXECUTION-CONTEXT>UNSPECIFIED</EXECUTION-CONTEXT>
              <SW-SERVICE-IMPL-POLICY>STANDARD</SW-SERVICE-IMPL-POLICY>
              <BSW-ENTRY-KIND>CONCRETE</BSW-ENTRY-KIND>
            </BSW-MODULE-ENTRY>
            <BSW-MODULE-ENTRY UUID="f2fa20df-ace5-4c25-90a8-52ca11ca0e43">
              <SHORT-NAME>Gpt_GetPredefTimerValue</SHORT-NAME>
              <SERVICE-ID>13</SERVICE-ID>
              <IS-REENTRANT>true</IS-REENTRANT>
              <IS-SYNCHRONOUS>true</IS-SYNCHRONOUS>
              <CALL-TYPE>REGULAR</CALL-TYPE>
              <SW-SERVICE-IMPL-POLICY>STANDARD</SW-SERVICE-IMPL-POLICY>
              <BSW-ENTRY-KIND>CONCRETE</BSW-ENTRY-KIND>
            </BSW-MODULE-ENTRY>
            <BSW-MODULE-ENTRY UUID="c6f7bad0-2e2d-4973-8809-48c5b981a628">
              <SHORT-NAME>Gpt_GetTimeElapsed</SHORT-NAME>
              <SERVICE-ID>3</SERVICE-ID>
              <IS-REENTRANT>true</IS-REENTRANT>
              <IS-SYNCHRONOUS>true</IS-SYNCHRONOUS>
              <CALL-TYPE>REGULAR</CALL-TYPE>
              <EXECUTION-CONTEXT>UNSPECIFIED</EXECUTION-CONTEXT>
              <SW-SERVICE-IMPL-POLICY>STANDARD</SW-SERVICE-IMPL-POLICY>
              <BSW-ENTRY-KIND>CONCRETE</BSW-ENTRY-KIND>
            </BSW-MODULE-ENTRY>
            <BSW-MODULE-ENTRY UUID="39f4dc9a-050a-403d-abe0-c59051860bc2">
              <SHORT-NAME>Gpt_GetTimeRemaining</SHORT-NAME>
              <SERVICE-ID>4</SERVICE-ID>
              <IS-REENTRANT>true</IS-REENTRANT>
              <IS-SYNCHRONOUS>true</IS-SYNCHRONOUS>
              <CALL-TYPE>REGULAR</CALL-TYPE>
              <EXECUTION-CONTEXT>UNSPECIFIED</EXECUTION-CONTEXT>
              <SW-SERVICE-IMPL-POLICY>STANDARD</SW-SERVICE-IMPL-POLICY>
              <BSW-ENTRY-KIND>CONCRETE</BSW-ENTRY-KIND>
            </BSW-MODULE-ENTRY>
            <BSW-MODULE-ENTRY UUID="7403bc97-2282-484c-b96c-63e16ab3305b">
              <SHORT-NAME>Gpt_GetVersionInfo</SHORT-NAME>
              <SERVICE-ID>0</SERVICE-ID>
              <IS-REENTRANT>true</IS-REENTRANT>
              <IS-SYNCHRONOUS>true</IS-SYNCHRONOUS>
              <CALL-TYPE>REGULAR</CALL-TYPE>
              <EXECUTION-CONTEXT>UNSPECIFIED</EXECUTION-CONTEXT>
              <SW-SERVICE-IMPL-POLICY>STANDARD</SW-SERVICE-IMPL-POLICY>
              <BSW-ENTRY-KIND>CONCRETE</BSW-ENTRY-KIND>
            </BSW-MODULE-ENTRY>
            <BSW-MODULE-ENTRY UUID="04c93879-99f9-4d8e-bb19-d20a0798432e">
              <SHORT-NAME>Gpt_Init</SHORT-NAME>
              <SERVICE-ID>1</SERVICE-ID>
              <IS-REENTRANT>false</IS-REENTRANT>
              <IS-SYNCHRONOUS>true</IS-SYNCHRONOUS>
              <CALL-TYPE>REGULAR</CALL-TYPE>
              <EXECUTION-CONTEXT>UNSPECIFIED</EXECUTION-CONTEXT>
              <SW-SERVICE-IMPL-POLICY>STANDARD</SW-SERVICE-IMPL-POLICY>
              <BSW-ENTRY-KIND>CONCRETE</BSW-ENTRY-KIND>
            </BSW-MODULE-ENTRY>
            <BSW-MODULE-ENTRY UUID="b0544b32-9f88-4c65-b049-7fb902f61ea4">
              <SHORT-NAME>Gpt_SetMode</SHORT-NAME>
              <SERVICE-ID>9</SERVICE-ID>
              <IS-REENTRANT>false</IS-REENTRANT>
              <IS-SYNCHRONOUS>true</IS-SYNCHRONOUS>
              <CALL-TYPE>REGULAR</CALL-TYPE>
              <EXECUTION-CONTEXT>UNSPECIFIED</EXECUTION-CONTEXT>
              <SW-SERVICE-IMPL-POLICY>STANDARD</SW-SERVICE-IMPL-POLICY>
              <BSW-ENTRY-KIND>CONCRETE</BSW-ENTRY-KIND>
            </BSW-MODULE-ENTRY>
            <BSW-MODULE-ENTRY UUID="71fdd36c-ecb7-4811-a441-a979d2d92147">
              <SHORT-NAME>Gpt_StartTimer</SHORT-NAME>
              <SERVICE-ID>5</SERVICE-ID>
              <IS-REENTRANT>true</IS-REENTRANT>
              <IS-SYNCHRONOUS>true</IS-SYNCHRONOUS>
              <CALL-TYPE>REGULAR</CALL-TYPE>
              <EXECUTION-CONTEXT>UNSPECIFIED</EXECUTION-CONTEXT>
              <SW-SERVICE-IMPL-POLICY>STANDARD</SW-SERVICE-IMPL-POLICY>
              <BSW-ENTRY-KIND>CONCRETE</BSW-ENTRY-KIND>
            </BSW-MODULE-ENTRY>
            <BSW-MODULE-ENTRY UUID="2c043d29-babc-440f-903c-46f7a63c5a40">
              <SHORT-NAME>Gpt_StopTimer</SHORT-NAME>
              <SERVICE-ID>6</SERVICE-ID>
              <IS-REENTRANT>true</IS-REENTRANT>
              <IS-SYNCHRONOUS>true</IS-SYNCHRONOUS>
              <CALL-TYPE>REGULAR</CALL-TYPE>
              <EXECUTION-CONTEXT>UNSPECIFIED</EXECUTION-CONTEXT>
              <SW-SERVICE-IMPL-POLICY>STANDARD</SW-SERVICE-IMPL-POLICY>
              <BSW-ENTRY-KIND>CONCRETE</BSW-ENTRY-KIND>
            </BSW-MODULE-ENTRY>
          </ELEMENTS>
        </AR-PACKAGE>
      </AR-PACKAGES>
    </AR-PACKAGE>
  </AR-PACKAGES>
[!ENDSELECT!]  
</AUTOSAR>
