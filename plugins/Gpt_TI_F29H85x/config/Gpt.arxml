AUTOSAR XML (schema 00044)
package /TI_F29H85x
  ecuc definition collection myEcuParameterDefinition: module=Gpt
  module definition Gpt: post-build-variant-support=true, refined-module-def=Gpt, variants post-build/pre-compile  # Configuration of the Gpt (General Purpose Timer) module.
    container GptChannelConfigSet  # This container is the base of a Configuration Set which contains the configured GPT channels. This way, different configuration sets can be defined for post-build process.
      boolean GptUseTimer2InOS: origin=Texas Instruments, set at pre-compile, default-value=false  # Enable/Disable of CPU timer2 usage in OS
      container GptChannelConfiguration [1..3]  # Configuration of an individual GPT channel.
        integer GptChannelId: 0..2, scope=ECU, set at pre-compile, symbolic-name-value=true, default-value=0  # Channel Id of the GPT channel. This value will be assigned to the symbolic name derived of the GptChannelConfiguration container short name.
        enumeration GptChannelMode: {GPT_CH_MODE_CONTINUOUS, GPT_CH_MODE_ONESHOT}, scope=ECU, post-build-variant-value=true, set at post-build in variant post-build / pre-compile in variant pre-compile, default-value=GPT_CH_MODE_ONESHOT  # Specifies the behavior of the timer channel after the target time is reached.
        integer GptChannelPrescaleValue: 0..65535, origin=Texas Instruments, set at pre-compile in variant pre-compile / post-build in variant post-build, default-value=0  # The input GPT clock will be divided by this value
        float GptChannelTickFrequency: 0.0..INF, scope=ECU, post-build-variant-value=true, set at post-build in variant post-build / pre-compile in variant pre-compile, default-value=1.0  # Specifies the tick frequency of the timer channel in Hz.
        integer GptChannelTickValueMax: 0..4294967295, scope=ECU, post-build-variant-value=true, set at post-build in variant post-build / pre-compile in variant pre-compile, default-value=4294967295  # Maximum value in ticks, the timer channel is able to count. With the next tick, the timer rolls over to zero.
        boolean GptEnableWakeup: post-build-variant-value=true, set at post-build in variant post-build / pre-compile in variant pre-compile, default-value=false  # Enables wakeup capability of MCU for a channel.
        function name GptNotification [0..1]: multiplicity set at post-build in variant post-build / pre-compile in variant pre-compile, post-build-variant-multiplicity=true, post-build-variant-value=true, set at post-build in variant post-build / pre-compile in variant pre-compile, default-value=NULL_PTR  # Function pointer to callback function (for non-wakeup notification)
        enumeration GptSimulationStatus: {GPT_SIM_DISABLE, GPT_SIM_ENABLE}, scope=ECU, origin=Texas Instruments, post-build-variant-value=true, set at post-build in variant post-build / pre-compile in variant pre-compile, default-value=GPT_SIM_DISABLE  # Specifies the simulation state(Enable/Disable) of the timer.
        enumeration GptSimulationMode: {GPT_SIM_STOP_TIMER_AT_NEXT_COUNTER_DEC, GPT_SIM_STOP_TIMER_AT_NEXT_TIMER_ELAPSE}, scope=ECU, origin=Texas Instruments, post-build-variant-value=true, set at post-build in variant post-build / pre-compile in variant pre-compile, default-value=GPT_SIM_STOP_TIMER_AT_NEXT_COUNTER_DEC  # Specifies the behavior of the timer in simulation mode(Stop timer at next counter decrement or Stop timer at nect elapsed time).
        enumeration GptTypeofInterrupt: {GPT_ISR_CAT1_RTINT, GPT_ISR_CAT1_INT, GPT_ISR_CAT2}, origin=Texas Instruments, set at pre-compile, default-value=GPT_ISR_CAT1_RTINT  # Type of ISR function
        reference GptChannelClkSrcRef [0..1]: post-build-variant-value=true, set at post-build in variant post-build / pre-compile in variant pre-compile, destination=GptClockReferencePoint  # Reference to the GptClockReferencePoint from which the channel
        container GptWakeupConfiguration [0..1]  # Function pointer to callback function (for wakeup notification).
          symbolic name reference GptWakeupSourceRef: post-build-variant-value=true, set at post-build in variant post-build / pre-compile in variant pre-compile, destination=EcuMWakeupSource  # In case the wakeup-capability is true this value is transmitted to the Ecu State Manager.
    container GptConfigurationOfOptApiServices  # This container contains all configuration switches for configuring optional API services of the GPT driver.
      boolean GptDeinitApi: set at pre-compile, default-value=false  # Adds / removes the service Gpt_DeInit() from the code.
      boolean GptEnableDisableNotificationApi: set at pre-compile, default-value=false  # Adds / removes the services Gpt_EnableNotification() and Gpt_DisableNotification from the code.
      boolean GptTimeElapsedApi: set at pre-compile, default-value=false  # Adds / removes the service Gpt_GetTimeElapsed() from the code
      boolean GptTimeRemainingApi: set at pre-compile, default-value=false  # Adds / removes the service Gpt_GetTimeRemaining() from the code.
      boolean GptVersionInfoApi: set at pre-compile, default-value=false  # Adds / removes the service Gpt_GetVersionInfo() from the code.
      boolean GptWakeupFunctionalityApi: set at pre-compile, default-value=false  # Adds / removes the services Gpt_SetMode(), Gpt_EnableWakeup() Gpt_DisableWakeup() and Gpt_CheckWakeup() from the code.
    container GptDriverConfiguration  # This container contains the module-wide configuration (parameters) of the GPT Driver
      boolean GptDevErrorDetect: set at pre-compile, default-value=false  # Switches the development error detection and notification on or off.
      boolean GptPredefTimer100us32bitEnable: scope=ECU, set at pre-compile, default-value=false  # Enables/disables the GPT Predef Timer 100?s32bit.
      enumeration GptPredefTimer1usEnablingGrade: {GPT_PREDEF_TIMER_1US_16BIT_ENABLED, GPT_PREDEF_TIMER_1US_16_24BIT_ENABLED, GPT_PREDEF_TIMER_1US_16_24_32BIT_ENABLED, GPT_PREDEF_TIMER_1US_DISABLED}, scope=ECU, set at pre-compile, default-value=GPT_PREDEF_TIMER_1US_DISABLED  # Specifies the grade of enabling the GPT Predef Timers with 1?s tick duration.
      boolean GptReportWakeupSource: set at pre-compile, default-value=false  # Enables/Disables wakeup source reporting.
      container GptClockReferencePoint  # This container is required for AUTOSAR compliance but is not used in C29x platform. Add one instance with default values to satisfy the minimum multiplicity constraint.
        reference GptClockReference: set at pre-compile, destination=McuClockReferencePoint  # Reference to a container of the type McuClockReferencePoint. Not used in C29x platform as the Mcu module handles the GPT clock configuration.
