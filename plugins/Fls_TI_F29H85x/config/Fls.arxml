AUTOSAR XML (schema 00044)
package /TI_F29H85x
  ecuc definition collection myEcuParameterDefinition: module=Fls
  module definition Fls [1..*]: post-build-variant-support=true, refined-module-def=Fls, variants post-build/pre-compile  # Configuration of the Fls (internal or external flash driver) module.
    container FlsConfigSet  # Container for runtime configuration parameters of the flash driver.
      integer FlsAcErase: 0..4294967295, post-build-variant-value=true, set at post-build in variant post-build / pre-compile in variant pre-compile, default-value=100  # Address offset in RAM to which the erase flash access code shall be loaded.
      integer FlsAcWrite: 0..4294967295, post-build-variant-value=true, set at post-build in variant post-build / pre-compile in variant pre-compile, default-value=16  # Address offset in RAM to which the write flash access code shall be loaded.
      float FlsCallCycle: 0.0..100.0, post-build-variant-value=true, set at post-build in variant post-build / pre-compile in variant pre-compile, default-value=0.01  # Cycle time of calls of the flash driver's main function (in seconds).
      enumeration FlsDefaultMode: {MEMIF_MODE_FAST, MEMIF_MODE_SLOW}, post-build-variant-value=true, set at post-build in variant post-build / pre-compile in variant pre-compile, default-value=MEMIF_MODE_SLOW  # This parameter is the default FLS device mode after initialization.
      function name FlsJobEndNotification [0..1]: multiplicity set at post-build in variant post-build / pre-compile in variant pre-compile, post-build-variant-multiplicity=true, post-build-variant-value=true, set at post-build in variant post-build / pre-compile in variant pre-compile, default-value=NULL_PTR  # Mapped to the job end notification routine provided by some upper layer module, typically the Fee module.
      function name FlsJobErrorNotification [0..1]: multiplicity set at post-build in variant post-build / pre-compile in variant pre-compile, post-build-variant-multiplicity=true, post-build-variant-value=true, set at post-build in variant post-build / pre-compile in variant pre-compile, default-value=NULL_PTR  # Mapped to the job error notification routine provided by some upper layer module, typically the Fee module.
      integer FlsMaxReadFastMode: 0..4294967295, post-build-variant-value=true, set at post-build in variant post-build / pre-compile in variant pre-compile, default-value=16  # The maximum number of bytes to read or compare in one cycle of the flash driver's job processing function in fast mode.
      integer FlsMaxWriteFastMode: 0..4294967295, post-build-variant-value=true, set at post-build in variant post-build / pre-compile in variant pre-compile, default-value=16  # The maximum number of bytes to read or compare in one cycle of the flash driver's job processing function in fast mode.
      integer FlsMaxReadNormalMode: 0..4294967295, post-build-variant-value=true, set at post-build in variant post-build / pre-compile in variant pre-compile, default-value=16  # The maximum number of bytes to read or compare in one cycle of the flash driver's job processing function in normal mode.
      integer FlsMaxWriteNormalMode: 8..16, post-build-variant-value=true, set at post-build in variant post-build / pre-compile in variant pre-compile, default-value=16  # The maximum number of bytes to write in one cycle of the flash driver's job processing function in normal mode. It must be 8 bytes or 16 bytes
      integer FlsProtection: 0..4294967295, post-build-variant-value=true, set at post-build in variant post-build / pre-compile in variant pre-compile, default-value=0  # Erase/write protection settings. Only relevant if supported by hardware. Currently, not supported by Hardware.
      integer Fls_CMDWEPROTA: 0..4294967295, origin=Texas Instruments, post-build-variant-value=true, set at post-build in variant post-build / pre-compile in variant pre-compile, default-value=0  # Erase/write protection settings. CMDWEPROTA controls program/erase protection for first 32 sectors. Each bit allows users to enable/disable protection for each sector. Eg: Bit 0 allows protection configuration for Sectors 0. A value of 0 disables protection and a value of 1 enables protection from program/erase
      integer Fls_CMDWEPROTB: 0..4294967295, origin=Texas Instruments, post-build-variant-value=true, set at post-build in variant post-build / pre-compile in variant pre-compile, default-value=0  # Erase/write protection settings. CMDWEPROTB controls program/erase protection for sectors 32 to 255. Each bit allows users to enable/disable protection for a group of eight sectors. Note - The first 4 bit fields are reserved (bits 0-3) and protection of bit 4 and above would begin at sector 32. Eg: Bit 4 allows protection configuration for Sectors 32-39. A value of 0 disables protection and a value of 1 enables protection from program/erase
      container FlsExternalDriver [0..1]  # This container is present for external Flash drivers only. Internal Flash drivers do not use the parameter listed in this container, hence its multiplicity is 0 for internal drivers. Currently, not supported as only internal flash is present.
        symbolic name reference FlsSpiReference [1..*]: multiplicity set at pre-compile, set at pre-compile, destination=SpiSequence  # Reference to SPI sequence (required for external Flash drivers).
      container FlsSectorList  # List of flashable sectors and pages.
        container FlsSector [1..*]  # Configuration description of a flashable sector
          integer FlsNumberOfSectors: 0..65535, set at pre-compile, default-value=1  # Number of continuous sectors with identical values for FlsSectorSize and
          integer FlsPageSize: 0..4294967295, set at pre-compile, default-value=256  # Size of one page of this sector.
          integer FlsSectorSize: 0..4294967295, set at pre-compile, default-value=2048  # Size of this sector.
          integer FlsSectorStartaddress: 0..4294967295, set at pre-compile, default-value=0  # Start address of this sector.
    container FlsGeneral  # Container for general parameters of the flash driver. These parameters are always pre-compile.
      enumeration FlsDeviceVariant: {F29H85x}, origin=Texas Instruments, set at pre-compile, default-value=F29H85x  # Select required Device Variant.
      boolean FlsAcLoadOnJobStart: set at pre-compile, default-value=false  # The flash driver shall load the flash access code to RAM whenever an erase or write job is started and unload (overwrite) it after that job has been finished or canceled.
      integer FlsPointToRamBaseAddress [0..0]: 0..4294967295, origin=Texas Instruments, set at pre-compile, default-value=536870912  # The RAM memory start address.
      integer FlsBaseAddress: 0..4294967295, set at pre-compile, default-value=281018368  # The flash memory start address (see also SWS_Fls_00208 and SWS_Fls_00209).
      integer FlsTotalSize: 0..4294967295, set at pre-compile, default-value=262144  # The total amount of flash memory in bytes (see also SWS_Fls_00208 and SWS_Fls_00209).
      integer FlsNumBanks: 0..4294967295, origin=Texas Instruments, set at pre-compile, default-value=1  # The number of banks present in the current device.
      integer FlsSectorSizeInBytes: 0..4294967295, origin=Texas Instruments, set at pre-compile, default-value=2048  # The flash memory's sector size in bytes.
      boolean FlsBlankCheckApi: set at pre-compile, default-value=false  # Compile switch to enable/disable the Fls_BlankCheck function.
      boolean FlsCancelApi: set at pre-compile, default-value=true  # Compile switch to enable and disable the Fls_Cancel function.
      boolean FlsCompareApi: set at pre-compile, default-value=false  # Compile switch to enable and disable the Fls_Compare function.
      boolean FlsDevErrorDetect: set at pre-compile, default-value=true  # Switches the development error detection and notification on or off.
      integer FlsDriverIndex: 0..254, scope=ECU, set at pre-compile, symbolic-name-value=true, default-value=0  # Index of the driver, used by FEE.
      boolean FlsEraseVerificationEnabled: set at pre-compile, default-value=false  # Compile switch to enable erase verification.
      boolean FlsGetJobResultApi: set at pre-compile, default-value=true  # Compile switch to enable and disable the Fls_GetJobResult function.
      boolean FlsGetStatusApi: set at pre-compile, default-value=true  # Compile switch to enable and disable the Fls_GetStatus function.
      boolean FlsSetModeApi: set at pre-compile, default-value=false  # Compile switch to enable and disable the Fls_SetMode function.
      boolean FlsTimeoutSupervisionEnabled: set at pre-compile, default-value=false  # Compile switch to enable timeout supervision.
      boolean FlsUseInterrupts: set at pre-compile, default-value=false  # Job processing triggered by hardware interrupt.
      boolean FlsVersionInfoApi: set at pre-compile, default-value=true  # Pre-processor switch to enable / disable the API to read out the modules version information.
      boolean FlsWriteVerificationEnabled: set at pre-compile, default-value=false  # Compile switch to enable write verification.
      enumeration FlsIrqType: {FLS_ISR_VOID, FLS_ISR_CAT1, FLS_ISR_CAT2}, origin=Texas Instruments, set at pre-compile, default-value=FLS_ISR_CAT1  # Type of Isr function: void functionname(void) CAT1 see description in oil tool : interrupt void func(void) CAT2 see description in oil tool : ISR(func)
      integer FlsDefaultOSCounterId: 0..16, origin=Texas Instruments, set at pre-compile, default-value=0  # Default Os Counter Id if node reference to OsCounter ref FlsOsCounterRef is not set
      integer FlsWaitStates: 1..3, origin=Texas Instruments, set at pre-compile, default-value=3  # defines the number of random access wait states. When CPU performs a read access to Flash, data is returned after (RWAIT + 1) SYSCLK cycles.
      reference FlsSysClockRef: origin=Texas Instruments, set at pre-compile in variant pre-compile / link in variant link-time / post-build in variant post-build, destination=McuClockReferencePoint  # This parameter references the SYSCLK to convert timeout values from milliseconds to clock ticks. Users should ensure the correct clock reference point is selected to achieve accurate timeout calculations.
      reference FlsCpuClockRef: origin=Texas Instruments, set at pre-compile, destination=McuClockReferencePoint  # Reference to the CPU clock configuration, which is set in the MCU driver configuration
    container FlsPublishedInformation  # Additional published parameters not covered by CommonPublishedInformation container.
      integer FlsAcLocationErase: 0..4294967295, set at published-information, default-value=0  # Position in RAM, to which the erase flash access code has to be loaded.
      integer FlsAcLocationWrite: 0..4294967295, set at published-information, default-value=0  # Position in RAM, to which the write flash access code has to be loaded.
      integer FlsAcSizeErase: 0..4294967295, set at published-information, default-value=16  # Number of bytes in RAM needed for the erase flash access code.
      integer FlsAcSizeWrite: 0..4294967295, set at published-information, default-value=16  # Number of bytes in RAM needed for the write flash access code.
      integer FlsErasedValue: 0..4294967295, set at published-information, default-value=255  # The contents of an erased flash memory cell.
      float FlsEraseTime: 0.0..4.294967294E9, set at published-information, default-value=1003000.0  # Maximum time to erase one complete flash sector in micro seconds.
      string FlsExpectedHwId: set at published-information, default-value=0  # Unique identifier of the hardware device that is expected by this driver (the device for which this driver has been implemented).
      integer FlsSpecifiedEraseCycles: 0..4294967295, set at published-information, default-value=100000  # Number of erase cycles specified for the flash device (usually given in the device data sheet).
      integer FlsSpecifiedEraseCyclesForHigherMemory: 0..4294967295, origin=Texas Instruments, set at published-information, default-value=100000  # Number of erase cycles specified for the flash device for the memory greater than first 32KB (usually given in the device data sheet).
      float FlsWriteTime: 0.0..4.294967294E9, set at published-information, default-value=635.0  # Maximum time to program one flash word (16 bytes) in micro-seconds.
