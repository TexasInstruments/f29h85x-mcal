<?xml version="1.0" encoding="UTF-8"?>
[!AUTOSPACING!][!//
<AUTOSAR xmlns="http://autosar.org/schema/r4.0" xmlns:xsi="http://www.w3.org/2001/XMLSchema-instance" xsi:schemaLocation="http://autosar.org/schema/r4.0 AUTOSAR_00044.xsd">
    <AR-PACKAGES>
        <AR-PACKAGE UUID="[!"as:uuid()"!]">
        <SHORT-NAME>Fls_TI_F29H85x</SHORT-NAME>

            <ELEMENTS>
                <BSW-MODULE-DESCRIPTION UUID="[!"as:uuid()"!]">
                <SHORT-NAME>Fls</SHORT-NAME>
                    <IMPLEMENTED-ENTRYS>
                        [!IF "as:modconf('Fls')[1]/FlsGeneral/FlsBlankCheckApi = 'true'"!]
                        <BSW-MODULE-ENTRY-REF-CONDITIONAL>
                        <BSW-MODULE-ENTRY-REF DEST="BSW-MODULE-ENTRY">/Fls_TI_F29H85x/Fls_ModuleEntry/Fls_BlankCheck</BSW-MODULE-ENTRY-REF>
                        </BSW-MODULE-ENTRY-REF-CONDITIONAL>
                        [!ENDIF!]
                        [!IF "as:modconf('Fls')[1]/FlsGeneral/FlsCancelApi = 'true'"!]
                        <BSW-MODULE-ENTRY-REF-CONDITIONAL>
                        <BSW-MODULE-ENTRY-REF DEST="BSW-MODULE-ENTRY">/Fls_TI_F29H85x/Fls_ModuleEntry/Fls_Cancel</BSW-MODULE-ENTRY-REF>
                        </BSW-MODULE-ENTRY-REF-CONDITIONAL>
                        [!ENDIF!]
                        [!IF "as:modconf('Fls')[1]/FlsGeneral/FlsCompareApi = 'true'"!]
                        <BSW-MODULE-ENTRY-REF-CONDITIONAL>
                        <BSW-MODULE-ENTRY-REF DEST="BSW-MODULE-ENTRY">/Fls_TI_F29H85x/Fls_ModuleEntry/Fls_Compare</BSW-MODULE-ENTRY-REF>
                        </BSW-MODULE-ENTRY-REF-CONDITIONAL>
                        [!ENDIF!]
                        <BSW-MODULE-ENTRY-REF-CONDITIONAL>
                        <BSW-MODULE-ENTRY-REF DEST="BSW-MODULE-ENTRY">/Fls_TI_F29H85x/Fls_ModuleEntry/Fls_Erase</BSW-MODULE-ENTRY-REF>
                        </BSW-MODULE-ENTRY-REF-CONDITIONAL>
                        [!IF "as:modconf('Fls')[1]/FlsGeneral/FlsGetJobResultApi = 'true'"!]
                        <BSW-MODULE-ENTRY-REF-CONDITIONAL>
                        <BSW-MODULE-ENTRY-REF DEST="BSW-MODULE-ENTRY">/Fls_TI_F29H85x/Fls_ModuleEntry/Fls_GetJobResult</BSW-MODULE-ENTRY-REF>
                        </BSW-MODULE-ENTRY-REF-CONDITIONAL>
                        [!ENDIF!]
                        [!IF "as:modconf('Fls')[1]/FlsGeneral/FlsGetStatusApi = 'true'"!]
                        <BSW-MODULE-ENTRY-REF-CONDITIONAL>
                        <BSW-MODULE-ENTRY-REF DEST="BSW-MODULE-ENTRY">/Fls_TI_F29H85x/Fls_ModuleEntry/Fls_GetStatus</BSW-MODULE-ENTRY-REF>
                        </BSW-MODULE-ENTRY-REF-CONDITIONAL>
                        [!ENDIF!]
                        [!IF "as:modconf('Fls')[1]/FlsGeneral/FlsVersionInfoApi = 'true'"!]
                        <BSW-MODULE-ENTRY-REF-CONDITIONAL>
                        <BSW-MODULE-ENTRY-REF DEST="BSW-MODULE-ENTRY">/Fls_TI_F29H85x/Fls_ModuleEntry/Fls_GetVersionInfo</BSW-MODULE-ENTRY-REF>
                        </BSW-MODULE-ENTRY-REF-CONDITIONAL>
                        [!ENDIF!]
                        <BSW-MODULE-ENTRY-REF-CONDITIONAL>
                        <BSW-MODULE-ENTRY-REF DEST="BSW-MODULE-ENTRY">/Fls_TI_F29H85x/Fls_ModuleEntry/Fls_Init</BSW-MODULE-ENTRY-REF>
                        </BSW-MODULE-ENTRY-REF-CONDITIONAL>
                        <BSW-MODULE-ENTRY-REF-CONDITIONAL>
                        <BSW-MODULE-ENTRY-REF DEST="BSW-MODULE-ENTRY">/Fls_TI_F29H85x/Fls_ModuleEntry/Fls_MainFunction</BSW-MODULE-ENTRY-REF>
                        </BSW-MODULE-ENTRY-REF-CONDITIONAL>
                        <BSW-MODULE-ENTRY-REF-CONDITIONAL>
                        <BSW-MODULE-ENTRY-REF DEST="BSW-MODULE-ENTRY">/Fls_TI_F29H85x/Fls_ModuleEntry/Fls_Read</BSW-MODULE-ENTRY-REF>
                        </BSW-MODULE-ENTRY-REF-CONDITIONAL>
                        <BSW-MODULE-ENTRY-REF-CONDITIONAL>
                        <BSW-MODULE-ENTRY-REF DEST="BSW-MODULE-ENTRY">/Fls_TI_F29H85x/Fls_ModuleEntry/Fls_SetEraseType</BSW-MODULE-ENTRY-REF>
                        </BSW-MODULE-ENTRY-REF-CONDITIONAL>                        
                        [!IF "as:modconf('Fls')[1]/FlsGeneral/FlsSetModeApi = 'true'"!]
                        <BSW-MODULE-ENTRY-REF-CONDITIONAL>
                        <BSW-MODULE-ENTRY-REF DEST="BSW-MODULE-ENTRY">/Fls_TI_F29H85x/Fls_ModuleEntry/Fls_SetMode</BSW-MODULE-ENTRY-REF>
                        </BSW-MODULE-ENTRY-REF-CONDITIONAL> 
                        [!ENDIF!]
                        <BSW-MODULE-ENTRY-REF-CONDITIONAL>
                        <BSW-MODULE-ENTRY-REF DEST="BSW-MODULE-ENTRY">/Fls_TI_F29H85x/Fls_ModuleEntry/Fls_Write</BSW-MODULE-ENTRY-REF>
                        </BSW-MODULE-ENTRY-REF-CONDITIONAL>
                    </IMPLEMENTED-ENTRYS>

                    <MODULE-ID>92</MODULE-ID>

                    <BSW-MODULE-DEPENDENCYS>
                        <BSW-MODULE-DEPENDENCY UUID="[!"as:uuid()"!]">
                        <SHORT-NAME>Det</SHORT-NAME>
                        <TARGET-MODULE-ID>15</TARGET-MODULE-ID>
                        <TARGET-MODULE-REFS>
                        <BSW-MODULE-DESCRIPTION-REF-CONDITIONAL>
                            <BSW-MODULE-DESCRIPTION-REF DEST="BSW-MODULE-DESCRIPTION">/AUTOSAR_Det/Det</BSW-MODULE-DESCRIPTION-REF>
                        </BSW-MODULE-DESCRIPTION-REF-CONDITIONAL>
                        </TARGET-MODULE-REFS>
                        </BSW-MODULE-DEPENDENCY>
                    </BSW-MODULE-DEPENDENCYS>

                    <INTERNAL-BEHAVIORS>
                        <BSW-INTERNAL-BEHAVIOR UUID="[!"as:uuid()"!]">
                        <SHORT-NAME>Fls_Behavior</SHORT-NAME>
                        <EXCLUSIVE-AREAS>
                            <EXCLUSIVE-AREA UUID="[!"as:uuid()"!]">
                            <SHORT-NAME>FLS_EXCLUSIVE_AREA_0</SHORT-NAME>
                            </EXCLUSIVE-AREA>
                        </EXCLUSIVE-AREAS>

                        <ENTITYS>
                            [!IF "as:modconf('Fls')[1]/FlsGeneral/FlsBlankCheckApi = 'true'"!]
                            <BSW-CALLED-ENTITY UUID="[!"as:uuid()"!]">
                            <SHORT-NAME>Fls_BlankCheck</SHORT-NAME>
                            <REENTRANCY-LEVEL>NON-REENTRANT</REENTRANCY-LEVEL>
                            [!IF "as:modconf('Fls')[1]/FlsGeneral/FlsDevErrorDetect = 'true'"!]
                            <CALL-POINTS>
                                <BSW-DIRECT-CALL-POINT>
                                <SHORT-NAME>Det_ReportError</SHORT-NAME>
                                <CALLED-ENTRY-REF DEST="BSW-MODULE-ENTRY">/AUTOSAR_Det/BSWModuleEntry/Det_ReportError</CALLED-ENTRY-REF>
                                </BSW-DIRECT-CALL-POINT>
                            </CALL-POINTS>
                            [!ENDIF!]
                            <IMPLEMENTED-ENTRY-REF DEST="BSW-MODULE-ENTRY">/Fls_TI_F29H85x/Fls_ModuleEntry/Fls_BlankCheck</IMPLEMENTED-ENTRY-REF>
                            </BSW-CALLED-ENTITY>
                            [!ENDIF!]

                            [!IF "as:modconf('Fls')[1]/FlsGeneral/FlsCancelApi = 'true'"!]
                            <BSW-CALLED-ENTITY UUID="[!"as:uuid()"!]">
                            <SHORT-NAME>Fls_Cancel</SHORT-NAME>
                            <REENTRANCY-LEVEL>NON-REENTRANT</REENTRANCY-LEVEL>
                            [!IF "as:modconf('Fls')[1]/FlsGeneral/FlsDevErrorDetect = 'true'"!]
                            <CALL-POINTS>
                                <BSW-DIRECT-CALL-POINT>
                                <SHORT-NAME>Det_ReportError</SHORT-NAME>
                                <CALLED-ENTRY-REF DEST="BSW-MODULE-ENTRY">/AUTOSAR_Det/BSWModuleEntry/Det_ReportError</CALLED-ENTRY-REF>
                                </BSW-DIRECT-CALL-POINT>
                            </CALL-POINTS>
                            [!ENDIF!]
                            <IMPLEMENTED-ENTRY-REF DEST="BSW-MODULE-ENTRY">/Fls_TI_F29H85x/Fls_ModuleEntry/Fls_Cancel</IMPLEMENTED-ENTRY-REF>
                            </BSW-CALLED-ENTITY>
                            [!ENDIF!]

                            [!IF "as:modconf('Fls')[1]/FlsGeneral/FlsCompareApi = 'true'"!]
                            <BSW-CALLED-ENTITY UUID="[!"as:uuid()"!]">
                            <SHORT-NAME>Fls_Compare</SHORT-NAME>
                            <REENTRANCY-LEVEL>NON-REENTRANT</REENTRANCY-LEVEL>
                            [!IF "as:modconf('Fls')[1]/FlsGeneral/FlsDevErrorDetect = 'true'"!]
                            <CALL-POINTS>
                                <BSW-DIRECT-CALL-POINT>
                                <SHORT-NAME>Det_ReportError</SHORT-NAME>
                                <CALLED-ENTRY-REF DEST="BSW-MODULE-ENTRY">/AUTOSAR_Det/BSWModuleEntry/Det_ReportError</CALLED-ENTRY-REF>
                                </BSW-DIRECT-CALL-POINT>
                            </CALL-POINTS>
                            [!ENDIF!]
                            <IMPLEMENTED-ENTRY-REF DEST="BSW-MODULE-ENTRY">/Fls_TI_F29H85x/Fls_ModuleEntry/Fls_Compare</IMPLEMENTED-ENTRY-REF>
                            </BSW-CALLED-ENTITY>
                            [!ENDIF!]

                            <BSW-CALLED-ENTITY UUID="[!"as:uuid()"!]">
                            <SHORT-NAME>Fls_Erase</SHORT-NAME>
                            <REENTRANCY-LEVEL>NON-REENTRANT</REENTRANCY-LEVEL>
                            [!IF "as:modconf('Fls')[1]/FlsGeneral/FlsDevErrorDetect = 'true'"!]
                            <CALL-POINTS>
                                <BSW-DIRECT-CALL-POINT>
                                <SHORT-NAME>Det_ReportError</SHORT-NAME>
                                <CALLED-ENTRY-REF DEST="BSW-MODULE-ENTRY">/AUTOSAR_Det/BSWModuleEntry/Det_ReportError</CALLED-ENTRY-REF>
                                </BSW-DIRECT-CALL-POINT>
                            </CALL-POINTS>
                            [!ENDIF!]
                            <IMPLEMENTED-ENTRY-REF DEST="BSW-MODULE-ENTRY">/Fls_TI_F29H85x/Fls_ModuleEntry/Fls_Erase</IMPLEMENTED-ENTRY-REF>
                            </BSW-CALLED-ENTITY>

                            [!IF "as:modconf('Fls')[1]/FlsGeneral/FlsGetJobResultApi = 'true'"!]
                            <BSW-CALLED-ENTITY UUID="[!"as:uuid()"!]">
                            <SHORT-NAME>Fls_GetJobResult</SHORT-NAME>
                            <REENTRANCY-LEVEL>SINGLE-CORE-REENTRANT</REENTRANCY-LEVEL>
                            [!IF "as:modconf('Fls')[1]/FlsGeneral/FlsDevErrorDetect = 'true'"!]
                            <CALL-POINTS>
                                <BSW-DIRECT-CALL-POINT>
                                <SHORT-NAME>Det_ReportError</SHORT-NAME>
                                <CALLED-ENTRY-REF DEST="BSW-MODULE-ENTRY">/AUTOSAR_Det/BSWModuleEntry/Det_ReportError</CALLED-ENTRY-REF>
                                </BSW-DIRECT-CALL-POINT>
                            </CALL-POINTS>
                            [!ENDIF!]
                            <IMPLEMENTED-ENTRY-REF DEST="BSW-MODULE-ENTRY">/Fls_TI_F29H85x/Fls_ModuleEntry/Fls_GetJobResult</IMPLEMENTED-ENTRY-REF>
                            </BSW-CALLED-ENTITY>
                            [!ENDIF!]

                            [!IF "as:modconf('Fls')[1]/FlsGeneral/FlsGetStatusApi = 'true'"!]
                            <BSW-CALLED-ENTITY UUID="[!"as:uuid()"!]">
                            <SHORT-NAME>Fls_GetStatus</SHORT-NAME>
                            <REENTRANCY-LEVEL>SINGLE-CORE-REENTRANT</REENTRANCY-LEVEL>
                            <IMPLEMENTED-ENTRY-REF DEST="BSW-MODULE-ENTRY">/Fls_TI_F29H85x/Fls_ModuleEntry/Fls_GetStatus</IMPLEMENTED-ENTRY-REF>
                            </BSW-CALLED-ENTITY>
                            [!ENDIF!]

                            [!IF "as:modconf('Fls')[1]/FlsGeneral/FlsVersionInfoApi = 'true'"!]
                            <BSW-CALLED-ENTITY UUID="[!"as:uuid()"!]">
                            <SHORT-NAME>Fls_GetVersionInfo</SHORT-NAME>
                            <REENTRANCY-LEVEL>SINGLE-CORE-REENTRANT</REENTRANCY-LEVEL>
                            [!IF "as:modconf('Fls')[1]/FlsGeneral/FlsDevErrorDetect = 'true'"!]
                            <CALL-POINTS>
                                <BSW-DIRECT-CALL-POINT>
                                <SHORT-NAME>Det_ReportError</SHORT-NAME>
                                <CALLED-ENTRY-REF DEST="BSW-MODULE-ENTRY">/AUTOSAR_Det/BSWModuleEntry/Det_ReportError</CALLED-ENTRY-REF>
                                </BSW-DIRECT-CALL-POINT>
                            </CALL-POINTS>
                            [!ENDIF!]
                            <IMPLEMENTED-ENTRY-REF DEST="BSW-MODULE-ENTRY">/Fls_TI_F29H85x/Fls_ModuleEntry/Fls_GetVersionInfo</IMPLEMENTED-ENTRY-REF>
                            </BSW-CALLED-ENTITY>
                            [!ENDIF!]

<!--                            <BSW-CALLED-ENTITY UUID="[!"as:uuid()"!]">   -->
             <BSW-CALLED-ENTITY UUID="1c915b6a-38c7-1713-9b71-69b989537653">
                            <SHORT-NAME>Fls_Init</SHORT-NAME>
                            <REENTRANCY-LEVEL>NON-REENTRANT</REENTRANCY-LEVEL>
                            <CALL-POINTS>
                                [!IF "as:modconf('Fls')[1]/FlsGeneral/FlsDevErrorDetect = 'true'"!]
                                <BSW-DIRECT-CALL-POINT>
                                <SHORT-NAME>Det_ReportError</SHORT-NAME>
                                <CALLED-ENTRY-REF DEST="BSW-MODULE-ENTRY">/AUTOSAR_Det/BSWModuleEntry/Det_ReportError</CALLED-ENTRY-REF>
                                </BSW-DIRECT-CALL-POINT>
                                [!ENDIF!]
                                <BSW-DIRECT-CALL-POINT>
                                <SHORT-NAME>Det_ReportRuntimeError</SHORT-NAME>
                                <CALLED-ENTRY-REF DEST="BSW-MODULE-ENTRY">/AUTOSAR_Det/BSWModuleEntry/Det_ReportRuntimeError</CALLED-ENTRY-REF>
                                </BSW-DIRECT-CALL-POINT>
                            </CALL-POINTS>
                            <IMPLEMENTED-ENTRY-REF DEST="BSW-MODULE-ENTRY">/Fls_TI_F29H85x/Fls_ModuleEntry/Fls_Init</IMPLEMENTED-ENTRY-REF>
                            </BSW-CALLED-ENTITY>

                            <BSW-SCHEDULABLE-ENTITY UUID="[!"as:uuid()"!]">
                            <SHORT-NAME>Fls_MainFunction</SHORT-NAME>
                            <CAN-ENTER-EXCLUSIVE-AREA-REFS>
                                <CAN-ENTER-EXCLUSIVE-AREA-REF DEST="EXCLUSIVE-AREA">/Fls_TI_F29H85x/Fls/Fls_Behavior/FLS_EXCLUSIVE_AREA_0</CAN-ENTER-EXCLUSIVE-AREA-REF>
                            </CAN-ENTER-EXCLUSIVE-AREA-REFS>
                            <REENTRANCY-LEVEL>NON-REENTRANT</REENTRANCY-LEVEL>
                            <CALL-POINTS>
                                [!IF "as:modconf('Fls')[1]/FlsGeneral/FlsDevErrorDetect = 'true'"!]
                                <BSW-DIRECT-CALL-POINT>
                                <SHORT-NAME>Det_ReportError</SHORT-NAME>
                                <CALLED-ENTRY-REF DEST="BSW-MODULE-ENTRY">/AUTOSAR_Det/BSWModuleEntry/Det_ReportError</CALLED-ENTRY-REF>
                                </BSW-DIRECT-CALL-POINT>
                                [!ENDIF!]
                                <BSW-DIRECT-CALL-POINT>
                                <SHORT-NAME>Det_ReportRuntimeError</SHORT-NAME>
                                <CALLED-ENTRY-REF DEST="BSW-MODULE-ENTRY">/AUTOSAR_Det/BSWModuleEntry/Det_ReportRuntimeError</CALLED-ENTRY-REF>
                                </BSW-DIRECT-CALL-POINT>
                            </CALL-POINTS>
                            <IMPLEMENTED-ENTRY-REF DEST="BSW-MODULE-ENTRY">/Fls_TI_F29H85x/Fls_ModuleEntry/Fls_MainFunction</IMPLEMENTED-ENTRY-REF>
                            </BSW-SCHEDULABLE-ENTITY>

                            <BSW-CALLED-ENTITY UUID="[!"as:uuid()"!]">
                            <SHORT-NAME>Fls_Read</SHORT-NAME>
                            <REENTRANCY-LEVEL>NON-REENTRANT</REENTRANCY-LEVEL>
                            [!IF "as:modconf('Fls')[1]/FlsGeneral/FlsDevErrorDetect = 'true'"!]
                            <CALL-POINTS>
                                <BSW-DIRECT-CALL-POINT>
                                <SHORT-NAME>Det_ReportError</SHORT-NAME>
                                <CALLED-ENTRY-REF DEST="BSW-MODULE-ENTRY">/AUTOSAR_Det/BSWModuleEntry/Det_ReportError</CALLED-ENTRY-REF>
                                </BSW-DIRECT-CALL-POINT>
                            </CALL-POINTS>
                            [!ENDIF!]
                            <IMPLEMENTED-ENTRY-REF DEST="BSW-MODULE-ENTRY">/Fls_TI_F29H85x/Fls_ModuleEntry/Fls_Read</IMPLEMENTED-ENTRY-REF>
                            </BSW-CALLED-ENTITY>

                            <BSW-CALLED-ENTITY UUID="[!"as:uuid()"!]">
                            <SHORT-NAME>Fls_SetEraseType</SHORT-NAME>
                            <REENTRANCY-LEVEL>NON-REENTRANT</REENTRANCY-LEVEL>
                            <IMPLEMENTED-ENTRY-REF DEST="BSW-MODULE-ENTRY">/Fls_TI_F29H85x/Fls_ModuleEntry/Fls_SetEraseType</IMPLEMENTED-ENTRY-REF>
                            </BSW-CALLED-ENTITY>

                            [!IF "as:modconf('Fls')[1]/FlsGeneral/FlsSetModeApi = 'true'"!]
                            <BSW-CALLED-ENTITY UUID="[!"as:uuid()"!]">
                            <SHORT-NAME>Fls_SetMode</SHORT-NAME>
                            <REENTRANCY-LEVEL>NON-REENTRANT</REENTRANCY-LEVEL>
                            <IMPLEMENTED-ENTRY-REF DEST="BSW-MODULE-ENTRY">/Fls_TI_F29H85x/Fls_ModuleEntry/Fls_SetMode</IMPLEMENTED-ENTRY-REF>
                            </BSW-CALLED-ENTITY>
                            [!ENDIF!]

                            <BSW-CALLED-ENTITY UUID="[!"as:uuid()"!]">
                            <SHORT-NAME>Fls_Write</SHORT-NAME>
                            <REENTRANCY-LEVEL>NON-REENTRANT</REENTRANCY-LEVEL>
                            [!IF "as:modconf('Fls')[1]/FlsGeneral/FlsDevErrorDetect = 'true'"!]
                            <CALL-POINTS>
                                <BSW-DIRECT-CALL-POINT>
                                <SHORT-NAME>Det_ReportError</SHORT-NAME>
                                <CALLED-ENTRY-REF DEST="BSW-MODULE-ENTRY">/AUTOSAR_Det/BSWModuleEntry/Det_ReportError</CALLED-ENTRY-REF>
                                </BSW-DIRECT-CALL-POINT>
                            </CALL-POINTS>
                            [!ENDIF!]
                            <IMPLEMENTED-ENTRY-REF DEST="BSW-MODULE-ENTRY">/Fls_TI_F29H85x/Fls_ModuleEntry/Fls_Write</IMPLEMENTED-ENTRY-REF>
                            </BSW-CALLED-ENTITY>
                        </ENTITYS>

                        <EVENTS>
                            <BSW-TIMING-EVENT UUID="[!"as:uuid()"!]">
                            <SHORT-NAME>Fls_MainFunctionTimingEvent</SHORT-NAME>
                            <STARTS-ON-EVENT-REF DEST="BSW-SCHEDULABLE-ENTITY">/Fls_TI_F29H85x/Fls/Fls_Behavior/Fls_MainFunction</STARTS-ON-EVENT-REF>
                            <PERIOD>[!"as:modconf('Fls')[1]/FlsConfigSet/FlsCallCycle"!]</PERIOD>
                            </BSW-TIMING-EVENT>
                        </EVENTS>

                        </BSW-INTERNAL-BEHAVIOR>
                    </INTERNAL-BEHAVIORS>
                </BSW-MODULE-DESCRIPTION>

                <BSW-IMPLEMENTATION UUID="[!"as:uuid()"!]">
                <SHORT-NAME>Fls_Impl</SHORT-NAME>
                <CODE-DESCRIPTORS>
                    <CODE UUID="[!"as:uuid()"!]">
                    <SHORT-NAME>Files</SHORT-NAME>
                    <ARTIFACT-DESCRIPTORS>
                        <AUTOSAR-ENGINEERING-OBJECT>
                        <SHORT-LABEL>generate::include::Fls_Cfg.h</SHORT-LABEL>
                        <CATEGORY>SWHDR</CATEGORY>
                        </AUTOSAR-ENGINEERING-OBJECT>
                        <AUTOSAR-ENGINEERING-OBJECT>
                        <SHORT-LABEL>generate::src::Fls_Cfg.c</SHORT-LABEL>
                        <CATEGORY>SWSRC</CATEGORY>
                        </AUTOSAR-ENGINEERING-OBJECT>
                        <AUTOSAR-ENGINEERING-OBJECT>
                        <SHORT-LABEL>include::Fls.h</SHORT-LABEL>
                        <CATEGORY>SWHDR</CATEGORY>
                        </AUTOSAR-ENGINEERING-OBJECT>
                        <AUTOSAR-ENGINEERING-OBJECT>
                        <SHORT-LABEL>include::Fls_Cbk.h</SHORT-LABEL>
                        <CATEGORY>SWHDR</CATEGORY>
                        </AUTOSAR-ENGINEERING-OBJECT>
                        <AUTOSAR-ENGINEERING-OBJECT>
                        <SHORT-LABEL>include::Fls_Ac.h</SHORT-LABEL>
                        <CATEGORY>SWHDR</CATEGORY>
                        </AUTOSAR-ENGINEERING-OBJECT>
                        <AUTOSAR-ENGINEERING-OBJECT>
                        <SHORT-LABEL>include::Fls_Priv.h</SHORT-LABEL>
                        <CATEGORY>SWHDR</CATEGORY>
                        </AUTOSAR-ENGINEERING-OBJECT>
                        <AUTOSAR-ENGINEERING-OBJECT>
                        <SHORT-LABEL>src::Fls.c</SHORT-LABEL>
                        <CATEGORY>SWSRC</CATEGORY>
                        </AUTOSAR-ENGINEERING-OBJECT>
                        <AUTOSAR-ENGINEERING-OBJECT>
                        <SHORT-LABEL>src::Fls_Ac.c</SHORT-LABEL>
                        <CATEGORY>SWSRC</CATEGORY>
                        </AUTOSAR-ENGINEERING-OBJECT>
                        <AUTOSAR-ENGINEERING-OBJECT>
                        <SHORT-LABEL>src::Fls_Priv.c</SHORT-LABEL>
                        <CATEGORY>SWSRC</CATEGORY>
                        </AUTOSAR-ENGINEERING-OBJECT>
                        <AUTOSAR-ENGINEERING-OBJECT>
                        <SHORT-LABEL>generate::src::Fls_PBcfg.c</SHORT-LABEL>
                        <CATEGORY>SWSRC</CATEGORY>
                        </AUTOSAR-ENGINEERING-OBJECT>
                    </ARTIFACT-DESCRIPTORS>             
                    </CODE>
                </CODE-DESCRIPTORS>

                <COMPILERS>
                    <COMPILER UUID="[!"as:uuid()"!]">
                    <SHORT-NAME>TI_C29Clang</SHORT-NAME>
                    <NAME>TI C29 Clang Compiler</NAME>
                    <VENDOR>Texas Instruments</VENDOR>
                    <VERSION>1.0.0</VERSION>
                    </COMPILER>
                </COMPILERS>

                <LINKERS>
                    <LINKER UUID="[!"as:uuid()"!]">
                    <SHORT-NAME>TI_C29Linker</SHORT-NAME>
                    <NAME>TI C29 Clang Linker</NAME>
                    <VENDOR>Texas Instruments</VENDOR>
                    <VERSION>1.0.0</VERSION>
                    </LINKER>
                </LINKERS>
                
                <PROGRAMMING-LANGUAGE>C</PROGRAMMING-LANGUAGE>
                <RESOURCE-CONSUMPTION UUID="[!"as:uuid()"!]">
                    <SHORT-NAME>ResourceConsumption</SHORT-NAME>
                    <MEMORY-SECTIONS>
                    <MEMORY-SECTION UUID="[!"as:uuid()"!]">
                        <SHORT-NAME>FLS_CODE</SHORT-NAME>
                        <SW-ADDRMETHOD-REF DEST="SW-ADDR-METHOD">/AUTOSAR_MemMap/SwAddrMethods/CODE</SW-ADDRMETHOD-REF>
                        <SYMBOL>CODE</SYMBOL>
                    </MEMORY-SECTION>
                    <MEMORY-SECTION UUID="[!"as:uuid()"!]">
                        <SHORT-NAME>FLS_CONFIG_DATA</SHORT-NAME>
                        <ALIGNMENT>UNSPECIFIED</ALIGNMENT>
                        <SW-ADDRMETHOD-REF DEST="SW-ADDR-METHOD">/AUTOSAR_MemMap/SwAddrMethods/CONST_PBCFG</SW-ADDRMETHOD-REF>
                        <SYMBOL>CONFIG_DATA</SYMBOL>
                    </MEMORY-SECTION>
                    <MEMORY-SECTION UUID="[!"as:uuid()"!]">
                        <SHORT-NAME>FLS_VAR_INIT_32</SHORT-NAME>
                        <ALIGNMENT>32</ALIGNMENT>
                        <SW-ADDRMETHOD-REF DEST="SW-ADDR-METHOD">/AUTOSAR_MemMap/SwAddrMethods/VAR_INIT</SW-ADDRMETHOD-REF>
                        <SYMBOL>VAR_INIT_32</SYMBOL>
                    </MEMORY-SECTION>
                    <MEMORY-SECTION UUID="[!"as:uuid()"!]">
                        <SHORT-NAME>FLS_VAR_INIT_8</SHORT-NAME>
                        <ALIGNMENT>8</ALIGNMENT>
                        <SW-ADDRMETHOD-REF DEST="SW-ADDR-METHOD">/AUTOSAR_MemMap/SwAddrMethods/VAR_INIT</SW-ADDRMETHOD-REF>
                        <SYMBOL>VAR_INIT_8</SYMBOL>
                    </MEMORY-SECTION>
                    <MEMORY-SECTION UUID="[!"as:uuid()"!]">
                        <SHORT-NAME>FLS_VAR_INIT_UNSPECIFIED</SHORT-NAME>
                        <ALIGNMENT>UNSPECIFIED</ALIGNMENT>
                        <SW-ADDRMETHOD-REF DEST="SW-ADDR-METHOD">/AUTOSAR_MemMap/SwAddrMethods/VAR_INIT</SW-ADDRMETHOD-REF>
                        <SYMBOL>VAR_INIT_UNSPECIFIED</SYMBOL>
                    </MEMORY-SECTION>
                    <MEMORY-SECTION UUID="[!"as:uuid()"!]">
                        <SHORT-NAME>FLS_VAR_NO_INIT_32</SHORT-NAME>
                        <ALIGNMENT>32</ALIGNMENT>
                        <SW-ADDRMETHOD-REF DEST="SW-ADDR-METHOD">/AUTOSAR_MemMap/SwAddrMethods/VAR_NO_INIT</SW-ADDRMETHOD-REF>
                        <SYMBOL>VAR_NO_INIT_32</SYMBOL>
                    </MEMORY-SECTION>
                    <MEMORY-SECTION UUID="[!"as:uuid()"!]">
                        <SHORT-NAME>FLS_VAR_NO_INIT_8</SHORT-NAME>
                        <ALIGNMENT>8</ALIGNMENT>
                        <SW-ADDRMETHOD-REF DEST="SW-ADDR-METHOD">/AUTOSAR_MemMap/SwAddrMethods/VAR_NO_INIT</SW-ADDRMETHOD-REF>
                        <SYMBOL>VAR_NO_INIT_8</SYMBOL>
                    </MEMORY-SECTION>
                    <MEMORY-SECTION UUID="[!"as:uuid()"!]">
                        <SHORT-NAME>FLS_VAR_NO_INIT_UNSPECIFIED</SHORT-NAME>
                        <ALIGNMENT>UNSPECIFIED</ALIGNMENT>
                        <SW-ADDRMETHOD-REF DEST="SW-ADDR-METHOD">/AUTOSAR_MemMap/SwAddrMethods/VAR_NO_INIT</SW-ADDRMETHOD-REF>
                        <SYMBOL>VAR_NO_INIT_UNSPECIFIED</SYMBOL>
                    </MEMORY-SECTION>
                    </MEMORY-SECTIONS>
                </RESOURCE-CONSUMPTION>

                <SW-VERSION>[!"$moduleSoftwareVer"!]</SW-VERSION>
                <VENDOR-ID>44</VENDOR-ID>
                <AR-RELEASE-VERSION>[!"substring-after($moduleReleaseVer, 'AUTOSAR ')"!]</AR-RELEASE-VERSION>
                <BEHAVIOR-REF DEST="BSW-INTERNAL-BEHAVIOR">/Fls_TI_F29H85x/Fls/Fls_Behavior</BEHAVIOR-REF>
                <VENDOR-SPECIFIC-MODULE-DEF-REFS>
                    <VENDOR-SPECIFIC-MODULE-DEF-REF DEST="ECUC-MODULE-DEF">/TI_F29H85x/Fls</VENDOR-SPECIFIC-MODULE-DEF-REF>
                </VENDOR-SPECIFIC-MODULE-DEF-REFS> 

                </BSW-IMPLEMENTATION>
            </ELEMENTS>

            <AR-PACKAGES>
                <AR-PACKAGE UUID="[!"as:uuid()"!]">
                <SHORT-NAME>Fls_ModuleEntry</SHORT-NAME>

                    <ELEMENTS>
                        <BSW-MODULE-ENTRY UUID="[!"as:uuid()"!]">
                        <SHORT-NAME>Fls_BlankCheck</SHORT-NAME>
                        <SERVICE-ID>10</SERVICE-ID>
                        <IS-REENTRANT>false</IS-REENTRANT>
                        <IS-SYNCHRONOUS>false</IS-SYNCHRONOUS>
                        <CALL-TYPE>REGULAR</CALL-TYPE>
                        <EXECUTION-CONTEXT>UNSPECIFIED</EXECUTION-CONTEXT>
                        <SW-SERVICE-IMPL-POLICY>STANDARD</SW-SERVICE-IMPL-POLICY>
                        <BSW-ENTRY-KIND>CONCRETE</BSW-ENTRY-KIND>
                        </BSW-MODULE-ENTRY>

                        <BSW-MODULE-ENTRY UUID="[!"as:uuid()"!]">
                        <SHORT-NAME>Fls_Cancel</SHORT-NAME>
                        <SERVICE-ID>3</SERVICE-ID>
                        <IS-REENTRANT>false</IS-REENTRANT>
                        <IS-SYNCHRONOUS>true</IS-SYNCHRONOUS>              
                        <CALL-TYPE>REGULAR</CALL-TYPE>
                        <EXECUTION-CONTEXT>UNSPECIFIED</EXECUTION-CONTEXT>
                        <SW-SERVICE-IMPL-POLICY>STANDARD</SW-SERVICE-IMPL-POLICY>
                        <BSW-ENTRY-KIND>CONCRETE</BSW-ENTRY-KIND>
                        </BSW-MODULE-ENTRY>
                        
                        <BSW-MODULE-ENTRY UUID="[!"as:uuid()"!]">
                        <SHORT-NAME>Fls_Compare</SHORT-NAME>
                        <SERVICE-ID>8</SERVICE-ID>
                        <IS-REENTRANT>false</IS-REENTRANT>
                        <IS-SYNCHRONOUS>false</IS-SYNCHRONOUS> 
                        <CALL-TYPE>REGULAR</CALL-TYPE>
                        <EXECUTION-CONTEXT>UNSPECIFIED</EXECUTION-CONTEXT>
                        <SW-SERVICE-IMPL-POLICY>STANDARD</SW-SERVICE-IMPL-POLICY>
                        <BSW-ENTRY-KIND>CONCRETE</BSW-ENTRY-KIND>
                        </BSW-MODULE-ENTRY>
                        
                        <BSW-MODULE-ENTRY UUID="[!"as:uuid()"!]">
                        <SHORT-NAME>Fls_Erase</SHORT-NAME>
                        <SERVICE-ID>1</SERVICE-ID>
                        <IS-REENTRANT>false</IS-REENTRANT>
                        <IS-SYNCHRONOUS>false</IS-SYNCHRONOUS> 
                        <CALL-TYPE>REGULAR</CALL-TYPE>
                        <EXECUTION-CONTEXT>UNSPECIFIED</EXECUTION-CONTEXT>
                        <SW-SERVICE-IMPL-POLICY>STANDARD</SW-SERVICE-IMPL-POLICY>
                        <BSW-ENTRY-KIND>CONCRETE</BSW-ENTRY-KIND>
                        </BSW-MODULE-ENTRY>
                        
                        <BSW-MODULE-ENTRY UUID="[!"as:uuid()"!]">
                        <SHORT-NAME>Fls_GetJobResult</SHORT-NAME>
                        <SERVICE-ID>5</SERVICE-ID>
                        <IS-REENTRANT>true</IS-REENTRANT>
                        <IS-SYNCHRONOUS>true</IS-SYNCHRONOUS>
                        <CALL-TYPE>REGULAR</CALL-TYPE>
                        <EXECUTION-CONTEXT>UNSPECIFIED</EXECUTION-CONTEXT>
                        <SW-SERVICE-IMPL-POLICY>STANDARD</SW-SERVICE-IMPL-POLICY>
                        <BSW-ENTRY-KIND>CONCRETE</BSW-ENTRY-KIND>
                        </BSW-MODULE-ENTRY>
                        
                        <BSW-MODULE-ENTRY UUID="[!"as:uuid()"!]">
                        <SHORT-NAME>Fls_GetStatus</SHORT-NAME>
                        <SERVICE-ID>4</SERVICE-ID>
                        <IS-REENTRANT>true</IS-REENTRANT>
                        <IS-SYNCHRONOUS>true</IS-SYNCHRONOUS>
                        <CALL-TYPE>REGULAR</CALL-TYPE>
                        <EXECUTION-CONTEXT>UNSPECIFIED</EXECUTION-CONTEXT>
                        <SW-SERVICE-IMPL-POLICY>STANDARD</SW-SERVICE-IMPL-POLICY>
                        <BSW-ENTRY-KIND>CONCRETE</BSW-ENTRY-KIND>
                        </BSW-MODULE-ENTRY>
                        
                        <BSW-MODULE-ENTRY UUID="[!"as:uuid()"!]">
                        <SHORT-NAME>Fls_GetVersionInfo</SHORT-NAME>
                        <SERVICE-ID>16</SERVICE-ID>
                        <IS-REENTRANT>true</IS-REENTRANT>
                        <IS-SYNCHRONOUS>true</IS-SYNCHRONOUS>
                        <CALL-TYPE>REGULAR</CALL-TYPE>
                        <EXECUTION-CONTEXT>UNSPECIFIED</EXECUTION-CONTEXT>
                        <SW-SERVICE-IMPL-POLICY>STANDARD</SW-SERVICE-IMPL-POLICY>
                        <BSW-ENTRY-KIND>CONCRETE</BSW-ENTRY-KIND>
                        </BSW-MODULE-ENTRY>

                        <BSW-MODULE-ENTRY UUID="[!"as:uuid()"!]">
                        <SHORT-NAME>Fls_Init</SHORT-NAME>
                        <SERVICE-ID>0</SERVICE-ID>
                        <IS-REENTRANT>false</IS-REENTRANT>
                        <IS-SYNCHRONOUS>true</IS-SYNCHRONOUS>
                        <CALL-TYPE>REGULAR</CALL-TYPE>
                        <EXECUTION-CONTEXT>UNSPECIFIED</EXECUTION-CONTEXT>
                        <SW-SERVICE-IMPL-POLICY>STANDARD</SW-SERVICE-IMPL-POLICY>
                        <BSW-ENTRY-KIND>CONCRETE</BSW-ENTRY-KIND>
                        </BSW-MODULE-ENTRY>

                        <BSW-MODULE-ENTRY UUID="[!"as:uuid()"!]">
                        <SHORT-NAME>Fls_MainFunction</SHORT-NAME>
                        <SERVICE-ID>6</SERVICE-ID>
                        <IS-REENTRANT>false</IS-REENTRANT>
                        <IS-SYNCHRONOUS>true</IS-SYNCHRONOUS>
                        <CALL-TYPE>SCHEDULED</CALL-TYPE>
                        <EXECUTION-CONTEXT>UNSPECIFIED</EXECUTION-CONTEXT>
                        <SW-SERVICE-IMPL-POLICY>STANDARD</SW-SERVICE-IMPL-POLICY>
                        <BSW-ENTRY-KIND>CONCRETE</BSW-ENTRY-KIND>
                        </BSW-MODULE-ENTRY>

                        <BSW-MODULE-ENTRY UUID="[!"as:uuid()"!]">
                        <SHORT-NAME>Fls_Read</SHORT-NAME>
                        <SERVICE-ID>7</SERVICE-ID>
                        <IS-REENTRANT>false</IS-REENTRANT>
                        <IS-SYNCHRONOUS>false</IS-SYNCHRONOUS>
                        <CALL-TYPE>REGULAR</CALL-TYPE>
                        <EXECUTION-CONTEXT>UNSPECIFIED</EXECUTION-CONTEXT>
                        <SW-SERVICE-IMPL-POLICY>STANDARD</SW-SERVICE-IMPL-POLICY>
                        <BSW-ENTRY-KIND>CONCRETE</BSW-ENTRY-KIND>
                        </BSW-MODULE-ENTRY>

                        <BSW-MODULE-ENTRY UUID="[!"as:uuid()"!]">
                        <SHORT-NAME>Fls_SetEraseType</SHORT-NAME>
                        <SERVICE-ID>12</SERVICE-ID>
                        <IS-REENTRANT>false</IS-REENTRANT>
                        <IS-SYNCHRONOUS>true</IS-SYNCHRONOUS>
                        <CALL-TYPE>REGULAR</CALL-TYPE>
                        <EXECUTION-CONTEXT>UNSPECIFIED</EXECUTION-CONTEXT>
                        <SW-SERVICE-IMPL-POLICY>STANDARD</SW-SERVICE-IMPL-POLICY>
                        <BSW-ENTRY-KIND>CONCRETE</BSW-ENTRY-KIND>
                        </BSW-MODULE-ENTRY>             

                        <BSW-MODULE-ENTRY UUID="[!"as:uuid()"!]">
                        <SHORT-NAME>Fls_SetMode</SHORT-NAME>
                        <SERVICE-ID>9</SERVICE-ID>
                        <IS-REENTRANT>false</IS-REENTRANT>
                        <IS-SYNCHRONOUS>true</IS-SYNCHRONOUS>
                        <CALL-TYPE>REGULAR</CALL-TYPE>
                        <EXECUTION-CONTEXT>UNSPECIFIED</EXECUTION-CONTEXT>
                        <SW-SERVICE-IMPL-POLICY>STANDARD</SW-SERVICE-IMPL-POLICY>
                        <BSW-ENTRY-KIND>CONCRETE</BSW-ENTRY-KIND>
                        </BSW-MODULE-ENTRY>

                        <BSW-MODULE-ENTRY UUID="[!"as:uuid()"!]">
                        <SHORT-NAME>Fls_Write</SHORT-NAME>
                        <SERVICE-ID>2</SERVICE-ID>
                        <IS-REENTRANT>false</IS-REENTRANT>
                        <IS-SYNCHRONOUS>false</IS-SYNCHRONOUS>
                        <CALL-TYPE>REGULAR</CALL-TYPE>
                        <EXECUTION-CONTEXT>UNSPECIFIED</EXECUTION-CONTEXT>
                        <SW-SERVICE-IMPL-POLICY>STANDARD</SW-SERVICE-IMPL-POLICY>
                        <BSW-ENTRY-KIND>CONCRETE</BSW-ENTRY-KIND>
                        </BSW-MODULE-ENTRY>
                    </ELEMENTS>

                </AR-PACKAGE>
            </AR-PACKAGES>
        </AR-PACKAGE>
    </AR-PACKAGES>
</AUTOSAR>
