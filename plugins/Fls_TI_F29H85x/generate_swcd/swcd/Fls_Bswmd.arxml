<?xml version="1.0" encoding="UTF-8"?>
[!SELECT "as:modconf('Fls')[as:path(node:dtos(.))='/TI_F29H85x/Fls']"!]
[!AUTOSPACING!][!//
<AUTOSAR xmlns="http://autosar.org/schema/r4.0" xmlns:xsi="http://www.w3.org/2001/XMLSchema-instance" xsi:schemaLocation="http://autosar.org/schema/r4.0 AUTOSAR_00044.xsd">
    <AR-PACKAGES>
        <AR-PACKAGE UUID="bae58a76-5275-4cfb-8c3e-5b45dea49e78">
        <SHORT-NAME>Fls_TI_F29H85x</SHORT-NAME>

            <ELEMENTS>
                <BSW-MODULE-DESCRIPTION UUID="4043ba93-b642-4683-af25-f0c19bcc45ab">
                <SHORT-NAME>Fls</SHORT-NAME>
                    <IMPLEMENTED-ENTRYS>
                        [!IF "FlsGeneral/FlsBlankCheckApi = 'true'"!]
                        <BSW-MODULE-ENTRY-REF-CONDITIONAL>
                        <BSW-MODULE-ENTRY-REF DEST="BSW-MODULE-ENTRY">/Fls_TI_F29H85x/Fls_ModuleEntry/Fls_BlankCheck</BSW-MODULE-ENTRY-REF>
                        </BSW-MODULE-ENTRY-REF-CONDITIONAL>
                        [!ENDIF!]
                        [!IF "FlsGeneral/FlsCancelApi = 'true'"!]
                        <BSW-MODULE-ENTRY-REF-CONDITIONAL>
                        <BSW-MODULE-ENTRY-REF DEST="BSW-MODULE-ENTRY">/Fls_TI_F29H85x/Fls_ModuleEntry/Fls_Cancel</BSW-MODULE-ENTRY-REF>
                        </BSW-MODULE-ENTRY-REF-CONDITIONAL>
                        [!ENDIF!]
                        [!IF "FlsGeneral/FlsCompareApi = 'true'"!]
                        <BSW-MODULE-ENTRY-REF-CONDITIONAL>
                        <BSW-MODULE-ENTRY-REF DEST="BSW-MODULE-ENTRY">/Fls_TI_F29H85x/Fls_ModuleEntry/Fls_Compare</BSW-MODULE-ENTRY-REF>
                        </BSW-MODULE-ENTRY-REF-CONDITIONAL>
                        [!ENDIF!]
                        <BSW-MODULE-ENTRY-REF-CONDITIONAL>
                        <BSW-MODULE-ENTRY-REF DEST="BSW-MODULE-ENTRY">/Fls_TI_F29H85x/Fls_ModuleEntry/Fls_Erase</BSW-MODULE-ENTRY-REF>
                        </BSW-MODULE-ENTRY-REF-CONDITIONAL>
                        [!IF "FlsGeneral/FlsGetJobResultApi = 'true'"!]
                        <BSW-MODULE-ENTRY-REF-CONDITIONAL>
                        <BSW-MODULE-ENTRY-REF DEST="BSW-MODULE-ENTRY">/Fls_TI_F29H85x/Fls_ModuleEntry/Fls_GetJobResult</BSW-MODULE-ENTRY-REF>
                        </BSW-MODULE-ENTRY-REF-CONDITIONAL>
                        [!ENDIF!]
                        [!IF "FlsGeneral/FlsGetStatusApi = 'true'"!]
                        <BSW-MODULE-ENTRY-REF-CONDITIONAL>
                        <BSW-MODULE-ENTRY-REF DEST="BSW-MODULE-ENTRY">/Fls_TI_F29H85x/Fls_ModuleEntry/Fls_GetStatus</BSW-MODULE-ENTRY-REF>
                        </BSW-MODULE-ENTRY-REF-CONDITIONAL>
                        [!ENDIF!]
                        [!IF "FlsGeneral/FlsVersionInfoApi = 'true'"!]
                        <BSW-MODULE-ENTRY-REF-CONDITIONAL>
                        <BSW-MODULE-ENTRY-REF DEST="BSW-MODULE-ENTRY">/Fls_TI_F29H85x/Fls_ModuleEntry/Fls_GetVersionInfo</BSW-MODULE-ENTRY-REF>
                        </BSW-MODULE-ENTRY-REF-CONDITIONAL>
                        [!ENDIF!]
                        <BSW-MODULE-ENTRY-REF-CONDITIONAL>
                        <BSW-MODULE-ENTRY-REF DEST="BSW-MODULE-ENTRY">/Fls_TI_F29H85x/Fls_ModuleEntry/Fls_Init</BSW-MODULE-ENTRY-REF>
                        </BSW-MODULE-ENTRY-REF-CONDITIONAL>
                        <BSW-MODULE-ENTRY-REF-CONDITIONAL>
                        <BSW-MODULE-ENTRY-REF DEST="BSW-MODULE-ENTRY">/Fls_TI_F29H85x/Fls_ModuleEntry/Fls_MainFunction</BSW-MODULE-ENTRY-REF>
                        </BSW-MODULE-ENTRY-REF-CONDITIONAL>
                        <BSW-MODULE-ENTRY-REF-CONDITIONAL>
                        <BSW-MODULE-ENTRY-REF DEST="BSW-MODULE-ENTRY">/Fls_TI_F29H85x/Fls_ModuleEntry/Fls_Read</BSW-MODULE-ENTRY-REF>
                        </BSW-MODULE-ENTRY-REF-CONDITIONAL>
                        <BSW-MODULE-ENTRY-REF-CONDITIONAL>
                        <BSW-MODULE-ENTRY-REF DEST="BSW-MODULE-ENTRY">/Fls_TI_F29H85x/Fls_ModuleEntry/Fls_SetEraseType</BSW-MODULE-ENTRY-REF>
                        </BSW-MODULE-ENTRY-REF-CONDITIONAL>                        
                        [!IF "FlsGeneral/FlsSetModeApi = 'true'"!]
                        <BSW-MODULE-ENTRY-REF-CONDITIONAL>
                        <BSW-MODULE-ENTRY-REF DEST="BSW-MODULE-ENTRY">/Fls_TI_F29H85x/Fls_ModuleEntry/Fls_SetMode</BSW-MODULE-ENTRY-REF>
                        </BSW-MODULE-ENTRY-REF-CONDITIONAL> 
                        [!ENDIF!]
                        <BSW-MODULE-ENTRY-REF-CONDITIONAL>
                        <BSW-MODULE-ENTRY-REF DEST="BSW-MODULE-ENTRY">/Fls_TI_F29H85x/Fls_ModuleEntry/Fls_Write</BSW-MODULE-ENTRY-REF>
                        </BSW-MODULE-ENTRY-REF-CONDITIONAL>
                    </IMPLEMENTED-ENTRYS>

                    <MODULE-ID>92</MODULE-ID>

                    <BSW-MODULE-DEPENDENCYS>
                        <BSW-MODULE-DEPENDENCY UUID="946cff30-7d16-4026-86a1-001a9b49d095">
                        <SHORT-NAME>Det</SHORT-NAME>
                        <TARGET-MODULE-ID>15</TARGET-MODULE-ID>
                        <TARGET-MODULE-REFS>
                        <BSW-MODULE-DESCRIPTION-REF-CONDITIONAL>
                            <BSW-MODULE-DESCRIPTION-REF DEST="BSW-MODULE-DESCRIPTION">/AUTOSAR_Det/Det</BSW-MODULE-DESCRIPTION-REF>
                        </BSW-MODULE-DESCRIPTION-REF-CONDITIONAL>
                        </TARGET-MODULE-REFS>
                        </BSW-MODULE-DEPENDENCY>
                    </BSW-MODULE-DEPENDENCYS>

                    <INTERNAL-BEHAVIORS>
                        <BSW-INTERNAL-BEHAVIOR UUID="85f25969-956a-410b-b7da-d609897dfa7f">
                        <SHORT-NAME>Fls_Behavior</SHORT-NAME>
                        <EXCLUSIVE-AREAS>
                            <EXCLUSIVE-AREA UUID="44942d26-43a3-4d27-b9ab-dacb0622fcbb">
                            <SHORT-NAME>FLS_EXCLUSIVE_AREA_0</SHORT-NAME>
                            </EXCLUSIVE-AREA>
                        </EXCLUSIVE-AREAS>

                        <ENTITYS>
                            [!IF "FlsGeneral/FlsBlankCheckApi = 'true'"!]
                            <BSW-CALLED-ENTITY UUID="918b5a41-a685-4675-8a02-4d22e4098ec1">
                            <SHORT-NAME>Fls_BlankCheck</SHORT-NAME>
                            <REENTRANCY-LEVEL>NON-REENTRANT</REENTRANCY-LEVEL>
                            [!IF "FlsGeneral/FlsDevErrorDetect = 'true'"!]
                            <CALL-POINTS>
                                <BSW-DIRECT-CALL-POINT>
                                <SHORT-NAME>Det_ReportError</SHORT-NAME>
                                <CALLED-ENTRY-REF DEST="BSW-MODULE-ENTRY">/AUTOSAR_Det/BSWModuleEntry/Det_ReportError</CALLED-ENTRY-REF>
                                </BSW-DIRECT-CALL-POINT>
                            </CALL-POINTS>
                            [!ENDIF!]
                            <IMPLEMENTED-ENTRY-REF DEST="BSW-MODULE-ENTRY">/Fls_TI_F29H85x/Fls_ModuleEntry/Fls_BlankCheck</IMPLEMENTED-ENTRY-REF>
                            </BSW-CALLED-ENTITY>
                            [!ENDIF!]

                            [!IF "FlsGeneral/FlsCancelApi = 'true'"!]
                            <BSW-CALLED-ENTITY UUID="1fcd31b3-4174-4c85-b3a8-5f86043d4d73">
                            <SHORT-NAME>Fls_Cancel</SHORT-NAME>
                            <REENTRANCY-LEVEL>NON-REENTRANT</REENTRANCY-LEVEL>
                            [!IF "FlsGeneral/FlsDevErrorDetect = 'true'"!]
                            <CALL-POINTS>
                                <BSW-DIRECT-CALL-POINT>
                                <SHORT-NAME>Det_ReportError</SHORT-NAME>
                                <CALLED-ENTRY-REF DEST="BSW-MODULE-ENTRY">/AUTOSAR_Det/BSWModuleEntry/Det_ReportError</CALLED-ENTRY-REF>
                                </BSW-DIRECT-CALL-POINT>
                            </CALL-POINTS>
                            [!ENDIF!]
                            <IMPLEMENTED-ENTRY-REF DEST="BSW-MODULE-ENTRY">/Fls_TI_F29H85x/Fls_ModuleEntry/Fls_Cancel</IMPLEMENTED-ENTRY-REF>
                            </BSW-CALLED-ENTITY>
                            [!ENDIF!]

                            [!IF "FlsGeneral/FlsCompareApi = 'true'"!]
                            <BSW-CALLED-ENTITY UUID="699cfa0c-a5ea-4d42-902b-21d231071fcb">
                            <SHORT-NAME>Fls_Compare</SHORT-NAME>
                            <REENTRANCY-LEVEL>NON-REENTRANT</REENTRANCY-LEVEL>
                            [!IF "FlsGeneral/FlsDevErrorDetect = 'true'"!]
                            <CALL-POINTS>
                                <BSW-DIRECT-CALL-POINT>
                                <SHORT-NAME>Det_ReportError</SHORT-NAME>
                                <CALLED-ENTRY-REF DEST="BSW-MODULE-ENTRY">/AUTOSAR_Det/BSWModuleEntry/Det_ReportError</CALLED-ENTRY-REF>
                                </BSW-DIRECT-CALL-POINT>
                            </CALL-POINTS>
                            [!ENDIF!]
                            <IMPLEMENTED-ENTRY-REF DEST="BSW-MODULE-ENTRY">/Fls_TI_F29H85x/Fls_ModuleEntry/Fls_Compare</IMPLEMENTED-ENTRY-REF>
                            </BSW-CALLED-ENTITY>
                            [!ENDIF!]

                            <BSW-CALLED-ENTITY UUID="79609a9a-28b7-4355-947c-d5789043f7c8">
                            <SHORT-NAME>Fls_Erase</SHORT-NAME>
                            <REENTRANCY-LEVEL>NON-REENTRANT</REENTRANCY-LEVEL>
                            [!IF "FlsGeneral/FlsDevErrorDetect = 'true'"!]
                            <CALL-POINTS>
                                <BSW-DIRECT-CALL-POINT>
                                <SHORT-NAME>Det_ReportError</SHORT-NAME>
                                <CALLED-ENTRY-REF DEST="BSW-MODULE-ENTRY">/AUTOSAR_Det/BSWModuleEntry/Det_ReportError</CALLED-ENTRY-REF>
                                </BSW-DIRECT-CALL-POINT>
                            </CALL-POINTS>
                            [!ENDIF!]
                            <IMPLEMENTED-ENTRY-REF DEST="BSW-MODULE-ENTRY">/Fls_TI_F29H85x/Fls_ModuleEntry/Fls_Erase</IMPLEMENTED-ENTRY-REF>
                            </BSW-CALLED-ENTITY>

                            [!IF "FlsGeneral/FlsGetJobResultApi = 'true'"!]
                            <BSW-CALLED-ENTITY UUID="dfd58d87-8c71-4f04-8fae-03351ab050cb">
                            <SHORT-NAME>Fls_GetJobResult</SHORT-NAME>
                            <REENTRANCY-LEVEL>SINGLE-CORE-REENTRANT</REENTRANCY-LEVEL>
                            [!IF "FlsGeneral/FlsDevErrorDetect = 'true'"!]
                            <CALL-POINTS>
                                <BSW-DIRECT-CALL-POINT>
                                <SHORT-NAME>Det_ReportError</SHORT-NAME>
                                <CALLED-ENTRY-REF DEST="BSW-MODULE-ENTRY">/AUTOSAR_Det/BSWModuleEntry/Det_ReportError</CALLED-ENTRY-REF>
                                </BSW-DIRECT-CALL-POINT>
                            </CALL-POINTS>
                            [!ENDIF!]
                            <IMPLEMENTED-ENTRY-REF DEST="BSW-MODULE-ENTRY">/Fls_TI_F29H85x/Fls_ModuleEntry/Fls_GetJobResult</IMPLEMENTED-ENTRY-REF>
                            </BSW-CALLED-ENTITY>
                            [!ENDIF!]

                            [!IF "FlsGeneral/FlsGetStatusApi = 'true'"!]
                            <BSW-CALLED-ENTITY UUID="b18523d2-81d2-4121-91a6-503e47b94f0e">
                            <SHORT-NAME>Fls_GetStatus</SHORT-NAME>
                            <REENTRANCY-LEVEL>SINGLE-CORE-REENTRANT</REENTRANCY-LEVEL>
                            <IMPLEMENTED-ENTRY-REF DEST="BSW-MODULE-ENTRY">/Fls_TI_F29H85x/Fls_ModuleEntry/Fls_GetStatus</IMPLEMENTED-ENTRY-REF>
                            </BSW-CALLED-ENTITY>
                            [!ENDIF!]

                            [!IF "FlsGeneral/FlsVersionInfoApi = 'true'"!]
                            <BSW-CALLED-ENTITY UUID="41ce2d70-0385-46a4-89f0-c2220c89195e">
                            <SHORT-NAME>Fls_GetVersionInfo</SHORT-NAME>
                            <REENTRANCY-LEVEL>SINGLE-CORE-REENTRANT</REENTRANCY-LEVEL>
                            [!IF "FlsGeneral/FlsDevErrorDetect = 'true'"!]
                            <CALL-POINTS>
                                <BSW-DIRECT-CALL-POINT>
                                <SHORT-NAME>Det_ReportError</SHORT-NAME>
                                <CALLED-ENTRY-REF DEST="BSW-MODULE-ENTRY">/AUTOSAR_Det/BSWModuleEntry/Det_ReportError</CALLED-ENTRY-REF>
                                </BSW-DIRECT-CALL-POINT>
                            </CALL-POINTS>
                            [!ENDIF!]
                            <IMPLEMENTED-ENTRY-REF DEST="BSW-MODULE-ENTRY">/Fls_TI_F29H85x/Fls_ModuleEntry/Fls_GetVersionInfo</IMPLEMENTED-ENTRY-REF>
                            </BSW-CALLED-ENTITY>
                            [!ENDIF!]

                            <BSW-CALLED-ENTITY UUID="1c915b6a-38c7-1713-9b71-69b989537653">
                            <SHORT-NAME>Fls_Init</SHORT-NAME>
                            <REENTRANCY-LEVEL>NON-REENTRANT</REENTRANCY-LEVEL>
                            <CALL-POINTS>
                                [!IF "FlsGeneral/FlsDevErrorDetect = 'true'"!]
                                <BSW-DIRECT-CALL-POINT>
                                <SHORT-NAME>Det_ReportError</SHORT-NAME>
                                <CALLED-ENTRY-REF DEST="BSW-MODULE-ENTRY">/AUTOSAR_Det/BSWModuleEntry/Det_ReportError</CALLED-ENTRY-REF>
                                </BSW-DIRECT-CALL-POINT>
                                [!ENDIF!]
                                <BSW-DIRECT-CALL-POINT>
                                <SHORT-NAME>Det_ReportRuntimeError</SHORT-NAME>
                                <CALLED-ENTRY-REF DEST="BSW-MODULE-ENTRY">/AUTOSAR_Det/BSWModuleEntry/Det_ReportRuntimeError</CALLED-ENTRY-REF>
                                </BSW-DIRECT-CALL-POINT>
                            </CALL-POINTS>
                            <IMPLEMENTED-ENTRY-REF DEST="BSW-MODULE-ENTRY">/Fls_TI_F29H85x/Fls_ModuleEntry/Fls_Init</IMPLEMENTED-ENTRY-REF>
                            </BSW-CALLED-ENTITY>

                            <BSW-SCHEDULABLE-ENTITY UUID="307c3957-6ce9-444b-84a7-e564be0cd6f3">
                            <SHORT-NAME>Fls_MainFunction</SHORT-NAME>
                            <CAN-ENTER-EXCLUSIVE-AREA-REFS>
                                <CAN-ENTER-EXCLUSIVE-AREA-REF DEST="EXCLUSIVE-AREA">/Fls_TI_F29H85x/Fls/Fls_Behavior/FLS_EXCLUSIVE_AREA_0</CAN-ENTER-EXCLUSIVE-AREA-REF>
                            </CAN-ENTER-EXCLUSIVE-AREA-REFS>
                            <REENTRANCY-LEVEL>NON-REENTRANT</REENTRANCY-LEVEL>
                            <CALL-POINTS>
                                [!IF "FlsGeneral/FlsDevErrorDetect = 'true'"!]
                                <BSW-DIRECT-CALL-POINT>
                                <SHORT-NAME>Det_ReportError</SHORT-NAME>
                                <CALLED-ENTRY-REF DEST="BSW-MODULE-ENTRY">/AUTOSAR_Det/BSWModuleEntry/Det_ReportError</CALLED-ENTRY-REF>
                                </BSW-DIRECT-CALL-POINT>
                                [!ENDIF!]
                                <BSW-DIRECT-CALL-POINT>
                                <SHORT-NAME>Det_ReportRuntimeError</SHORT-NAME>
                                <CALLED-ENTRY-REF DEST="BSW-MODULE-ENTRY">/AUTOSAR_Det/BSWModuleEntry/Det_ReportRuntimeError</CALLED-ENTRY-REF>
                                </BSW-DIRECT-CALL-POINT>
                            </CALL-POINTS>
                            <IMPLEMENTED-ENTRY-REF DEST="BSW-MODULE-ENTRY">/Fls_TI_F29H85x/Fls_ModuleEntry/Fls_MainFunction</IMPLEMENTED-ENTRY-REF>
                            </BSW-SCHEDULABLE-ENTITY>

                            <BSW-CALLED-ENTITY UUID="f84c3bd5-aeb4-473d-9b55-542b756ea37a">
                            <SHORT-NAME>Fls_Read</SHORT-NAME>
                            <REENTRANCY-LEVEL>NON-REENTRANT</REENTRANCY-LEVEL>
                            [!IF "FlsGeneral/FlsDevErrorDetect = 'true'"!]
                            <CALL-POINTS>
                                <BSW-DIRECT-CALL-POINT>
                                <SHORT-NAME>Det_ReportError</SHORT-NAME>
                                <CALLED-ENTRY-REF DEST="BSW-MODULE-ENTRY">/AUTOSAR_Det/BSWModuleEntry/Det_ReportError</CALLED-ENTRY-REF>
                                </BSW-DIRECT-CALL-POINT>
                            </CALL-POINTS>
                            [!ENDIF!]
                            <IMPLEMENTED-ENTRY-REF DEST="BSW-MODULE-ENTRY">/Fls_TI_F29H85x/Fls_ModuleEntry/Fls_Read</IMPLEMENTED-ENTRY-REF>
                            </BSW-CALLED-ENTITY>

                            <BSW-CALLED-ENTITY UUID="adb36965-9328-4a85-9448-9e320a3f3537">
                            <SHORT-NAME>Fls_SetEraseType</SHORT-NAME>
                            <REENTRANCY-LEVEL>NON-REENTRANT</REENTRANCY-LEVEL>
                            <IMPLEMENTED-ENTRY-REF DEST="BSW-MODULE-ENTRY">/Fls_TI_F29H85x/Fls_ModuleEntry/Fls_SetEraseType</IMPLEMENTED-ENTRY-REF>
                            </BSW-CALLED-ENTITY>

                            [!IF "FlsGeneral/FlsSetModeApi = 'true'"!]
                            <BSW-CALLED-ENTITY UUID="e39f326c-0e71-4583-9af6-35e718da9e03">
                            <SHORT-NAME>Fls_SetMode</SHORT-NAME>
                            <REENTRANCY-LEVEL>NON-REENTRANT</REENTRANCY-LEVEL>
                            <IMPLEMENTED-ENTRY-REF DEST="BSW-MODULE-ENTRY">/Fls_TI_F29H85x/Fls_ModuleEntry/Fls_SetMode</IMPLEMENTED-ENTRY-REF>
                            </BSW-CALLED-ENTITY>
                            [!ENDIF!]

                            <BSW-CALLED-ENTITY UUID="791afe65-898a-46e8-87e7-6e31e262b234">
                            <SHORT-NAME>Fls_Write</SHORT-NAME>
                            <REENTRANCY-LEVEL>NON-REENTRANT</REENTRANCY-LEVEL>
                            [!IF "FlsGeneral/FlsDevErrorDetect = 'true'"!]
                            <CALL-POINTS>
                                <BSW-DIRECT-CALL-POINT>
                                <SHORT-NAME>Det_ReportError</SHORT-NAME>
                                <CALLED-ENTRY-REF DEST="BSW-MODULE-ENTRY">/AUTOSAR_Det/BSWModuleEntry/Det_ReportError</CALLED-ENTRY-REF>
                                </BSW-DIRECT-CALL-POINT>
                            </CALL-POINTS>
                            [!ENDIF!]
                            <IMPLEMENTED-ENTRY-REF DEST="BSW-MODULE-ENTRY">/Fls_TI_F29H85x/Fls_ModuleEntry/Fls_Write</IMPLEMENTED-ENTRY-REF>
                            </BSW-CALLED-ENTITY>
                        </ENTITYS>

                        <EVENTS>
                            <BSW-TIMING-EVENT UUID="82518acf-a2cb-469e-8855-275874c93510">
                            <SHORT-NAME>Fls_MainFunctionTimingEvent</SHORT-NAME>
                            <STARTS-ON-EVENT-REF DEST="BSW-SCHEDULABLE-ENTITY">/Fls_TI_F29H85x/Fls/Fls_Behavior/Fls_MainFunction</STARTS-ON-EVENT-REF>
                            <PERIOD>[!"FlsConfigSet/FlsCallCycle"!]</PERIOD>
                            </BSW-TIMING-EVENT>
                        </EVENTS>

                        </BSW-INTERNAL-BEHAVIOR>
                    </INTERNAL-BEHAVIORS>
                </BSW-MODULE-DESCRIPTION>

                <BSW-IMPLEMENTATION UUID=="bfc248a6-4d0e-48e6-ac25-ada2fc33db91">
                <SHORT-NAME>Fls_Impl</SHORT-NAME>
                <CODE-DESCRIPTORS>
                    <CODE UUID="459a8987-f4d7-4450-a16c-65b3100ef8d7">
                    <SHORT-NAME>Files</SHORT-NAME>
                    <ARTIFACT-DESCRIPTORS>
                        <AUTOSAR-ENGINEERING-OBJECT>
                        <SHORT-LABEL>generate::include::Fls_Cfg.h</SHORT-LABEL>
                        <CATEGORY>SWHDR</CATEGORY>
                        </AUTOSAR-ENGINEERING-OBJECT>
                        <AUTOSAR-ENGINEERING-OBJECT>
                        <SHORT-LABEL>generate::src::Fls_Cfg.c</SHORT-LABEL>
                        <CATEGORY>SWSRC</CATEGORY>
                        </AUTOSAR-ENGINEERING-OBJECT>
                        <AUTOSAR-ENGINEERING-OBJECT>
                        <SHORT-LABEL>include::Fls.h</SHORT-LABEL>
                        <CATEGORY>SWHDR</CATEGORY>
                        </AUTOSAR-ENGINEERING-OBJECT>
                        <AUTOSAR-ENGINEERING-OBJECT>
                        <SHORT-LABEL>include::Fls_Cbk.h</SHORT-LABEL>
                        <CATEGORY>SWHDR</CATEGORY>
                        </AUTOSAR-ENGINEERING-OBJECT>
                        <AUTOSAR-ENGINEERING-OBJECT>
                        <SHORT-LABEL>include::Fls_Ac.h</SHORT-LABEL>
                        <CATEGORY>SWHDR</CATEGORY>
                        </AUTOSAR-ENGINEERING-OBJECT>
                        <AUTOSAR-ENGINEERING-OBJECT>
                        <SHORT-LABEL>include::Fls_Priv.h</SHORT-LABEL>
                        <CATEGORY>SWHDR</CATEGORY>
                        </AUTOSAR-ENGINEERING-OBJECT>
                        <AUTOSAR-ENGINEERING-OBJECT>
                        <SHORT-LABEL>src::Fls.c</SHORT-LABEL>
                        <CATEGORY>SWSRC</CATEGORY>
                        </AUTOSAR-ENGINEERING-OBJECT>
                        <AUTOSAR-ENGINEERING-OBJECT>
                        <SHORT-LABEL>src::Fls_Ac.c</SHORT-LABEL>
                        <CATEGORY>SWSRC</CATEGORY>
                        </AUTOSAR-ENGINEERING-OBJECT>
                        <AUTOSAR-ENGINEERING-OBJECT>
                        <SHORT-LABEL>src::Fls_Priv.c</SHORT-LABEL>
                        <CATEGORY>SWSRC</CATEGORY>
                        </AUTOSAR-ENGINEERING-OBJECT>
                        <AUTOSAR-ENGINEERING-OBJECT>
                        <SHORT-LABEL>generate::src::Fls_PBcfg.c</SHORT-LABEL>
                        <CATEGORY>SWSRC</CATEGORY>
                        </AUTOSAR-ENGINEERING-OBJECT>
                    </ARTIFACT-DESCRIPTORS>             
                    </CODE>
                </CODE-DESCRIPTORS>

                <COMPILERS>
                    <COMPILER UUID="282210cb-089a-4c31-9227-66e31472cb6d">
                    <SHORT-NAME>TI_C29Clang</SHORT-NAME>
                    <NAME>TI C29 Clang Compiler</NAME>
                    <VENDOR>Texas Instruments</VENDOR>
                    <VERSION>1.0.0</VERSION>
                    </COMPILER>
                </COMPILERS>

                <LINKERS>
                    <LINKER UUID="74f319d3-23a4-4270-83f8-76b7dc9492af">
                    <SHORT-NAME>TI_C29Linker</SHORT-NAME>
                    <NAME>TI C29 Clang Linker</NAME>
                    <VENDOR>Texas Instruments</VENDOR>
                    <VERSION>1.0.0</VERSION>
                    </LINKER>
                </LINKERS>
                
                <PROGRAMMING-LANGUAGE>C</PROGRAMMING-LANGUAGE>
                <RESOURCE-CONSUMPTION UUID="3d0007f8-fc84-4747-b740-1f4a29a7c3b2">
                    <SHORT-NAME>ResourceConsumption</SHORT-NAME>
                    <MEMORY-SECTIONS>
                    <MEMORY-SECTION UUID="ac707ba3-ca92-47ce-a3a4-0ac5da29cf14">
                        <SHORT-NAME>FLS_CODE</SHORT-NAME>
                        <SW-ADDRMETHOD-REF DEST="SW-ADDR-METHOD">/AUTOSAR_MemMap/SwAddrMethods/CODE</SW-ADDRMETHOD-REF>
                        <SYMBOL>CODE</SYMBOL>
                    </MEMORY-SECTION>
                    <MEMORY-SECTION UUID="2fae3375-f1d5-4fdf-a79a-476daeec678d">
                        <SHORT-NAME>FLS_CONFIG_DATA</SHORT-NAME>
                        <ALIGNMENT>UNSPECIFIED</ALIGNMENT>
                        <SW-ADDRMETHOD-REF DEST="SW-ADDR-METHOD">/AUTOSAR_MemMap/SwAddrMethods/CONST_PBCFG</SW-ADDRMETHOD-REF>
                        <SYMBOL>CONFIG_DATA</SYMBOL>
                    </MEMORY-SECTION>
                    <MEMORY-SECTION UUID="b5400584-8779-483e-81d4-bff2e418be65">
                        <SHORT-NAME>FLS_VAR_INIT_32</SHORT-NAME>
                        <ALIGNMENT>32</ALIGNMENT>
                        <SW-ADDRMETHOD-REF DEST="SW-ADDR-METHOD">/AUTOSAR_MemMap/SwAddrMethods/VAR_INIT</SW-ADDRMETHOD-REF>
                        <SYMBOL>VAR_INIT_32</SYMBOL>
                    </MEMORY-SECTION>
                    <MEMORY-SECTION UUID="efea4500-a551-4ba4-9fdf-efb549628822">
                        <SHORT-NAME>FLS_VAR_INIT_8</SHORT-NAME>
                        <ALIGNMENT>8</ALIGNMENT>
                        <SW-ADDRMETHOD-REF DEST="SW-ADDR-METHOD">/AUTOSAR_MemMap/SwAddrMethods/VAR_INIT</SW-ADDRMETHOD-REF>
                        <SYMBOL>VAR_INIT_8</SYMBOL>
                    </MEMORY-SECTION>
                    <MEMORY-SECTION UUID="2a9dec4c-ae9a-44f5-9708-8dab3ab2f6bc">
                        <SHORT-NAME>FLS_VAR_INIT_UNSPECIFIED</SHORT-NAME>
                        <ALIGNMENT>UNSPECIFIED</ALIGNMENT>
                        <SW-ADDRMETHOD-REF DEST="SW-ADDR-METHOD">/AUTOSAR_MemMap/SwAddrMethods/VAR_INIT</SW-ADDRMETHOD-REF>
                        <SYMBOL>VAR_INIT_UNSPECIFIED</SYMBOL>
                    </MEMORY-SECTION>
                    <MEMORY-SECTION UUID="30f138df-6666-4862-87a8-e1b41838561a">
                        <SHORT-NAME>FLS_VAR_NO_INIT_32</SHORT-NAME>
                        <ALIGNMENT>32</ALIGNMENT>
                        <SW-ADDRMETHOD-REF DEST="SW-ADDR-METHOD">/AUTOSAR_MemMap/SwAddrMethods/VAR_NO_INIT</SW-ADDRMETHOD-REF>
                        <SYMBOL>VAR_NO_INIT_32</SYMBOL>
                    </MEMORY-SECTION>
                    <MEMORY-SECTION UUID="2ec99bc6-4cd9-48bb-bf9f-d730648759e8">
                        <SHORT-NAME>FLS_VAR_NO_INIT_8</SHORT-NAME>
                        <ALIGNMENT>8</ALIGNMENT>
                        <SW-ADDRMETHOD-REF DEST="SW-ADDR-METHOD">/AUTOSAR_MemMap/SwAddrMethods/VAR_NO_INIT</SW-ADDRMETHOD-REF>
                        <SYMBOL>VAR_NO_INIT_8</SYMBOL>
                    </MEMORY-SECTION>
                    <MEMORY-SECTION UUID="b06efa30-63e5-4f18-b3d2-c4e0200e3f87">
                        <SHORT-NAME>FLS_VAR_NO_INIT_UNSPECIFIED</SHORT-NAME>
                        <ALIGNMENT>UNSPECIFIED</ALIGNMENT>
                        <SW-ADDRMETHOD-REF DEST="SW-ADDR-METHOD">/AUTOSAR_MemMap/SwAddrMethods/VAR_NO_INIT</SW-ADDRMETHOD-REF>
                        <SYMBOL>VAR_NO_INIT_UNSPECIFIED</SYMBOL>
                    </MEMORY-SECTION>
                    </MEMORY-SECTIONS>
                </RESOURCE-CONSUMPTION>

                <SW-VERSION>[!"$moduleSoftwareVer"!]</SW-VERSION>
                <VENDOR-ID>44</VENDOR-ID>
                <AR-RELEASE-VERSION>[!"substring-after($moduleReleaseVer, 'AUTOSAR ')"!]</AR-RELEASE-VERSION>
                <BEHAVIOR-REF DEST="BSW-INTERNAL-BEHAVIOR">/Fls_TI_F29H85x/Fls/Fls_Behavior</BEHAVIOR-REF>
                <VENDOR-SPECIFIC-MODULE-DEF-REFS>
                    <VENDOR-SPECIFIC-MODULE-DEF-REF DEST="ECUC-MODULE-DEF">/TI_F29H85x/Fls</VENDOR-SPECIFIC-MODULE-DEF-REF>
                </VENDOR-SPECIFIC-MODULE-DEF-REFS> 

                </BSW-IMPLEMENTATION>
            </ELEMENTS>

            <AR-PACKAGES>
                <AR-PACKAGE UUID="7ed0172e-a6e9-4dc4-9e55-8d47b8fcb1d5">
                <SHORT-NAME>Fls_ModuleEntry</SHORT-NAME>

                    <ELEMENTS>
                        <BSW-MODULE-ENTRY UUID="1fa976e8-909c-4a85-bff8-80fc2aaac618">
                        <SHORT-NAME>Fls_BlankCheck</SHORT-NAME>
                        <SERVICE-ID>10</SERVICE-ID>
                        <IS-REENTRANT>false</IS-REENTRANT>
                        <IS-SYNCHRONOUS>false</IS-SYNCHRONOUS>
                        <CALL-TYPE>REGULAR</CALL-TYPE>
                        <EXECUTION-CONTEXT>UNSPECIFIED</EXECUTION-CONTEXT>
                        <SW-SERVICE-IMPL-POLICY>STANDARD</SW-SERVICE-IMPL-POLICY>
                        <BSW-ENTRY-KIND>CONCRETE</BSW-ENTRY-KIND>
                        </BSW-MODULE-ENTRY>

                        <BSW-MODULE-ENTRY UUID="28d2b9c1-1a61-41af-b894-8385132e1981">
                        <SHORT-NAME>Fls_Cancel</SHORT-NAME>
                        <SERVICE-ID>3</SERVICE-ID>
                        <IS-REENTRANT>false</IS-REENTRANT>
                        <IS-SYNCHRONOUS>true</IS-SYNCHRONOUS>              
                        <CALL-TYPE>REGULAR</CALL-TYPE>
                        <EXECUTION-CONTEXT>UNSPECIFIED</EXECUTION-CONTEXT>
                        <SW-SERVICE-IMPL-POLICY>STANDARD</SW-SERVICE-IMPL-POLICY>
                        <BSW-ENTRY-KIND>CONCRETE</BSW-ENTRY-KIND>
                        </BSW-MODULE-ENTRY>
                        
                        <BSW-MODULE-ENTRY UUID="017e17f7-0612-46e1-8740-5770a1585d27">
                        <SHORT-NAME>Fls_Compare</SHORT-NAME>
                        <SERVICE-ID>8</SERVICE-ID>
                        <IS-REENTRANT>false</IS-REENTRANT>
                        <IS-SYNCHRONOUS>false</IS-SYNCHRONOUS> 
                        <CALL-TYPE>REGULAR</CALL-TYPE>
                        <EXECUTION-CONTEXT>UNSPECIFIED</EXECUTION-CONTEXT>
                        <SW-SERVICE-IMPL-POLICY>STANDARD</SW-SERVICE-IMPL-POLICY>
                        <BSW-ENTRY-KIND>CONCRETE</BSW-ENTRY-KIND>
                        </BSW-MODULE-ENTRY>
                        
                        <BSW-MODULE-ENTRY UUID="d40564c5-a291-47fe-83d3-8f72ec12958a">
                        <SHORT-NAME>Fls_Erase</SHORT-NAME>
                        <SERVICE-ID>1</SERVICE-ID>
                        <IS-REENTRANT>false</IS-REENTRANT>
                        <IS-SYNCHRONOUS>false</IS-SYNCHRONOUS> 
                        <CALL-TYPE>REGULAR</CALL-TYPE>
                        <EXECUTION-CONTEXT>UNSPECIFIED</EXECUTION-CONTEXT>
                        <SW-SERVICE-IMPL-POLICY>STANDARD</SW-SERVICE-IMPL-POLICY>
                        <BSW-ENTRY-KIND>CONCRETE</BSW-ENTRY-KIND>
                        </BSW-MODULE-ENTRY>
                        
                        <BSW-MODULE-ENTRY UUID="5f2ebd37-99dc-4a95-9ab5-d9df240c539b">
                        <SHORT-NAME>Fls_GetJobResult</SHORT-NAME>
                        <SERVICE-ID>5</SERVICE-ID>
                        <IS-REENTRANT>true</IS-REENTRANT>
                        <IS-SYNCHRONOUS>true</IS-SYNCHRONOUS>
                        <CALL-TYPE>REGULAR</CALL-TYPE>
                        <EXECUTION-CONTEXT>UNSPECIFIED</EXECUTION-CONTEXT>
                        <SW-SERVICE-IMPL-POLICY>STANDARD</SW-SERVICE-IMPL-POLICY>
                        <BSW-ENTRY-KIND>CONCRETE</BSW-ENTRY-KIND>
                        </BSW-MODULE-ENTRY>
                        
                        <BSW-MODULE-ENTRY UUID="f08e46dc-8313-49be-8897-e6dc587e1e2c">
                        <SHORT-NAME>Fls_GetStatus</SHORT-NAME>
                        <SERVICE-ID>4</SERVICE-ID>
                        <IS-REENTRANT>true</IS-REENTRANT>
                        <IS-SYNCHRONOUS>true</IS-SYNCHRONOUS>
                        <CALL-TYPE>REGULAR</CALL-TYPE>
                        <EXECUTION-CONTEXT>UNSPECIFIED</EXECUTION-CONTEXT>
                        <SW-SERVICE-IMPL-POLICY>STANDARD</SW-SERVICE-IMPL-POLICY>
                        <BSW-ENTRY-KIND>CONCRETE</BSW-ENTRY-KIND>
                        </BSW-MODULE-ENTRY>
                        
                        <BSW-MODULE-ENTRY UUID="0f951a68-1b45-4064-96ce-7211a464212c">
                        <SHORT-NAME>Fls_GetVersionInfo</SHORT-NAME>
                        <SERVICE-ID>16</SERVICE-ID>
                        <IS-REENTRANT>true</IS-REENTRANT>
                        <IS-SYNCHRONOUS>true</IS-SYNCHRONOUS>
                        <CALL-TYPE>REGULAR</CALL-TYPE>
                        <EXECUTION-CONTEXT>UNSPECIFIED</EXECUTION-CONTEXT>
                        <SW-SERVICE-IMPL-POLICY>STANDARD</SW-SERVICE-IMPL-POLICY>
                        <BSW-ENTRY-KIND>CONCRETE</BSW-ENTRY-KIND>
                        </BSW-MODULE-ENTRY>

                        <BSW-MODULE-ENTRY UUID="855b3a8e-1555-42fb-a1b2-32233c157a46">
                        <SHORT-NAME>Fls_Init</SHORT-NAME>
                        <SERVICE-ID>0</SERVICE-ID>
                        <IS-REENTRANT>false</IS-REENTRANT>
                        <IS-SYNCHRONOUS>true</IS-SYNCHRONOUS>
                        <CALL-TYPE>REGULAR</CALL-TYPE>
                        <EXECUTION-CONTEXT>UNSPECIFIED</EXECUTION-CONTEXT>
                        <SW-SERVICE-IMPL-POLICY>STANDARD</SW-SERVICE-IMPL-POLICY>
                        <BSW-ENTRY-KIND>CONCRETE</BSW-ENTRY-KIND>
                        </BSW-MODULE-ENTRY>

                        <BSW-MODULE-ENTRY UUID="817702b8-0a82-4b90-b717-e812c9ff2a67">
                        <SHORT-NAME>Fls_MainFunction</SHORT-NAME>
                        <SERVICE-ID>6</SERVICE-ID>
                        <IS-REENTRANT>false</IS-REENTRANT>
                        <IS-SYNCHRONOUS>true</IS-SYNCHRONOUS>
                        <CALL-TYPE>SCHEDULED</CALL-TYPE>
                        <EXECUTION-CONTEXT>UNSPECIFIED</EXECUTION-CONTEXT>
                        <SW-SERVICE-IMPL-POLICY>STANDARD</SW-SERVICE-IMPL-POLICY>
                        <BSW-ENTRY-KIND>CONCRETE</BSW-ENTRY-KIND>
                        </BSW-MODULE-ENTRY>

                        <BSW-MODULE-ENTRY UUID="c5719b2e-33fd-4bc5-aff8-28ee8aea6a10">
                        <SHORT-NAME>Fls_Read</SHORT-NAME>
                        <SERVICE-ID>7</SERVICE-ID>
                        <IS-REENTRANT>false</IS-REENTRANT>
                        <IS-SYNCHRONOUS>false</IS-SYNCHRONOUS>
                        <CALL-TYPE>REGULAR</CALL-TYPE>
                        <EXECUTION-CONTEXT>UNSPECIFIED</EXECUTION-CONTEXT>
                        <SW-SERVICE-IMPL-POLICY>STANDARD</SW-SERVICE-IMPL-POLICY>
                        <BSW-ENTRY-KIND>CONCRETE</BSW-ENTRY-KIND>
                        </BSW-MODULE-ENTRY>

                        <BSW-MODULE-ENTRY UUID="1c1933ad-e641-44b6-837b-63801633920e">
                        <SHORT-NAME>Fls_SetEraseType</SHORT-NAME>
                        <SERVICE-ID>12</SERVICE-ID>
                        <IS-REENTRANT>false</IS-REENTRANT>
                        <IS-SYNCHRONOUS>true</IS-SYNCHRONOUS>
                        <CALL-TYPE>REGULAR</CALL-TYPE>
                        <EXECUTION-CONTEXT>UNSPECIFIED</EXECUTION-CONTEXT>
                        <SW-SERVICE-IMPL-POLICY>STANDARD</SW-SERVICE-IMPL-POLICY>
                        <BSW-ENTRY-KIND>CONCRETE</BSW-ENTRY-KIND>
                        </BSW-MODULE-ENTRY>             

                        <BSW-MODULE-ENTRY UUID="e39f326c-0e71-4583-9af6-35e718da9e03">
                        <SHORT-NAME>Fls_SetMode</SHORT-NAME>
                        <SERVICE-ID>9</SERVICE-ID>
                        <IS-REENTRANT>false</IS-REENTRANT>
                        <IS-SYNCHRONOUS>true</IS-SYNCHRONOUS>
                        <CALL-TYPE>REGULAR</CALL-TYPE>
                        <EXECUTION-CONTEXT>UNSPECIFIED</EXECUTION-CONTEXT>
                        <SW-SERVICE-IMPL-POLICY>STANDARD</SW-SERVICE-IMPL-POLICY>
                        <BSW-ENTRY-KIND>CONCRETE</BSW-ENTRY-KIND>
                        </BSW-MODULE-ENTRY>

                        <BSW-MODULE-ENTRY UUID="e96184f9-1b96-4a72-8bf0-e22ef2e11d7a">
                        <SHORT-NAME>Fls_Write</SHORT-NAME>
                        <SERVICE-ID>2</SERVICE-ID>
                        <IS-REENTRANT>false</IS-REENTRANT>
                        <IS-SYNCHRONOUS>false</IS-SYNCHRONOUS>
                        <CALL-TYPE>REGULAR</CALL-TYPE>
                        <EXECUTION-CONTEXT>UNSPECIFIED</EXECUTION-CONTEXT>
                        <SW-SERVICE-IMPL-POLICY>STANDARD</SW-SERVICE-IMPL-POLICY>
                        <BSW-ENTRY-KIND>CONCRETE</BSW-ENTRY-KIND>
                        </BSW-MODULE-ENTRY>
                    </ELEMENTS>

                </AR-PACKAGE>
            </AR-PACKAGES>
        </AR-PACKAGE>
    </AR-PACKAGES>
</AUTOSAR>
[!ENDSELECT!]
