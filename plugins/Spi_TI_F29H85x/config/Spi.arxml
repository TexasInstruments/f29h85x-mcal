AUTOSAR XML (schema 00044)
package /TI_F29H85x
  ecuc definition collection myEcuParameterDefinition: module=Spi
  module definition Spi: post-build-variant-support=true, refined-module-def=Spi, variants link-time/post-build/pre-compile  # Configuration of the Spi (Serial Peripheral Interface) module.
    container SpiDemEventParameterRefs [0..1]: multiplicity set at link in variant link-time / post-build in variant post-build / pre-compile in variant pre-compile  # Container for the references to DemEventParameter elements which shall be invoked using the API Dem_SetEventStatus in case the corresponding error occurs. The EventId is taken from the referenced DemEventParameter's DemEventId symbolic value. The standardized errors are provided in this container and can be extended by vendor-specific error references.
      symbolic name reference SPI_E_HARDWARE_ERROR [0..1]: multiplicity set at pre-compile, set at pre-compile, destination=DemEventParameter  # Reference to configured DEM event to report "Hardware failure". If the reference is not configured the error shall not be reported.
    container SpiDriver  # This container contains the configuration parameters and sub containers of the AUTOSAR Spi module.
      integer SpiMaxChannel: 1..1, post-build-variant-value=true, set at link in variant link-time / post-build in variant post-build / pre-compile in variant pre-compile, default-value=1  # This parameter contains the number of Channels configured. It will be gathered by tools during the configuration stage.
      integer SpiMaxJob: 1..65535, post-build-variant-value=true, set at link in variant link-time / post-build in variant post-build / pre-compile in variant pre-compile, default-value=1  # Total number of Jobs configured.
      integer SpiMaxSequence: 0..255, post-build-variant-value=true, set at link in variant link-time / post-build in variant post-build / pre-compile in variant pre-compile, default-value=0  # Total number of Sequences configured.
      float SpiSequenceTimeOut: 1.0E-6..10.0, origin=Texas Instruments, post-build-variant-value=true, set at link in variant link-time / post-build in variant post-build / pre-compile in variant pre-compile, default-value=5.0E-5  # TimeOut value for sync transmission in seconds, if sync transmission didn't happen within this time frame transmission will be aborted and DET runtime error is reported with SPI_E_SEQ_TIMEOUT error code
      reference SpiCounterClockRef: origin=Texas Instruments, set at pre-compile in variant pre-compile / link in variant link-time / post-build in variant post-build, destination=McuClockReferencePoint  # This parameter references the SYSCLK to convert timeout values from milliseconds to clock ticks. Users should ensure the correct clock reference point is selected to achieve accurate timeout calculations.
      container SpiChannel [1..*]: multiplicity set at link in variant link-time / post-build in variant post-build / pre-compile in variant pre-compile  # All data needed to configure one SPI-channel
        integer SpiChannelId: 0..255, set at pre-compile, symbolic-name-value=true, default-value=0  # SPI Channel ID, used as parameter in SPI API functions.
        enumeration SpiChannelType: {EB, IB}, post-build-variant-value=true, set at link in variant link-time / post-build in variant post-build / pre-compile in variant pre-compile, default-value=IB  # Buffer usage with EB/IB channel.
        integer SpiDataWidth: 1..16, post-build-variant-value=true, set at link in variant link-time / post-build in variant post-build / pre-compile in variant pre-compile, default-value=8  # This parameter is the width of a transmitted data unit.
        integer SpiDefaultData [0..1]: 0..65535, multiplicity set at link in variant link-time / post-build in variant post-build / pre-compile in variant pre-compile, post-build-variant-multiplicity=true, post-build-variant-value=true, set at link in variant link-time / post-build in variant post-build / pre-compile in variant pre-compile, default-value=65535  # The default data to be transmitted when (for internal buffer or external buffer) the pointer passed to Spi_WriteIB (for internal buffer) or to Spi_SetupEB (for external buffer) is NULL. In case of SpiDataWidth is less than 16, only LSB bits are considered and MSB bits are ignored
        integer SpiEbMaxLength: 0..65535, post-build-variant-value=true, set at link in variant link-time / post-build in variant post-build / pre-compile in variant pre-compile, default-value=0  # This parameter contains the maximum size (number of data elements) of data buffers in case of EB Channels and only.
        integer SpiIbNBuffers: 0..65535, post-build-variant-value=true, set at link in variant link-time / post-build in variant post-build / pre-compile in variant pre-compile, default-value=0  # This parameter contains the maximum number of data buffers in case of IB Channels and only.
        enumeration SpiTransferStart: {LSB, MSB}, post-build-variant-value=true, set at link in variant link-time / post-build in variant post-build / pre-compile in variant pre-compile, default-value=MSB  # This parameter defines the first starting bit for transmission.
      container SpiJob [1..*]: multiplicity set at link in variant link-time / post-build in variant post-build / pre-compile in variant pre-compile  # All data needed to configure one SPI-Job, amongst others the connection between the internal SPI unit and the special settings for an external device is done.
        enumeration SpiHwUnitSynchronous [0..1]: {ASYNCHRONOUS, SYNCHRONOUS}, multiplicity set at link in variant link-time / post-build in variant post-build / pre-compile in variant pre-compile, post-build-variant-multiplicity=true, post-build-variant-value=true, set at link in variant link-time / post-build in variant post-build / pre-compile in variant pre-compile, default-value=SYNCHRONOUS  # If SpiHwUnitSynchronous is set to "SYNCHRONOUS", the SpiJob uses its containing SpiDriver in a synchronous manner. If it is set to "ASYNCHRONOUS", it uses the driver in an asynchronous way. If the parameter is not set, the SpiChannel uses the driver also in an asynchronous way. Tags: atp.Status=obsolete
        function name SpiJobEndNotification [0..1]: multiplicity set at link in variant link-time / post-build in variant post-build / pre-compile in variant pre-compile, post-build-variant-multiplicity=true, post-build-variant-value=true, set at link in variant link-time / post-build in variant post-build / pre-compile in variant pre-compile, default-value=NULL_PTR  # This parameter is a reference to a notification function.
        integer SpiJobId: 0..65535, set at pre-compile, symbolic-name-value=true, default-value=0  # SPI Job ID, used as parameter in SPI API functions.
        integer SpiJobPriority: 0..3, post-build-variant-value=true, set at link in variant link-time / post-build in variant post-build / pre-compile in variant pre-compile, default-value=0  # Priority set accordingly to SPI093: 0, lowest, 3, highest priority
        reference SpiDeviceAssignment: set at pre-compile, destination=SpiExternalDevice  # Reference to the external device used by this job
        container SpiChannelList [1..*]: multiplicity set at link in variant link-time / post-build in variant post-build / pre-compile in variant pre-compile  # References to SPI channels and their order within the Job.
          integer SpiChannelIndex: 0..255, post-build-variant-value=true, set at link in variant link-time / post-build in variant post-build / pre-compile in variant pre-compile, default-value=0  # This parameter specifies the order of Channels within the Job.
          reference SpiChannelAssignment: post-build-variant-value=true, set at link in variant link-time / post-build in variant post-build / pre-compile in variant pre-compile, destination=SpiChannel  # A job reference to a SPI channel.
      container SpiSequence [1..*]: multiplicity set at link in variant link-time / post-build in variant post-build / pre-compile in variant pre-compile  # All data needed to configure one SPI-sequence
        boolean SpiInterruptibleSequence: post-build-variant-value=true, set at link in variant link-time / post-build in variant post-build / pre-compile in variant pre-compile, default-value=false  # This parameter allows or not this Sequence to be suspended by another one.
        function name SpiSeqEndNotification [0..1]: multiplicity set at link in variant link-time / post-build in variant post-build / pre-compile in variant pre-compile, post-build-variant-multiplicity=true, post-build-variant-value=true, set at link in variant link-time / post-build in variant post-build / pre-compile in variant pre-compile, default-value=NULL_PTR  # This parameter is a reference to a notification function.
        integer SpiSequenceId: 0..255, scope=ECU, set at pre-compile, symbolic-name-value=true, default-value=0  # SPI Sequence ID, used as parameter in SPI API functions.
        reference SpiJobAssignment [1..*]: multiplicity set at link in variant link-time / post-build in variant post-build / pre-compile in variant pre-compile, post-build-variant-multiplicity=true, post-build-variant-value=true, set at link in variant link-time / post-build in variant post-build / pre-compile in variant pre-compile, destination=SpiJob  # A sequence references several jobs, which are executed during a communication sequence
      container SpiExternalDevice [1..*]: multiplicity set at link in variant link-time / post-build in variant post-build / pre-compile in variant pre-compile  # The communication settings of an external device. Closely linked to SpiJob.
        integer SpiExternalDeviceId: 0..65535, origin=Texas Instruments, set at pre-compile, default-value=0  # The index of the corresponding external device config associated with job.
        float SpiBaudrate: 0.0..5000000.0, post-build-variant-value=true, set at link in variant link-time / post-build in variant post-build / pre-compile in variant pre-compile, default-value=0.0  # This parameter is the communication baudrate in bits per second (bps), Range is SYSCLK/128 to SYSCLK/4
        integer SpiclkDivider: 0..127, origin=Texas Instruments, post-build-variant-value=true, set at link in variant link-time / post-build in variant post-build / pre-compile in variant pre-compile, default-value=0  # This parameter is the SPIBRR value
        string SpiCsIdentifier: set at pre-compile, symbolic-name-value=true, default-value=SPI_PERIPHERAL_CS_IDENTIFIER  # This parameter is the symbolic name to identify the Chip Select (CS) allocated to this Job.
        enumeration SpiCsPolarity: {HIGH, LOW}, post-build-variant-value=true, set at link in variant link-time / post-build in variant post-build / pre-compile in variant pre-compile, default-value=LOW  # This parameter defines the active polarity of Chip Select.
        enumeration SpiCsSelection [0..1]: {CS_VIA_GPIO, CS_VIA_PERIPHERAL_ENGINE}, multiplicity set at link in variant link-time / post-build in variant post-build / pre-compile in variant pre-compile, post-build-variant-multiplicity=true, post-build-variant-value=true, set at link in variant link-time / post-build in variant post-build / pre-compile in variant pre-compile, default-value=CS_VIA_PERIPHERAL_ENGINE  # When the Chip select handling is enabled (see SpiEnableCs), then this parameter specifies if the chip select is handled automatically by Peripheral HW engine or via general purpose IO by Spi driver.
        enumeration SpiDataShiftEdge: {LEADING, TRAILING}, post-build-variant-value=true, set at link in variant link-time / post-build in variant post-build / pre-compile in variant pre-compile, default-value=TRAILING  # This parameter defines the SPI data shift edge.
        boolean SpiEnableCs: post-build-variant-value=true, set at link in variant link-time / post-build in variant post-build / pre-compile in variant pre-compile, default-value=false  # This parameter enables or not the Chip Select handling functions. If this parameter is enabled then parameter SpiCsSelection further details the type of chip selection.
        enumeration SpiHwUnit: {SPI_UNIT_SPIA, SPI_UNIT_SPIB, SPI_UNIT_SPIC, SPI_UNIT_SPID, SPI_UNIT_SPIE}, post-build-variant-value=true, set at link in variant link-time / post-build in variant post-build / pre-compile in variant pre-compile, default-value=SPI_UNIT_SPIA  # This parameter is the symbolic name to identify the HW SPI Hardware
        enumeration SpiShiftClockIdleLevel: {HIGH, LOW}, post-build-variant-value=true, set at link in variant link-time / post-build in variant post-build / pre-compile in variant pre-compile, default-value=LOW  # This parameter defines the SPI shift clock idle level.
        integer SpiDataWordDelay: 0..255, origin=Texas Instruments, post-build-variant-value=true, set at link in variant link-time / post-build in variant post-build / pre-compile in variant pre-compile, default-value=0  # This parameter defines the SPI delay between every transfer from FIFO transmit buffer to transmit shift register, work only in FIFO mode
        float SpiTimeClk2Cs: 0.0..1.0E-4, post-build-variant-value=true, set at link in variant link-time / post-build in variant post-build / pre-compile in variant pre-compile, default-value=0.0  # Timing between clock and chip select (in seconds) - This parameter allows to use a range of values from 0 up to 0.0001 seconds., This parameter is not supported for this Hardware
        reference SpiSysClockRef: origin=Texas Instruments, post-build-variant-value=true, set at pre-compile in variant pre-compile / link in variant link-time / post-build in variant post-build, destination=McuClockReferencePoint  # Reference to the SPI clock source configuration, which is set in the MCU driver configuration.
        reference SpiCsGpioRef [0..1]: multiplicity set at link in variant link-time / post-build in variant post-build / pre-compile in variant pre-compile, origin=Texas Instruments, set at pre-compile, destination=DioChannel  # Reference to the Dio channel configuration to get symbolic name from Dio, which is set in the DIO driver configuration
      container SpiHwUnitConfig [1..5]: multiplicity set at link in variant link-time / post-build in variant post-build / pre-compile in variant pre-compile  # HW Unit configurations
        enumeration SpiHwUnitType: {SPI_UNIT_SPIA, SPI_UNIT_SPIB, SPI_UNIT_SPIC, SPI_UNIT_SPID, SPI_UNIT_SPIE}, origin=Texas Instruments, set at link in variant link-time / post-build in variant post-build / pre-compile in variant pre-compile, default-value=SPI_UNIT_SPIA  # SPI HW unit to use.
        boolean SpiHighSpeedMode: origin=Texas Instruments, set at pre-compile in variant pre-compile / link in variant link-time / post-build in variant post-build, default-value=false  # Enables High speed mode for SPI instance, Note: Since only selected pins support HS mode, to enable high speed communication apropriate HS pins shall be configured for SPI in port configration, please check c29x TRM and data sheet for HS mode supported pins
        boolean SpiLoopBackMode: origin=Texas Instruments, set at pre-compile in variant pre-compile / link in variant link-time / post-build in variant post-build, default-value=false  # Enables Loop Back mode for SPI instance
        boolean SpiFifoModeEnable: origin=Texas Instruments, set at pre-compile in variant pre-compile / link in variant link-time / post-build in variant post-build, default-value=true  # Enables FIFO mode for SPI instance
        enumeration SpiIrqType: {SPI_ISR_CAT1_RTINT, SPI_ISR_CAT1_INT, SPI_ISR_CAT2}, origin=Texas Instruments, set at pre-compile, default-value=SPI_ISR_CAT2  # Type of Isr function: CAT1 realtime interrupt or CAT1 : interrupt void func(void) or CAT2 : ISR(func)
    container SpiGeneral  # General configuration settings for SPI-Handler
      boolean SpiCancelApi: set at pre-compile, default-value=false  # Switches the Spi_Cancel function ON or OFF.
      integer SpiChannelBuffersAllowed: 0..2, set at pre-compile, default-value=2  # Selects the SPI Handler/Driver Channel Buffers usage allowed and delivered, IB = 0; EB = 1; IB/EB = 2;
      integer SpiChannelInternalBufferMaxLength: 1..131070, origin=Texas Instruments, set at pre-compile, default-value=64  # Internal Buffer length in bytes - applicable for SpiChannelBuffer type - SPI_IB. This is the maximum length that can be allocated by each channel and it is fixed.Can vary buffer length per channel by configuring SpiIbNBuffers and SpiDataWidth. Refer MCAL-24874 and MCAL-25127
      boolean SpiDevErrorDetect: set at pre-compile, default-value=false  # Switches the development error detection and notification on or off.
      boolean SpiHwStatusApi: set at pre-compile, default-value=false  # Switches the Spi_GetHWUnitStatus function ON or OFF.
      boolean SpiInterruptibleSeqAllowed: set at pre-compile, default-value=false  # Switches the Interruptible Sequences handling functionality ON or OFF.
      integer SpiLevelDelivered: 0..2, set at pre-compile, default-value=0  # Selects the SPI Handler/Driver level of scalable functionality that is available and delivered.
      float SpiMainFunctionPeriod [0..1]: 0.0..INF, multiplicity set at pre-compile, set at pre-compile, default-value=0.01  # This parameter defines the cycle time of the function Spi_MainFunction_Handling in seconds. The parameter is not used by the driver it self, but it is used by upper layer.
      boolean SpiSupportConcurrentSyncTransmit: set at pre-compile, default-value=false  # Specifies whether concurrent Spi_SyncTransmit() calls for different sequences shall be configurable.
      string SpiUserCallbackHeaderFile [0..*]: multiplicity set at pre-compile, set at pre-compile, default-value=HeaderFileName  # Header file name which will be included by the Spi. The value of this parameter shall be used as h-char-sequence or q-char-sequence according to ISO C90 section 6.10.2 "source file inclusion". The parameter value MUST NOT represent a path, since ISO C90 does not specify how such a path is treated (i.e., this is implementation defined (and additionally depends on the operating system and the underlying file system)).
      boolean SpiVersionInfoApi: set at pre-compile, default-value=false  # Switches the Spi_GetVersionInfo function ON or OFF.
    container SpiPublishedInformation  # Container holding all SPI specific published information parameters
      integer SpiMaxHwUnit: 0..5, set at published-information, default-value=5  # Number of different SPI hardware microcontroller peripherals (units/busses) available and handled by this SPI Handler/Driver module.
