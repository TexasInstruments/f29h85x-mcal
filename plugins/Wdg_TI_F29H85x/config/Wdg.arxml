AUTOSAR XML (schema 00044)
package /TI_F29H85x
  ecuc definition collection myEcuParameterDefinition: module=Wdg
  module definition Wdg [1..*]: post-build-variant-support=true, refined-module-def=Wdg, variants link-time/post-build/pre-compile  # Configuration of the Wdg (Watchdog driver) module.
    container WdgDemEventParameterRefs [0..1]  # Container for the references to DemEventParameter elements which shall be invoked using the API Dem_SetEventStatus in case the corresponding error occurs. The EventId is taken from the referenced DemEventParameter's DemEventId symbolic value. The standardized errors are provided in this container and can be extended by vendor-specific error references.
      symbolic name reference WDG_E_DISABLE_REJECTED [0..1]: multiplicity set at pre-compile, set at pre-compile, destination=DemEventParameter  # Reference to the DemEventParameter which shall be issued when the error "Initialization or mode switch failed because it would disable the watchdog" has occurred.
      symbolic name reference WDG_E_MODE_FAILED [0..1]: multiplicity set at pre-compile, set at pre-compile, destination=DemEventParameter  # Reference to the DemEventParameter which shall be issued when the error "Setting a watchdog mode failed (during initialization or mode switch)" has occurred.
    container WdgGeneral  # All general parameters of the watchdog driver are collected here.
      boolean WdgDevErrorDetect: set at pre-compile, default-value=false  # Switches the development error detection and notification on or off.
      boolean WdgDisableAllowed: set at pre-compile, default-value=false  # Compile switch to allow / forbid disabling the watchdog driver during runtime.
      integer WdgIndex: 0..255, set at pre-compile, symbolic-name-value=true, default-value=0  # Specifies the InstanceId of this module instance. If only one instance is present it shall have the Id 0.
      float WdgInitialTimeout: 0.0..0.1, set at pre-compile, default-value=0.1  # This is read only parameter just to display the initial timeout value based on the default mode. The initial timeout (sec) for the trigger condition to be initialized during Init function. It shall be not larger than WdgMaxTimeout. (click on auto calculate before generating)
      float WdgMaxTimeout: 0.0..7.0, set at pre-compile, default-value=6.684672000000001  # This is read only parameter just to display the maximum timeout value based on the default mode. The maximum timeout (sec) to which the watchdog trigger condition can be initialized.Set the fast/slow mode timeout settings. (click on auto calculate before generating)
      enumeration WdgRunArea: {RAM, ROM}, set at pre-compile, default-value=RAM  # Represents the watchdog driver execution area is either from ROM(Flash) or RAM as required with the particular microcontroller.
      function name WdgTriggerLocation: set at pre-compile, default-value=NULL_PTR  # Location (memory address) of the watchdog trigger routine.
      boolean WdgVersionInfoApi: set at pre-compile, default-value=true  # Compile switch to enable / disable the version information API
    container WdgPublishedInformation  # Container holding all Wdg specific published information parameters
      enumeration WdgTriggerMode: {WDG_BOTH, WDG_TOGGLE, WDG_WINDOW}, set at published-information, default-value=WDG_WINDOW  # Watchdog trigger mode (toggle/window/both)
    container WdgSettingsConfig  # Configuration items for the different watchdog settings, including those for external watchdog hardware.
      enumeration WdgDefaultMode: {WDGIF_FAST_MODE, WDGIF_OFF_MODE, WDGIF_SLOW_MODE}, post-build-variant-value=true, set at link in variant link-time / post-build in variant post-build / pre-compile in variant pre-compile, default-value=WDGIF_SLOW_MODE  # Default mode for watchdog driver initialization.
      container WdgExternalConfiguration [0..1]  # Configuration items for an external watchdog hardware
        choice reference WdgExternalContainerRef [0..1]: multiplicity set at link in variant link-time / post-build in variant post-build / pre-compile in variant pre-compile, post-build-variant-multiplicity=true, post-build-variant-value=true, set at link in variant link-time / post-build in variant post-build / pre-compile in variant pre-compile, destination=[DioChannelGroup, SpiSequence]  # Reference to either
      container WdgSettingsFast  # Hardware dependent settings for the watchdog driver's "fast" mode.
        enumeration WdgPredivider: {WDG_PREDIV_2, WDG_PREDIV_4, WDG_PREDIV_8, WDG_PREDIV_16, WDG_PREDIV_32, WDG_PREDIV_64, WDG_PREDIV_128, WDG_PREDIV_256, WDG_PREDIV_512, WDG_PREDIV_1024, WDG_PREDIV_2048, WDG_PREDIV_4096}, origin=Texas Instruments, set at link in variant link-time / post-build in variant post-build / pre-compile in variant pre-compile, default-value=WDG_PREDIV_512  # Wdg_PreDivider determines the watchdog clock pre-divider, which is the first of the two dividers between INTOSC1 and the watchdog counter clock (WDCLK)
        enumeration WdgPrescaler: {WDG_PRESCALE_1, WDG_PRESCALE_2, WDG_PRESCALE_4, WDG_PRESCALE_8, WDG_PRESCALE_16, WDG_PRESCALE_32, WDG_PRESCALE_64}, origin=Texas Instruments, set at link in variant link-time / post-build in variant post-build / pre-compile in variant pre-compile, default-value=WDG_PRESCALE_1  # Wdg_PreScaler determines the watchdog clock prescaler, which is the second of the two dividers between INTOSC1 and the watchdog counter clock (WDCLK)
        float WdgTimeout: 0.0..6685.0, origin=Texas Instruments, set at pre-compile, default-value=0.0  # This is the maximum timeout value. Note: The user requested timeout value other than 0 from API is not considered into account.
        enumeration WdgReaction: {WDG_GENERATE_RESET, WDG_GENERATE_INTERRUPT}, origin=Texas Instruments, set at link in variant link-time / post-build in variant post-build / pre-compile in variant pre-compile, default-value=WDG_GENERATE_INTERRUPT  # Watchdog reaction for timer expiration or incorrect service.
        integer WdgThresholdValue: 0..255, origin=Texas Instruments, set at link in variant link-time / post-build in variant post-build / pre-compile in variant pre-compile, default-value=0  # Watchdog Threshold. It specifies lower limit of the watchdog counter reset window.
      container WdgSettingsOff  # Hardware dependent settings for the watchdog driver's "off" mode.
      container WdgSettingsSlow  # Hardware dependent settings for the watchdog driver's "slow" mode.
        enumeration WdgPredivider: {WDG_PREDIV_2, WDG_PREDIV_4, WDG_PREDIV_8, WDG_PREDIV_16, WDG_PREDIV_32, WDG_PREDIV_64, WDG_PREDIV_128, WDG_PREDIV_256, WDG_PREDIV_512, WDG_PREDIV_1024, WDG_PREDIV_2048, WDG_PREDIV_4096}, origin=Texas Instruments, set at link in variant link-time / post-build in variant post-build / pre-compile in variant pre-compile, default-value=WDG_PREDIV_4096  # Wdg_PreDivider determines the watchdog clock pre-divider, which is the first of the two dividers between INTOSC1 and the watchdog counter clock (WDCLK)
        enumeration WdgPrescaler: {WDG_PRESCALE_1, WDG_PRESCALE_2, WDG_PRESCALE_4, WDG_PRESCALE_8, WDG_PRESCALE_16, WDG_PRESCALE_32, WDG_PRESCALE_64}, origin=Texas Instruments, set at link in variant link-time / post-build in variant post-build / pre-compile in variant pre-compile, default-value=WDG_PRESCALE_64  # Wdg_PreScaler determines the watchdog clock prescaler, which is the second of the two dividers between INTOSC1 and the watchdog counter clock (WDCLK)
        float WdgTimeout: 0.0..6685.0, origin=Texas Instruments, set at pre-compile, default-value=0.0  # This is the maximum timeout value. Note: The user requested timeout value other than 0 from API is not considered into account.
        enumeration WdgReaction: {WDG_GENERATE_RESET, WDG_GENERATE_INTERRUPT}, origin=Texas Instruments, set at link in variant link-time / post-build in variant post-build / pre-compile in variant pre-compile, default-value=WDG_GENERATE_INTERRUPT  # Watchdog reaction for timer expiration or incorrect service.
        integer WdgThresholdValue: 0..255, origin=Texas Instruments, set at link in variant link-time / post-build in variant post-build / pre-compile in variant pre-compile, default-value=0  # Watchdog Threshold. It specifies lower limit of the watchdog counter reset window.
