AUTOSAR XML (schema 00044)
package /TI_F29H85x/Cdd_Sent
  ecuc definition collection myEcuParameterDefinition: module=Cdd
  module definition Cdd [1..*]: api-service-prefix=Cdd_Sent, refined-module-def=Cdd, variants pre-compile  # Configuration of the CddSent module
    container CddSentConfig  # This container contains the configuration parameters and sub containers of the CddSent module.
      container CddSentController [1..6]: multiplicity set at pre-compile  # This container contains the configuration parameters of the CddSent HW units.
        string CddSentBaseAddress: origin=Texas Instruments, set at pre-compile, default-value=SENT1_BASE_FRAME(0)  # Specifies the CddSent HW unit base address.
        integer CddSentHWUnitId: 0..5, scope=ECU, origin=Texas Instruments, set at pre-compile, symbolic-name-value=true, default-value=0  # This parameter provides the HW unit ID which is unique in a given CddSent Driver. The value for this parameter starts with 0 and continue without any gaps.
        integer CddSentClockTick: 0..600, scope=ECU, origin=Texas Instruments, set at pre-compile, default-value=0  # This parameter is for setting the clock tick for the CddSent in Use
        enumeration CddSentInterruptType: {CDD_SENT_ISR_CAT1_RTINT, CDD_SENT_ISR_CAT1_INT, CDD_SENT_ISR_CAT2}, origin=Texas Instruments, set at pre-compile, default-value=CDD_SENT_ISR_CAT2  # Defines the interrupt type.
        enumeration CddSentCRCType: {CDD_SENT_CRC_LEGACY_2007, CDD_SENT_CRC_RECOMENDED_2010, CDD_SENT_CRC_NONE}, origin=Texas Instruments, set at pre-compile, default-value=CDD_SENT_CRC_RECOMENDED_2010  # CddSent CRC type selection.
        enumeration CddSentCRCWidth: {CDD_SENT_CRC_4_BIT, CDD_SENT_CRC_6_BIT, CDD_SENT_CRC_8_BIT}, origin=Texas Instruments, set at pre-compile, default-value=CDD_SENT_CRC_4_BIT  # CddSent CRC Width selection.
        enumeration CddSentCRCWithStatus: {CDD_SENT_CRC_WITH_STATUS, CDD_SENT_CRC_WITHOUT_STATUS}, origin=Texas Instruments, set at pre-compile, default-value=CDD_SENT_CRC_WITH_STATUS  # Enable/Disable CRC with status..
        enumeration CddSentDataNibblesCount: {CDD_SENT_1_DATA_NIBBLES, CDD_SENT_2_DATA_NIBBLES, CDD_SENT_3_DATA_NIBBLES, CDD_SENT_4_DATA_NIBBLES, CDD_SENT_5_DATA_NIBBLES, CDD_SENT_6_DATA_NIBBLES, CDD_SENT_7_DATA_NIBBLES, CDD_SENT_8_DATA_NIBBLES}, origin=Texas Instruments, set at pre-compile, default-value=CDD_SENT_6_DATA_NIBBLES  # number of data nibbles expected
        enumeration CddSentFIFOTriggerLevel [0..1]: {CDD_SENT_TRIGDISABLE, CDD_SENT_TRIGLEV3, CDD_SENT_TRIGLEV4, CDD_SENT_TRIGLEV5, CDD_SENT_TRIGLEV6, CDD_SENT_TRIGLEV7, CDD_SENT_TRIGLEV8, CDD_SENT_TRIGLEV9, CDD_SENT_TRIGLEV10, CDD_SENT_TRIGLEV11, CDD_SENT_TRIGLEV12, CDD_SENT_TRIGLEV13, CDD_SENT_TRIGLEV14, CDD_SENT_TRIGLEV15, CDD_SENT_TRIGLEV16}, multiplicity set at pre-compile, origin=Texas Instruments, set at pre-compile, default-value=CDD_SENT_TRIGLEV6  # FIFO trigger level expected
        function name CddSentUserCallbackFunction: origin=Texas Instruments, set at pre-compile, default-value=NULL_PTR  # Call back function for the data
        function name CddSentUserErrorCallbackFunction: origin=Texas Instruments, set at pre-compile, default-value=NULL_PTR  # Call back function for the error
        integer CddSentSyncTimeout: 0..255, scope=ECU, origin=Texas Instruments, set at pre-compile, default-value=0  # This parameter is for setting Timeout for receiving the synchronization pulse
        integer CddSentGlitchFilter: 0..255, scope=ECU, origin=Texas Instruments, set at pre-compile, default-value=5  # This parameter is for number of SYSCLKS that the received serial data input is filtered by
        boolean CddSentMTP: origin=Texas Instruments, set at pre-compile, default-value=false  # Enable/disable MTP functionality.
        integer CddSentGlobalWaitTime [0..1]: 0..65535, scope=ECU, multiplicity set at pre-compile, origin=Texas Instruments, set at pre-compile, default-value=256  # This parameter is for delay time between the last frame received to the new master trigger pulse to be generated
        boolean CddSentAcceptErrorData: origin=Texas Instruments, set at pre-compile, default-value=false  # Accept error data or not.
        boolean CddSentEnableTimeStamp: origin=Texas Instruments, set at pre-compile, default-value=true  # Enable/disable Time stamping.
        reference CddSentInstanceRef: origin=Texas Instruments, set at pre-compile, destination=Cdd_SentAllocatedInstance  # Selects CddSent HW unit Instance.
        reference CddSentCpuClockRef: origin=Texas Instruments, set at pre-compile, destination=McuClockReferencePoint  # Reference to the CPU clock configuration, which is set in the MCU driver configuration
        container CddSentChannelObject [1..*]: multiplicity set at pre-compile  # This container contains the configuration parameters of the CddSent channel object
          enumeration CddSentSensorType: {CDD_SENT_CHANNEL_STANDARD_SENSOR, CDD_SENT_CHANNEL_SENSOR_1, CDD_SENT_CHANNEL_SENSOR_2, CDD_SENT_CHANNEL_SENSOR_3, CDD_SENT_CHANNEL_SENSOR_4}, origin=Texas Instruments, set at pre-compile, default-value=CDD_SENT_CHANNEL_STANDARD_SENSOR  # selection of sensor types
          enumeration CddSentChannelType: {CDD_SENT_CHANNEL_STANDARD_SENSOR_FAST_CHANNEL, CDD_SENT_CHANNEL_SENSOR_1_FAST_CHANNEL, CDD_SENT_CHANNEL_SENSOR_2_FAST_CHANNEL, CDD_SENT_CHANNEL_SENSOR_3_FAST_CHANNEL, CDD_SENT_CHANNEL_SENSOR_4_FAST_CHANNEL, SHORT_SERIAL_ENHANCED_SERIAL_12BIT_SLOW_CHANNEL, ENHANCED_SERIAL_16BIT_SLOW_CHANNEL}, origin=Texas Instruments, set at pre-compile, default-value=CDD_SENT_CHANNEL_STANDARD_SENSOR_FAST_CHANNEL  # selection of channel types
          integer CddSentChannelObjectID: 0..65535, scope=ECU, origin=Texas Instruments, set at pre-compile, default-value=0  # This parameter will be used when CddSentIntegrationWithAsrComStackEnable is disabled. This channel object identifier will be used in configured receive callback function to address the received object from respective sensor.
          integer CddSentMessageID [0..1]: 1..255, scope=ECU, multiplicity set at pre-compile, origin=Texas Instruments, set at pre-compile, default-value=1  # This parameter is the message id
          reference CddSentPduID [0..1]: multiplicity set at pre-compile, origin=Texas Instruments, set at pre-compile, destination=CddPduRLowerLayerRxPdu  # This parameter will be used when CddSentIntegrationWithAsrComStackEnable is enabled. This Pdu identifier will be used in receive function callback to PduR to address the received Pdu from respective sensor.
        container CddSentExternalDeviceConfig [0..5]: multiplicity set at pre-compile  # This container contains the configuration parameters of the CddSent MTP triggers.
          enumeration CddSentMTPSensorType: {CDD_SENT_CHANNEL_BROADCAST, CDD_SENT_CHANNEL_SENSOR_1, CDD_SENT_CHANNEL_SENSOR_2, CDD_SENT_CHANNEL_SENSOR_3, CDD_SENT_CHANNEL_SENSOR_4}, origin=Texas Instruments, set at pre-compile, default-value=CDD_SENT_CHANNEL_SENSOR_1  # selection of MTP sensor type
          enumeration CddSentSensorTriggerSource: {DISABLE, BROADCAST_DONE, SENSOR_1_DONE, SENSOR_2_DONE, SENSOR_3_DONE, SENSOR_4_DONE, CPU1_TINT0, CPU1_TINT1, CPU1_TINT2, CPU2_TINT0, CPU2_TINT1, CPU2_TINT2, CPU3_TINT0, CPU3_TINT1, CPU3_TINT2, INPUTXBAR5, INPUTXBAR11, INPUTXBAR12, INPUTXBAR13, INPUTXBAR14, INPUTXBAR15, INPUTXBAR16, EPWM1_ADCSOCA, EPWM1_ADCSOCB, EPWM2_ADCSOCA, EPWM2_ADCSOCB, EPWM3_ADCSOCA, EPWM3_ADCSOCB, EPWM4_ADCSOCA, EPWM4_ADCSOCB, EPWM5_ADCSOCA, EPWM5_ADCSOCB, EPWM6_ADCSOCA, EPWM6_ADCSOCB, EPWM7_ADCSOCA, EPWM7_ADCSOCB, EPWM8_ADCSOCA, EPWM8_ADCSOCB, EPWM9_ADCSOCA, EPWM9_ADCSOCB, EPWM10_ADCSOCA, EPWM10_ADCSOCB, EPWM11_ADCSOCA, EPWM11_ADCSOCB, EPWM12_ADCSOCA, EPWM12_ADCSOCB, EPWM13_ADCSOCA, EPWM13_ADCSOCB, EPWM14_ADCSOCA, EPWM14_ADCSOCB, EPWM15_ADCSOCA, EPWM15_ADCSOCB, EPWM16_ADCSOCA, EPWM16_ADCSOCB, EPWM17_ADCSOCA, EPWM17_ADCSOCB, EPWM18_ADCSOCA, EPWM18_ADCSOCB, ECAP1_SOC, ECAP2_SOC, ECAP3_SOC, ECAP4_SOC, ECAP5_SOC, ECAP6_SOC}, origin=Texas Instruments, set at pre-compile, default-value=DISABLE  # selection of channel types
          boolean CddSentMTPSensorEnable: origin=Texas Instruments, set at pre-compile, default-value=false  # Accept PArticular MTP channel.
          integer CddSentMTPSensorCompare1: 0..1023, scope=ECU, origin=Texas Instruments, set at pre-compile, default-value=0  # The time (inclock tick unit) of the Channel's Master Trigger Pulse Generator output to be toggled. No toggle if TOGGLETIME = 0.
          integer CddSentMTPSensorCompare2: 0..1023, scope=ECU, origin=Texas Instruments, set at pre-compile, default-value=0  # the time (inclock tick unit) of the Channel's Master Trigger Pulse Generator output to be toggled.For non-zero TOGGLETIME, it has to be larger than CddSentMTPSensorCompare1, No toggle if TOGGLETIME = 0.
          integer CddSentMTPSensorCompare3: 0..1023, scope=ECU, origin=Texas Instruments, set at pre-compile, default-value=0  # the time (inclock tick unit) of the Channel's Master Trigger Pulse Generator output to be toggled.For non-zero TOGGLETIME, it has to be larger than CddSentMTPSensorCompare2, No toggle if TOGGLETIME = 0.
          integer CddSentMTPSensorCompare4: 0..1023, scope=ECU, origin=Texas Instruments, set at pre-compile, default-value=0  # the time (inclock tick unit) of the Channel's Master Trigger Pulse Generator output to be toggled.For non-zero TOGGLETIME, it has to be larger than CddSentMTPSensorCompare3, No toggle if TOGGLETIME = 0.
          integer CddSentMTPSensorCompare5: 0..1023, scope=ECU, origin=Texas Instruments, set at pre-compile, default-value=0  # the time (inclock tick unit) of the Channel's Master Trigger Pulse Generator output to be toggled.For non-zero TOGGLETIME, it has to be larger than CddSentMTPSensorCompare4, No toggle if TOGGLETIME = 0.
          integer CddSentMTPSensorCompare6: 0..1023, scope=ECU, origin=Texas Instruments, set at pre-compile, default-value=0  # the time (inclock tick unit) of the Channel's Master Trigger Pulse Generator output to be toggled.For non-zero TOGGLETIME, it has to be larger than CddSentMTPSensorCompare5, No toggle if TOGGLETIME = 0.
          integer CddSentMTPSensorCompare7: 0..1023, scope=ECU, origin=Texas Instruments, set at pre-compile, default-value=0  # the time (inclock tick unit) of the Channel's Master Trigger Pulse Generator output to be toggled.For non-zero TOGGLETIME, it has to be larger than CddSentMTPSensorCompare6, No toggle if TOGGLETIME = 0.
          integer CddSentMTPSensorCompare8: 0..1023, scope=ECU, origin=Texas Instruments, set at pre-compile, default-value=0  # the time (inclock tick unit) of the Channel's Master Trigger Pulse Generator output to be toggled.For non-zero TOGGLETIME, it has to be larger than CddSentMTPSensorCompare7, No toggle if TOGGLETIME = 0.
          integer CddSentMTPSensorCompare9: 0..1023, scope=ECU, origin=Texas Instruments, set at pre-compile, default-value=0  # the time (inclock tick unit) of the Channel's Master Trigger Pulse Generator output to be toggled.For non-zero TOGGLETIME, it has to be larger than CddSentMTPSensorCompare8, No toggle if TOGGLETIME = 0.
          integer CddSentMTPSensorCompare10 [0..1]: 0..1023, scope=ECU, multiplicity set at pre-compile, origin=Texas Instruments, set at pre-compile, default-value=0  # the time (inclock tick unit) of the Channel's Master Trigger Pulse Generator output to be toggled.For non-zero TOGGLETIME, it has to be larger than CddSentMTPSensorCompare9, No toggle if TOGGLETIME = 0.
          integer CddSentMTPSensorPeriod: 0..1023, scope=ECU, origin=Texas Instruments, set at pre-compile, default-value=0  # the total time (inclock tick unit) mater trigger pulse output waveform is active. The CddSentMTPSensorPeriod must be larger than all Channel CddSentMTPSensorCompare10 value.
          integer CddSentMTPSensorTimeout [0..1]: 0..4294967295, scope=ECU, multiplicity set at pre-compile, origin=Texas Instruments, set at pre-compile, default-value=0  # The parameter CddSentMTPSensorTimeout indicates a time to initiate an interrupt if the sent receiver has not received responce
          integer CddSentExternalDeviceID [0..1]: 0..65535, scope=ECU, multiplicity set at pre-compile, origin=Texas Instruments, set at pre-compile, default-value=0  # This parameter will be used when CddSentIntegrationWithAsrComStackEnable is disabled. This device identifier will be used in transmit function to address the respective sensor.
          reference CddSentMTPSensorPduID [0..1]: multiplicity set at pre-compile, origin=Texas Instruments, set at pre-compile, destination=CddPduRLowerLayerTxPdu  # This parameter will be used when CddSentIntegrationWithAsrComStackEnable is enabled. This Pdu identifier will be used in transmit function to address the respective sensor.
        container CddSentFIFOInterrupts [0..1]: multiplicity set at pre-compile  # Valid data interrupts
          boolean FIFO_Trigger_Event: origin=Texas Instruments, set at pre-compile, default-value=false  # The number of data in the receiver FIFO is greater than programmed trigger
          boolean FIFO_Overflow_Error: origin=Texas Instruments, set at pre-compile, default-value=false  # The CPU reads the receiver FIFO when it is full
          boolean FIFO_Underflow_Error: origin=Texas Instruments, set at pre-compile, default-value=false  # The CPU reads the receiver FIFO when it is empty
        container CddSentSlowChannelInterrupts  # Valid data interrupts
          boolean Slow_Channel: origin=Texas Instruments, set at pre-compile, default-value=false  # A valid slow channel data is recieved from single sensor
          boolean Slow_Channel_With_CRC_Error: origin=Texas Instruments, set at pre-compile, default-value=false  # If there is a CRC ierror in slow channel data
          boolean Slow_Channel_With_Format_Error: origin=Texas Instruments, set at pre-compile, default-value=false  # If there is a format error in slow channel data
        container CddSentFastChannelCRCErrorInterrupts  # Valid data interrupts
          boolean Sensor_{1..4}_Fast_Channel_With_CRC_Error: origin=Texas Instruments, set at pre-compile, default-value=false  # When there is a CRC error in sensor {1..4} fast channel data
        container CddSentFastChannelFrameErrorInterrupts  # Valid data interrupts
          boolean Sensor_{1..4}_Fast_Channel_With_Frame_Error: origin=Texas Instruments, set at pre-compile, default-value=false  # When there is a frame error (Invalif nibble) in sensor {1..4} fast channel data
        container CddSentTimeoutErrorInterrupts  # Valid data interrupts
          boolean Sensor_{1..4}_Timeout_Error: origin=Texas Instruments, set at pre-compile, default-value=false  # No responce from sensor {1..4} in timeout specified
        container CddSentOverflowErrorInterrupts  # Valid data interrupts
          boolean Broadcast_Overflow_Error: origin=Texas Instruments, set at pre-compile, default-value=false  # When the Broadcast channel trigger pulse genarator recieves a trigger reuest while it is busy
          boolean Sensor_{1..4}_Overflow_Error: origin=Texas Instruments, set at pre-compile, default-value=false  # When the sensor {1..4} channel trigger pulse genarator recieves a trigger reuest while it is busy
        container CddSentSyncErrorInterrupts  # Valid data interrupts
          boolean Fast_Channel_Sync_Pulse_Error: origin=Texas Instruments, set at pre-compile, default-value=false  # Indicates that the synchronization pulse varies by more than 25% from the expected 56 clock ticks
          boolean Successive_Calibration_Pulse_Error: origin=Texas Instruments, set at pre-compile, default-value=false  # The successive calibration pulses differ by greater than +1.5625 or less than -1.5625
          boolean Frequency_Drift_Error: origin=Texas Instruments, set at pre-compile, default-value=false  # The ratio of the calibration pulse to the message length varies by greater than 1/64 or less than -1/64 from one message to another
    container CddComStackContribution [0..1]: multiplicity set at pre-compile  # Contribution of COM Stack modules.
      container CddPduRLowerLayerContribution [0..1]: multiplicity set at pre-compile  # Parameters that are necessary for the configuration of a Complex Driver that serves as the LowerLayer of the Pdu Router module.
        container CddPduRLowerLayerRxPdu [1..*]: multiplicity set at pre-compile  # This container specifies Rx PDUs that are exchanged between the CDD and the standardized BSW module.
          enumeration CddPduRApiType [0..1]: {IF}, multiplicity set at pre-compile, set at pre-compile, default-value=IF  # This parameter configures the type of the CDD interface (IF/TP)
          integer CddPduRLowerLayerHandleId [0..1]: 0..65535, multiplicity set at pre-compile, set at pre-compile, symbolic-name-value=true, default-value=0  # ECU wide unique, symbolic handle for the Pdu.
          string CddSentPduRHandle [0..1]: multiplicity set at pre-compile, origin=Texas Instruments, set at pre-compile, default-value=NULL  # CddSentPduRHandle is a symbolic name of the Pdu with which Cdd_Sent module invokes the receive indication for upper layer. User can modify this parameter to match with the symbolic name used by upper layer.
          reference CddPduRLowerLayerPduRef: set at pre-compile, destination=Pdu  # Reference to the "global" Pdu structure to allow harmonization of handle IDs in the COM-Stack.
        container CddPduRLowerLayerTxPdu [0..*]: multiplicity set at pre-compile  # This container specifies Tx PDUs that are exchanged between the CDD and the standardized BSW module.
          enumeration CddPduRApiType [0..1]: {IF}, multiplicity set at pre-compile, set at pre-compile, default-value=IF  # This parameter configures the type of the CDD interface (IF/TP)
          integer CddPduRLowerLayerHandleId [0..1]: 0..65535, multiplicity set at pre-compile, set at pre-compile, symbolic-name-value=true, default-value=0  # ECU wide unique, symbolic handle for the Pdu.
          reference CddPduRLowerLayerPduRef: set at pre-compile, destination=Pdu  # Reference to the "global" Pdu structure to allow harmonization of handle IDs in the COM-Stack.
    container CddSentGeneral  # Contains the general configuration parameters of the module.
      integer CddInstanceId: 0..255, origin=Texas Instruments, set at pre-compile, default-value=0  # Specifies the InstanceId of this module instance. If only one instance is present it shall have the Id 0.
      boolean CddSentDevErrorDetect: origin=Texas Instruments, set at pre-compile, default-value=false  # Switches the development error detection and notification on or off.
      boolean CddSentVersionInfoApi: origin=Texas Instruments, set at pre-compile, default-value=false  # Adds / removes the service CddSent_GetVersionInfo() from the code.
      boolean CddSentIntegrationWithAsrComStackEnable: origin=Texas Instruments, set at pre-compile, default-value=false  # This parameter is used to enable the integration of Cdd Sent module with Autosar Com Stack. 0: Cdd Sent module is not integrated with Autosar Com stack. Transmission and Reception will be handled via Application Cdd or wrapper. 1: Cdd Sent module is integrated as lower module to PduR in Autosar Com stack. Transmission and Reception will be handled via Com Stack i.e. to and from PduR.
    container CddSentDemEventParameterRefs [0..1]: multiplicity set at pre-compile  # Container for the references to DemEventParameter elements which shall be invoked using the API Dem_SetEventStatus in case the corresponding error occurs. The EventId is taken from the referenced DemEventParameter's DemEventId symbolic value. The standardized errors are provided in this container and can be extended by vendor-specific error references.
      symbolic name reference CDD_SENT_E_HARDWARE_ERROR [0..1]: multiplicity set at pre-compile, origin=Texas Instruments, set at pre-compile, destination=DemEventParameter  # Reference to configured DEM event to report "Hardware failure".
