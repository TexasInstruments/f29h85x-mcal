AUTOSAR XML (schema 00044)
package /TI_F29H85x
  ecuc definition collection myEcuParameterDefinition: module=Cdd_Sent
  module definition Cdd_Sent [0..1]: refined-module-def=Cdd, variants pre-compile  # Configuration of the CddSent module.
    container CddSentConfig  # This container contains the configuration parameters and sub containers of the CddSent module.
      container CddSentController [1..6]  # This container contains the configuration parameters of the CddSent HW units.
        enumeration CddSentInstance: {SENT1, SENT2, SENT3, SENT4, SENT5, SENT6}, set at pre-compile, default-value=SENT1  # Selects CddSent HW unit Instance.
        integer CddSentBaseAddress: 0..4294967295, origin=Texas Instruments, set at pre-compile, default-value=0  # Specifies the CddSent HW unit base address.
        integer CddSentHWUnitId: 0..5, scope=ECU, origin=Texas Instruments, set at pre-compile, symbolic-name-value=true, default-value=0  # This parameter provides the HW unit ID which is unique in a given CddSent Driver. The value for this parameter starts with 0 and continue without any gaps.
        integer CddSentClockTick: 0..600, scope=ECU, origin=Texas Instruments, set at pre-compile, default-value=0  # This parameter is for setting the clock tick for the CddSent in Use
        enumeration CddSentInteruptType: {CDD_SENT_ISR_CAT1_RTINT, CDD_SENT_ISR_CAT1_INT, CDD_SENT_ISR_CAT2}, origin=Texas Instruments, set at pre-compile, default-value=CDD_SENT_ISR_CAT2  # Defines the interrupt type.
        enumeration CddSentCRCType: {CDD_SENT_CRC_LEGACY_2007, CDD_SENT_CRC_RECOMENDED_2010, CDD_SENT_CRC_NONE}, origin=Texas Instruments, set at pre-compile, default-value=CDD_SENT_CRC_RECOMENDED_2010  # CddSent CRC type selection.
        enumeration CddSentCRCWidth: {CDD_SENT_CRC_4_BIT, CDD_SENT_CRC_6_BIT, CDD_SENT_CRC_8_BIT}, origin=Texas Instruments, set at pre-compile, default-value=CDD_SENT_CRC_4_BIT  # CddSent CRC Width selection.
        enumeration CddSentCRCWithStatus: {CDD_SENT_CRC_WITH_STATUS, CDD_SENT_CRC_WITHOUT_STATUS}, origin=Texas Instruments, set at pre-compile, default-value=CDD_SENT_CRC_WITH_STATUS  # Enable/Disable CRC with status..
        enumeration CddSentDataNibblesCount: {CDD_SENT_1_DATA_NIBBLES, CDD_SENT_2_DATA_NIBBLES, CDD_SENT_3_DATA_NIBBLES, CDD_SENT_4_DATA_NIBBLES, CDD_SENT_5_DATA_NIBBLES, CDD_SENT_6_DATA_NIBBLES, CDD_SENT_7_DATA_NIBBLES, CDD_SENT_8_DATA_NIBBLES}, origin=Texas Instruments, set at pre-compile, default-value=CDD_SENT_6_DATA_NIBBLES  # number of data nibbles expected
        enumeration CddSentFIFOTriggerLevel: {CDD_SENT_TRIGDISABLE, CDD_SENT_TRIGLEV1, CDD_SENT_TRIGLEV2, CDD_SENT_TRIGLEV3, CDD_SENT_TRIGLEV4, CDD_SENT_TRIGLEV5, CDD_SENT_TRIGLEV6, CDD_SENT_TRIGLEV7, CDD_SENT_TRIGLEV8, CDD_SENT_TRIGLEV9, CDD_SENT_TRIGLEV10, CDD_SENT_TRIGLEV11, CDD_SENT_TRIGLEV12, CDD_SENT_TRIGLEV13, CDD_SENT_TRIGLEV14, CDD_SENT_TRIGLEV15, CDD_SENT_TRIGLEV16}, origin=Texas Instruments, set at pre-compile, default-value=CDD_SENT_TRIGLEV6  # FIFO trigger level expected
        function name CddSentUserCallbackFunction [0..1]: multiplicity set at pre-compile, set at pre-compile, default-value=NULL_PTR  # Call back function for the data
        boolean CddSentPausePulse: origin=Texas Instruments, set at pre-compile, default-value=true  # Enable/Disable Pause pulse.
        integer CddSentSyncTimeout: 0..255, scope=ECU, origin=Texas Instruments, set at pre-compile, default-value=0  # This parameter is for setting Timeout for receiving the synchronization pulse
        integer CddSentGlitchFilter: 0..255, scope=ECU, origin=Texas Instruments, set at pre-compile, default-value=5  # This parameter is for number of SYSCLKS that the received serial data input is filtered by
        boolean CddSentAcceptErrorData: origin=Texas Instruments, set at pre-compile, default-value=false  # Accept error data or not.
        reference CddSentCpuClockRef: origin=Texas Instruments, set at pre-compile, destination=McuClockReferencePoint  # Reference to the CPU clock configuration, which is set in the MCU driver configuration
        container CddSentChannelObject [1..256]  # This container contains the configuration parameters of the CddSent channel object
          enumeration CddSentSensorType: {CDD_SENT_CHANNEL_SENSOR_1, CDD_SENT_CHANNEL_SENSOR_2, CDD_SENT_CHANNEL_SENSOR_3, CDD_SENT_CHANNEL_SENSOR_4}, origin=Texas Instruments, set at pre-compile, default-value=CDD_SENT_CHANNEL_SENSOR_1  # selection of sensor types
          enumeration CddSentChannelType: {FAST_CHANNEL, SHORT_SERIAL_SLOW_CHANNEL, ENHANCED_SERIAL_12BIT_SLOW_CHANNEL, ENHANCED_SERIAL_16BIT_SLOW_CHANNEL}, origin=Texas Instruments, set at pre-compile, default-value=FAST_CHANNEL  # selection of channel types
          boolean CddSentEnableTimeStamp [0..1]: origin=Texas Instruments, set at pre-compile, default-value=false  # Enable/disable Time stamping.
          integer CddSentChannelID: 0..255, scope=ECU, origin=Texas Instruments, set at pre-compile, default-value=0  # This parameter is the sensor id for upper layer communication
          integer CddSentMessageID [0..1]: 0..255, scope=ECU, origin=Texas Instruments, set at pre-compile, default-value=1  # This parameter is the message id
    container CddSentGeneral  # General CddSent` module configuration parameters.
      boolean CddSentDevErrorDetect: origin=Texas Instruments, set at pre-compile, default-value=false  # Switches the development error detection and notification on or off.
      boolean CddSentVersionInfoApi: origin=Texas Instruments, set at pre-compile, default-value=false  # Adds / removes the service CddSent_ GetVersionInfo() from the code.
    container CddSentDemEventParameterRefs [0..1]  # Container for the references to DemEventParameter elements which shall be invoked using the API Dem_SetEventStatus in case the corresponding error occurs. The EventId is taken from the referenced DemEventParameter's DemEventId symbolic value. The standardized errors are provided in this container and can be extended by vendor-specific error references.
      symbolic name reference CDD_E_HARDWARE_ERROR [0..1]: set at pre-compile, destination=DemEventParameter  # Reference to configured DEM event to report "Hardware failure".
