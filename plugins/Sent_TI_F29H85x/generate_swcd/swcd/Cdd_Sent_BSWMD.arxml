<?xml version="1.0" encoding="UTF-8"?>
<AUTOSAR xmlns="http://autosar.org/schema/r4.0" xmlns:xsi="http://www.w3.org/2001/XMLSchema-instance" xsi:schemaLocation="http://autosar.org/schema/r4.0 AUTOSAR_00044.xsd">
[!AUTOSPACING!][!//
[!SELECT "as:modconf('Cdd_Sent/Cdd')[as:path(node:dtos(.))='/TI_F29H85x/Cdd_Sent/Cdd']"!]
[!VAR "Cat1Instances" = "''"!][!//
[!LOOP "CddSentConfig"!]
[!LOOP "CddSentController/*"!][!//
[!VAR "InstanceName" = "node:ref(CddSentInstanceRef)/InstanceName"!][!//
[!VAR "InstanceLetter" = "substring-after($InstanceName, 'SENT')"!][!//
[!// Track CAT1 instances (anything not explicitly CAT2)
[!IF "node:value(CddSentInterruptType) != 'CDD_SENT_ISR_CAT2'"!][!//
[!IF "$Cat1Instances = ''"!][!//
[!VAR "Cat1Instances" = "$InstanceLetter"!][!//
[!ELSE!][!//
[!VAR "Cat1Instances" = "concat($Cat1Instances, ',', $InstanceLetter)"!][!//
[!ENDIF!][!//
[!ENDIF!][!//
[!ENDLOOP!][!//
[!ENDLOOP!][!//
[!VAR "Cdd_SentDevErrorDetect_Enable"="Cdd_SentGeneral/Cdd_SentDevErrorDetect  = 'true'"!][!//
[!VAR "Cdd_SentVersionInfoApi_Enable"="Cdd_SentGeneral/Cdd_SentVersionInfoApi  = 'true'"!][!// 
  <AR-PACKAGES>
    <AR-PACKAGE UUID="ca92e0d1-28d1-465e-8fb0-6d8390bba966">
      <SHORT-NAME>Cdd_Sent_TI_F29H85x</SHORT-NAME>
      <ELEMENTS>
        <BSW-MODULE-DESCRIPTION UUID="411def68-701d-4737-9aba-fe4dad722c06">
          <SHORT-NAME>Cdd_Sent</SHORT-NAME>
          <EXPECTED-ENTRYS>
            <BSW-MODULE-ENTRY-REF-CONDITIONAL>
              <BSW-MODULE-ENTRY-REF DEST="BSW-MODULE-ENTRY">/Cdd_Sent_TI_F29H85x/Sent_ModuleEntry/Cdd_Sent_Deinit</BSW-MODULE-ENTRY-REF>
            </BSW-MODULE-ENTRY-REF-CONDITIONAL>
            <BSW-MODULE-ENTRY-REF-CONDITIONAL>
              <BSW-MODULE-ENTRY-REF DEST="BSW-MODULE-ENTRY">/Cdd_Sent_TI_F29H85x/Sent_ModuleEntry/Cdd_Sent_Transmit</BSW-MODULE-ENTRY-REF>
            </BSW-MODULE-ENTRY-REF-CONDITIONAL>
			[!IF "$Cdd_SentVersionInfoApi_Enable = 'true'"!][!//
            <BSW-MODULE-ENTRY-REF-CONDITIONAL>
              <BSW-MODULE-ENTRY-REF DEST="BSW-MODULE-ENTRY">/Cdd_Sent_TI_F29H85x/Sent_ModuleEntry/Cdd_Sent_GetVersionInfo</BSW-MODULE-ENTRY-REF>
            </BSW-MODULE-ENTRY-REF-CONDITIONAL>
			[!ENDIF!][!//
          </EXPECTED-ENTRYS>
          <IMPLEMENTED-ENTRYS>
[!LOOP "CddSentConfig"!]
[!LOOP "CddSentController/*"!][!//
[!VAR "InstanceName" = "node:ref(CddSentInstanceRef)/InstanceName"!][!//
[!VAR "InstanceLetter" = "substring-after($InstanceName, 'SENT')"!][!//
            <BSW-MODULE-ENTRY-REF-CONDITIONAL>
              <BSW-MODULE-ENTRY-REF DEST="BSW-MODULE-ENTRY">/Cdd_Sent_TI_F29H85x/Sent_ModuleEntry/Cdd_Sent_[!"$InstanceLetter"!]_ISR</BSW-MODULE-ENTRY-REF>
            </BSW-MODULE-ENTRY-REF-CONDITIONAL>
[!ENDLOOP!][!//
[!ENDLOOP!][!//
            <BSW-MODULE-ENTRY-REF-CONDITIONAL S="">
              <BSW-MODULE-ENTRY-REF DEST="BSW-MODULE-ENTRY">/Cdd_Sent_TI_F29H85x/Sent_ModuleEntry/Cdd_Sent_Init</BSW-MODULE-ENTRY-REF>
            </BSW-MODULE-ENTRY-REF-CONDITIONAL>
          </IMPLEMENTED-ENTRYS>
          <BSW-MODULE-DEPENDENCYS>
		    [!IF "$Cdd_SentDevErrorDetect_Enable = 'true'"!][!//
            <BSW-MODULE-DEPENDENCY UUID="76e396b2-0d1d-4a1d-8ff9-45669a8bedc9">
              <SHORT-NAME>Det</SHORT-NAME>
              <TARGET-MODULE-ID>15</TARGET-MODULE-ID>
              <TARGET-MODULE-REFS>
                <BSW-MODULE-DESCRIPTION-REF-CONDITIONAL>
                  <BSW-MODULE-DESCRIPTION-REF DEST="BSW-MODULE-DESCRIPTION">/AUTOSAR_Det/Det</BSW-MODULE-DESCRIPTION-REF>
                </BSW-MODULE-DESCRIPTION-REF-CONDITIONAL>
              </TARGET-MODULE-REFS>
            </BSW-MODULE-DEPENDENCY>
		    [!ENDIF!][!//
        [!IF "CddSentGeneral/CddSentIntegrationWithAsrComStackEnable = 'true'"!]
            <BSW-MODULE-DEPENDENCY UUID="157dd34f-c7a8-4e68-a45a-950108cb05fd">
                <SHORT-NAME>PduR</SHORT-NAME>
                <TARGET-MODULE-ID>51</TARGET-MODULE-ID>
                <TARGET-MODULE-REFS>
                  <BSW-MODULE-DESCRIPTION-REF-CONDITIONAL/>
                </TARGET-MODULE-REFS>
              </BSW-MODULE-DEPENDENCY>
        [!ENDIF!][!//
          </BSW-MODULE-DEPENDENCYS>
          <INTERNAL-BEHAVIORS>
            <BSW-INTERNAL-BEHAVIOR UUID="f22cb3c1-7fd7-46dd-aab0-df4d0397ce2a">
              <SHORT-NAME>Cdd_Sent_Behavior</SHORT-NAME>
              <ENTITYS>
[!LOOP "CddSentConfig"!]
[!LOOP "CddSentController/*"!][!//
[!VAR "InstanceName" = "node:ref(CddSentInstanceRef)/InstanceName"!][!//
[!VAR "InstanceLetter" = "substring-after($InstanceName, 'SENT')"!][!//
[!VAR "InstanceLetterLower" = "translate($InstanceLetter, 'ABCDEFGHIJKLMNOPQRSTUVWXYZ', 'abcdefghijklmnopqrstuvwxyz')"!][!//
                <BSW-INTERRUPT-ENTITY UUID="8859c13f-9fe5-4c20-9e0a-59a21733170[!"$InstanceLetterLower"!]">
                  <SHORT-NAME>Cdd_Sent_[!"$InstanceLetter"!]_ISR</SHORT-NAME>
                  <REENTRANCY-LEVEL>NON-REENTRANT</REENTRANCY-LEVEL>
                  [!IF "../../../CddSentGeneral/CddSentIntegrationWithAsrComStackEnable = 'true'"!]
                  <CALL-POINTS>
                    <BSW-DIRECT-CALL-POINT>
                      <SHORT-NAME>PduR_Cdd_Sent_RxIndication</SHORT-NAME>
                      <CALLED-ENTRY-REF DEST="BSW-MODULE-ENTRY">/AUTOSAR_PduR/BSWModuleEntry/PduR_Cdd_Sent_RxIndication</CALLED-ENTRY-REF>
                    </BSW-DIRECT-CALL-POINT>
                  </CALL-POINTS>
                  [!ENDIF!][!//
                  <IMPLEMENTED-ENTRY-REF DEST="BSW-MODULE-ENTRY">/Cdd_Sent_TI_F29H85x/Cdd_Sent_ModuleEntry/Cdd_Sent_[!"$InstanceLetter"!]_ISR</IMPLEMENTED-ENTRY-REF>
[!IF "node:value(CddSentInterruptType) = 'CDD_SENT_ISR_CAT2'"!][!//
                  <INTERRUPT-CATEGORY>CAT-2</INTERRUPT-CATEGORY>
[!ELSE!][!//
                  <INTERRUPT-CATEGORY>CAT-1</INTERRUPT-CATEGORY>
[!ENDIF!][!//
[!ENDLOOP!][!//
[!ENDLOOP!][!//
                </BSW-INTERRUPT-ENTITY>
                <BSW-CALLED-ENTITY UUID="28dcc4b7-ec8c-445e-8633-320f1f61567e">
                  <SHORT-NAME>Cdd_Sent_Deinit</SHORT-NAME>
                  <REENTRANCY-LEVEL>NON-REENTRANT</REENTRANCY-LEVEL>
				  <CALL-POINTS>
                    [!IF "$Cdd_SentDevErrorDetect_Enable = 'true'"!][!//
                    <BSW-DIRECT-CALL-POINT>
                      <SHORT-NAME>Det_ReportError</SHORT-NAME>
                      <CALLED-ENTRY-REF DEST="BSW-MODULE-ENTRY">/AUTOSAR_Det/BSWModuleEntry/Det_ReportError</CALLED-ENTRY-REF>
                    </BSW-DIRECT-CALL-POINT>
                    [!ENDIF!][!// 
                  </CALL-POINTS>
                  <IMPLEMENTED-ENTRY-REF DEST="BSW-MODULE-ENTRY">/Cdd_Sent_TI_F29H85x/Cdd_Sent_ModuleEntry/Cdd_Sent_Deinit</IMPLEMENTED-ENTRY-REF>
                </BSW-CALLED-ENTITY>
                <BSW-CALLED-ENTITY UUID="d1b4d9f5-f8cb-45de-a2ba-e26973348fe6">
                  <SHORT-NAME>Cdd_Sent_GetVersionInfo</SHORT-NAME>
                  <REENTRANCY-LEVEL>SINGLE-CORE-REENTRANT</REENTRANCY-LEVEL>
				  <CALL-POINTS>
                    [!IF "$Cdd_SentDevErrorDetect_Enable = 'true'"!][!//
                    <BSW-DIRECT-CALL-POINT>
                      <SHORT-NAME>Det_ReportError</SHORT-NAME>
                      <CALLED-ENTRY-REF DEST="BSW-MODULE-ENTRY">/AUTOSAR_Det/BSWModuleEntry/Det_ReportError</CALLED-ENTRY-REF>
                    </BSW-DIRECT-CALL-POINT>
                    [!ENDIF!][!// 
                  </CALL-POINTS>
                  <IMPLEMENTED-ENTRY-REF DEST="BSW-MODULE-ENTRY">/Cdd_Sent_TI_F29H85x/Cdd_Sent_ModuleEntry/Cdd_Sent_GetVersionInfo</IMPLEMENTED-ENTRY-REF>
                </BSW-CALLED-ENTITY>
                <BSW-CALLED-ENTITY UUID="fa4b7c00-9abc-4d85-9049-8409e6e0286d">
                  <SHORT-NAME>Cdd_Sent_Init</SHORT-NAME>
                  <REENTRANCY-LEVEL>NON-REENTRANT</REENTRANCY-LEVEL>
				  <CALL-POINTS>
                    [!IF "$Cdd_SentDevErrorDetect_Enable = 'true'"!][!//
                    <BSW-DIRECT-CALL-POINT>
                      <SHORT-NAME>Det_ReportError</SHORT-NAME>
                      <CALLED-ENTRY-REF DEST="BSW-MODULE-ENTRY">/AUTOSAR_Det/BSWModuleEntry/Det_ReportError</CALLED-ENTRY-REF>
                    </BSW-DIRECT-CALL-POINT>
                    [!ENDIF!][!// 
                  </CALL-POINTS>
                  <IMPLEMENTED-ENTRY-REF DEST="BSW-MODULE-ENTRY">/Cdd_Sent_TI_F29H85x/Cdd_Sent_ModuleEntry/Cdd_Sent_Init</IMPLEMENTED-ENTRY-REF>
                </BSW-CALLED-ENTITY>
                <BSW-CALLED-ENTITY UUID="fa4b7c00-9abb-4d85-9049-8409e6e0286d">
                  <SHORT-NAME>Cdd_Sent_Transmit</SHORT-NAME>
                  <REENTRANCY-LEVEL>NON-REENTRANT</REENTRANCY-LEVEL>
				  <CALL-POINTS>
                    [!IF "$Cdd_SentDevErrorDetect_Enable = 'true'"!][!//
                    <BSW-DIRECT-CALL-POINT>
                      <SHORT-NAME>Det_ReportError</SHORT-NAME>
                      <CALLED-ENTRY-REF DEST="BSW-MODULE-ENTRY">/AUTOSAR_Det/BSWModuleEntry/Det_ReportError</CALLED-ENTRY-REF>
                    </BSW-DIRECT-CALL-POINT>
                    [!ENDIF!][!// 
                  </CALL-POINTS>
                  <IMPLEMENTED-ENTRY-REF DEST="BSW-MODULE-ENTRY">/Cdd_Sent_TI_F29H85x/Cdd_Sent_ModuleEntry/Cdd_Sent_Transmit</IMPLEMENTED-ENTRY-REF>
                </BSW-CALLED-ENTITY>
              </ENTITYS>
            </BSW-INTERNAL-BEHAVIOR>
          </INTERNAL-BEHAVIORS>
        </BSW-MODULE-DESCRIPTION>
        <BSW-IMPLEMENTATION UUID="e8294f8e-7b82-4bc7-a3e2-852798f9b512">
          <SHORT-NAME>Cdd_Sent_Impl</SHORT-NAME>
          <CODE-DESCRIPTORS>
            <CODE UUID="26b018e2-5eb5-45d8-9735-fa0ed3183d54">
              <SHORT-NAME>Files</SHORT-NAME>
              <ARTIFACT-DESCRIPTORS>
                <AUTOSAR-ENGINEERING-OBJECT>
                  <SHORT-LABEL>generate::Cdd_Sent_Cfg.c</SHORT-LABEL>
                  <CATEGORY>SWSRC</CATEGORY>
                </AUTOSAR-ENGINEERING-OBJECT>
                <AUTOSAR-ENGINEERING-OBJECT>
                  <SHORT-LABEL>generate::Cdd_Sent_Cfg.h</SHORT-LABEL>
                  <CATEGORY>SWHDR</CATEGORY>
                </AUTOSAR-ENGINEERING-OBJECT>
                <AUTOSAR-ENGINEERING-OBJECT>
                  <SHORT-LABEL>generate::Cdd_Sent_Cbk.h</SHORT-LABEL>
                  <CATEGORY>SWHDR</CATEGORY>
                </AUTOSAR-ENGINEERING-OBJECT>
                <AUTOSAR-ENGINEERING-OBJECT>
                  <SHORT-LABEL>include::Cdd_Sent.h</SHORT-LABEL>
                  <CATEGORY>SWHDR</CATEGORY>
                </AUTOSAR-ENGINEERING-OBJECT>
                <AUTOSAR-ENGINEERING-OBJECT>
                  <SHORT-LABEL>include::Cdd_Sent_Priv.h</SHORT-LABEL>
                  <CATEGORY>SWHDR</CATEGORY>
                </AUTOSAR-ENGINEERING-OBJECT>
                <AUTOSAR-ENGINEERING-OBJECT>
                  <SHORT-LABEL>src::Cdd_Sent.c</SHORT-LABEL>
                  <CATEGORY>SWSRC</CATEGORY>
                </AUTOSAR-ENGINEERING-OBJECT>
                <AUTOSAR-ENGINEERING-OBJECT>
                  <SHORT-LABEL>src::Cdd_Sent_Irq.c</SHORT-LABEL>
                  <CATEGORY>SWSRC</CATEGORY>
                </AUTOSAR-ENGINEERING-OBJECT>
                <AUTOSAR-ENGINEERING-OBJECT>
                  <SHORT-LABEL>src::Cdd_Sent_Priv.c</SHORT-LABEL>
                  <CATEGORY>SWSRC</CATEGORY>
                </AUTOSAR-ENGINEERING-OBJECT>
              </ARTIFACT-DESCRIPTORS>
            </CODE>
          </CODE-DESCRIPTORS>
          <COMPILERS>
            <COMPILER UUID="665ea444-241d-4b3f-b501-bede73d4dc93">
              <SHORT-NAME>TI_C29Clang</SHORT-NAME>
              <NAME>TI_C29Clang</NAME>
              <VENDOR>Texas Instruments</VENDOR>
              <VERSION>2.0.0</VERSION>
            </COMPILER>
          </COMPILERS>
          <LINKERS>
            <LINKER UUID="18301b6d-a83b-46af-94f8-287a42d5f371">
              <SHORT-NAME>TI_C29Linker</SHORT-NAME>
              <NAME>TI_C29Linker</NAME>
              <VENDOR>Texas Instruments</VENDOR>
              <VERSION>2.0.0</VERSION>
            </LINKER>
          </LINKERS>
          <RESOURCE-CONSUMPTION UUID="66149de9-9906-4405-a5a2-1f7aef840039">
		  <SHORT-NAME>MemoryMappedSections</SHORT-NAME>
            <MEMORY-SECTIONS>
              <MEMORY-SECTION UUID="88093617-d5ab-4d85-b891-25a5ab1c7627">
                <SHORT-NAME>CDD_SENT_CODE</SHORT-NAME>
                <ALIGNMENT>UNSPECIFIED</ALIGNMENT>
				<SW-ADDRMETHOD-REF DEST="SW-ADDR-METHOD">/AUTOSAR_MemMap/SwAddrMethods/CODE</SW-ADDRMETHOD-REF>
                <SYMBOL>CODE</SYMBOL>
              </MEMORY-SECTION>
              <MEMORY-SECTION UUID="502bbff0-c5e8-4bd0-9bc4-0beb1eb43f1e">
                <SHORT-NAME>CDD_SENT_CONFIG_DATA</SHORT-NAME>
                <ALIGNMENT>UNSPECIFIED</ALIGNMENT>
				<SW-ADDRMETHOD-REF DEST="SW-ADDR-METHOD">/AUTOSAR_MemMap/SwAddrMethods/CONST_PBCFG</SW-ADDRMETHOD-REF>
                <SYMBOL>CONFIG_DATA</SYMBOL>
              </MEMORY-SECTION>
              <MEMORY-SECTION UUID="26933050-f58a-456b-9596-8d3c378d8f18">
                <SHORT-NAME>CDD_SENT_ISR_CODE</SHORT-NAME>
                <ALIGNMENT>UNSPECIFIED</ALIGNMENT>
				<SW-ADDRMETHOD-REF DEST="SW-ADDR-METHOD">/AUTOSAR_MemMap/SwAddrMethods/CODE</SW-ADDRMETHOD-REF>
                <SYMBOL>ISR_CODE</SYMBOL>
              </MEMORY-SECTION>
              <MEMORY-SECTION UUID="41814b72-69fa-45df-a7ea-a5a087a9acc4">
                <SHORT-NAME>CDD_SENT_VAR_INIT_BOOLEAN</SHORT-NAME>
                <ALIGNMENT>BOOLEAN</ALIGNMENT>
				<SW-ADDRMETHOD-REF DEST="SW-ADDR-METHOD">/AUTOSAR_MemMap/SwAddrMethods/VAR_INIT</SW-ADDRMETHOD-REF>
                <SYMBOL>VAR_INIT_BOOLEAN</SYMBOL>
              </MEMORY-SECTION>
              <MEMORY-SECTION UUID="46c11a93-b18d-467d-9ece-efae1f8c75f0">
                <SHORT-NAME>CDD_SENT_VAR_INIT_UNSPECIFIED</SHORT-NAME>
                <ALIGNMENT>UNSPECIFIED</ALIGNMENT>
				<SW-ADDRMETHOD-REF DEST="SW-ADDR-METHOD">/AUTOSAR_MemMap/SwAddrMethods/VAR_INIT</SW-ADDRMETHOD-REF>
                <SYMBOL>VAR_INIT_UNSPECIFIED</SYMBOL>
              </MEMORY-SECTION>
            </MEMORY-SECTIONS>
          </RESOURCE-CONSUMPTION>
          <SW-VERSION>[!"$moduleSoftwareVer"!]</SW-VERSION>
          <VENDOR-ID>44</VENDOR-ID>
          <AR-RELEASE-VERSION>[!"substring-after($moduleReleaseVer, 'AUTOSAR ')"!]</AR-RELEASE-VERSION>
          <BEHAVIOR-REF DEST="BSW-INTERNAL-BEHAVIOR">/Cdd_Sent_TI_F29H85x/Cdd_Sent/Cdd_Sent_Behavior</BEHAVIOR-REF>
          <VENDOR-SPECIFIC-MODULE-DEF-REFS>
            <VENDOR-SPECIFIC-MODULE-DEF-REF DEST="ECUC-MODULE-DEF">/TI_F29H85x/Cdd_Sent/Cdd</VENDOR-SPECIFIC-MODULE-DEF-REF>
          </VENDOR-SPECIFIC-MODULE-DEF-REFS>
        </BSW-IMPLEMENTATION>
      </ELEMENTS>
      <AR-PACKAGES>
        <AR-PACKAGE UUID="e4c1a855-ddc0-4cc4-89d9-693a7f31481c">
          <SHORT-NAME>Cdd_Sent_ModuleEntry</SHORT-NAME>
          <ELEMENTS>
[!LOOP "text:split(ecu:get('ResourceAllocator_F29H85x.Cdd_SentInstanceName'), ',')"!][!//
[!VAR "RAInstanceName" = "."!][!//
[!VAR "InstanceLetter" = "substring-after($RAInstanceName, 'SENT')"!][!//
            <BSW-MODULE-ENTRY UUID="[!"concat('0859b596-bedf-43df-b165-ebc8527ab72', $InstanceLetter)"!]">
              <SHORT-NAME>Cdd_Sent_[!"$InstanceLetter"!]_ISR</SHORT-NAME>
              <IS-REENTRANT>false</IS-REENTRANT>
              <IS-SYNCHRONOUS>true</IS-SYNCHRONOUS>
              <CALL-TYPE>INTERRUPT</CALL-TYPE>
[!IF "text:contains(text:split($Cat1Instances, ','), $InstanceLetter)"!][!//
              <EXECUTION-CONTEXT>INTERRUPT-CAT-1</EXECUTION-CONTEXT>
[!ELSE!][!//
              <EXECUTION-CONTEXT>INTERRUPT-CAT-2</EXECUTION-CONTEXT>
[!ENDIF!][!//
              <SW-SERVICE-IMPL-POLICY>STANDARD</SW-SERVICE-IMPL-POLICY>
              <BSW-ENTRY-KIND>CONCRETE</BSW-ENTRY-KIND>
            </BSW-MODULE-ENTRY>
[!ENDLOOP!][!//
            <BSW-MODULE-ENTRY UUID="f0d0e534-9d4a-4215-a578-6ac637407677">
              <SHORT-NAME>Cdd_Sent_Deinit</SHORT-NAME>
              <SERVICE-ID>2</SERVICE-ID>
              <IS-REENTRANT>false</IS-REENTRANT>
              <IS-SYNCHRONOUS>true</IS-SYNCHRONOUS>
              <CALL-TYPE>REGULAR</CALL-TYPE>
              <EXECUTION-CONTEXT>UNSPECIFIED</EXECUTION-CONTEXT>
              <SW-SERVICE-IMPL-POLICY>STANDARD</SW-SERVICE-IMPL-POLICY>
              <BSW-ENTRY-KIND>CONCRETE</BSW-ENTRY-KIND>
            </BSW-MODULE-ENTRY>
            <BSW-MODULE-ENTRY UUID="cc5d53c5-74e0-49d2-b500-058baa77a2f7">
              <SHORT-NAME>Cdd_Sent_GetVersionInfo</SHORT-NAME>
              <SERVICE-ID>0</SERVICE-ID>
              <IS-REENTRANT>true</IS-REENTRANT>
              <IS-SYNCHRONOUS>true</IS-SYNCHRONOUS>
              <CALL-TYPE>REGULAR</CALL-TYPE>
              <EXECUTION-CONTEXT>UNSPECIFIED</EXECUTION-CONTEXT>
              <SW-SERVICE-IMPL-POLICY>STANDARD</SW-SERVICE-IMPL-POLICY>
              <BSW-ENTRY-KIND>CONCRETE</BSW-ENTRY-KIND>
            </BSW-MODULE-ENTRY>
            <BSW-MODULE-ENTRY UUID="e54cb365-3cf4-41a5-acef-451f44d04abb">
              <SHORT-NAME>Cdd_Sent_Init</SHORT-NAME>
              <SERVICE-ID>1</SERVICE-ID>
              <IS-REENTRANT>false</IS-REENTRANT>
              <IS-SYNCHRONOUS>true</IS-SYNCHRONOUS>
              <CALL-TYPE>REGULAR</CALL-TYPE>
              <EXECUTION-CONTEXT>UNSPECIFIED</EXECUTION-CONTEXT>
              <SW-SERVICE-IMPL-POLICY>STANDARD</SW-SERVICE-IMPL-POLICY>
              <BSW-ENTRY-KIND>CONCRETE</BSW-ENTRY-KIND>
            </BSW-MODULE-ENTRY>
            <BSW-MODULE-ENTRY UUID="e54cb366-3cf4-41a5-acef-451f45d04abb">
              <SHORT-NAME>Cdd_Sent_Transmit</SHORT-NAME>
              <SERVICE-ID>3</SERVICE-ID>
              <IS-REENTRANT>false</IS-REENTRANT>
              <IS-SYNCHRONOUS>true</IS-SYNCHRONOUS>
              <CALL-TYPE>REGULAR</CALL-TYPE>
              <EXECUTION-CONTEXT>UNSPECIFIED</EXECUTION-CONTEXT>
              <SW-SERVICE-IMPL-POLICY>STANDARD</SW-SERVICE-IMPL-POLICY>
              <BSW-ENTRY-KIND>CONCRETE</BSW-ENTRY-KIND>
            </BSW-MODULE-ENTRY>
          </ELEMENTS>
        </AR-PACKAGE>
      </AR-PACKAGES>
    </AR-PACKAGE>
  </AR-PACKAGES>
</AUTOSAR>
[!ENDSELECT!]
