AUTOSAR XML (schema 00044)
package /TI_F29H85x
  ecuc definition collection myEcuParameterDefinition: module=Mcu
  module definition Mcu: post-build-variant-support=true, refined-module-def=Mcu, variants post-build/pre-compile  # Configuration of the Mcu (Microcontroller Unit) module.
    container McuGeneralConfiguration  # This container contains the configuration (parameters) of the MCU driver.
      boolean McuDevErrorDetect: set at pre-compile, default-value=false  # Switches the development error detection and notification on or off.
      boolean McuClockConfigLockCriticalRegisters: origin=Texas Instruments, set at pre-compile, default-value=false  # Switches the Lock for clock configuration critical registers on or off.
      boolean McuCpuPeripheralConfigLockCriticalRegisters: origin=Texas Instruments, set at pre-compile, default-value=false  # Switches the Lock for cpu peripheral configuration critical registers on or off.
      boolean McuCpuSystemLockCriticalRegisters: origin=Texas Instruments, set at pre-compile, default-value=false  # Switches the Lock for cpu system critical registers on or off.
      boolean McuGetRamStateApi: set at pre-compile, default-value=true  # Pre-processor switch to enable/disable the API Mcu_GetRamState.
      boolean McuInitClock: set at pre-compile, default-value=true  # If this parameter is set to FALSE, the clock initialization has to be disabled from the MCU driver. This concept applies when there are some write once clock registers and a bootloader is present. If this parameter is set to TRUE, the MCU driver is responsible of the clock initialization.
      boolean McuNoPll: set at pre-compile, default-value=true  # This parameter shall be set True, if the H/W does not have a PLL or the PLL circuitry is enabled after the power on without S/W intervention. In this case MCU_DistributePllClock has to be disabled and MCU_GetPllStatus has to return MCU_PLL_STATUS_UNDEFINED. Otherwise this parameters has to be set False
      boolean McuPerformResetApi: set at pre-compile, default-value=true  # Pre-processor switch to enable / disable the use of the function Mcu_PerformReset()
      boolean McuVersionInfoApi: set at pre-compile, default-value=false  # Pre-processor switch to enable / disable the API to read out the modules version information.
    container McuModuleConfiguration  # This container contains the configuration (parameters) of the MCU driver
      enumeration McuClockSrcFailureNotification: {DISABLED, ENABLED}, post-build-variant-value=true, set at post-build in variant post-build / pre-compile in variant pre-compile, default-value=DISABLED  # Enables/Disables clock failure notification. In case this feature is not supported by HW the setting should be disabled.
      integer McuNumberOfMcuModes: 1..255, post-build-variant-value=true, set at post-build in variant post-build / pre-compile in variant pre-compile, default-value=1  # This parameter shall represent the number of Modes available for the MCU.
      integer McuRamSectors: 0..4294967295, post-build-variant-value=true, set at post-build in variant post-build / pre-compile in variant pre-compile, default-value=0  # This parameter shall represent the number of RAM sectors available for the MCU.
      integer McuResetSetting [0..1]: 1..255, multiplicity set at pre-compile, set at pre-compile, default-value=1  # This parameter relates to the MCU specific reset configuration. This applies to the function Mcu_PerformReset, which performs a microcontroller reset using the hardware feature of the microcontroller.
      container McuClockSettingConfig [1..*]: requires-index=true  # This container contains the configuration (parameters) for the Clock settings of the MCU. Please see MCU031 for more information on the MCU clock settings.
        integer McuClockSettingId: 0..255, set at pre-compile, symbolic-name-value=true, default-value=0  # The Id of this McuClockSettingConfig to be used as argument for the API call "Mcu_InitClock".
        container McuClockReferencePoint [1..*]  # This container defines a reference point in the Mcu Clock tree. It defines the frequency which then can be used by other modules as an input value. Lower multiplicity is 1, as even in the simplest case (only one frequency is used), there is one frequency to be defined.
          float McuClockReferencePointFrequency: 0.0..INF, scope=ECU, post-build-variant-value=true, set at post-build in variant post-build / pre-compile in variant pre-compile, default-value=2.0E8  # This is the frequency for the specific instance of the McuClockReferencePoint container. It shall be given in Hz. This will not be autocalulated based on the configured divider. The user has to take care of calculating the value based on the clock source and divider value
        container McuClkConfig  # Device specific clock settings
          enumeration McuClockSource: {MCU_CLKSRC_OSC2, MCU_CLKSRC_OSC1, MCU_CLKSRC_XTAL, MCU_CLKSRC_XTAL_SE}, origin=Texas Instruments, set at pre-compile, default-value=MCU_CLKSRC_XTAL  # Select Clock Source | Configures the clock source.
          integer McuExternalClkFreq: 10000000..25000000, origin=Texas Instruments, set at pre-compile, default-value=20000000  # External Clock Frequency | Frequency of the external clock source (XTAL) in Hz.
          integer McuSysClkDiv: 1..64, origin=Texas Instruments, set at pre-compile, default-value=1  # System Clock Divider | Configures the System Clock Divider. Value should be 1 or even value up to 64.
          enumeration McuHsmClkDiv: {MCU_HSMCLK_DIV_1, MCU_HSMCLK_DIV_2, MCU_HSMCLK_DIV_4, MCU_HSMCLK_DIV_8, MCU_HSMCLK_DIV_16}, origin=Texas Instruments, set at pre-compile, default-value=MCU_HSMCLK_DIV_16  # HSM Clock Divider | Configures the HSM Clock Divider. Value should be 1 or even value up to 16.
          enumeration McuEpwmClkDiv: {MCU_EPWMCLK_DIV_1, MCU_EPWMCLK_DIV_2}, origin=Texas Instruments, set at pre-compile, default-value=MCU_EPWMCLK_DIV_2  # EPWM Clock Divider | Configures the EPWM Clock Divider. Value should be 1 or 2.
          enumeration McuEmifClkDiv: {MCU_EMIFCLK_DIV_1, MCU_EMIFCLK_DIV_2, MCU_EMIFCLK_DIV_4}, origin=Texas Instruments, set at pre-compile, default-value=MCU_EMIFCLK_DIV_2  # EMIF Clock Divider | Configures the EMIF Clock Divider. Value should be 1 or 2 or 4.
        container McuLinClkConfig [1..2]  # Device specific Lin clock settings
          enumeration McuLinInstance: {MCU_LIN_A, MCU_LIN_B}, origin=Texas Instruments, set at pre-compile, default-value=MCU_LIN_A  # Select Lin Instance ID | Configures the Instance ID for Lin module.
          enumeration McuLinClkDiv: {MCU_LINCLK_DIV_1, MCU_LINCLK_DIV_2, MCU_LINCLK_DIV_4}, origin=Texas Instruments, set at pre-compile, default-value=MCU_LINCLK_DIV_2  # Lin Clock Divider | Configures the Lin Clock Divider.
        container McuMCanClkConfig [1..6]  # Device specific MCan clock settings
          enumeration McuMCanInstance: {MCU_MCAN_A, MCU_MCAN_B, MCU_MCAN_C, MCU_MCAN_D, MCU_MCAN_E, MCU_MCAN_F}, origin=Texas Instruments, set at pre-compile, default-value=MCU_MCAN_A  # Select MCan Instance ID | Configures the Instance ID for MCan module.
          enumeration McuMCanClockSource: {MCU_MCANCLKSRC_PERxSYSCLK, MCU_MCANCLKSRC_AUXCLKIN, MCU_MCANCLKSRC_PLLRAWCLK}, origin=Texas Instruments, set at pre-compile, default-value=MCU_MCANCLKSRC_PERxSYSCLK  # Select MCan Clock Source | Configures the clock source for MCan module.
          enumeration McuMCanClkDiv: {MCU_MCANCLK_DIV_1, MCU_MCANCLK_DIV_2, MCU_MCANCLK_DIV_3, MCU_MCANCLK_DIV_4, MCU_MCANCLK_DIV_5, MCU_MCANCLK_DIV_6, MCU_MCANCLK_DIV_7, MCU_MCANCLK_DIV_8, MCU_MCANCLK_DIV_9, MCU_MCANCLK_DIV_10, MCU_MCANCLK_DIV_11, MCU_MCANCLK_DIV_12, MCU_MCANCLK_DIV_13, MCU_MCANCLK_DIV_14, MCU_MCANCLK_DIV_15, MCU_MCANCLK_DIV_16, MCU_MCANCLK_DIV_17, MCU_MCANCLK_DIV_18, MCU_MCANCLK_DIV_19, MCU_MCANCLK_DIV_20}, origin=Texas Instruments, set at pre-compile, default-value=MCU_MCANCLK_DIV_20  # MCan Clock Divider | Configures the MCan Clock Divider.
        container McuCpuTimerClkConfig  # Device specific CPU Timer clock settings
          enumeration McuCpuTimer2ClockSource: {MCU_CPUTIMERCLKSRC_SYSCLK, MCU_CPUTIMERCLKSRC_INTOSC1, MCU_CPUTIMERCLKSRC_INTOSC2, MCU_CPUTIMERCLKSRC_XTAL}, origin=Texas Instruments, set at pre-compile, default-value=MCU_CPUTIMERCLKSRC_SYSCLK  # Select CPU timer2 Clock Source | Configures the clock source for CpuTimer 2 module.
          integer McuCpuTimer2ClkDiv: 1..5, origin=Texas Instruments, set at pre-compile, default-value=1  # Cpu timer 2 Clock Divider | Configures the CpuTimer 2 prescalar.
        container McuExternalClkOutConfig  # Device specific External clock output settings
          boolean McuExternalClockOut: origin=Texas Instruments, set at pre-compile, default-value=true  # External Clock output Enable flag.
          enumeration McuExternalClockOutSource [0..1]: {MCU_XCLKOUTSRC_PLLSYS, MCU_XCLKOUTSRC_CPU1CLK, MCU_XCLKOUTSRC_CPU2CLK, MCU_XCLKOUTSRC_CPU3CLK, MCU_XCLKOUTSRC_INTOSC1, MCU_XCLKOUTSRC_INTOSC2, MCU_XCLKOUTSRC_XTALOSC}, origin=Texas Instruments, set at pre-compile, default-value=MCU_XCLKOUTSRC_PLLSYS  # Select External Clock Output Source | Configures the clock source for External clock output module.
          enumeration McuExternalClkOutDiv [0..1]: {MCU_XCLKOUT_DIV_1, MCU_XCLKOUT_DIV_2, MCU_XCLKOUT_DIV_4, MCU_XCLKOUT_DIV_8}, origin=Texas Instruments, set at pre-compile, default-value=MCU_XCLKOUT_DIV_8  # External Clock Output Divider | Configures the External clock output divider.
        container McuEthercatClkConfig  # Device specific Ethercat clock settings
          enumeration McuEthercatPhyClkEnable: {MCU_ECAT_PHYCLK_ENABLE, MCU_ECAT_PHYCLK_DISABLE}, origin=Texas Instruments, set at pre-compile, default-value=MCU_ECAT_PHYCLK_ENABLE  # Ethercat Clock Enable value.
          enumeration McuEthercatClkDiv: {MCU_ECATCLKOUT_DIV_1, MCU_ECATCLKOUT_DIV_2, MCU_ECATCLKOUT_DIV_3, MCU_ECATCLKOUT_DIV_4, MCU_ECATCLKOUT_DIV_5, MCU_ECATCLKOUT_DIV_6, MCU_ECATCLKOUT_DIV_7, MCU_ECATCLKOUT_DIV_8}, origin=Texas Instruments, set at pre-compile, default-value=MCU_ECATCLKOUT_DIV_8  # Ethercat clock Divider | Configures the Ethercat clock divider.
        container McuPllConfig [0..1]  # Device specific PLL settings
          integer McuPLLRefDiv: 1..32, origin=Texas Instruments, set at pre-compile, default-value=1  # Reference Clock Divider | Configures Reference Clock Divider.
          integer McuPLLIntMult: 4..255, origin=Texas Instruments, set at pre-compile, default-value=30  # Integer Multiplier | Configures Integer Multiplier.
          integer McuPLLOutDiv: 1..32, origin=Texas Instruments, set at pre-compile, default-value=3  # Output Clock Divider | Configures Output Clock Divider.
        container McuPeripheralClock0  # Device specific Peripheral Clock settings
          boolean MCU_PERIPH_CLK_RTDMA1: origin=Texas Instruments, set at pre-compile, default-value=true  # Module Clock Enable bit.
          boolean MCU_PERIPH_CLK_RTDMA2: origin=Texas Instruments, set at pre-compile, default-value=true  # Module Clock Enable bit.
          boolean MCU_PERIPH_CLK_CPUTIMER{0..2}: origin=Texas Instruments, set at pre-compile, default-value=true  # Module Clock Enable bit.
          boolean MCU_PERIPH_CLK_TBCLKSYNC: origin=Texas Instruments, set at pre-compile, default-value=true  # EPWM Time Base Clock sync.
          boolean MCU_PERIPH_CLK_GTBCLKSYNC: origin=Texas Instruments, set at pre-compile, default-value=true  # EPWM Time Base Clock Global sync.
          boolean MCU_PERIPH_CLK_CPUXERAD: origin=Texas Instruments, set at pre-compile, default-value=true  # ERAD Clock Enable Bit.
          boolean MCU_PERIPH_CLK_CPUXDLT: origin=Texas Instruments, set at pre-compile, default-value=true  # DLT Clock Enable Bit.
        container McuPeripheralClock1  # Peripheral Clock Gating - EMIF
          boolean MCU_PERIPH_CLK_EMIF1: origin=Texas Instruments, set at pre-compile, default-value=true  # EMIF1 Clock Enable bit.
        container McuPeripheralClock2  # Device specific Peripheral Clock settings - EPWM
          boolean MCU_PERIPH_CLK_EPWM{1..18}: origin=Texas Instruments, set at pre-compile, default-value=true  # EPWM{1..18} Clock Enable bit.
        container McuPeripheralClock3  # Device specific Peripheral Clock settings - ECAP
          boolean MCU_PERIPH_CLK_ECAP{1..3}: origin=Texas Instruments, set at pre-compile, default-value=true  # ECAP1 Clock Enable bit.
          boolean MCU_PERIPH_CLK_ECAP{4..6}: origin=Texas Instruments, set at pre-compile, default-value=true  # ECAP{4..6} Clock Enable bit.
        container McuPeripheralClock4  # Device specific Peripheral Clock settings - EQEP
          boolean MCU_PERIPH_CLK_EQEP1: origin=Texas Instruments, set at pre-compile, default-value=true  # EQEP1 Clock Enable bit.
          boolean MCU_PERIPH_CLK_EQEP2: origin=Texas Instruments, set at pre-compile, default-value=true  # EQEP1 Clock Enable bit.
          boolean MCU_PERIPH_CLK_EQEP{3..6}: origin=Texas Instruments, set at pre-compile, default-value=true  # EQEP{3..6} Clock Enable bit.
        container McuPeripheralClock6  # Device specific Peripheral Clock settings - SDFM
          boolean MCU_PERIPH_CLK_SD{1..4}: origin=Texas Instruments, set at pre-compile, default-value=true  # SD{1..4} Clock Enable bit.
        container McuPeripheralClock7  # Device specific Peripheral Clock settings - SCI, UART
          boolean MCU_PERIPH_CLK_UARTA: origin=Texas Instruments, set at pre-compile, default-value=true  # UART A Module Clock Enable bit.
          boolean MCU_PERIPH_CLK_UARTB: origin=Texas Instruments, set at pre-compile, default-value=true  # UART B Module Clock Enable bit.
          boolean MCU_PERIPH_CLK_UARTC: origin=Texas Instruments, set at pre-compile, default-value=true  # UART C Module Clock Enable bit.
          boolean MCU_PERIPH_CLK_UARTD: origin=Texas Instruments, set at pre-compile, default-value=true  # UART D Module Clock Enable bit.
          boolean MCU_PERIPH_CLK_UARTE: origin=Texas Instruments, set at pre-compile, default-value=true  # UART E Module Clock Enable bit.
          boolean MCU_PERIPH_CLK_UARTF: origin=Texas Instruments, set at pre-compile, default-value=true  # UART F Module Clock Enable bit.
        container McuPeripheralClock8  # Device specific Peripheral Clock settings - SPI
          boolean MCU_PERIPH_CLK_SPIA: origin=Texas Instruments, set at pre-compile, default-value=true  # SPI_A Clock Enable bit
          boolean MCU_PERIPH_CLK_SPIB: origin=Texas Instruments, set at pre-compile, default-value=true  # SPI_B Clock Enable bit.
          boolean MCU_PERIPH_CLK_SPIC: origin=Texas Instruments, set at pre-compile, default-value=true  # SPI_C Clock Enable bit.
          boolean MCU_PERIPH_CLK_SPID: origin=Texas Instruments, set at pre-compile, default-value=true  # SPI_D Clock Enable bit.
          boolean MCU_PERIPH_CLK_SPIE: origin=Texas Instruments, set at pre-compile, default-value=true  # SPI_E Clock Enable bit.
        container McuPeripheralClock9  # Device specific Peripheral Clock settings - I2C
          boolean MCU_PERIPH_CLK_I2CA: origin=Texas Instruments, set at pre-compile, default-value=true  # I2C_A Clock Enable bit:.
          boolean MCU_PERIPH_CLK_I2CB: origin=Texas Instruments, set at pre-compile, default-value=true  # I2C_B Clock Enable bit:.
        container McuPeripheralClock10  # Device specific Peripheral Clock settings - CAN
          boolean MCU_PERIPH_CLK_MCANA: origin=Texas Instruments, set at pre-compile, default-value=true  # MCAN_A Clock Enable bit.
          boolean MCU_PERIPH_CLK_MCANB: origin=Texas Instruments, set at pre-compile, default-value=true  # MCAN_B Clock Enable bit.
          boolean MCU_PERIPH_CLK_MCANC: origin=Texas Instruments, set at pre-compile, default-value=true  # MCAN_C Clock Enable bit.
          boolean MCU_PERIPH_CLK_MCAND: origin=Texas Instruments, set at pre-compile, default-value=true  # MCAN_D Clock Enable bit.
          boolean MCU_PERIPH_CLK_MCANE: origin=Texas Instruments, set at pre-compile, default-value=true  # MCAN_E Clock Enable bit.
          boolean MCU_PERIPH_CLK_MCANF: origin=Texas Instruments, set at pre-compile, default-value=true  # MCAN_F Clock Enable bit.
        container McuPeripheralClock13  # Device specific Peripheral Clock settings - ADC
          boolean MCU_PERIPH_CLK_ADCA: origin=Texas Instruments, set at pre-compile, default-value=true  # ADC_A Clock Enable bit.
          boolean MCU_PERIPH_CLK_ADCB: origin=Texas Instruments, set at pre-compile, default-value=true  # ADC_B Clock Enable bit.
          boolean MCU_PERIPH_CLK_ADCC: origin=Texas Instruments, set at pre-compile, default-value=true  # ADC_C Clock Enable bit.
          boolean MCU_PERIPH_CLK_ADCD: origin=Texas Instruments, set at pre-compile, default-value=true  # ADC_D Clock Enable bit.
          boolean MCU_PERIPH_CLK_ADCE: origin=Texas Instruments, set at pre-compile, default-value=true  # ADC_E Clock Enable bit.
        container McuPeripheralClock14  # Device specific Peripheral Clock settings - CMPSS
          boolean MCU_PERIPH_CLK_CMPSS{1..12}: origin=Texas Instruments, set at pre-compile, default-value=true  # CMPSS{1..12} Clock Enable bit.
        container McuPeripheralClock16  # Device specific Peripheral Clock settings- Buf DAC
          boolean MCU_PERIPH_CLK_DACA: origin=Texas Instruments, set at pre-compile, default-value=true  # Buffered_DAC_A Clock Enable Bit.
          boolean MCU_PERIPH_CLK_DACB: origin=Texas Instruments, set at pre-compile, default-value=true  # Buffered_DAC_B Clock Enable Bit.
        container McuPeripheralClock17  # Device specific Peripheral Clock settings - CLB
          boolean MCU_PERIPH_CLK_CLB{1..6}: origin=Texas Instruments, set at pre-compile, default-value=true  # CLB{1..6} Clock Enable bit.
        container McuPeripheralClock18  # Device specific Peripheral Clock settings - FSI
          boolean MCU_PERIPH_CLK_FSITXA: origin=Texas Instruments, set at pre-compile, default-value=true  # FSITX_A Clock Enable bit.
          boolean MCU_PERIPH_CLK_FSITXB: origin=Texas Instruments, set at pre-compile, default-value=true  # FSITX_B Clock Enable bit
          boolean MCU_PERIPH_CLK_FSITXC: origin=Texas Instruments, set at pre-compile, default-value=true  # FSITX_C Clock Enable bit.
          boolean MCU_PERIPH_CLK_FSITXD: origin=Texas Instruments, set at pre-compile, default-value=true  # FSITX_D Clock Enable bit.
          boolean MCU_PERIPH_CLK_FSIRXA: origin=Texas Instruments, set at pre-compile, default-value=true  # FSIRX_A Clock Enable bit.
          boolean MCU_PERIPH_CLK_FSIRXB: origin=Texas Instruments, set at pre-compile, default-value=true  # FSIRX_B Clock Enable bit.
          boolean MCU_PERIPH_CLK_FSIRXC: origin=Texas Instruments, set at pre-compile, default-value=true  # FSIRX_C Clock Enable bit.
          boolean MCU_PERIPH_CLK_FSIRXD: origin=Texas Instruments, set at pre-compile, default-value=true  # FSIRX_D Clock Enable bit.
        container McuPeripheralClock19  # Device specific Peripheral Clock settings - LIN
          boolean MCU_PERIPH_CLK_LINA: origin=Texas Instruments, set at pre-compile, default-value=true  # LIN_A Clock Enable bit.
          boolean MCU_PERIPH_CLK_LINB: origin=Texas Instruments, set at pre-compile, default-value=true  # LIN_B Clock Enable bit.
        container McuPeripheralClock20  # Device specific Peripheral Clock settings - PMBUS
          boolean MCU_PERIPH_CLK_PMBUSA: origin=Texas Instruments, set at pre-compile, default-value=true  # PMBUS_A Clock Enable bit.
        container McuPeripheralClock21  # Device specific Peripheral Clock settings - DCC
          boolean MCU_PERIPH_CLK_DCC1: origin=Texas Instruments, set at pre-compile, default-value=true  # DCC1 Clock Enable Bit.
          boolean MCU_PERIPH_CLK_DCC2: origin=Texas Instruments, set at pre-compile, default-value=true  # DCC1 Clock Enable Bit.
          boolean MCU_PERIPH_CLK_DCC3: origin=Texas Instruments, set at pre-compile, default-value=true  # DCC3 Clock Enable Bit.
        container McuPeripheralClock23  # Device specific Peripheral Clock settings - EtherCAT
          boolean MCU_PERIPH_CLK_ETHERCAT: origin=Texas Instruments, set at pre-compile, default-value=true  # ETHERCAT Clock Enable Bit.
        container McuPeripheralClock25  # Device specific Peripheral Clock settings - HRCAL0,1,2
          boolean MCU_PERIPH_CLK_HRCAL{0..2}: origin=Texas Instruments, set at pre-compile, default-value=true  # HRCAL{0..2} Clock Enable Bit.
        container McuPeripheralClock27  # Device specific Peripheral Clock settings - EPG
          boolean MCU_PERIPH_CLK_EPG1: origin=Texas Instruments, set at pre-compile, default-value=true  # EPG1 Clock Enable Bit.
        container McuPeripheralClock28  # Device specific Peripheral Clock settings - ADCCHECKER
          boolean MCU_PERIPH_CLK_ADCCHECKER{1..10}: origin=Texas Instruments, set at pre-compile, default-value=true  # Clock Enable Bit.
          boolean MCU_PERIPH_CLK_ADCSEAGGRCPU{1..3}: origin=Texas Instruments, set at pre-compile, default-value=true  # Clock Enable Bit.
        container McuPeripheralClock30  # Device specific Peripheral Clock settings - SENT
          boolean MCU_PERIPH_CLK_SENT{1..4}: origin=Texas Instruments, set at pre-compile, default-value=true  # SENT{1..4} Clock Enable Bit.
          boolean MCU_PERIPH_CLK_SENT5: origin=Texas Instruments, set at pre-compile, default-value=true  # SENT1 Clock Enable Bit.
          boolean MCU_PERIPH_CLK_SENT6: origin=Texas Instruments, set at pre-compile, default-value=true  # SENT6 Clock Enable Bit.
        container McuPeripheralClock32  # Device specific Peripheral Clock settings - WADI
          boolean MCU_PERIPH_CLK_WADI1: origin=Texas Instruments, set at pre-compile, default-value=true  # WADI1 Clock Enable Bit.
          boolean MCU_PERIPH_CLK_WADI2: origin=Texas Instruments, set at pre-compile, default-value=true  # WADI2 Clock Enable Bit.
      container McuDemEventParameterRefs [0..1]  # Container for the references to DemEventParameter elements which shall be invoked using the API Dem_SetEventStatus in case the corresponding error occurs. The EventId is taken from the referenced DemEventParameter's DemEventId symbolic value. The standardized errors are provided in this container and can be extended by vendor-specific error references.
        symbolic name reference MCU_E_CLOCK_FAILURE [0..1]: multiplicity set at pre-compile, set at pre-compile, destination=DemEventParameter  # Reference to configured DEM event to report "Clock source failure".
      container McuModeSettingConf [1..2]  # This container contains the configuration (parameters) for the Mode setting of the MCU. Please see MCU035 for more information on the MCU mode settings.
        integer McuMode: 0..1, set at pre-compile, symbolic-name-value=true, default-value=0  # The parameter represents the MCU Mode settings. IDLE Mode :0, STANDBY mode :1
        integer McuQualPeriod [0..1]: 2..65, origin=Texas Instruments, set at post-build in variant post-build / pre-compile in variant pre-compile, default-value=2  # The number of OSCCLK clock cycles used to qualify the selected inputs when waking from STANDBY mode.
        boolean McuEnableWDWakeup [0..1]: origin=Texas Instruments, set at post-build in variant post-build / pre-compile in variant pre-compile, default-value=false  # Enable/Disable using watchdog to wakeup from standby or halt mode
      container McuRamSectorSettingConf [0..*]  # This container contains the configuration (parameters) for the RAM Sector setting. Please see MCU030 for more information on RAM sec-tor settings.
        integer McuRamDefaultValue: 0..255, post-build-variant-value=true, set at post-build in variant post-build / pre-compile in variant pre-compile, default-value=0  # This parameter shall represent the Data pre-setting to be initialized
        integer McuRamSectionBaseAddress: 0..4294967295, post-build-variant-value=true, set at post-build in variant post-build / pre-compile in variant pre-compile, default-value=0  # This parameter shall represent the MCU RAM section base address
        integer McuRamSectionSize: 0..4294967295, post-build-variant-value=true, set at post-build in variant post-build / pre-compile in variant pre-compile, default-value=0  # This parameter represents the MCU RAM Section size in bytes.
        integer McuRamSectionWriteSize: 1..8, post-build-variant-value=true, set at post-build in variant post-build / pre-compile in variant pre-compile, default-value=1  # This parameter shall define the size in bytes of data which can be written into RAM at once.
    container McuPublishedInformation  # Container holding all MCU specific published information parameters
      container McuResetReasonConf [1..7]  # This container contains the configuration for the different type of reset reason that can be retrieved from Mcu_GetResetReason Api.
        integer McuResetReason: 0..6, scope=ECU, set at published-information, symbolic-name-value=true, default-value=0  # The parameter represents the different type of reset that a Micro supports. This parameter is referenced by the parameter EcuMResetReason in the ECU State manager module.
