AUTOSAR XML (schema 00044)
package /Wdg_TI_F29H85x
  bsw module description Wdg: category=BSW_MODULE, implemented-entrys=[Wdg_GetVersionInfo, Wdg_Init, Wdg_SetMode, Wdg_SetTriggerCondition], module-id=102
    bsw module dependency Dem: target-module-id=54, target-module=Dem
    bsw module dependency Det: target-module-id=15, target-module=Det
    bsw internal behavior Wdg_Behavior
      4 x bsw called entity, all with reentrancy-level=SINGLE-CORE-REENTRANT:
        Wdg_GetVersionInfo: implemented-entry=Wdg_GetVersionInfo
          bsw direct call point Det_ReportError: called-entry=Det_ReportError
        Wdg_Init: implemented-entry=Wdg_Init
          bsw direct call point Dem_SetEventStatus: called-entry=Dem_SetEventStatus
          bsw direct call point Det_ReportError: called-entry=Det_ReportError
        Wdg_SetMode: implemented-entry=Wdg_SetMode
          bsw direct call point Dem_SetEventStatus: called-entry=Dem_SetEventStatus
          bsw direct call point Det_ReportError: called-entry=Det_ReportError
        Wdg_SetTriggerCondition: implemented-entry=Wdg_SetTriggerCondition
          bsw direct call point Det_ReportError: called-entry=Det_ReportError
  bsw implementation Wdg_Impl: programming-language=C, sw-version=2.0.1, vendor-id=44, ar-release-version=4.3.1, behavior=Wdg_Behavior, vendor-specific-module-def=Wdg
    code-descriptors:
      code Files
        artifact-descriptors:
          short-label=generate::include::Wdg_Cfg.h, category=SWHDR
          short-label=generate::src::Wdg_Cfg.c, category=SWSRC
          short-label=generate::src::Wdg_PBcfg.c, category=SWSRC
          short-label=generate::src::Wdg_Lcfg.c, category=SWSRC
          short-label=include::Wdg.h, category=SWHDR
          short-label=include::Wdg_Priv.h, category=SWHDR
          short-label=src::Wdg.c, category=SWSRC
          short-label=src::Wdg_Priv.c, category=SWSRC
    compiler TI_C29Clang: name=TI_C29Clang, vendor=Texas Instruments, version=2.0.0
    linker TI_C29Linker: name=TI_C29Linker, vendor=Texas Instruments, version=2.0.0
    resource consumption MemoryMappedSections
      4 x memory section, all with alignment=UNSPECIFIED:
        WDG_CODE: sw-addrmethod=CODE, symbol=CODE
        WDG_VAR_NO_INIT_UNSPECIFIED: sw-addrmethod=VAR_NO_INIT, symbol=VAR_NO_INIT_UNSPECIFIED
        WDG_VAR_INIT_UNSPECIFIED: sw-addrmethod=VAR_INIT, symbol=VAR_INIT_UNSPECIFIED
        WDG_CONFIG_DATA: sw-addrmethod=CONST_PBCFG, symbol=CONFIG_DATA
package /Wdg_TI_F29H85x/Wdg_ModuleEntry
  4 x bsw module entry, all with is-synchronous=true, call-type=REGULAR, execution-context=UNSPECIFIED, sw-service-impl-policy=STANDARD, bsw-entry-kind=CONCRETE:
    Wdg_GetVersionInfo: service-id=4, is-reentrant=true
    Wdg_Init: service-id=0, is-reentrant=false
    Wdg_SetMode: service-id=1, is-reentrant=false
    Wdg_SetTriggerCondition: service-id=3, is-reentrant=false
