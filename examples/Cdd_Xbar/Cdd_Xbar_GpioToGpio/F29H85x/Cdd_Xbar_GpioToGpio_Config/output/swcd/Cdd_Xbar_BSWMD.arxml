AUTOSAR XML (schema 00044)
package /Cdd_Xbar_TI_F29H85x
  bsw module description Cdd_Xbar: category=BSW_MODULE, module-id=255
    implemented-entrys:
      Cdd_Xbar_GetVersionInfo
      Cdd_Xbar_Init
      Cdd_Xbar_SelectInput
      Cdd_Xbar_SetExternalInterruptType
      Cdd_Xbar_SetExternalInterruptState
      Cdd_Xbar_GetExternalInterruptCounter
      Cdd_Xbar_OutLatchSelect
      Cdd_Xbar_OutLatchSelectSts
      Cdd_Xbar_OutLatchFlagStatus
      Cdd_Xbar_OutLatchFlagForce
      Cdd_Xbar_OutLatchFlagClear
      Cdd_Xbar_OutInvBeforeLatch
      Cdd_Xbar_OutInvCheckBeforeLatch
      Cdd_Xbar_OutOutputSignal
      Cdd_Xbar_OutStretchPulse
      Cdd_Xbar_OutStretchPulseClear
      Cdd_Xbar_OutStretchPulseCheck
      Cdd_Xbar_SelectOutputInversion
      Cdd_Xbar_CheckOutputInversion
      Cdd_Xbar_Lock
      Cdd_Xbar_LockStatus
      Cdd_Xbar_InputFlagClear
      Cdd_Xbar_InputFlagStatus
    bsw module dependency Det: target-module-id=15, target-module=Det
    bsw internal behavior Cdd_Xbar_Behavior
      23 x bsw called entity, all with reentrancy-level=SINGLE-CORE-REENTRANT:
        Cdd_Xbar_GetVersionInfo: implemented-entry=Cdd_Xbar_GetVersionInfo
          bsw direct call point Det_ReportError: called-entry=Det_ReportError
        Cdd_Xbar_Init: implemented-entry=Cdd_Xbar_Init
          bsw direct call point Det_ReportError: called-entry=Det_ReportError
        Cdd_Xbar_SelectInput: implemented-entry=Cdd_Xbar_SelectInput
          bsw direct call point Det_ReportError: called-entry=Det_ReportError
        Cdd_Xbar_SetExternalInterruptType: implemented-entry=Cdd_Xbar_SetExternalInterruptType
          bsw direct call point Det_ReportError: called-entry=Det_ReportError
        Cdd_Xbar_SetExternalInterruptState: implemented-entry=Cdd_Xbar_SetExternalInterruptState
          bsw direct call point Det_ReportError: called-entry=Det_ReportError
        Cdd_Xbar_GetExternalInterruptCounter: implemented-entry=Cdd_Xbar_SetExternalInterruptState
          bsw direct call point Det_ReportError: called-entry=Det_ReportError
        Cdd_Xbar_OutLatchSelect: implemented-entry=Cdd_Xbar_OutLatchSelect
          bsw direct call point Det_ReportError: called-entry=Det_ReportError
        Cdd_Xbar_OutLatchSelectSts: implemented-entry=Cdd_Xbar_OutLatchSelectSts
          bsw direct call point Det_ReportError: called-entry=Det_ReportError
        Cdd_Xbar_OutLatchFlagStatus: implemented-entry=Cdd_Xbar_OutLatchFlagStatus
          bsw direct call point Det_ReportError: called-entry=Det_ReportError
        Cdd_Xbar_OutLatchFlagForce: implemented-entry=Cdd_Xbar_OutLatchFlagForce
          bsw direct call point Det_ReportError: called-entry=Det_ReportError
        Cdd_Xbar_OutLatchFlagClear: implemented-entry=Cdd_Xbar_OutLatchFlagClear
          bsw direct call point Det_ReportError: called-entry=Det_ReportError
        Cdd_Xbar_OutInvBeforeLatch: implemented-entry=Cdd_Xbar_OutInvBeforeLatch
          bsw direct call point Det_ReportError: called-entry=Det_ReportError
        Cdd_Xbar_OutInvCheckBeforeLatch: implemented-entry=Cdd_Xbar_OutInvCheckBeforeLatch
          bsw direct call point Det_ReportError: called-entry=Det_ReportError
        Cdd_Xbar_OutOutputSignal: implemented-entry=Cdd_Xbar_OutOutputSignal
          bsw direct call point Det_ReportError: called-entry=Det_ReportError
        Cdd_Xbar_OutStretchPulse: implemented-entry=Cdd_Xbar_OutStretchPulse
          bsw direct call point Det_ReportError: called-entry=Det_ReportError
        Cdd_Xbar_OutStretchPulseClear: implemented-entry=Cdd_Xbar_OutStretchPulseClear
          bsw direct call point Det_ReportError: called-entry=Det_ReportError
        Cdd_Xbar_OutStretchPulseCheck: implemented-entry=Cdd_Xbar_OutStretchPulseCheck
          bsw direct call point Det_ReportError: called-entry=Det_ReportError
        Cdd_Xbar_SelectOutputInversion: implemented-entry=Cdd_Xbar_SelectOutputInversion
          bsw direct call point Det_ReportError: called-entry=Det_ReportError
        Cdd_Xbar_CheckOutputInversion: implemented-entry=Cdd_Xbar_CheckOutputInversion
          bsw direct call point Det_ReportError: called-entry=Det_ReportError
        Cdd_Xbar_Lock: implemented-entry=Cdd_Xbar_Lock
          bsw direct call point Det_ReportError: called-entry=Det_ReportError
        Cdd_Xbar_LockStatus: implemented-entry=Cdd_Xbar_LockStatus
          bsw direct call point Det_ReportError: called-entry=Det_ReportError
        Cdd_Xbar_InputFlagClear: implemented-entry=Cdd_Xbar_InputFlagClear
          bsw direct call point Det_ReportError: called-entry=Det_ReportError
        Cdd_Xbar_InputFlagStatus: implemented-entry=Cdd_Xbar_InputFlagStatus
          bsw direct call point Det_ReportError: called-entry=Det_ReportError
  bsw implementation Cdd_Xbar_Impl: programming-language=C, sw-version=3.0.1, vendor-id=44, ar-release-version=4.3.1, behavior=Cdd_Xbar_Behavior, vendor-specific-module-def=Cdd
    code-descriptors:
      code Files
        artifact-descriptors:
          short-label=generate::include::Cdd_Xbar_Cfg.h, category=SWHDR
          short-label=generate::src::Cdd_Xbar_Cfg.c, category=SWSRC
          short-label=include::Cdd_Xbar.h, category=SWHDR
          short-label=include::Cdd_Xbar_Priv.h, category=SWHDR
          short-label=src::Cdd_Xbar.c, category=SWSRC
          short-label=src::Cdd_Xbar_Priv.c, category=SWSRC
    compiler c29clang: name=TI C29 Clang Compiler, vendor=Texas Instruments, version=2.0.0
    linker c29lnk: name=TI C29 Linker, vendor=Texas Instruments, version=2.0.0
    resource consumption ResourceConsumption
      4 x memory section:
        CDD_XBAR_CODE: alignment=UNSPECIFIED, sw-addrmethod=CODE, symbol=CODE
        CDD_XBAR_CONFIG_DATA: alignment=UNSPECIFIED, sw-addrmethod=CONST_PBCFG, symbol=CONFIG_DATA
        CDD_XBAR_VAR_INIT_8: alignment=8, sw-addrmethod=VAR_INIT, symbol=VAR_INIT_8
        CDD_XBAR_VAR_INIT_PTR: alignment=UNSPECIFIED, sw-addrmethod=VAR_INIT, symbol=VAR_INIT_PTR
package /Cdd_Xbar_TI_F29H85x/BSWModuleEntry
  23 x bsw module entry, all with is-reentrant=true, is-synchronous=true, call-type=REGULAR, execution-context=UNSPECIFIED, sw-service-impl-policy=STANDARD, bsw-entry-kind=CONCRETE:
    Cdd_Xbar_GetVersionInfo: service-id=1
    Cdd_Xbar_Init: service-id=2
    Cdd_Xbar_SelectInput: service-id=3
    Cdd_Xbar_OutLatchSelect: service-id=4
    Cdd_Xbar_OutLatchSelectSts: service-id=5
    Cdd_Xbar_OutLatchFlagStatus: service-id=6
    Cdd_Xbar_OutLatchFlagForce: service-id=7
    Cdd_Xbar_OutLatchFlagClear: service-id=8
    Cdd_Xbar_OutInvBeforeLatch: service-id=9
    Cdd_Xbar_OutInvCheckBeforeLatch: service-id=10
    Cdd_Xbar_OutOutputSignal: service-id=11
    Cdd_Xbar_OutStretchPulse: service-id=12
    Cdd_Xbar_OutStretchPulseClear: service-id=13
    Cdd_Xbar_OutStretchPulseCheck: service-id=14
    Cdd_Xbar_SelectOutputInversion: service-id=15
    Cdd_Xbar_CheckOutputInversion: service-id=16
    Cdd_Xbar_Lock: service-id=17
    Cdd_Xbar_LockStatus: service-id=18
    Cdd_Xbar_InputFlagStatus: service-id=19
    Cdd_Xbar_InputFlagClear: service-id=20
    Cdd_Xbar_SetExternalInterruptType: service-id=21
    Cdd_Xbar_SetExternalInterruptState: service-id=22
    Cdd_Xbar_GetExternalInterruptCounter: service-id=23
