AUTOSAR XML (schema 00044)
package /Dio_TI_F29H85x
  bsw module description Dio: module-id=120
    implemented-entrys:
      Dio_FlipChannel
      Dio_GetVersionInfo
      Dio_ReadChannel
      Dio_ReadChannelGroup
      Dio_ReadPort
      Dio_WriteChannel
      Dio_WriteChannelGroup
      Dio_WritePort
    bsw module dependency Det: target-module-id=15, target-module=Det
    bsw internal behavior Dio_Behaviour
      8 x bsw called entity, all with reentrancy-level=SINGLE-CORE-REENTRANT:
        Dio_FlipChannel: implemented-entry=Dio_FlipChannel
          bsw direct call point Det_ReportError: called-entry=Det_ReportError
        Dio_GetVersionInfo: implemented-entry=Dio_GetVersionInfo
          bsw direct call point Det_ReportError: called-entry=Det_ReportError
        Dio_ReadChannel: implemented-entry=Dio_ReadChannel
          bsw direct call point Det_ReportError: called-entry=Det_ReportError
        Dio_ReadChannelGroup: implemented-entry=Dio_ReadChannelGroup
          bsw direct call point Det_ReportError: called-entry=Det_ReportError
        Dio_ReadPort: implemented-entry=Dio_ReadPort
          bsw direct call point Det_ReportError: called-entry=Det_ReportError
        Dio_WriteChannel: implemented-entry=Dio_WriteChannel
          bsw direct call point Det_ReportError: called-entry=Det_ReportError
        Dio_WriteChannelGroup: implemented-entry=Dio_WriteChannelGroup
          bsw direct call point Det_ReportError: called-entry=Det_ReportError
        Dio_WritePort: implemented-entry=Dio_WritePort
          bsw direct call point Det_ReportError: called-entry=Det_ReportError
  bsw implementation Dio_Impl: programming-language=C, sw-version=1.1.0, vendor-id=44, ar-release-version=4.3.1, behavior=Dio_Behaviour, vendor-specific-module-def=Dio
    code-descriptors:
      code Files
        artifact-descriptors:
          short-label=generate::include::Dio_Cfg.h, category=SWHDR
          short-label=generate::src::Dio_Cfg.c, category=SWSRC
          short-label=generate::src::Dio_Lcfg.c, category=SWSRC
          short-label=include::Dio.h, category=SWHDR
          short-label=include::Dio_Priv.h, category=SWHDR
          short-label=src::Dio.c, category=SWSRC
          short-label=src::Dio_Priv.c, category=SWSRC
    compiler TI_C29Clang: name=TI_C29Clang, vendor=Texas Instruments, version=2.2.0
    linker TI_C29Linker: name=TI_C29Linker, vendor=Texas Instruments, version=2.2.0
    resource consumption ResourceConsumption
      memory section DIO_CODE: alignment=UNSPECIFIED, sw-addrmethod=CODE, symbol=CODE
      memory section DIO_CONFIG_DATA: alignment=UNSPECIFIED, sw-addrmethod=CONST_PBCFG, symbol=CONFIG_DATA
      memory section DIO_VAR_INIT_PTR: alignment=UNSPECIFIED, sw-addrmethod=VAR_INIT, symbol=VAR_INIT_PTR
package /Dio_TI_F29H85x/BSWModuleEntry
  8 x bsw module entry, all with is-reentrant=true, is-synchronous=true, call-type=REGULAR, execution-context=UNSPECIFIED, sw-service-impl-policy=STANDARD, bsw-entry-kind=CONCRETE:
    Dio_FlipChannel: service-id=17
    Dio_GetVersionInfo: service-id=18
    Dio_ReadChannel: service-id=0
    Dio_ReadChannelGroup: service-id=4
    Dio_ReadPort: service-id=2
    Dio_WriteChannel: service-id=1
    Dio_WriteChannelGroup: service-id=5
    Dio_WritePort: service-id=3
