AUTOSAR XML (schema 00044)
package /Mcu_TI_F29H85x
  bsw module description Mcu: category=BSW_MODULE, module-id=101
    implemented-entrys:
      Mcu_GetPllStatus
      Mcu_GetRamState
      Mcu_GetResetRawValue
      Mcu_GetResetReason
      Mcu_GetVersionInfo
      Mcu_Init
      Mcu_InitClock
      Mcu_InitRamSection
      Mcu_PerformReset
      Mcu_SetMode
      Mcu_GetSystemClock
      Mcu_ASysCtl_SelectInternalTestNode
      Mcu_ASysCtl_ConfigADCGlobalSOC
      Mcu_ASysCtl_ForceADCGlobalSOC
      Mcu_ASysCtl_CommitLock
      Mcu_SysCtl_ConfigEPWMXLink
    bsw module dependency Dem: target-module-id=54, target-module=Dem
    bsw module dependency Det: target-module-id=15, target-module=Det
    bsw internal behavior Mcu_Behavior
      exclusive area MCU_EXCLUSIVE_AREA_0
      17 x bsw called entity:
        Mcu_DistributePllClock: can-enter-exclusive-area=MCU_EXCLUSIVE_AREA_0, reentrancy-level=SINGLE-CORE-REENTRANT, implemented-entry=Mcu_DistributePllClock
          bsw direct call point Det_ReportError: called-entry=Det_ReportError
        Mcu_GetPllStatus: reentrancy-level=SINGLE-CORE-REENTRANT, implemented-entry=Mcu_GetPllStatus
          bsw direct call point Det_ReportError: called-entry=Det_ReportError
        Mcu_GetRamState: reentrancy-level=SINGLE-CORE-REENTRANT, implemented-entry=Mcu_GetRamState
          bsw direct call point Det_ReportError: called-entry=Det_ReportError
        Mcu_GetResetRawValue: reentrancy-level=SINGLE-CORE-REENTRANT, implemented-entry=Mcu_GetResetRawValue
          bsw direct call point Det_ReportError: called-entry=Det_ReportError
        Mcu_GetResetReason: reentrancy-level=SINGLE-CORE-REENTRANT, implemented-entry=Mcu_GetResetReason
          bsw direct call point Det_ReportError: called-entry=Det_ReportError
        Mcu_GetVersionInfo: reentrancy-level=SINGLE-CORE-REENTRANT, implemented-entry=Mcu_GetVersionInfo
          bsw direct call point Det_ReportError: called-entry=Det_ReportError
        Mcu_Init: reentrancy-level=NON-REENTRANT, implemented-entry=Mcu_Init
          bsw direct call point Det_ReportError: called-entry=Det_ReportError
        Mcu_InitClock: can-enter-exclusive-area=MCU_EXCLUSIVE_AREA_0, reentrancy-level=SINGLE-CORE-REENTRANT, implemented-entry=Mcu_InitClock
          bsw direct call point Dem_SetEventStatus: called-entry=Dem_SetEventStatus
          bsw direct call point Det_ReportError: called-entry=Det_ReportError
        Mcu_InitRamSection: reentrancy-level=NON-REENTRANT, implemented-entry=Mcu_InitRamSection
          bsw direct call point Det_ReportError: called-entry=Det_ReportError
        Mcu_PerformReset: reentrancy-level=SINGLE-CORE-REENTRANT, implemented-entry=Mcu_PerformReset
          bsw direct call point Det_ReportError: called-entry=Det_ReportError
        Mcu_SetMode: reentrancy-level=SINGLE-CORE-REENTRANT, implemented-entry=Mcu_SetMode
          bsw direct call point Det_ReportError: called-entry=Det_ReportError
        Mcu_GetSystemClock: reentrancy-level=SINGLE-CORE-REENTRANT, implemented-entry=Mcu_GetSystemClock
          bsw direct call point Det_ReportError: called-entry=Det_ReportError
        Mcu_ASysCtl_SelectInternalTestNode: reentrancy-level=SINGLE-CORE-REENTRANT, implemented-entry=Mcu_ASysCtl_SelectInternalTestNode
          bsw direct call point Det_ReportError: called-entry=Det_ReportError
        Mcu_ASysCtl_ConfigADCGlobalSOC: reentrancy-level=SINGLE-CORE-REENTRANT, implemented-entry=Mcu_ASysCtl_ConfigADCGlobalSOC
          bsw direct call point Det_ReportError: called-entry=Det_ReportError
        Mcu_ASysCtl_ForceADCGlobalSOC: reentrancy-level=SINGLE-CORE-REENTRANT, implemented-entry=Mcu_ASysCtl_ForceADCGlobalSOC
          bsw direct call point Det_ReportError: called-entry=Det_ReportError
        Mcu_ASysCtl_CommitLock: reentrancy-level=SINGLE-CORE-REENTRANT, implemented-entry=Mcu_ASysCtl_CommitLock
          bsw direct call point Det_ReportError: called-entry=Det_ReportError
        Mcu_SysCtl_ConfigEPWMXLink: reentrancy-level=SINGLE-CORE-REENTRANT, implemented-entry=Mcu_SysCtl_ConfigEPWMXLink
          bsw direct call point Det_ReportError: called-entry=Det_ReportError
  bsw implementation Mcu_Impl: programming-language=C, sw-version=2.3.0, vendor-id=44, ar-release-version=4.3.1, behavior=Mcu_Behavior, vendor-specific-module-def=Mcu
    code-descriptors:
      code Files
        artifact-descriptors:
          short-label=generate::include::Mcu_Cfg.h, category=SWHDR
          short-label=generate::src::Mcu_Cfg.c, category=SWSRC
          short-label=generate::src::Mcu_PBCfg.c, category=SWSRC
          short-label=include::Mcu.h, category=SWHDR
          short-label=include::Mcu_Priv.h, category=SWHDR
          short-label=src::Mcu.c, category=SWSRC
          short-label=src::Mcu_Priv.c, category=SWSRC
    compiler TI_C29Clang: name=TI_C29Clang, vendor=Texas Instruments, version=2.2.0
    linker TI_C29Linker: name=TI_C29Linker, vendor=Texas Instruments, version=2.2.0
    resource consumption MemoryMappedSections
      5 x memory section:
        MCU_CODE: alignment=UNSPECIFIED, sw-addrmethod=CODE, symbol=CODE
        MCU_VAR_INIT_PTR: alignment=UNSPECIFIED, sw-addrmethod=VAR_INIT, symbol=VAR_INIT_PTR
        MCU_VAR_INIT_BOOLEAN: alignment=BOOLEAN, sw-addrmethod=VAR_INIT, symbol=VAR_INIT_BOOLEAN
        MCU_CONFIG_DATA: alignment=UNSPECIFIED, sw-addrmethod=CONST_PBCFG, symbol=CONFIG_DATA
        MCU_VAR_INIT_32: alignment=32, sw-addrmethod=VAR_INIT, symbol=VAR_INIT_32
package /Mcu_TI_F29H85x/Mcu_ModuleEntry
  17 x bsw module entry, all with is-synchronous=true, call-type=REGULAR, execution-context=UNSPECIFIED, sw-service-impl-policy=STANDARD, bsw-entry-kind=CONCRETE:
    Mcu_DistributePllClock: service-id=3, is-reentrant=false
    Mcu_GetPllStatus: service-id=4, is-reentrant=true
    Mcu_GetRamState: service-id=10, is-reentrant=true
    Mcu_GetResetRawValue: service-id=6, is-reentrant=true
    Mcu_GetResetReason: service-id=5, is-reentrant=true
    Mcu_GetVersionInfo: service-id=9, is-reentrant=true
    Mcu_Init: service-id=0, is-reentrant=false
    Mcu_InitClock: service-id=2, is-reentrant=false
    Mcu_InitRamSection: service-id=1, is-reentrant=false
    Mcu_PerformReset: service-id=7, is-reentrant=false
    Mcu_SetMode: service-id=8, is-reentrant=true
    Mcu_GetSystemClock: service-id=11, is-reentrant=true
    Mcu_ASysCtl_SelectInternalTestNode: service-id=12, is-reentrant=true
    Mcu_ASysCtl_ConfigADCGlobalSOC: service-id=13, is-reentrant=true
    Mcu_ASysCtl_ForceADCGlobalSOC: service-id=14, is-reentrant=true
    Mcu_ASysCtl_CommitLock: service-id=15, is-reentrant=true
    Mcu_SysCtl_ConfigEPWMXLink: service-id=16, is-reentrant=true
