AUTOSAR XML (schema 00044)
package /Cdd_Dma_TI_F29H85x
  bsw module description Cdd_Dma: category=BSW_MODULE, module-id=255
    implemented-entrys:
      Cdd_Dma_RTDMA1_CH1_Isr
      Cdd_Dma_GetVersionInfo
      Cdd_Dma_Init
      Cdd_Dma_DeInit
      Cdd_Dma_SetChannelProperties
      Cdd_Dma_SetTransferProperties
      Cdd_Dma_SetTransferSize
      Cdd_Dma_SetTransferSrcProperties
      Cdd_Dma_SetTransferDestProperties
      Cdd_Dma_SetTransferSrcAddress
      Cdd_Dma_SetTransferDestAddress
      Cdd_Dma_SetTransferWrapSrcProperties
      Cdd_Dma_SetTransferWrapDestProperties
      Cdd_Dma_EnablePeripheralEventTrigger
      Cdd_Dma_DisablePeripheralEventTrigger
      Cdd_Dma_SetPeripheralEventTriggerSource
      Cdd_Dma_StartChannelTransfer
      Cdd_Dma_StopChannelTransfer
      Cdd_Dma_ForcePeripheralEventTrigger
      Cdd_Dma_ClearPeripheralEventTrigger
      Cdd_Dma_TriggerSoftReset
      Cdd_Dma_SetChannelPriority
      Cdd_Dma_GetChannelStatus
      Cdd_Dma_ClearErrorFlag
      Cdd_Dma_SetChannelCommit
      Cdd_Dma_SetDmaCfgCommit
      Cdd_Dma_SetMpuRegionCommit
      Cdd_Dma_SetMpuCfgCommit
      Cdd_Dma_GetChannelPriority
      Cdd_Dma_PeriodicReadback
    bsw module dependency Det: target-module-id=15, target-module=Det
    bsw internal behavior Cdd_Dma_Behavior
      exclusive area CDD_DMA_EXCLUSIVE_AREA_0
      bsw interrupt entity Cdd_Dma_RTDMA1_CH1_Isr: reentrancy-level=NON-REENTRANT, implemented-entry=Cdd_Dma_RTDMA1_CH1_Isr, interrupt-category=CAT-2
      29 x bsw called entity:
        Cdd_Dma_GetVersionInfo: reentrancy-level=SINGLE-CORE-REENTRANT, implemented-entry=Cdd_Dma_GetVersionInfo
          bsw direct call point Det_ReportError: called-entry=Det_ReportError
        Cdd_Dma_Init: reentrancy-level=NON-REENTRANT, implemented-entry=Cdd_Dma_Init
          bsw direct call point Det_ReportError: called-entry=Det_ReportError
        Cdd_Dma_DeInit: reentrancy-level=NON-REENTRANT, implemented-entry=Cdd_Dma_DeInit
          bsw direct call point Det_ReportError: called-entry=Det_ReportError
        Cdd_Dma_SetChannelProperties: can-enter-exclusive-area=CDD_DMA_EXCLUSIVE_AREA_0, reentrancy-level=SINGLE-CORE-REENTRANT, implemented-entry=Cdd_Dma_SetChannelProperties
          bsw direct call point Det_ReportError: called-entry=Det_ReportError
        Cdd_Dma_SetTransferProperties: can-enter-exclusive-area=CDD_DMA_EXCLUSIVE_AREA_0, reentrancy-level=SINGLE-CORE-REENTRANT, implemented-entry=Cdd_Dma_SetTransferProperties
          bsw direct call point Det_ReportError: called-entry=Det_ReportError
        Cdd_Dma_SetTransferSize: can-enter-exclusive-area=CDD_DMA_EXCLUSIVE_AREA_0, reentrancy-level=SINGLE-CORE-REENTRANT, implemented-entry=Cdd_Dma_SetTransferSize
          bsw direct call point Det_ReportError: called-entry=Det_ReportError
        Cdd_Dma_SetTransferSrcProperties: can-enter-exclusive-area=CDD_DMA_EXCLUSIVE_AREA_0, reentrancy-level=SINGLE-CORE-REENTRANT, implemented-entry=Cdd_Dma_SetTransferSrcProperties
          bsw direct call point Det_ReportError: called-entry=Det_ReportError
        Cdd_Dma_SetTransferDestProperties: can-enter-exclusive-area=CDD_DMA_EXCLUSIVE_AREA_0, reentrancy-level=SINGLE-CORE-REENTRANT, implemented-entry=Cdd_Dma_SetTransferDestProperties
          bsw direct call point Det_ReportError: called-entry=Det_ReportError
        Cdd_Dma_SetTransferSrcAddress: can-enter-exclusive-area=CDD_DMA_EXCLUSIVE_AREA_0, reentrancy-level=SINGLE-CORE-REENTRANT, implemented-entry=Cdd_Dma_SetTransferSrcAddress
          bsw direct call point Det_ReportError: called-entry=Det_ReportError
        Cdd_Dma_SetTransferDestAddress: can-enter-exclusive-area=CDD_DMA_EXCLUSIVE_AREA_0, reentrancy-level=SINGLE-CORE-REENTRANT, implemented-entry=Cdd_Dma_SetTransferDestAddress
          bsw direct call point Det_ReportError: called-entry=Det_ReportError
        Cdd_Dma_SetTransferWrapSrcProperties: can-enter-exclusive-area=CDD_DMA_EXCLUSIVE_AREA_0, reentrancy-level=SINGLE-CORE-REENTRANT, implemented-entry=Cdd_Dma_SetTransferWrapSrcProperties
          bsw direct call point Det_ReportError: called-entry=Det_ReportError
        Cdd_Dma_SetTransferWrapDestProperties: can-enter-exclusive-area=CDD_DMA_EXCLUSIVE_AREA_0, reentrancy-level=SINGLE-CORE-REENTRANT, implemented-entry=Cdd_Dma_SetTransferWrapDestProperties
          bsw direct call point Det_ReportError: called-entry=Det_ReportError
        Cdd_Dma_EnablePeripheralEventTrigger: can-enter-exclusive-area=CDD_DMA_EXCLUSIVE_AREA_0, reentrancy-level=SINGLE-CORE-REENTRANT, implemented-entry=Cdd_Dma_EnablePeripheralEventTrigger
          bsw direct call point Det_ReportError: called-entry=Det_ReportError
        Cdd_Dma_DisablePeripheralEventTrigger: can-enter-exclusive-area=CDD_DMA_EXCLUSIVE_AREA_0, reentrancy-level=SINGLE-CORE-REENTRANT, implemented-entry=Cdd_Dma_DisablePeripheralEventTrigger
          bsw direct call point Det_ReportError: called-entry=Det_ReportError
        Cdd_Dma_SetPeripheralEventTriggerSource: can-enter-exclusive-area=CDD_DMA_EXCLUSIVE_AREA_0, reentrancy-level=SINGLE-CORE-REENTRANT, implemented-entry=Cdd_Dma_SetPeripheralEventTriggerSource
          bsw direct call point Det_ReportError: called-entry=Det_ReportError
        Cdd_Dma_StartChannelTransfer: can-enter-exclusive-area=CDD_DMA_EXCLUSIVE_AREA_0, reentrancy-level=SINGLE-CORE-REENTRANT, implemented-entry=Cdd_Dma_StartChannelTransfer
          bsw direct call point Det_ReportError: called-entry=Det_ReportError
        Cdd_Dma_StopChannelTransfer: can-enter-exclusive-area=CDD_DMA_EXCLUSIVE_AREA_0, reentrancy-level=SINGLE-CORE-REENTRANT, implemented-entry=Cdd_Dma_StopChannelTransfer
          bsw direct call point Det_ReportError: called-entry=Det_ReportError
        Cdd_Dma_ForcePeripheralEventTrigger: can-enter-exclusive-area=CDD_DMA_EXCLUSIVE_AREA_0, reentrancy-level=SINGLE-CORE-REENTRANT, implemented-entry=Cdd_Dma_ForcePeripheralEventTrigger
          bsw direct call point Det_ReportError: called-entry=Det_ReportError
        Cdd_Dma_ClearPeripheralEventTrigger: can-enter-exclusive-area=CDD_DMA_EXCLUSIVE_AREA_0, reentrancy-level=SINGLE-CORE-REENTRANT, implemented-entry=Cdd_Dma_ClearPeripheralEventTrigger
          bsw direct call point Det_ReportError: called-entry=Det_ReportError
        Cdd_Dma_TriggerSoftReset: can-enter-exclusive-area=CDD_DMA_EXCLUSIVE_AREA_0, reentrancy-level=SINGLE-CORE-REENTRANT, implemented-entry=Cdd_Dma_TriggerSoftReset
          bsw direct call point Det_ReportError: called-entry=Det_ReportError
        Cdd_Dma_SetChannelPriority: can-enter-exclusive-area=CDD_DMA_EXCLUSIVE_AREA_0, reentrancy-level=SINGLE-CORE-REENTRANT, implemented-entry=Cdd_Dma_SetChannelPriority
          bsw direct call point Det_ReportError: called-entry=Det_ReportError
        Cdd_Dma_GetChannelStatus: reentrancy-level=SINGLE-CORE-REENTRANT, implemented-entry=Cdd_Dma_GetChannelStatus
          bsw direct call point Det_ReportError: called-entry=Det_ReportError
        Cdd_Dma_ClearErrorFlag: can-enter-exclusive-area=CDD_DMA_EXCLUSIVE_AREA_0, reentrancy-level=SINGLE-CORE-REENTRANT, implemented-entry=Cdd_Dma_ClearErrorFlag
          bsw direct call point Det_ReportError: called-entry=Det_ReportError
        Cdd_Dma_SetChannelCommit: reentrancy-level=NON-REENTRANT, implemented-entry=Cdd_Dma_SetChannelCommit
          bsw direct call point Det_ReportError: called-entry=Det_ReportError
        Cdd_Dma_SetDmaCfgCommit: reentrancy-level=NON-REENTRANT, implemented-entry=Cdd_Dma_SetDmaCfgCommit
          bsw direct call point Det_ReportError: called-entry=Det_ReportError
        Cdd_Dma_SetMpuRegionCommit: reentrancy-level=NON-REENTRANT, implemented-entry=Cdd_Dma_SetMpuRegionCommit
          bsw direct call point Det_ReportError: called-entry=Det_ReportError
        Cdd_Dma_SetMpuCfgCommit: reentrancy-level=NON-REENTRANT, implemented-entry=Cdd_Dma_SetMpuCfgCommit
          bsw direct call point Det_ReportError: called-entry=Det_ReportError
        Cdd_Dma_GetChannelPriority: reentrancy-level=SINGLE-CORE-REENTRANT, implemented-entry=Cdd_Dma_GetChannelPriority
          bsw direct call point Det_ReportError: called-entry=Det_ReportError
        Cdd_Dma_PeriodicReadback: reentrancy-level=SINGLE-CORE-REENTRANT, implemented-entry=Cdd_Dma_PeriodicReadback
          bsw direct call point Det_ReportError: called-entry=Det_ReportError
  bsw implementation Cdd_Dma_Impl: programming-language=C, sw-version=1.1.0, vendor-id=44, ar-release-version=4.3.1, behavior=Cdd_Dma_Behavior, vendor-specific-module-def=Cdd
    code-descriptors:
      code Files
        artifact-descriptors:
          short-label=generate::include::Cdd_Dma_Cfg.h, category=SWHDR
          short-label=generate::include::Cdd_Dma_Cbk.h, category=SWHDR
          short-label=generate::src::Cdd_Dma_Cfg.c, category=SWSRC
          short-label=include::Cdd_Dma.h, category=SWHDR
          short-label=include::Cdd_Dma_Priv.h, category=SWHDR
          short-label=src::Cdd_Dma.c, category=SWSRC
          short-label=src::Cdd_Dma_Priv.c, category=SWSRC
          short-label=src::Cdd_Dma_Irq.c, category=SWSRC
    compiler TI_C29Clang: name=TI_C29Clang, vendor=Texas Instruments, version=2.2.0
    linker TI_C29Linker: name=TI_C29Linker, vendor=Texas Instruments, version=2.2.0
    resource consumption ResourceConsumption
      6 x memory section, all with alignment=UNSPECIFIED:
        CDD_DMA_CODE: sw-addrmethod=CODE, symbol=CODE
        CDD_DMA_ISR_CODE: sw-addrmethod=CODE, symbol=ISR_CODE
        CDD_DMA_CONFIG_DATA: sw-addrmethod=CONST_PBCFG, symbol=CONFIG_DATA
        CDD_DMA_VAR_INIT_BOOLEAN: sw-addrmethod=VAR_INIT, symbol=VAR_INIT_BOOLEAN
        CDD_DMA_VAR_INIT_PTR: sw-addrmethod=VAR_INIT, symbol=VAR_INIT_PTR
        CDD_DMA_VAR_NO_INIT_UNSPECIFIED: sw-addrmethod=VAR_NO_INIT, symbol=VAR_NO_INIT_UNSPECIFIED
package /Cdd_Dma_TI_F29H85x/BSWModuleEntry
  49 x bsw module entry, all with is-synchronous=true, sw-service-impl-policy=STANDARD, bsw-entry-kind=CONCRETE:
    Cdd_Dma_RTDMA1_CH1_Isr: is-reentrant=false, call-type=INTERRUPT, execution-context=INTERRUPT-CAT-2
    Cdd_Dma_RTDMA1_CH{2..10}_Isr: is-reentrant=false, call-type=INTERRUPT, execution-context=INTERRUPT-CAT-1
    Cdd_Dma_RTDMA2_CH{1..10}_Isr: is-reentrant=false, call-type=INTERRUPT, execution-context=INTERRUPT-CAT-1
    Cdd_Dma_GetVersionInfo: service-id=0, is-reentrant=true, call-type=REGULAR, execution-context=UNSPECIFIED
    Cdd_Dma_Init: service-id=1, is-reentrant=false, call-type=REGULAR, execution-context=UNSPECIFIED
    Cdd_Dma_DeInit: service-id=2, is-reentrant=false, call-type=REGULAR, execution-context=UNSPECIFIED
    Cdd_Dma_SetChannelProperties: service-id=3, is-reentrant=true, call-type=REGULAR, execution-context=UNSPECIFIED
    Cdd_Dma_SetTransferProperties: service-id=4, is-reentrant=true, call-type=REGULAR, execution-context=UNSPECIFIED
    Cdd_Dma_SetTransferSize: service-id=5, is-reentrant=true, call-type=REGULAR, execution-context=UNSPECIFIED
    Cdd_Dma_SetTransferSrcProperties: service-id=6, is-reentrant=true, call-type=REGULAR, execution-context=UNSPECIFIED
    Cdd_Dma_SetTransferDestProperties: service-id=7, is-reentrant=true, call-type=REGULAR, execution-context=UNSPECIFIED
    Cdd_Dma_SetTransferSrcAddress: service-id=8, is-reentrant=true, call-type=REGULAR, execution-context=UNSPECIFIED
    Cdd_Dma_SetTransferDestAddress: service-id=9, is-reentrant=true, call-type=REGULAR, execution-context=UNSPECIFIED
    Cdd_Dma_SetTransferWrapSrcProperties: service-id=10, is-reentrant=true, call-type=REGULAR, execution-context=UNSPECIFIED
    Cdd_Dma_SetTransferWrapDestProperties: service-id=11, is-reentrant=true, call-type=REGULAR, execution-context=UNSPECIFIED
    Cdd_Dma_EnablePeripheralEventTrigger: service-id=12, is-reentrant=true, call-type=REGULAR, execution-context=UNSPECIFIED
    Cdd_Dma_DisablePeripheralEventTrigger: service-id=13, is-reentrant=true, call-type=REGULAR, execution-context=UNSPECIFIED
    Cdd_Dma_SetPeripheralEventTriggerSource: service-id=14, is-reentrant=true, call-type=REGULAR, execution-context=UNSPECIFIED
    Cdd_Dma_StartChannelTransfer: service-id=15, is-reentrant=true, call-type=REGULAR, execution-context=UNSPECIFIED
    Cdd_Dma_StopChannelTransfer: service-id=16, is-reentrant=true, call-type=REGULAR, execution-context=UNSPECIFIED
    Cdd_Dma_ForcePeripheralEventTrigger: service-id=17, is-reentrant=true, call-type=REGULAR, execution-context=UNSPECIFIED
    Cdd_Dma_ClearPeripheralEventTrigger: service-id=18, is-reentrant=true, call-type=REGULAR, execution-context=UNSPECIFIED
    Cdd_Dma_TriggerSoftReset: service-id=19, is-reentrant=true, call-type=REGULAR, execution-context=UNSPECIFIED
    Cdd_Dma_SetChannelPriority: service-id=20, is-reentrant=true, call-type=REGULAR, execution-context=UNSPECIFIED
    Cdd_Dma_GetChannelStatus: service-id=21, is-reentrant=true, call-type=REGULAR, execution-context=UNSPECIFIED
    Cdd_Dma_ClearErrorFlag: service-id=22, is-reentrant=true, call-type=REGULAR, execution-context=UNSPECIFIED
    Cdd_Dma_SetChannelCommit: service-id=23, is-reentrant=false, call-type=REGULAR, execution-context=UNSPECIFIED
    Cdd_Dma_SetDmaCfgCommit: service-id=24, is-reentrant=false, call-type=REGULAR, execution-context=UNSPECIFIED
    Cdd_Dma_SetMpuRegionCommit: service-id=25, is-reentrant=false, call-type=REGULAR, execution-context=UNSPECIFIED
    Cdd_Dma_SetMpuCfgCommit: service-id=26, is-reentrant=false, call-type=REGULAR, execution-context=UNSPECIFIED
    Cdd_Dma_GetChannelPriority: service-id=27, is-reentrant=true, call-type=REGULAR, execution-context=UNSPECIFIED
    Cdd_Dma_PeriodicReadback: service-id=28, is-reentrant=true, call-type=REGULAR, execution-context=UNSPECIFIED
