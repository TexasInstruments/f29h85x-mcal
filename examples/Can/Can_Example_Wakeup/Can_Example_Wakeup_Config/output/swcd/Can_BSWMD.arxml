AUTOSAR XML (schema 00044)
package /Can_TI_F29H85x
  bsw module description Can: category=BSW_MODULE, module-id=80
    implemented-entrys:
      Can_1_Int0ISR
      Can_1_Int1ISR
      Can_DeInit
      Can_DisableControllerInterrupts
      Can_EnableControllerInterrupts
      Can_GetControllerErrorState
      Can_GetControllerMode
      Can_GetVersionInfo
      Can_Init
      Can_MainFunction_BusOff
      Can_MainFunction_Mode
      Can_MainFunction_Read_CanMainFunctionRWPeriods_0
      Can_MainFunction_Write_CanMainFunctionRWPeriods_0
      Can_MainFunction_Read_CanMainFunctionRWPeriods_1
      Can_MainFunction_Write_CanMainFunctionRWPeriods_1
      Can_MainFunction_Read_CanMainFunctionRWPeriods_2
      Can_MainFunction_Write_CanMainFunctionRWPeriods_2
      Can_SetControllerMode
      Can_Write
      Can_PeriodicReadback
    5 x bsw module dependency:
      CanIf: target-module-id=60, target-module=CanIf
      Dem: target-module-id=54, target-module=Dem
      Det: target-module-id=15, target-module=Det
      EcuM: target-module-id=10, target-module=EcuM
      Os: target-module-id=1, target-module=Os
    bsw internal behavior Can_Behavior
      exclusive area CAN_EXCLUSIVE_AREA_0
      exclusive area CAN_EXCLUSIVE_AREA_1
      bsw interrupt entity Can_1_Int0ISR: reentrancy-level=NON-REENTRANT, implemented-entry=Can_1_Int0ISR, interrupt-category=CAT-1
        bsw direct call point Det_ReportError: called-entry=Det_ReportError
      bsw interrupt entity Can_1_Int1ISR: reentrancy-level=NON-REENTRANT, implemented-entry=Can_1_Int1ISR, interrupt-category=CAT-1
        bsw direct call point Det_ReportError: called-entry=Det_ReportError
      7 x bsw called entity:
        Can_DeInit: reentrancy-level=NON-REENTRANT, implemented-entry=Can_DeInit
          bsw direct call point Det_ReportError: called-entry=Det_ReportError
        Can_DisableControllerInterrupts: can-enter-exclusive-area=CAN_EXCLUSIVE_AREA_0, reentrancy-level=SINGLE-CORE-REENTRANT, implemented-entry=Can_EnableControllerInterrupts
          bsw direct call point Det_ReportError: called-entry=Det_ReportError
        Can_EnableControllerInterrupts: can-enter-exclusive-area=CAN_EXCLUSIVE_AREA_0, reentrancy-level=SINGLE-CORE-REENTRANT, implemented-entry=Can_EnableControllerInterrupts
          bsw direct call point Det_ReportError: called-entry=Det_ReportError
        Can_GetControllerErrorState: reentrancy-level=SINGLE-CORE-REENTRANT, implemented-entry=Can_GetControllerErrorState
          bsw direct call point Det_ReportError: called-entry=Det_ReportError
        Can_GetControllerMode: reentrancy-level=NON-REENTRANT, implemented-entry=Can_GetControllerMode
          bsw direct call point Det_ReportError: called-entry=Det_ReportError
        Can_GetVersionInfo: reentrancy-level=SINGLE-CORE-REENTRANT, implemented-entry=Can_GetVersionInfo
          bsw direct call point Det_ReportError: called-entry=Det_ReportError
        Can_Init: reentrancy-level=NON-REENTRANT, implemented-entry=Can_Init
          bsw direct call point Det_ReportError: called-entry=Det_ReportError
      8 x bsw schedulable entity, all with reentrancy-level=NON-REENTRANT:
        Can_MainFunction_BusOff: implemented-entry=Can_MainFunction_BusOff
          bsw direct call point CanIf_ControllerBusOff: called-entry=CanIf_ControllerBusOff
          bsw direct call point Dem_SetEventStatus: called-entry=Dem_SetEventStatus
        Can_MainFunction_Mode: implemented-entry=Can_MainFunction_Mode
          bsw direct call point CanIf_ControllerModeIndication: called-entry=CanIf_ControllerModeIndication
        Can_MainFunction_Read_CanMainFunctionRWPeriods_0: implemented-entry=Can_MainFunction_Read_CanMainFunctionRWPeriods_0
          bsw direct call point CanIf_RxIndication: called-entry=CanIf_RxIndication
        Can_MainFunction_Write_CanMainFunctionRWPeriods_0: implemented-entry=Can_MainFunction_Write_CanMainFunctionRWPeriods_0
          bsw direct call point CanIf_TxConfirmation: called-entry=CanIf_TxConfirmation
        Can_MainFunction_Read_CanMainFunctionRWPeriods_1: implemented-entry=Can_MainFunction_Read_CanMainFunctionRWPeriods_1
          bsw direct call point CanIf_RxIndication: called-entry=CanIf_RxIndication
        Can_MainFunction_Write_CanMainFunctionRWPeriods_1: implemented-entry=Can_MainFunction_Write_CanMainFunctionRWPeriods_1
          bsw direct call point CanIf_TxConfirmation: called-entry=CanIf_TxConfirmation
        Can_MainFunction_Read_CanMainFunctionRWPeriods_2: implemented-entry=Can_MainFunction_Read_CanMainFunctionRWPeriods_2
          bsw direct call point CanIf_RxIndication: called-entry=CanIf_RxIndication
        Can_MainFunction_Write_CanMainFunctionRWPeriods_2: implemented-entry=Can_MainFunction_Write_CanMainFunctionRWPeriods_2
          bsw direct call point CanIf_TxConfirmation: called-entry=CanIf_TxConfirmation
      4 x bsw called entity:
        Can_SetControllerMode: reentrancy-level=NON-REENTRANT, implemented-entry=Can_SetControllerMode
          4 x bsw direct call point:
            Dem_SetEventStatus: called-entry=Dem_SetEventStatus
            Det_ReportError: called-entry=Det_ReportError
            GetCounterValue: called-entry=GetCounterValue
            GetElapsedValue: called-entry=GetElapsedValue
        Can_SetIcomConfiguration: reentrancy-level=SINGLE-CORE-REENTRANT, implemented-entry=Can_SetIcomConfiguration
          bsw direct call point CanIf_CurrentIcomConfiguration: called-entry=CanIf_CurrentIcomConfiguration
          bsw direct call point Det_ReportError: called-entry=Det_ReportError
        Can_Write: can-enter-exclusive-area=CAN_EXCLUSIVE_AREA_1, reentrancy-level=SINGLE-CORE-REENTRANT, implemented-entry=Can_Write
          4 x bsw direct call point:
            CanIf_TxConfirmation: called-entry=CanIf_TxConfirmation
            Det_ReportError: called-entry=Det_ReportError
            GetCounterValue: called-entry=GetCounterValue
            GetElapsedValue: called-entry=GetElapsedValue
        Can_PeriodicReadback: reentrancy-level=NON-REENTRANT, implemented-entry=Can_PeriodicReadback
          bsw direct call point Det_ReportError: called-entry=Det_ReportError
      8 x bsw timing event, all with period=0.01:
        Can_MainFunctionTimingEvent_BusOff: starts-on-event=Can_MainFunction_BusOff
        Can_MainFunctionTimingEvent_Mode: starts-on-event=Can_MainFunction_Mode
        Can_MainFunctionTimingEvent_Read_CanMainFunctionRWPeriods_0: starts-on-event=Can_MainFunction_Read_CanMainFunctionRWPeriods_0
        Can_MainFunctionTimingEvent_Write_CanMainFunctionRWPeriods_0: starts-on-event=Can_MainFunction_Write_CanMainFunctionRWPeriods_0
        Can_MainFunctionTimingEvent_Read_CanMainFunctionRWPeriods_1: starts-on-event=Can_MainFunction_Read_CanMainFunctionRWPeriods_1
        Can_MainFunctionTimingEvent_Write_CanMainFunctionRWPeriods_1: starts-on-event=Can_MainFunction_Write_CanMainFunctionRWPeriods_1
        Can_MainFunctionTimingEvent_Read_CanMainFunctionRWPeriods_2: starts-on-event=Can_MainFunction_Read_CanMainFunctionRWPeriods_2
        Can_MainFunctionTimingEvent_Write_CanMainFunctionRWPeriods_2: starts-on-event=Can_MainFunction_Write_CanMainFunctionRWPeriods_2
  bsw implementation Can_Impl: programming-language=C, sw-version=2.0.0, vendor-id=44, ar-release-version=4.3.1, behavior=Can_Behavior, vendor-specific-module-def=Can
    code-descriptors:
      code Files
        artifact-descriptors:
          short-label=generate::include::Can_Cfg.h, category=SWHDR
          short-label=generate::src::Can_PBcfg.c, category=SWSRC
          short-label=generate::src::Can_Cfg.c, category=SWSRC
          short-label=include::Can.h, category=SWHDR
          short-label=include::Can_Priv.h, category=SWHDR
          short-label=src::Can.c, category=SWSRC
          short-label=src::Can_Irq.c, category=SWSRC
          short-label=src::Can_Priv.c, category=SWSRC
    compiler c29clang: name=TI C29 Clang Compiler, vendor=Texas Instruments, version=1.0.0
    linker c29lnk: name=TI C29 Linker, vendor=Texas Instruments, version=1.0.0
    resource consumption ResourceConsumption
      7 x memory section:
        CAN_CODE: alignment=UNSPECIFIED, sw-addrmethod=CODE, symbol=CODE
        CAN_CONFIG_DATA: alignment=UNSPECIFIED, sw-addrmethod=CONST_PBCFG, symbol=CONFIG_DATA
        CAN_ISR_CODE: alignment=UNSPECIFIED, sw-addrmethod=CODE, symbol=ISR_CODE
        CAN_VAR_INIT_8: alignment=8, sw-addrmethod=VAR_INIT, symbol=VAR_INIT_8
        CAN_CONST_8: alignment=8, sw-addrmethod=CONST, symbol=CONST_8
        CAN_VAR_NO_INIT_UNSPECIFIED: alignment=UNSPECIFIED, sw-addrmethod=VAR_NO_INIT, symbol=VAR_NO_INIT_UNSPECIFIED
        CAN_VAR_INIT_UNSPECIFIED: alignment=UNSPECIFIED, sw-addrmethod=VAR_INIT, symbol=VAR_INIT_UNSPECIFIED
package /Can_TI_F29H85x/BSWModuleEntry
  34 x bsw module entry, all with sw-service-impl-policy=STANDARD, bsw-entry-kind=CONCRETE:
    Can_1_Int0ISR: is-reentrant=false, is-synchronous=true, call-type=INTERRUPT, execution-context=INTERRUPT-CAT-1
    Can_1_Int1ISR: is-reentrant=false, is-synchronous=true, call-type=INTERRUPT, execution-context=INTERRUPT-CAT-1
    Can_2_Int0ISR: is-reentrant=false, is-synchronous=true, call-type=INTERRUPT, execution-context=INTERRUPT-CAT-2
    Can_2_Int1ISR: is-reentrant=false, is-synchronous=true, call-type=INTERRUPT, execution-context=INTERRUPT-CAT-2
    Can_3_Int0ISR: is-reentrant=false, is-synchronous=true, call-type=INTERRUPT, execution-context=INTERRUPT-CAT-2
    Can_3_Int1ISR: is-reentrant=false, is-synchronous=true, call-type=INTERRUPT, execution-context=INTERRUPT-CAT-2
    Can_4_Int0ISR: is-reentrant=false, is-synchronous=true, call-type=INTERRUPT, execution-context=INTERRUPT-CAT-2
    Can_4_Int1ISR: is-reentrant=false, is-synchronous=true, call-type=INTERRUPT, execution-context=INTERRUPT-CAT-2
    Can_5_Int0ISR: is-reentrant=false, is-synchronous=true, call-type=INTERRUPT, execution-context=INTERRUPT-CAT-2
    Can_5_Int1ISR: is-reentrant=false, is-synchronous=true, call-type=INTERRUPT, execution-context=INTERRUPT-CAT-2
    Can_6_Int0ISR: is-reentrant=false, is-synchronous=true, call-type=INTERRUPT, execution-context=INTERRUPT-CAT-2
    Can_6_Int1ISR: is-reentrant=false, is-synchronous=true, call-type=INTERRUPT, execution-context=INTERRUPT-CAT-2
    Can_CheckWakeup: service-id=11, is-reentrant=false, is-synchronous=true, call-type=REGULAR, execution-context=UNSPECIFIED
    Can_DeInit: service-id=16, is-reentrant=false, is-synchronous=true, call-type=REGULAR, execution-context=UNSPECIFIED
    Can_DisableControllerInterrupts: service-id=4, is-reentrant=true, is-synchronous=true, call-type=REGULAR, execution-context=UNSPECIFIED
    Can_EnableControllerInterrupts: service-id=5, is-reentrant=true, is-synchronous=true, call-type=REGULAR, execution-context=UNSPECIFIED
    Can_GetControllerErrorState: service-id=17, is-reentrant=true, is-synchronous=true, call-type=REGULAR, execution-context=UNSPECIFIED
    Can_GetControllerMode: service-id=18, is-reentrant=false, is-synchronous=true, call-type=REGULAR, execution-context=UNSPECIFIED
    Can_GetVersionInfo: service-id=7, is-reentrant=true, is-synchronous=true, call-type=REGULAR, execution-context=UNSPECIFIED
    Can_Init: service-id=0, is-reentrant=false, is-synchronous=true, call-type=REGULAR, execution-context=UNSPECIFIED
    Can_MainFunction_BusOff: service-id=9, is-reentrant=false, is-synchronous=false, call-type=SCHEDULED, execution-context=UNSPECIFIED
    Can_MainFunction_Mode: service-id=12, is-reentrant=false, is-synchronous=false, call-type=SCHEDULED, execution-context=UNSPECIFIED
    Can_MainFunction_Read_CanMainFunctionRWPeriods_0: service-id=8, is-reentrant=false, is-synchronous=false, call-type=SCHEDULED, execution-context=UNSPECIFIED
    Can_MainFunction_Write_CanMainFunctionRWPeriods_0: service-id=1, is-reentrant=false, is-synchronous=false, call-type=SCHEDULED, execution-context=UNSPECIFIED
    Can_MainFunction_Read_CanMainFunctionRWPeriods_1: service-id=8, is-reentrant=false, is-synchronous=false, call-type=SCHEDULED, execution-context=UNSPECIFIED
    Can_MainFunction_Write_CanMainFunctionRWPeriods_1: service-id=1, is-reentrant=false, is-synchronous=false, call-type=SCHEDULED, execution-context=UNSPECIFIED
    Can_MainFunction_Read_CanMainFunctionRWPeriods_2: service-id=8, is-reentrant=false, is-synchronous=false, call-type=SCHEDULED, execution-context=UNSPECIFIED
    Can_MainFunction_Write_CanMainFunctionRWPeriods_2: service-id=1, is-reentrant=false, is-synchronous=false, call-type=SCHEDULED, execution-context=UNSPECIFIED
    Can_MainFunction_Wakeup: service-id=10, is-reentrant=false, is-synchronous=false, call-type=SCHEDULED, execution-context=UNSPECIFIED
    Can_SetBaudrate: service-id=15, is-reentrant=true, is-synchronous=true, call-type=REGULAR, execution-context=UNSPECIFIED
    Can_SetControllerMode: service-id=3, is-reentrant=false, is-synchronous=false, call-type=REGULAR, execution-context=UNSPECIFIED
    Can_SetIcomConfiguration: service-id=33, is-reentrant=true, is-synchronous=false, call-type=REGULAR, execution-context=UNSPECIFIED
    Can_Write: service-id=6, is-reentrant=true, is-synchronous=true, call-type=REGULAR, execution-context=UNSPECIFIED
    Can_PeriodicReadback: service-id=34, is-reentrant=false, is-synchronous=false, call-type=REGULAR, execution-context=UNSPECIFIED
