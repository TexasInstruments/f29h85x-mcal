AUTOSAR XML (schema 00044)
package /Cdd_Sent_TI_F29H85x
  bsw module description Cdd_Sent: expected-entrys=[Cdd_Sent_Deinit, Cdd_Sent_Transmit], implemented-entrys=[Cdd_Sent_1_ISR, Cdd_Sent_2_ISR, Cdd_Sent_3_ISR, Cdd_Sent_4_ISR, Cdd_Sent_5_ISR, Cdd_Sent_6_ISR, Cdd_Sent_Init]
    bsw module dependency PduR: target-module-id=51
    bsw internal behavior Cdd_Sent_Behavior
      6 x bsw interrupt entity, all with reentrancy-level=NON-REENTRANT, interrupt-category=CAT-1:
        Cdd_Sent_1_ISR: implemented-entry=Cdd_Sent_1_ISR
          bsw direct call point PduR_Cdd_Sent_RxIndication: called-entry=PduR_Cdd_Sent_RxIndication
        Cdd_Sent_2_ISR: implemented-entry=Cdd_Sent_2_ISR
          bsw direct call point PduR_Cdd_Sent_RxIndication: called-entry=PduR_Cdd_Sent_RxIndication
        Cdd_Sent_3_ISR: implemented-entry=Cdd_Sent_3_ISR
          bsw direct call point PduR_Cdd_Sent_RxIndication: called-entry=PduR_Cdd_Sent_RxIndication
        Cdd_Sent_4_ISR: implemented-entry=Cdd_Sent_4_ISR
          bsw direct call point PduR_Cdd_Sent_RxIndication: called-entry=PduR_Cdd_Sent_RxIndication
        Cdd_Sent_5_ISR: implemented-entry=Cdd_Sent_5_ISR
          bsw direct call point PduR_Cdd_Sent_RxIndication: called-entry=PduR_Cdd_Sent_RxIndication
        Cdd_Sent_6_ISR: implemented-entry=Cdd_Sent_6_ISR
          bsw direct call point PduR_Cdd_Sent_RxIndication: called-entry=PduR_Cdd_Sent_RxIndication
      4 x bsw called entity:
        Cdd_Sent_Deinit: reentrancy-level=NON-REENTRANT, implemented-entry=Cdd_Sent_Deinit
        Cdd_Sent_GetVersionInfo: reentrancy-level=SINGLE-CORE-REENTRANT, implemented-entry=Cdd_Sent_GetVersionInfo
        Cdd_Sent_Init: reentrancy-level=NON-REENTRANT, implemented-entry=Cdd_Sent_Init
        Cdd_Sent_Transmit: reentrancy-level=NON-REENTRANT, implemented-entry=Cdd_Sent_Transmit
  bsw implementation Cdd_Sent_Impl: sw-version=2.0.1, vendor-id=44, ar-release-version=4.3.1, behavior=Cdd_Sent_Behavior, vendor-specific-module-def=Cdd
    code-descriptors:
      code Files
        artifact-descriptors:
          short-label=generate::Cdd_Sent_Cfg.c, category=SWSRC
          short-label=generate::Cdd_Sent_Cfg.h, category=SWHDR
          short-label=generate::Cdd_Sent_Cbk.h, category=SWHDR
          short-label=include::Cdd_Sent.h, category=SWHDR
          short-label=include::Cdd_Sent_Priv.h, category=SWHDR
          short-label=src::Cdd_Sent.c, category=SWSRC
          short-label=src::Cdd_Sent_Irq.c, category=SWSRC
          short-label=src::Cdd_Sent_Priv.c, category=SWSRC
    compiler TI_C29Clang: name=TI_C29Clang, vendor=Texas Instruments, version=2.0.0
    linker TI_C29Linker: name=TI_C29Linker, vendor=Texas Instruments, version=2.0.0
    resource consumption MemoryMappedSections
      5 x memory section:
        CDD_SENT_CODE: alignment=UNSPECIFIED, sw-addrmethod=CODE, symbol=CODE
        CDD_SENT_CONFIG_DATA: alignment=UNSPECIFIED, sw-addrmethod=CONST_PBCFG, symbol=CONFIG_DATA
        CDD_SENT_ISR_CODE: alignment=UNSPECIFIED, sw-addrmethod=CODE, symbol=ISR_CODE
        CDD_SENT_VAR_INIT_BOOLEAN: alignment=BOOLEAN, sw-addrmethod=VAR_INIT, symbol=VAR_INIT_BOOLEAN
        CDD_SENT_VAR_INIT_UNSPECIFIED: alignment=UNSPECIFIED, sw-addrmethod=VAR_INIT, symbol=VAR_INIT_UNSPECIFIED
package /Cdd_Sent_TI_F29H85x/Cdd_Sent_ModuleEntry
  10 x bsw module entry, all with is-synchronous=true, sw-service-impl-policy=STANDARD, bsw-entry-kind=CONCRETE:
    Cdd_Sent_{1..6}_ISR: is-reentrant=false, call-type=INTERRUPT, execution-context=INTERRUPT-CAT-1
    Cdd_Sent_Deinit: service-id=2, is-reentrant=false, call-type=REGULAR, execution-context=UNSPECIFIED
    Cdd_Sent_GetVersionInfo: service-id=0, is-reentrant=true, call-type=REGULAR, execution-context=UNSPECIFIED
    Cdd_Sent_Init: service-id=1, is-reentrant=false, call-type=REGULAR, execution-context=UNSPECIFIED
    Cdd_Sent_Transmit: service-id=3, is-reentrant=false, call-type=REGULAR, execution-context=UNSPECIFIED
