AUTOSAR XML (schema 00044)
package /Port_TI_F29H85x
  bsw module description Port: category=BSW_MODULE, module-id=124
    implemented-entrys:
      Port_GetVersionInfo
      Port_Init
      Port_CommitConfiguration
      Port_RefreshPinDirection
      Port_SetPinDirection
      Port_SetPinMode
    bsw module dependency Det: target-module-id=15, target-module=Det
    bsw internal behavior Port_Behaviour
      exclusive area PORT_EXCLUSIVE_AREA_0
      6 x bsw called entity:
        Port_CommitConfiguration: reentrancy-level=NON-REENTRANT, implemented-entry=Port_CommitConfiguration
          bsw direct call point Det_ReportError: called-entry=Det_ReportError
        Port_GetVersionInfo: reentrancy-level=SINGLE-CORE-REENTRANT, implemented-entry=Port_GetVersionInfo
          bsw direct call point Det_ReportError: called-entry=Det_ReportError
        Port_Init: reentrancy-level=NON-REENTRANT, implemented-entry=Port_Init
          bsw direct call point Det_ReportError: called-entry=Det_ReportError
        Port_RefreshPinDirection: can-enter-exclusive-area=PORT_EXCLUSIVE_AREA_0, reentrancy-level=NON-REENTRANT, implemented-entry=Port_RefreshPinDirection
          bsw direct call point Det_ReportError: called-entry=Det_ReportError
        Port_SetPinDirection: can-enter-exclusive-area=PORT_EXCLUSIVE_AREA_0, reentrancy-level=SINGLE-CORE-REENTRANT, implemented-entry=Port_SetPinDirection
          bsw direct call point Det_ReportError: called-entry=Det_ReportError
        Port_SetPinMode: can-enter-exclusive-area=PORT_EXCLUSIVE_AREA_0, reentrancy-level=SINGLE-CORE-REENTRANT, implemented-entry=Port_SetPinMode
          bsw direct call point Det_ReportError: called-entry=Det_ReportError
  bsw implementation Port_Impl: programming-language=C, sw-version=4.1.0, vendor-id=44, ar-release-version=4.3.1, behavior=Port_Behaviour, vendor-specific-module-def=Port
    code-descriptors:
      code Files
        artifact-descriptors:
          short-label=generate::include::Port_Cfg.h, category=SWHDR
          short-label=generate::src::Port_Cfg.c, category=SWSRC
          short-label=generate::src::Port_PBCfg.c, category=SWSRC
          short-label=include::Port.h, category=SWHDR
          short-label=include::Port_Pin_Map.h, category=SWHDR
          short-label=include::Port_Priv.h, category=SWHDR
          short-label=src::Port.c, category=SWSRC
          short-label=src::Port_Priv.c, category=SWSRC
    compiler TI_C29Clang: name=TI_C29Clang, vendor=Texas Instruments, version=2.2.0
    linker TI_C29Linker: name=TI_C29Linker, vendor=Texas Instruments, version=2.2.0
    resource consumption ResourceConsumption
      4 x memory section:
        PORT_CODE: alignment=UNSPECIFIED, sw-addrmethod=CODE, symbol=CODE
        PORT_CONFIG_DATA: alignment=UNSPECIFIED, sw-addrmethod=CONST_PBCFG, symbol=CONFIG_DATA
        PORT_VAR_INIT_PTR: alignment=UNSPECIFIED, sw-addrmethod=VAR_INIT, symbol=VAR_INIT_PTR
        PORT_VAR_INIT_BOOLEAN: alignment=BOOLEAN, sw-addrmethod=VAR_INIT, symbol=VAR_INIT_BOOLEAN
package /Port_TI_F29H85x/BSWModuleEntry
  6 x bsw module entry, all with is-synchronous=true, call-type=REGULAR, execution-context=UNSPECIFIED, sw-service-impl-policy=STANDARD, bsw-entry-kind=CONCRETE:
    Port_CommitConfiguration: service-id=5, is-reentrant=false
    Port_GetVersionInfo: service-id=3, is-reentrant=true
    Port_Init: service-id=0, is-reentrant=false
    Port_RefreshPinDirection: service-id=2, is-reentrant=false
    Port_SetPinDirection: service-id=1, is-reentrant=true
    Port_SetPinMode: service-id=4, is-reentrant=true
