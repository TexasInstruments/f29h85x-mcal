AUTOSAR XML (schema 00044)
package /Cdd_Pwm_TI_F29H85x
  bsw module description Cdd_Pwm: category=BSW_MODULE, module-id=255
    implemented-entrys:
      Cdd_Pwm_Epwm{1..4}_IntIsr
      Cdd_Pwm_Epwm7_IntIsr
      Cdd_Pwm_EnableNotification
      Cdd_Pwm_DisableNotification
      Cdd_Pwm_GetVersionInfo
      Cdd_Pwm_Init
      Cdd_Pwm_SetInterruptEventCount
      Cdd_Pwm_SetEmulationMode
      Cdd_Pwm_ConfigureTripZoneNotification
      Cdd_Pwm_SetTimeBaseCounter
      Cdd_Pwm_SetCountModeAfterSync
      Cdd_Pwm_SetClockPrescaler
      Cdd_Pwm_ForceSyncPulse
      Cdd_Pwm_SetSyncInPulseSource
      Cdd_Pwm_ConfigureSyncOutPulseSource
      Cdd_Pwm_SetOneShotSyncOutTrigger
      Cdd_Pwm_SetPeriodLoadMode
      Cdd_Pwm_ConfigurePhaseShiftLoad
      Cdd_Pwm_SetTimeBaseCounterMode
      Cdd_Pwm_SelectPeriodLoadEvent
      Cdd_Pwm_ConfigureOneShotSync
      Cdd_Pwm_StartOneShotSync
      Cdd_Pwm_GetTimeBaseCounterValue
      Cdd_Pwm_GetTimeBaseCounterOverflowStatus
      Cdd_Pwm_ClearTimeBaseCounterOverflowEvent
      Cdd_Pwm_GetSyncStatus
      Cdd_Pwm_ClearSyncEvent
      Cdd_Pwm_GetTimeBaseCounterDirection
      Cdd_Pwm_SetPhaseShift
      Cdd_Pwm_SetTimeBasePeriod
      Cdd_Pwm_GetTimeBasePeriod
      Cdd_Pwm_SetCounterCompareShadowLoadMode
      Cdd_Pwm_DisableCounterCompareShadowLoadMode
      Cdd_Pwm_SetCounterCompareValue
      Cdd_Pwm_GetCounterCompareValue
      Cdd_Pwm_GetCounterCompareShadowStatus
      Cdd_Pwm_ConfigureLinkDutyHR
      Cdd_Pwm_SetActionQualifierShadowLoadMode
      Cdd_Pwm_DisableActionQualifierShadowLoadMode
      Cdd_Pwm_SetActionQualifierT1TriggerSource
      Cdd_Pwm_SetActionQualifierT2TriggerSource
      Cdd_Pwm_SetActionQualifierAction
      Cdd_Pwm_SetActionQualifierActionComplete
      Cdd_Pwm_SetAdditionalActionQualifierActionComplete
      Cdd_Pwm_SetActionQualifierContSwForceShadowMode
      Cdd_Pwm_SetActionQualifierContSwForceAction
      Cdd_Pwm_SetActionQualifierSwAction
      Cdd_Pwm_ForceActionQualifierSwAction
      Cdd_Pwm_SetDeadBandOutputSwapMode
      Cdd_Pwm_SetDeadBandDelayMode
      Cdd_Pwm_SetDeadBandDelayPolarity
      Cdd_Pwm_SetRisingEdgeDeadBandDelayInput
      Cdd_Pwm_SetFallingEdgeDeadBandDelayInput
      Cdd_Pwm_SetDeadBandControlShadowLoadMode
      Cdd_Pwm_DisableDeadBandControlShadowLoadMode
      Cdd_Pwm_SetRisingEdgeDelayCountShadowLoadMode
      Cdd_Pwm_DisableRisingEdgeDelayCountShadowLoadMode
      Cdd_Pwm_SetFallingEdgeDelayCountShadowLoadMode
      Cdd_Pwm_DisableFallingEdgeDelayCountShadowLoadMode
      Cdd_Pwm_SetDeadBandCounterClock
      Cdd_Pwm_SetRisingEdgeDelayCount
      Cdd_Pwm_SetFallingEdgeDelayCount
      Cdd_Pwm_ConfigureChopper
      Cdd_Pwm_SetChopperDutyCycle
      Cdd_Pwm_SetChopperFreq
      Cdd_Pwm_SetChopperFirstPulseWidth
      Cdd_Pwm_ConfigureTripZoneSignals
      Cdd_Pwm_SetTripZoneDigitalCompareEventCondition
      Cdd_Pwm_ConfigureTripZoneAdvAction
      Cdd_Pwm_SetTripZoneAction
      Cdd_Pwm_SetTripZoneAdvAction
      Cdd_Pwm_SetTripZoneAdvDigitalCompareAction
      Cdd_Pwm_ConfigureTripZoneInterrupt
      Cdd_Pwm_GetTripZoneFlagStatus
      Cdd_Pwm_GetCycleByCycleTripZoneFlagStatus
      Cdd_Pwm_GetOneShotTripZoneFlagStatus
      Cdd_Pwm_SelectCycleByCycleTripZoneClearEvent
      Cdd_Pwm_ClearTripZoneFlag
      Cdd_Pwm_ClearCycleByCycleTripZoneFlag
      Cdd_Pwm_ClearOneShotTripZoneFlag
      Cdd_Pwm_ForceTripZoneEvent
      Cdd_Pwm_ConfigureTripOutSource
      Cdd_Pwm_ConfigureInterrupt
      Cdd_Pwm_SetInterruptSource
      Cdd_Pwm_GetEventTriggerInterruptStatus
      Cdd_Pwm_ClearEventTriggerInterruptFlag
      Cdd_Pwm_ConfigureInterruptEventCountInit
      Cdd_Pwm_ForceInterruptEventCountInit
      Cdd_Pwm_SetInterruptEventCountInitValue
      Cdd_Pwm_GetInterruptEventCount
      Cdd_Pwm_ForceEventTriggerInterrupt
      Cdd_Pwm_SetMixEvtTriggerSource
      Cdd_Pwm_ConfigureAdcTrigger
      Cdd_Pwm_SetAdcTriggerSource
      Cdd_Pwm_SetAdcTriggerEventPrescale
      Cdd_Pwm_GetAdcTriggerFlagStatus
      Cdd_Pwm_ClearAdcTriggerFlag
      Cdd_Pwm_ConfigureAdcTriggerEventCountInit
      Cdd_Pwm_ForceAdcTriggerEventCountInit
      Cdd_Pwm_SetAdcTriggerEventCountInitValue
      Cdd_Pwm_GetAdcTriggerEventCount
      Cdd_Pwm_ForceAdcTrigger
      Cdd_Pwm_SelectDigitalCompareTripInput
      Cdd_Pwm_ConfigureDigitalCompareBlankingWindow
      Cdd_Pwm_ConfigureDigitalCompareWindowInverseMode
      Cdd_Pwm_SetDigitalCompareBlankingEvent
      Cdd_Pwm_SetDigitalCompareFilterInput
      Cdd_Pwm_ConfigureDigitalCompareEdgeFilter
      Cdd_Pwm_SetDigitalCompareEdgeFilterMode
      Cdd_Pwm_SetDigitalCompareEdgeFilterEdgeCount
      Cdd_Pwm_GetDigitalCompareEdgeFilterEdgeCount
      Cdd_Pwm_GetDigitalCompareEdgeFilterEdgeStatus
      Cdd_Pwm_SetDigitalCompareWindowOffset
      Cdd_Pwm_SetDigitalCompareWindowLength
      Cdd_Pwm_GetDigitalCompareBlankingWindowOffsetCount
      Cdd_Pwm_GetDigitalCompareBlankingWindowLengthCount
      Cdd_Pwm_SetDigitalCompareEventSource
      Cdd_Pwm_SetDigitalCompareEventSyncMode
      Cdd_Pwm_ConfigureDigitalCompareAdcTrigger
      Cdd_Pwm_ConfigureDigitalCompareSyncEvent
      Cdd_Pwm_SetDigitalCompareCBCLatchMode
      Cdd_Pwm_SelectDigitalCompareCBCLatchClearEvent
      Cdd_Pwm_GetDigitalCompareCBCLatchStatus
      Cdd_Pwm_ConfigureDigitalCompareCounterCapture
      Cdd_Pwm_SetDigitalCompareCounterShadowMode
      Cdd_Pwm_GetDigitalCompareCaptureStatus
      Cdd_Pwm_ConfigureDigitalCompareCounterCaptureMode
      Cdd_Pwm_ClearDigitalCompareCaptureStatusFlag
      Cdd_Pwm_GetDigitalCompareCaptureCount
      Cdd_Pwm_ConfigureDigitalCompareTripCombinationInput
      Cdd_Pwm_ConfigureCaptureInEvent
      Cdd_Pwm_ConfigCaptureGateInputPolarity
      Cdd_Pwm_InvertCaptureInputPolarity
      Cdd_Pwm_ConfigureIndependentPulseLogic
      Cdd_Pwm_ForceCaptureEventLoad
      Cdd_Pwm_SelectCaptureTripInput
      Cdd_Pwm_ConfigureCaptureTripCombinationInput
      Cdd_Pwm_ConfigureValleyCapture
      Cdd_Pwm_StartValleyCapture
      Cdd_Pwm_SetValleyTriggerSource
      Cdd_Pwm_SetValleyTriggerEdgeCounts
      Cdd_Pwm_ConfigureValleyHwDelay
      Cdd_Pwm_SetValleySwDelayValue
      Cdd_Pwm_SetValleyDelayDivider
      Cdd_Pwm_GetValleyEdgeStatus
      Cdd_Pwm_GetValleyCount
      Cdd_Pwm_GetValleyHwDelay
      Cdd_Pwm_ConfigureGlobalLoad
      Cdd_Pwm_SetGlobalLoadTrigger
      Cdd_Pwm_SetGlobalLoadEventPrescale
      Cdd_Pwm_GetGlobalLoadEventCount
      Cdd_Pwm_ConfigureGlobalLoadOneShotMode
      Cdd_Pwm_SetGlobalLoadOneShotLatch
      Cdd_Pwm_ForceGlobalLoadOneShotEvent
      Cdd_Pwm_ConfigureGlobalLoadRegisters
      Cdd_Pwm_LockRegisters
      Cdd_Pwm_ConfigureXCmpMode
      Cdd_Pwm_ConfigureSplitXCmp
      Cdd_Pwm_AllocAXCmp
      Cdd_Pwm_AllocBXCmp
      Cdd_Pwm_SetXCmpRegValue
      Cdd_Pwm_SetCmpShadowRegValue
      Cdd_Pwm_SetXMinMaxRegValue
      Cdd_Pwm_SetXCmpActionQualifierAction
      Cdd_Pwm_EnableXLoad
      Cdd_Pwm_ForceXLoad
      Cdd_Pwm_SetXCmpLoadMode
      Cdd_Pwm_SetXCmpShadowLevel
      Cdd_Pwm_SetXCmpShadowBufPtrLoadOnce
      Cdd_Pwm_SetXCmpShadowRepeatBufxCount
      Cdd_Pwm_ConfigureMinimumDeadBand
      Cdd_Pwm_InvertMinimumDeadBandSignal
      Cdd_Pwm_SelectMinimumDeadBandAndOrLogic
      Cdd_Pwm_SelectMinimumDeadBandBlockingSignal
      Cdd_Pwm_SelectMinimumDeadBandReferenceSignal
      Cdd_Pwm_GetMinDeadBandDelay
      Cdd_Pwm_SetMinimumDeadBandDelay
      Cdd_Pwm_ConfigureIllegalComboLogic
      Cdd_Pwm_SelectXbarInput
      Cdd_Pwm_SetLutDecX
      Cdd_Pwm_ConfigureDiodeEmulationMode
      Cdd_Pwm_SetDiodeEmulationMode
      Cdd_Pwm_SetDiodeEmulationReentryDelay
      Cdd_Pwm_ConfigureDiodeEmulationTripLowSources
      Cdd_Pwm_ConfigureDiodeEmulationTripHighSources
      Cdd_Pwm_SelectDiodeEmulationPwmSignal
      Cdd_Pwm_SelectDiodeEmulationTripSignal
      Cdd_Pwm_NoBypassDiodeEmulationLogic
      Cdd_Pwm_ByPassDiodeEmulationLogic
      Cdd_Pwm_ForceDiodeEmulationActive
      Cdd_Pwm_ConfigureDiodeEmulationMonitorModeControl
      Cdd_Pwm_SetDiodeEmulationMonitorModeStep
      Cdd_Pwm_SetDiodeEmulationMonitorCounterThreshold
      Cdd_Pwm_ClearDiodeEmulationActiveFlag
      Cdd_Pwm_HrpwmSetPhaseShift
      Cdd_Pwm_HrpwmSetHiResPhaseShiftOnly
      Cdd_Pwm_HrpwmSetTimeBasePeriod
      Cdd_Pwm_HrpwmSetHiResTimeBasePeriodOnly
      Cdd_Pwm_HrpwmGetTimeBasePeriod
      Cdd_Pwm_HrpwmGetHiResTimeBasePeriodOnly
      Cdd_Pwm_HrpwmSetMepEdgeSelect
      Cdd_Pwm_HrpwmSetMepControlMode
      Cdd_Pwm_HrpwmSetCounterCompareShadowLoadEvent
      Cdd_Pwm_HrpwmSetOutputSwapMode
      Cdd_Pwm_HrpwmSetChannelBOutputPath
      Cdd_Pwm_HrpwmConfigureAutoConversion
      Cdd_Pwm_HrpwmConfigurePeriodControl
      Cdd_Pwm_HrpwmConfigurePhaseShiftLoad
      Cdd_Pwm_HrpwmSetSyncPulseSource
      Cdd_Pwm_HrpwmSetTranslatorRemainder
      Cdd_Pwm_HrpwmSetCounterCompareValue
      Cdd_Pwm_HrpwmSetHiResCounterCompareValueOnly
      Cdd_Pwm_HrpwmGetCounterCompareValue
      Cdd_Pwm_GetHiResCounterCompareValueOnly
      Cdd_Pwm_HrpwmSetRisingEdgeDelay
      Cdd_Pwm_HrpwmSetHiResRisingEdgeDelayOnly
      Cdd_Pwm_HrpwmSetFallingEdgeDelay
      Cdd_Pwm_HrpwmSetMepStep
      Cdd_Pwm_HrpwmSetDeadbandMepEdgeSelect
      Cdd_Pwm_HrpwmSetRisingEdgeDelayLoadMode
      Cdd_Pwm_HrpwmSetFallingEdgeDelayLoadMode
      Cdd_Pwm_HrpwmLockRegisters
      Cdd_Pwm_HrpwmSetXCmpRegValue
      Cdd_Pwm_HrpwmSetHiResXCmpRegValueOnly
      Cdd_Pwm_ConfigureTripZone2Signals
      Cdd_Pwm_Sfo
    bsw module dependency Det: target-module-id=15, target-module=Det
    bsw internal behavior Cdd_Pwm_Behavior
      exclusive area CDD_PWM_EXCLUSIVE_AREA_0
      5 x bsw interrupt entity, all with reentrancy-level=NON-REENTRANT, interrupt-category=CAT-1:
        Cdd_Pwm_Epwm{1..4}_IntIsr: implemented-entry=Cdd_Pwm_Epwm{1..4}_IntIsr
        Cdd_Pwm_Epwm7_IntIsr: implemented-entry=Cdd_Pwm_Epwm7_IntIsr
      224 x bsw called entity:
        Cdd_Pwm_Init: reentrancy-level=NON-REENTRANT, implemented-entry=Cdd_Pwm_Init
          bsw direct call point Det: called-entry=Det_ReportError
        Cdd_Pwm_SetInterruptEventCount: reentrancy-level=NON-REENTRANT, implemented-entry=Cdd_Pwm_SetInterruptEventCount
          bsw direct call point Det: called-entry=Det_ReportError
        Cdd_Pwm_GetVersionInfo: reentrancy-level=SINGLE-CORE-REENTRANT, implemented-entry=Cdd_Pwm_GetVersionInfo
          bsw direct call point Det: called-entry=Det_ReportError
        Cdd_Pwm_EnableNotification: can-enter-exclusive-area=CDD_PWM_EXCLUSIVE_AREA_0, reentrancy-level=SINGLE-CORE-REENTRANT, implemented-entry=Cdd_Pwm_EnableNotification
          bsw direct call point Det: called-entry=Det_ReportError
        Cdd_Pwm_DisableNotification: can-enter-exclusive-area=CDD_PWM_EXCLUSIVE_AREA_0, reentrancy-level=SINGLE-CORE-REENTRANT, implemented-entry=Cdd_Pwm_DisableNotification
          bsw direct call point Det: called-entry=Det_ReportError
        Cdd_Pwm_SetEmulationMode: reentrancy-level=NON-REENTRANT, implemented-entry=Cdd_Pwm_SetEmulationMode
          bsw direct call point Det: called-entry=Det_ReportError
        Cdd_Pwm_ConfigureTripZoneNotification: can-enter-exclusive-area=CDD_PWM_EXCLUSIVE_AREA_0, reentrancy-level=SINGLE-CORE-REENTRANT, implemented-entry=Cdd_Pwm_ConfigureTripZoneNotification
          bsw direct call point Det: called-entry=Det_ReportError
        Cdd_Pwm_SetTimeBaseCounter: reentrancy-level=NON-REENTRANT, implemented-entry=Cdd_Pwm_SetTimeBaseCounter
          bsw direct call point Det: called-entry=Det_ReportError
        Cdd_Pwm_SetCountModeAfterSync: reentrancy-level=NON-REENTRANT, implemented-entry=Cdd_Pwm_SetCountModeAfterSync
          bsw direct call point Det: called-entry=Det_ReportError
        Cdd_Pwm_SetClockPrescaler: reentrancy-level=NON-REENTRANT, implemented-entry=Cdd_Pwm_SetClockPrescaler
          bsw direct call point Det: called-entry=Det_ReportError
        Cdd_Pwm_ForceSyncPulse: reentrancy-level=NON-REENTRANT, implemented-entry=Cdd_Pwm_ForceSyncPulse
          bsw direct call point Det: called-entry=Det_ReportError
        Cdd_Pwm_SetSyncInPulseSource: reentrancy-level=NON-REENTRANT, implemented-entry=Cdd_Pwm_SetSyncInPulseSource
          bsw direct call point Det: called-entry=Det_ReportError
        Cdd_Pwm_ConfigureSyncOutPulseSource: reentrancy-level=NON-REENTRANT, implemented-entry=Cdd_Pwm_ConfigureSyncOutPulseSource
          bsw direct call point Det: called-entry=Det_ReportError
        Cdd_Pwm_SetOneShotSyncOutTrigger: reentrancy-level=NON-REENTRANT, implemented-entry=Cdd_Pwm_SetOneShotSyncOutTrigger
          bsw direct call point Det: called-entry=Det_ReportError
        Cdd_Pwm_SetPeriodLoadMode: reentrancy-level=NON-REENTRANT, implemented-entry=Cdd_Pwm_SetPeriodLoadMode
          bsw direct call point Det: called-entry=Det_ReportError
        Cdd_Pwm_ConfigurePhaseShiftLoad: reentrancy-level=NON-REENTRANT, implemented-entry=Cdd_Pwm_ConfigurePhaseShiftLoad
          bsw direct call point Det: called-entry=Det_ReportError
        Cdd_Pwm_SetTimeBaseCounterMode: reentrancy-level=NON-REENTRANT, implemented-entry=Cdd_Pwm_SetTimeBaseCounterMode
          bsw direct call point Det: called-entry=Det_ReportError
        Cdd_Pwm_SelectPeriodLoadEvent: reentrancy-level=NON-REENTRANT, implemented-entry=Cdd_Pwm_SelectPeriodLoadEvent
          bsw direct call point Det: called-entry=Det_ReportError
        Cdd_Pwm_ConfigureOneShotSync: reentrancy-level=NON-REENTRANT, implemented-entry=Cdd_Pwm_ConfigureOneShotSync
          bsw direct call point Det: called-entry=Det_ReportError
        Cdd_Pwm_StartOneShotSync: reentrancy-level=NON-REENTRANT, implemented-entry=Cdd_Pwm_StartOneShotSync
          bsw direct call point Det: called-entry=Det_ReportError
        Cdd_Pwm_GetTimeBaseCounterValue: reentrancy-level=NON-REENTRANT, implemented-entry=Cdd_Pwm_GetTimeBaseCounterValue
          bsw direct call point Det: called-entry=Det_ReportError
        Cdd_Pwm_GetTimeBaseCounterOverflowStatus: reentrancy-level=NON-REENTRANT, implemented-entry=Cdd_Pwm_GetTimeBaseCounterOverflowStatus
          bsw direct call point Det: called-entry=Det_ReportError
        Cdd_Pwm_ClearTimeBaseCounterOverflowEvent: reentrancy-level=NON-REENTRANT, implemented-entry=Cdd_Pwm_ClearTimeBaseCounterOverflowEvent
          bsw direct call point Det: called-entry=Det_ReportError
        Cdd_Pwm_GetSyncStatus: reentrancy-level=NON-REENTRANT, implemented-entry=Cdd_Pwm_GetSyncStatus
          bsw direct call point Det: called-entry=Det_ReportError
        Cdd_Pwm_ClearSyncEvent: reentrancy-level=NON-REENTRANT, implemented-entry=Cdd_Pwm_ClearSyncEvent
          bsw direct call point Det: called-entry=Det_ReportError
        Cdd_Pwm_GetTimeBaseCounterDirection: reentrancy-level=NON-REENTRANT, implemented-entry=Cdd_Pwm_GetTimeBaseCounterDirection
          bsw direct call point Det: called-entry=Det_ReportError
        Cdd_Pwm_SetPhaseShift: reentrancy-level=NON-REENTRANT, implemented-entry=Cdd_Pwm_SetPhaseShift
          bsw direct call point Det: called-entry=Det_ReportError
        Cdd_Pwm_SetTimeBasePeriod: reentrancy-level=NON-REENTRANT, implemented-entry=Cdd_Pwm_SetTimeBasePeriod
          bsw direct call point Det: called-entry=Det_ReportError
        Cdd_Pwm_GetTimeBasePeriod: reentrancy-level=NON-REENTRANT, implemented-entry=Cdd_Pwm_GetTimeBasePeriod
          bsw direct call point Det: called-entry=Det_ReportError
        Cdd_Pwm_SetCounterCompareShadowLoadMode: reentrancy-level=NON-REENTRANT, implemented-entry=Cdd_Pwm_SetCounterCompareShadowLoadMode
          bsw direct call point Det: called-entry=Det_ReportError
        Cdd_Pwm_DisableCounterCompareShadowLoadMode: reentrancy-level=NON-REENTRANT, implemented-entry=Cdd_Pwm_DisableCounterCompareShadowLoadMode
          bsw direct call point Det: called-entry=Det_ReportError
        Cdd_Pwm_SetCounterCompareValue: reentrancy-level=NON-REENTRANT, implemented-entry=Cdd_Pwm_SetCounterCompareValue
          bsw direct call point Det: called-entry=Det_ReportError
        Cdd_Pwm_GetCounterCompareValue: reentrancy-level=NON-REENTRANT, implemented-entry=Cdd_Pwm_GetCounterCompareValue
          bsw direct call point Det: called-entry=Det_ReportError
        Cdd_Pwm_GetCounterCompareShadowStatus: reentrancy-level=NON-REENTRANT, implemented-entry=Cdd_Pwm_GetCounterCompareShadowStatus
          bsw direct call point Det: called-entry=Det_ReportError
        Cdd_Pwm_ConfigureLinkDutyHR: reentrancy-level=NON-REENTRANT, implemented-entry=Cdd_Pwm_ConfigureLinkDutyHR
          bsw direct call point Det: called-entry=Det_ReportError
        Cdd_Pwm_SetActionQualifierShadowLoadMode: reentrancy-level=NON-REENTRANT, implemented-entry=Cdd_Pwm_SetActionQualifierShadowLoadMode
          bsw direct call point Det: called-entry=Det_ReportError
        Cdd_Pwm_DisableActionQualifierShadowLoadMode: reentrancy-level=NON-REENTRANT, implemented-entry=Cdd_Pwm_DisableActionQualifierShadowLoadMode
          bsw direct call point Det: called-entry=Det_ReportError
        Cdd_Pwm_SetActionQualifierT1TriggerSource: reentrancy-level=NON-REENTRANT, implemented-entry=Cdd_Pwm_SetActionQualifierT1TriggerSource
          bsw direct call point Det: called-entry=Det_ReportError
        Cdd_Pwm_SetActionQualifierT2TriggerSource: reentrancy-level=NON-REENTRANT, implemented-entry=Cdd_Pwm_SetActionQualifierT2TriggerSource
          bsw direct call point Det: called-entry=Det_ReportError
        Cdd_Pwm_SetActionQualifierAction: reentrancy-level=NON-REENTRANT, implemented-entry=Cdd_Pwm_SetActionQualifierAction
          bsw direct call point Det: called-entry=Det_ReportError
        Cdd_Pwm_SetActionQualifierActionComplete: reentrancy-level=NON-REENTRANT, implemented-entry=Cdd_Pwm_SetActionQualifierActionComplete
          bsw direct call point Det: called-entry=Det_ReportError
        Cdd_Pwm_SetAdditionalActionQualifierActionComplete: reentrancy-level=NON-REENTRANT, implemented-entry=Cdd_Pwm_SetAdditionalActionQualifierActionComplete
          bsw direct call point Det: called-entry=Det_ReportError
        Cdd_Pwm_SetActionQualifierContSwForceShadowMode: reentrancy-level=NON-REENTRANT, implemented-entry=Cdd_Pwm_SetActionQualifierContSwForceShadowMode
          bsw direct call point Det: called-entry=Det_ReportError
        Cdd_Pwm_SetActionQualifierContSwForceAction: reentrancy-level=NON-REENTRANT, implemented-entry=Cdd_Pwm_SetActionQualifierContSwForceAction
          bsw direct call point Det: called-entry=Det_ReportError
        Cdd_Pwm_SetActionQualifierSwAction: reentrancy-level=NON-REENTRANT, implemented-entry=Cdd_Pwm_SetActionQualifierSwAction
          bsw direct call point Det: called-entry=Det_ReportError
        Cdd_Pwm_ForceActionQualifierSwAction: reentrancy-level=NON-REENTRANT, implemented-entry=Cdd_Pwm_ForceActionQualifierSwAction
          bsw direct call point Det: called-entry=Det_ReportError
        Cdd_Pwm_SetDeadBandOutputSwapMode: reentrancy-level=NON-REENTRANT, implemented-entry=Cdd_Pwm_SetDeadBandOutputSwapMode
          bsw direct call point Det: called-entry=Det_ReportError
        Cdd_Pwm_SetDeadBandDelayMode: reentrancy-level=NON-REENTRANT, implemented-entry=Cdd_Pwm_SetDeadBandDelayMode
          bsw direct call point Det: called-entry=Det_ReportError
        Cdd_Pwm_SetDeadBandDelayPolarity: reentrancy-level=NON-REENTRANT, implemented-entry=Cdd_Pwm_SetDeadBandDelayPolarity
          bsw direct call point Det: called-entry=Det_ReportError
        Cdd_Pwm_SetRisingEdgeDeadBandDelayInput: reentrancy-level=NON-REENTRANT, implemented-entry=Cdd_Pwm_SetRisingEdgeDeadBandDelayInput
          bsw direct call point Det: called-entry=Det_ReportError
        Cdd_Pwm_SetFallingEdgeDeadBandDelayInput: reentrancy-level=NON-REENTRANT, implemented-entry=Cdd_Pwm_SetFallingEdgeDeadBandDelayInput
          bsw direct call point Det: called-entry=Det_ReportError
        Cdd_Pwm_SetDeadBandControlShadowLoadMode: reentrancy-level=NON-REENTRANT, implemented-entry=Cdd_Pwm_SetDeadBandControlShadowLoadMode
          bsw direct call point Det: called-entry=Det_ReportError
        Cdd_Pwm_DisableDeadBandControlShadowLoadMode: reentrancy-level=NON-REENTRANT, implemented-entry=Cdd_Pwm_DisableDeadBandControlShadowLoadMode
          bsw direct call point Det: called-entry=Det_ReportError
        Cdd_Pwm_SetRisingEdgeDelayCountShadowLoadMode: reentrancy-level=NON-REENTRANT, implemented-entry=Cdd_Pwm_SetRisingEdgeDelayCountShadowLoadMode
          bsw direct call point Det: called-entry=Det_ReportError
        Cdd_Pwm_DisableRisingEdgeDelayCountShadowLoadMode: reentrancy-level=NON-REENTRANT, implemented-entry=Cdd_Pwm_DisableRisingEdgeDelayCountShadowLoadMode
          bsw direct call point Det: called-entry=Det_ReportError
        Cdd_Pwm_SetFallingEdgeDelayCountShadowLoadMode: reentrancy-level=NON-REENTRANT, implemented-entry=Cdd_Pwm_SetFallingEdgeDelayCountShadowLoadMode
          bsw direct call point Det: called-entry=Det_ReportError
        Cdd_Pwm_DisableFallingEdgeDelayCountShadowLoadMode: reentrancy-level=NON-REENTRANT, implemented-entry=Cdd_Pwm_DisableFallingEdgeDelayCountShadowLoadMode
          bsw direct call point Det: called-entry=Det_ReportError
        Cdd_Pwm_SetDeadBandCounterClock: reentrancy-level=NON-REENTRANT, implemented-entry=Cdd_Pwm_SetDeadBandCounterClock
          bsw direct call point Det: called-entry=Det_ReportError
        Cdd_Pwm_SetRisingEdgeDelayCount: reentrancy-level=NON-REENTRANT, implemented-entry=Cdd_Pwm_SetRisingEdgeDelayCount
          bsw direct call point Det: called-entry=Det_ReportError
        Cdd_Pwm_SetFallingEdgeDelayCount: reentrancy-level=NON-REENTRANT, implemented-entry=Cdd_Pwm_SetFallingEdgeDelayCount
          bsw direct call point Det: called-entry=Det_ReportError
        Cdd_Pwm_ConfigureChopper: reentrancy-level=NON-REENTRANT, implemented-entry=Cdd_Pwm_ConfigureChopper
          bsw direct call point Det: called-entry=Det_ReportError
        Cdd_Pwm_SetChopperDutyCycle: reentrancy-level=NON-REENTRANT, implemented-entry=Cdd_Pwm_SetChopperDutyCycle
          bsw direct call point Det: called-entry=Det_ReportError
        Cdd_Pwm_SetChopperFreq: reentrancy-level=NON-REENTRANT, implemented-entry=Cdd_Pwm_SetChopperFreq
          bsw direct call point Det: called-entry=Det_ReportError
        Cdd_Pwm_SetChopperFirstPulseWidth: reentrancy-level=NON-REENTRANT, implemented-entry=Cdd_Pwm_SetChopperFirstPulseWidth
          bsw direct call point Det: called-entry=Det_ReportError
        Cdd_Pwm_ConfigureTripZoneSignals: reentrancy-level=NON-REENTRANT, implemented-entry=Cdd_Pwm_ConfigureTripZoneSignals
          bsw direct call point Det: called-entry=Det_ReportError
        Cdd_Pwm_SetTripZoneDigitalCompareEventCondition: reentrancy-level=NON-REENTRANT, implemented-entry=Cdd_Pwm_SetTripZoneDigitalCompareEventCondition
          bsw direct call point Det: called-entry=Det_ReportError
        Cdd_Pwm_ConfigureTripZoneAdvAction: reentrancy-level=NON-REENTRANT, implemented-entry=Cdd_Pwm_ConfigureTripZoneAdvAction
          bsw direct call point Det: called-entry=Det_ReportError
        Cdd_Pwm_SetTripZoneAction: reentrancy-level=NON-REENTRANT, implemented-entry=Cdd_Pwm_SetTripZoneAction
          bsw direct call point Det: called-entry=Det_ReportError
        Cdd_Pwm_SetTripZoneAdvAction: reentrancy-level=NON-REENTRANT, implemented-entry=Cdd_Pwm_SetTripZoneAdvAction
          bsw direct call point Det: called-entry=Det_ReportError
        Cdd_Pwm_SetTripZoneAdvDigitalCompareAction: reentrancy-level=NON-REENTRANT, implemented-entry=Cdd_Pwm_SetTripZoneAdvDigitalCompareAction
          bsw direct call point Det: called-entry=Det_ReportError
        Cdd_Pwm_ConfigureTripZoneInterrupt: reentrancy-level=NON-REENTRANT, implemented-entry=Cdd_Pwm_ConfigureTripZoneInterrupt
          bsw direct call point Det: called-entry=Det_ReportError
        Cdd_Pwm_GetTripZoneFlagStatus: can-enter-exclusive-area=CDD_PWM_EXCLUSIVE_AREA_0, reentrancy-level=SINGLE-CORE-REENTRANT, implemented-entry=Cdd_Pwm_GetTripZoneFlagStatus
          bsw direct call point Det: called-entry=Det_ReportError
        Cdd_Pwm_GetCycleByCycleTripZoneFlagStatus: reentrancy-level=NON-REENTRANT, implemented-entry=Cdd_Pwm_GetCycleByCycleTripZoneFlagStatus
          bsw direct call point Det: called-entry=Det_ReportError
        Cdd_Pwm_GetOneShotTripZoneFlagStatus: reentrancy-level=NON-REENTRANT, implemented-entry=Cdd_Pwm_GetOneShotTripZoneFlagStatus
          bsw direct call point Det: called-entry=Det_ReportError
        Cdd_Pwm_SelectCycleByCycleTripZoneClearEvent: reentrancy-level=NON-REENTRANT, implemented-entry=Cdd_Pwm_SelectCycleByCycleTripZoneClearEvent
          bsw direct call point Det: called-entry=Det_ReportError
        Cdd_Pwm_ClearTripZoneFlag: reentrancy-level=NON-REENTRANT, implemented-entry=Cdd_Pwm_ClearTripZoneFlag
          bsw direct call point Det: called-entry=Det_ReportError
        Cdd_Pwm_ClearCycleByCycleTripZoneFlag: reentrancy-level=NON-REENTRANT, implemented-entry=Cdd_Pwm_ClearCycleByCycleTripZoneFlag
          bsw direct call point Det: called-entry=Det_ReportError
        Cdd_Pwm_ClearOneShotTripZoneFlag: reentrancy-level=NON-REENTRANT, implemented-entry=Cdd_Pwm_ClearOneShotTripZoneFlag
          bsw direct call point Det: called-entry=Det_ReportError
        Cdd_Pwm_ForceTripZoneEvent: reentrancy-level=NON-REENTRANT, implemented-entry=Cdd_Pwm_ForceTripZoneEvent
          bsw direct call point Det: called-entry=Det_ReportError
        Cdd_Pwm_ConfigureTripOutSource: reentrancy-level=NON-REENTRANT, implemented-entry=Cdd_Pwm_ConfigureTripOutSource
          bsw direct call point Det: called-entry=Det_ReportError
        Cdd_Pwm_ConfigureInterrupt: reentrancy-level=NON-REENTRANT, implemented-entry=Cdd_Pwm_ConfigureInterrupt
          bsw direct call point Det: called-entry=Det_ReportError
        Cdd_Pwm_SetInterruptSource: reentrancy-level=NON-REENTRANT, implemented-entry=Cdd_Pwm_SetInterruptSource
          bsw direct call point Det: called-entry=Det_ReportError
        Cdd_Pwm_GetEventTriggerInterruptStatus: reentrancy-level=NON-REENTRANT, implemented-entry=Cdd_Pwm_GetEventTriggerInterruptStatus
          bsw direct call point Det: called-entry=Det_ReportError
        Cdd_Pwm_ClearEventTriggerInterruptFlag: can-enter-exclusive-area=CDD_PWM_EXCLUSIVE_AREA_0, reentrancy-level=SINGLE-CORE-REENTRANT, implemented-entry=Cdd_Pwm_ClearEventTriggerInterruptFlag
          bsw direct call point Det: called-entry=Det_ReportError
        Cdd_Pwm_ConfigureInterruptEventCountInit: reentrancy-level=NON-REENTRANT, implemented-entry=Cdd_Pwm_ConfigureInterruptEventCountInit
          bsw direct call point Det: called-entry=Det_ReportError
        Cdd_Pwm_ForceInterruptEventCountInit: reentrancy-level=NON-REENTRANT, implemented-entry=Cdd_Pwm_ForceInterruptEventCountInit
          bsw direct call point Det: called-entry=Det_ReportError
        Cdd_Pwm_SetInterruptEventCountInitValue: reentrancy-level=NON-REENTRANT, implemented-entry=Cdd_Pwm_SetInterruptEventCountInitValue
          bsw direct call point Det: called-entry=Det_ReportError
        Cdd_Pwm_GetInterruptEventCount: reentrancy-level=NON-REENTRANT, implemented-entry=Cdd_Pwm_GetInterruptEventCount
          bsw direct call point Det: called-entry=Det_ReportError
        Cdd_Pwm_ForceEventTriggerInterrupt: reentrancy-level=NON-REENTRANT, implemented-entry=Cdd_Pwm_ForceEventTriggerInterrupt
          bsw direct call point Det: called-entry=Det_ReportError
        Cdd_Pwm_SetMixEvtTriggerSource: reentrancy-level=NON-REENTRANT, implemented-entry=Cdd_Pwm_SetMixEvtTriggerSource
          bsw direct call point Det: called-entry=Det_ReportError
        Cdd_Pwm_ConfigureAdcTrigger: reentrancy-level=NON-REENTRANT, implemented-entry=Cdd_Pwm_ConfigureAdcTrigger
          bsw direct call point Det: called-entry=Det_ReportError
        Cdd_Pwm_SetAdcTriggerSource: reentrancy-level=NON-REENTRANT, implemented-entry=Cdd_Pwm_SetAdcTriggerSource
          bsw direct call point Det: called-entry=Det_ReportError
        Cdd_Pwm_SetAdcTriggerEventPrescale: reentrancy-level=NON-REENTRANT, implemented-entry=Cdd_Pwm_SetAdcTriggerEventPrescale
          bsw direct call point Det: called-entry=Det_ReportError
        Cdd_Pwm_GetAdcTriggerFlagStatus: reentrancy-level=NON-REENTRANT, implemented-entry=Cdd_Pwm_GetAdcTriggerFlagStatus
          bsw direct call point Det: called-entry=Det_ReportError
        Cdd_Pwm_ClearAdcTriggerFlag: reentrancy-level=NON-REENTRANT, implemented-entry=Cdd_Pwm_ClearAdcTriggerFlag
          bsw direct call point Det: called-entry=Det_ReportError
        Cdd_Pwm_ConfigureAdcTriggerEventCountInit: reentrancy-level=NON-REENTRANT, implemented-entry=Cdd_Pwm_ConfigureAdcTriggerEventCountInit
          bsw direct call point Det: called-entry=Det_ReportError
        Cdd_Pwm_ForceAdcTriggerEventCountInit: reentrancy-level=NON-REENTRANT, implemented-entry=Cdd_Pwm_ForceAdcTriggerEventCountInit
          bsw direct call point Det: called-entry=Det_ReportError
        Cdd_Pwm_SetAdcTriggerEventCountInitValue: reentrancy-level=NON-REENTRANT, implemented-entry=Cdd_Pwm_SetAdcTriggerEventCountInitValue
          bsw direct call point Det: called-entry=Det_ReportError
        Cdd_Pwm_GetAdcTriggerEventCount: reentrancy-level=NON-REENTRANT, implemented-entry=Cdd_Pwm_GetAdcTriggerEventCount
          bsw direct call point Det: called-entry=Det_ReportError
        Cdd_Pwm_ForceAdcTrigger: reentrancy-level=NON-REENTRANT, implemented-entry=Cdd_Pwm_ForceAdcTrigger
          bsw direct call point Det: called-entry=Det_ReportError
        Cdd_Pwm_SelectDigitalCompareTripInput: reentrancy-level=NON-REENTRANT, implemented-entry=Cdd_Pwm_SelectDigitalCompareTripInput
          bsw direct call point Det: called-entry=Det_ReportError
        Cdd_Pwm_ConfigureDigitalCompareBlankingWindow: reentrancy-level=NON-REENTRANT, implemented-entry=Cdd_Pwm_ConfigureDigitalCompareBlankingWindow
          bsw direct call point Det: called-entry=Det_ReportError
        Cdd_Pwm_ConfigureDigitalCompareWindowInverseMode: reentrancy-level=NON-REENTRANT, implemented-entry=Cdd_Pwm_ConfigureDigitalCompareWindowInverseMode
          bsw direct call point Det: called-entry=Det_ReportError
        Cdd_Pwm_SetDigitalCompareBlankingEvent: reentrancy-level=NON-REENTRANT, implemented-entry=Cdd_Pwm_SetDigitalCompareBlankingEvent
          bsw direct call point Det: called-entry=Det_ReportError
        Cdd_Pwm_SetDigitalCompareFilterInput: reentrancy-level=NON-REENTRANT, implemented-entry=Cdd_Pwm_SetDigitalCompareFilterInput
          bsw direct call point Det: called-entry=Det_ReportError
        Cdd_Pwm_ConfigureDigitalCompareEdgeFilter: reentrancy-level=NON-REENTRANT, implemented-entry=Cdd_Pwm_ConfigureDigitalCompareEdgeFilter
          bsw direct call point Det: called-entry=Det_ReportError
        Cdd_Pwm_SetDigitalCompareEdgeFilterMode: reentrancy-level=NON-REENTRANT, implemented-entry=Cdd_Pwm_SetDigitalCompareEdgeFilterMode
          bsw direct call point Det: called-entry=Det_ReportError
        Cdd_Pwm_SetDigitalCompareEdgeFilterEdgeCount: reentrancy-level=NON-REENTRANT, implemented-entry=Cdd_Pwm_SetDigitalCompareEdgeFilterEdgeCount
          bsw direct call point Det: called-entry=Det_ReportError
        Cdd_Pwm_GetDigitalCompareEdgeFilterEdgeCount: reentrancy-level=NON-REENTRANT, implemented-entry=Cdd_Pwm_GetDigitalCompareEdgeFilterEdgeCount
          bsw direct call point Det: called-entry=Det_ReportError
        Cdd_Pwm_GetDigitalCompareEdgeFilterEdgeStatus: reentrancy-level=NON-REENTRANT, implemented-entry=Cdd_Pwm_GetDigitalCompareEdgeFilterEdgeStatus
          bsw direct call point Det: called-entry=Det_ReportError
        Cdd_Pwm_SetDigitalCompareWindowOffset: reentrancy-level=NON-REENTRANT, implemented-entry=Cdd_Pwm_SetDigitalCompareWindowOffset
          bsw direct call point Det: called-entry=Det_ReportError
        Cdd_Pwm_SetDigitalCompareWindowLength: reentrancy-level=NON-REENTRANT, implemented-entry=Cdd_Pwm_SetDigitalCompareWindowLength
          bsw direct call point Det: called-entry=Det_ReportError
        Cdd_Pwm_GetDigitalCompareBlankingWindowOffsetCount: reentrancy-level=NON-REENTRANT, implemented-entry=Cdd_Pwm_GetDigitalCompareBlankingWindowOffsetCount
          bsw direct call point Det: called-entry=Det_ReportError
        Cdd_Pwm_GetDigitalCompareBlankingWindowLengthCount: reentrancy-level=NON-REENTRANT, implemented-entry=Cdd_Pwm_GetDigitalCompareBlankingWindowLengthCount
          bsw direct call point Det: called-entry=Det_ReportError
        Cdd_Pwm_SetDigitalCompareEventSource: reentrancy-level=NON-REENTRANT, implemented-entry=Cdd_Pwm_SetDigitalCompareEventSource
          bsw direct call point Det: called-entry=Det_ReportError
        Cdd_Pwm_SetDigitalCompareEventSyncMode: reentrancy-level=NON-REENTRANT, implemented-entry=Cdd_Pwm_SetDigitalCompareEventSyncMode
          bsw direct call point Det: called-entry=Det_ReportError
        Cdd_Pwm_ConfigureDigitalCompareAdcTrigger: reentrancy-level=NON-REENTRANT, implemented-entry=Cdd_Pwm_ConfigureDigitalCompareAdcTrigger
          bsw direct call point Det: called-entry=Det_ReportError
        Cdd_Pwm_ConfigureDigitalCompareSyncEvent: reentrancy-level=NON-REENTRANT, implemented-entry=Cdd_Pwm_ConfigureDigitalCompareSyncEvent
          bsw direct call point Det: called-entry=Det_ReportError
        Cdd_Pwm_SetDigitalCompareCBCLatchMode: reentrancy-level=NON-REENTRANT, implemented-entry=Cdd_Pwm_SetDigitalCompareCBCLatchMode
          bsw direct call point Det: called-entry=Det_ReportError
        Cdd_Pwm_SelectDigitalCompareCBCLatchClearEvent: reentrancy-level=NON-REENTRANT, implemented-entry=Cdd_Pwm_SelectDigitalCompareCBCLatchClearEvent
          bsw direct call point Det: called-entry=Det_ReportError
        Cdd_Pwm_GetDigitalCompareCBCLatchStatus: reentrancy-level=NON-REENTRANT, implemented-entry=Cdd_Pwm_GetDigitalCompareCBCLatchStatus
          bsw direct call point Det: called-entry=Det_ReportError
        Cdd_Pwm_ConfigureDigitalCompareCounterCapture: reentrancy-level=NON-REENTRANT, implemented-entry=Cdd_Pwm_ConfigureDigitalCompareCounterCapture
          bsw direct call point Det: called-entry=Det_ReportError
        Cdd_Pwm_SetDigitalCompareCounterShadowMode: reentrancy-level=NON-REENTRANT, implemented-entry=Cdd_Pwm_SetDigitalCompareCounterShadowMode
          bsw direct call point Det: called-entry=Det_ReportError
        Cdd_Pwm_GetDigitalCompareCaptureStatus: reentrancy-level=NON-REENTRANT, implemented-entry=Cdd_Pwm_GetDigitalCompareCaptureStatus
          bsw direct call point Det: called-entry=Det_ReportError
        Cdd_Pwm_ConfigureDigitalCompareCounterCaptureMode: reentrancy-level=NON-REENTRANT, implemented-entry=Cdd_Pwm_ConfigureDigitalCompareCounterCaptureMode
          bsw direct call point Det: called-entry=Det_ReportError
        Cdd_Pwm_ClearDigitalCompareCaptureStatusFlag: reentrancy-level=NON-REENTRANT, implemented-entry=Cdd_Pwm_ClearDigitalCompareCaptureStatusFlag
          bsw direct call point Det: called-entry=Det_ReportError
        Cdd_Pwm_GetDigitalCompareCaptureCount: reentrancy-level=NON-REENTRANT, implemented-entry=Cdd_Pwm_GetDigitalCompareCaptureCount
          bsw direct call point Det: called-entry=Det_ReportError
        Cdd_Pwm_ConfigureDigitalCompareTripCombinationInput: reentrancy-level=NON-REENTRANT, implemented-entry=Cdd_Pwm_ConfigureDigitalCompareTripCombinationInput
          bsw direct call point Det: called-entry=Det_ReportError
        Cdd_Pwm_ConfigureCaptureInEvent: reentrancy-level=NON-REENTRANT, implemented-entry=Cdd_Pwm_ConfigureCaptureInEvent
          bsw direct call point Det: called-entry=Det_ReportError
        Cdd_Pwm_ConfigCaptureGateInputPolarity: reentrancy-level=NON-REENTRANT, implemented-entry=Cdd_Pwm_ConfigCaptureGateInputPolarity
          bsw direct call point Det: called-entry=Det_ReportError
        Cdd_Pwm_InvertCaptureInputPolarity: reentrancy-level=NON-REENTRANT, implemented-entry=Cdd_Pwm_InvertCaptureInputPolarity
          bsw direct call point Det: called-entry=Det_ReportError
        Cdd_Pwm_ConfigureIndependentPulseLogic: reentrancy-level=NON-REENTRANT, implemented-entry=Cdd_Pwm_ConfigureIndependentPulseLogic
          bsw direct call point Det: called-entry=Det_ReportError
        Cdd_Pwm_ForceCaptureEventLoad: reentrancy-level=NON-REENTRANT, implemented-entry=Cdd_Pwm_ForceCaptureEventLoad
          bsw direct call point Det: called-entry=Det_ReportError
        Cdd_Pwm_SelectCaptureTripInput: reentrancy-level=NON-REENTRANT, implemented-entry=Cdd_Pwm_SelectCaptureTripInput
          bsw direct call point Det: called-entry=Det_ReportError
        Cdd_Pwm_ConfigureCaptureTripCombinationInput: reentrancy-level=NON-REENTRANT, implemented-entry=Cdd_Pwm_ConfigureCaptureTripCombinationInput
          bsw direct call point Det: called-entry=Det_ReportError
        Cdd_Pwm_ConfigureValleyCapture: reentrancy-level=NON-REENTRANT, implemented-entry=Cdd_Pwm_ConfigureValleyCapture
          bsw direct call point Det: called-entry=Det_ReportError
        Cdd_Pwm_StartValleyCapture: reentrancy-level=NON-REENTRANT, implemented-entry=Cdd_Pwm_StartValleyCapture
          bsw direct call point Det: called-entry=Det_ReportError
        Cdd_Pwm_SetValleyTriggerSource: reentrancy-level=NON-REENTRANT, implemented-entry=Cdd_Pwm_SetValleyTriggerSource
          bsw direct call point Det: called-entry=Det_ReportError
        Cdd_Pwm_SetValleyTriggerEdgeCounts: reentrancy-level=NON-REENTRANT, implemented-entry=Cdd_Pwm_SetValleyTriggerEdgeCounts
          bsw direct call point Det: called-entry=Det_ReportError
        Cdd_Pwm_ConfigureValleyHwDelay: reentrancy-level=NON-REENTRANT, implemented-entry=Cdd_Pwm_ConfigureValleyHwDelay
          bsw direct call point Det: called-entry=Det_ReportError
        Cdd_Pwm_SetValleySwDelayValue: reentrancy-level=NON-REENTRANT, implemented-entry=Cdd_Pwm_SetValleySwDelayValue
          bsw direct call point Det: called-entry=Det_ReportError
        Cdd_Pwm_SetValleyDelayDivider: reentrancy-level=NON-REENTRANT, implemented-entry=Cdd_Pwm_SetValleyDelayDivider
          bsw direct call point Det: called-entry=Det_ReportError
        Cdd_Pwm_GetValleyEdgeStatus: reentrancy-level=NON-REENTRANT, implemented-entry=Cdd_Pwm_GetValleyEdgeStatus
          bsw direct call point Det: called-entry=Det_ReportError
        Cdd_Pwm_GetValleyCount: reentrancy-level=NON-REENTRANT, implemented-entry=Cdd_Pwm_GetValleyCount
          bsw direct call point Det: called-entry=Det_ReportError
        Cdd_Pwm_GetValleyHwDelay: reentrancy-level=NON-REENTRANT, implemented-entry=Cdd_Pwm_GetValleyHwDelay
          bsw direct call point Det: called-entry=Det_ReportError
        Cdd_Pwm_ConfigureGlobalLoad: reentrancy-level=NON-REENTRANT, implemented-entry=Cdd_Pwm_ConfigureGlobalLoad
          bsw direct call point Det: called-entry=Det_ReportError
        Cdd_Pwm_SetGlobalLoadTrigger: reentrancy-level=NON-REENTRANT, implemented-entry=Cdd_Pwm_SetGlobalLoadTrigger
          bsw direct call point Det: called-entry=Det_ReportError
        Cdd_Pwm_SetGlobalLoadEventPrescale: reentrancy-level=NON-REENTRANT, implemented-entry=Cdd_Pwm_SetGlobalLoadEventPrescale
          bsw direct call point Det: called-entry=Det_ReportError
        Cdd_Pwm_GetGlobalLoadEventCount: reentrancy-level=NON-REENTRANT, implemented-entry=Cdd_Pwm_GetGlobalLoadEventCount
          bsw direct call point Det: called-entry=Det_ReportError
        Cdd_Pwm_ConfigureGlobalLoadOneShotMode: reentrancy-level=NON-REENTRANT, implemented-entry=Cdd_Pwm_ConfigureGlobalLoadOneShotMode
          bsw direct call point Det: called-entry=Det_ReportError
        Cdd_Pwm_SetGlobalLoadOneShotLatch: reentrancy-level=NON-REENTRANT, implemented-entry=Cdd_Pwm_SetGlobalLoadOneShotLatch
          bsw direct call point Det: called-entry=Det_ReportError
        Cdd_Pwm_ForceGlobalLoadOneShotEvent: reentrancy-level=NON-REENTRANT, implemented-entry=Cdd_Pwm_ForceGlobalLoadOneShotEvent
          bsw direct call point Det: called-entry=Det_ReportError
        Cdd_Pwm_ConfigureGlobalLoadRegisters: reentrancy-level=NON-REENTRANT, implemented-entry=Cdd_Pwm_ConfigureGlobalLoadRegisters
          bsw direct call point Det: called-entry=Det_ReportError
        Cdd_Pwm_LockRegisters: reentrancy-level=NON-REENTRANT, implemented-entry=Cdd_Pwm_LockRegisters
          bsw direct call point Det: called-entry=Det_ReportError
        Cdd_Pwm_ConfigureXCmpMode: reentrancy-level=NON-REENTRANT, implemented-entry=Cdd_Pwm_ConfigureXCmpMode
          bsw direct call point Det: called-entry=Det_ReportError
        Cdd_Pwm_ConfigureSplitXCmp: reentrancy-level=NON-REENTRANT, implemented-entry=Cdd_Pwm_ConfigureSplitXCmp
          bsw direct call point Det: called-entry=Det_ReportError
        Cdd_Pwm_AllocAXCmp: reentrancy-level=NON-REENTRANT, implemented-entry=Cdd_Pwm_AllocAXCmp
          bsw direct call point Det: called-entry=Det_ReportError
        Cdd_Pwm_AllocBXCmp: reentrancy-level=NON-REENTRANT, implemented-entry=Cdd_Pwm_AllocBXCmp
          bsw direct call point Det: called-entry=Det_ReportError
        Cdd_Pwm_SetXCmpRegValue: reentrancy-level=NON-REENTRANT, implemented-entry=Cdd_Pwm_SetXCmpRegValue
          bsw direct call point Det: called-entry=Det_ReportError
        Cdd_Pwm_SetCmpShadowRegValue: reentrancy-level=NON-REENTRANT, implemented-entry=Cdd_Pwm_SetCmpShadowRegValue
          bsw direct call point Det: called-entry=Det_ReportError
        Cdd_Pwm_SetXMinMaxRegValue: reentrancy-level=NON-REENTRANT, implemented-entry=Cdd_Pwm_SetXMinMaxRegValue
          bsw direct call point Det: called-entry=Det_ReportError
        Cdd_Pwm_SetXCmpActionQualifierAction: reentrancy-level=NON-REENTRANT, implemented-entry=Cdd_Pwm_SetXCmpActionQualifierAction
          bsw direct call point Det: called-entry=Det_ReportError
        Cdd_Pwm_EnableXLoad: reentrancy-level=NON-REENTRANT, implemented-entry=Cdd_Pwm_EnableXLoad
          bsw direct call point Det: called-entry=Det_ReportError
        Cdd_Pwm_ForceXLoad: reentrancy-level=NON-REENTRANT, implemented-entry=Cdd_Pwm_ForceXLoad
          bsw direct call point Det: called-entry=Det_ReportError
        Cdd_Pwm_SetXCmpLoadMode: reentrancy-level=NON-REENTRANT, implemented-entry=Cdd_Pwm_SetXCmpLoadMode
          bsw direct call point Det: called-entry=Det_ReportError
        Cdd_Pwm_SetXCmpShadowLevel: reentrancy-level=NON-REENTRANT, implemented-entry=Cdd_Pwm_SetXCmpShadowLevel
          bsw direct call point Det: called-entry=Det_ReportError
        Cdd_Pwm_SetXCmpShadowBufPtrLoadOnce: reentrancy-level=NON-REENTRANT, implemented-entry=Cdd_Pwm_SetXCmpShadowBufPtrLoadOnce
          bsw direct call point Det: called-entry=Det_ReportError
        Cdd_Pwm_SetXCmpShadowRepeatBufxCount: reentrancy-level=NON-REENTRANT, implemented-entry=Cdd_Pwm_SetXCmpShadowRepeatBufxCount
          bsw direct call point Det: called-entry=Det_ReportError
        Cdd_Pwm_ConfigureMinimumDeadBand: reentrancy-level=NON-REENTRANT, implemented-entry=Cdd_Pwm_ConfigureMinimumDeadBand
          bsw direct call point Det: called-entry=Det_ReportError
        Cdd_Pwm_InvertMinimumDeadBandSignal: reentrancy-level=NON-REENTRANT, implemented-entry=Cdd_Pwm_InvertMinimumDeadBandSignal
          bsw direct call point Det: called-entry=Det_ReportError
        Cdd_Pwm_SelectMinimumDeadBandAndOrLogic: reentrancy-level=NON-REENTRANT, implemented-entry=Cdd_Pwm_SelectMinimumDeadBandAndOrLogic
          bsw direct call point Det: called-entry=Det_ReportError
        Cdd_Pwm_SelectMinimumDeadBandBlockingSignal: reentrancy-level=NON-REENTRANT, implemented-entry=Cdd_Pwm_SelectMinimumDeadBandBlockingSignal
          bsw direct call point Det: called-entry=Det_ReportError
        Cdd_Pwm_SelectMinimumDeadBandReferenceSignal: reentrancy-level=NON-REENTRANT, implemented-entry=Cdd_Pwm_SelectMinimumDeadBandReferenceSignal
          bsw direct call point Det: called-entry=Det_ReportError
        Cdd_Pwm_GetMinDeadBandDelay: reentrancy-level=NON-REENTRANT, implemented-entry=Cdd_Pwm_GetMinDeadBandDelay
          bsw direct call point Det: called-entry=Det_ReportError
        Cdd_Pwm_SetMinimumDeadBandDelay: reentrancy-level=NON-REENTRANT, implemented-entry=Cdd_Pwm_SetMinimumDeadBandDelay
          bsw direct call point Det: called-entry=Det_ReportError
        Cdd_Pwm_ConfigureIllegalComboLogic: reentrancy-level=NON-REENTRANT, implemented-entry=Cdd_Pwm_ConfigureIllegalComboLogic
          bsw direct call point Det: called-entry=Det_ReportError
        Cdd_Pwm_SelectXbarInput: reentrancy-level=NON-REENTRANT, implemented-entry=Cdd_Pwm_SelectXbarInput
          bsw direct call point Det: called-entry=Det_ReportError
        Cdd_Pwm_SetLutDecX: reentrancy-level=NON-REENTRANT, implemented-entry=Cdd_Pwm_SetLutDecX
          bsw direct call point Det: called-entry=Det_ReportError
        Cdd_Pwm_ConfigureDiodeEmulationMode: reentrancy-level=NON-REENTRANT, implemented-entry=Cdd_Pwm_ConfigureDiodeEmulationMode
          bsw direct call point Det: called-entry=Det_ReportError
        Cdd_Pwm_SetDiodeEmulationMode: reentrancy-level=NON-REENTRANT, implemented-entry=Cdd_Pwm_SetDiodeEmulationMode
          bsw direct call point Det: called-entry=Det_ReportError
        Cdd_Pwm_SetDiodeEmulationReentryDelay: reentrancy-level=NON-REENTRANT, implemented-entry=Cdd_Pwm_SetDiodeEmulationReentryDelay
          bsw direct call point Det: called-entry=Det_ReportError
        Cdd_Pwm_ConfigureDiodeEmulationTripLowSources: reentrancy-level=NON-REENTRANT, implemented-entry=Cdd_Pwm_ConfigureDiodeEmulationTripLowSources
          bsw direct call point Det: called-entry=Det_ReportError
        Cdd_Pwm_ConfigureDiodeEmulationTripHighSources: reentrancy-level=NON-REENTRANT, implemented-entry=Cdd_Pwm_ConfigureDiodeEmulationTripHighSources
          bsw direct call point Det: called-entry=Det_ReportError
        Cdd_Pwm_SelectDiodeEmulationPwmSignal: reentrancy-level=NON-REENTRANT, implemented-entry=Cdd_Pwm_SelectDiodeEmulationPwmSignal
          bsw direct call point Det: called-entry=Det_ReportError
        Cdd_Pwm_SelectDiodeEmulationTripSignal: reentrancy-level=NON-REENTRANT, implemented-entry=Cdd_Pwm_SelectDiodeEmulationTripSignal
          bsw direct call point Det: called-entry=Det_ReportError
        Cdd_Pwm_NoBypassDiodeEmulationLogic: reentrancy-level=NON-REENTRANT, implemented-entry=Cdd_Pwm_NoBypassDiodeEmulationLogic
          bsw direct call point Det: called-entry=Det_ReportError
        Cdd_Pwm_ByPassDiodeEmulationLogic: reentrancy-level=NON-REENTRANT, implemented-entry=Cdd_Pwm_ByPassDiodeEmulationLogic
          bsw direct call point Det: called-entry=Det_ReportError
        Cdd_Pwm_ForceDiodeEmulationActive: reentrancy-level=NON-REENTRANT, implemented-entry=Cdd_Pwm_ForceDiodeEmulationActive
          bsw direct call point Det: called-entry=Det_ReportError
        Cdd_Pwm_ConfigureDiodeEmulationMonitorModeControl: reentrancy-level=NON-REENTRANT, implemented-entry=Cdd_Pwm_ConfigureDiodeEmulationMonitorModeControl
          bsw direct call point Det: called-entry=Det_ReportError
        Cdd_Pwm_SetDiodeEmulationMonitorModeStep: reentrancy-level=NON-REENTRANT, implemented-entry=Cdd_Pwm_SetDiodeEmulationMonitorModeStep
          bsw direct call point Det: called-entry=Det_ReportError
        Cdd_Pwm_SetDiodeEmulationMonitorCounterThreshold: reentrancy-level=NON-REENTRANT, implemented-entry=Cdd_Pwm_SetDiodeEmulationMonitorCounterThreshold
          bsw direct call point Det: called-entry=Det_ReportError
        Cdd_Pwm_ClearDiodeEmulationActiveFlag: reentrancy-level=NON-REENTRANT, implemented-entry=Cdd_Pwm_ClearDiodeEmulationActiveFlag
          bsw direct call point Det: called-entry=Det_ReportError
        Cdd_Pwm_ConfigureTripZone2Signals: reentrancy-level=NON-REENTRANT, implemented-entry=Cdd_Pwm_ConfigureTripZone2Signals
          bsw direct call point Det: called-entry=Det_ReportError
        Cdd_Pwm_HrpwmSetPhaseShift: reentrancy-level=NON-REENTRANT, implemented-entry=Cdd_Pwm_HrpwmSetPhaseShift
          bsw direct call point Det: called-entry=Det_ReportError
        Cdd_Pwm_HrpwmSetHiResPhaseShiftOnly: reentrancy-level=NON-REENTRANT, implemented-entry=Cdd_Pwm_HrpwmSetHiResPhaseShiftOnly
          bsw direct call point Det: called-entry=Det_ReportError
        Cdd_Pwm_HrpwmSetTimeBasePeriod: reentrancy-level=NON-REENTRANT, implemented-entry=Cdd_Pwm_HrpwmSetTimeBasePeriod
          bsw direct call point Det: called-entry=Det_ReportError
        Cdd_Pwm_HrpwmSetHiResTimeBasePeriodOnly: reentrancy-level=NON-REENTRANT, implemented-entry=Cdd_Pwm_HrpwmSetHiResTimeBasePeriodOnly
          bsw direct call point Det: called-entry=Det_ReportError
        Cdd_Pwm_HrpwmGetTimeBasePeriod: reentrancy-level=NON-REENTRANT, implemented-entry=Cdd_Pwm_HrpwmGetTimeBasePeriod
          bsw direct call point Det: called-entry=Det_ReportError
        Cdd_Pwm_HrpwmGetHiResTimeBasePeriodOnly: reentrancy-level=NON-REENTRANT, implemented-entry=Cdd_Pwm_HrpwmGetHiResTimeBasePeriodOnly
          bsw direct call point Det: called-entry=Det_ReportError
        Cdd_Pwm_HrpwmSetMepEdgeSelect: reentrancy-level=NON-REENTRANT, implemented-entry=Cdd_Pwm_HrpwmSetMepEdgeSelect
          bsw direct call point Det: called-entry=Det_ReportError
        Cdd_Pwm_HrpwmSetMepControlMode: reentrancy-level=NON-REENTRANT, implemented-entry=Cdd_Pwm_HrpwmSetMepControlMode
          bsw direct call point Det: called-entry=Det_ReportError
        Cdd_Pwm_HrpwmSetCounterCompareShadowLoadEvent: reentrancy-level=NON-REENTRANT, implemented-entry=Cdd_Pwm_HrpwmSetCounterCompareShadowLoadEvent
          bsw direct call point Det: called-entry=Det_ReportError
        Cdd_Pwm_HrpwmSetOutputSwapMode: reentrancy-level=NON-REENTRANT, implemented-entry=Cdd_Pwm_HrpwmSetOutputSwapMode
          bsw direct call point Det: called-entry=Det_ReportError
        Cdd_Pwm_HrpwmSetChannelBOutputPath: reentrancy-level=NON-REENTRANT, implemented-entry=Cdd_Pwm_HrpwmSetChannelBOutputPath
          bsw direct call point Det: called-entry=Det_ReportError
        Cdd_Pwm_HrpwmConfigureAutoConversion: reentrancy-level=NON-REENTRANT, implemented-entry=Cdd_Pwm_HrpwmConfigureAutoConversion
          bsw direct call point Det: called-entry=Det_ReportError
        Cdd_Pwm_HrpwmConfigurePeriodControl: reentrancy-level=NON-REENTRANT, implemented-entry=Cdd_Pwm_HrpwmConfigurePeriodControl
          bsw direct call point Det: called-entry=Det_ReportError
        Cdd_Pwm_HrpwmConfigurePhaseShiftLoad: reentrancy-level=NON-REENTRANT, implemented-entry=Cdd_Pwm_HrpwmConfigurePhaseShiftLoad
          bsw direct call point Det: called-entry=Det_ReportError
        Cdd_Pwm_HrpwmSetSyncPulseSource: reentrancy-level=NON-REENTRANT, implemented-entry=Cdd_Pwm_HrpwmSetSyncPulseSource
          bsw direct call point Det: called-entry=Det_ReportError
        Cdd_Pwm_HrpwmSetTranslatorRemainder: reentrancy-level=NON-REENTRANT, implemented-entry=Cdd_Pwm_HrpwmSetTranslatorRemainder
          bsw direct call point Det: called-entry=Det_ReportError
        Cdd_Pwm_HrpwmSetCounterCompareValue: reentrancy-level=NON-REENTRANT, implemented-entry=Cdd_Pwm_HrpwmSetCounterCompareValue
          bsw direct call point Det: called-entry=Det_ReportError
        Cdd_Pwm_HrpwmSetHiResCounterCompareValueOnly: reentrancy-level=NON-REENTRANT, implemented-entry=Cdd_Pwm_HrpwmSetHiResCounterCompareValueOnly
          bsw direct call point Det: called-entry=Det_ReportError
        Cdd_Pwm_HrpwmGetCounterCompareValue: reentrancy-level=NON-REENTRANT, implemented-entry=Cdd_Pwm_HrpwmGetCounterCompareValue
          bsw direct call point Det: called-entry=Det_ReportError
        Cdd_Pwm_GetHiResCounterCompareValueOnly: reentrancy-level=NON-REENTRANT, implemented-entry=Cdd_Pwm_GetHiResCounterCompareValueOnly
          bsw direct call point Det: called-entry=Det_ReportError
        Cdd_Pwm_HrpwmSetRisingEdgeDelay: reentrancy-level=NON-REENTRANT, implemented-entry=Cdd_Pwm_HrpwmSetRisingEdgeDelay
          bsw direct call point Det: called-entry=Det_ReportError
        Cdd_Pwm_HrpwmSetHiResRisingEdgeDelayOnly: reentrancy-level=NON-REENTRANT, implemented-entry=Cdd_Pwm_HrpwmSetHiResRisingEdgeDelayOnly
          bsw direct call point Det: called-entry=Det_ReportError
        Cdd_Pwm_HrpwmSetFallingEdgeDelay: reentrancy-level=NON-REENTRANT, implemented-entry=Cdd_Pwm_HrpwmSetFallingEdgeDelay
          bsw direct call point Det: called-entry=Det_ReportError
        Cdd_Pwm_HrpwmSetMepStep: reentrancy-level=NON-REENTRANT, implemented-entry=Cdd_Pwm_HrpwmSetMepStep
          bsw direct call point Det: called-entry=Det_ReportError
        Cdd_Pwm_HrpwmSetDeadbandMepEdgeSelect: reentrancy-level=NON-REENTRANT, implemented-entry=Cdd_Pwm_HrpwmSetDeadbandMepEdgeSelect
          bsw direct call point Det: called-entry=Det_ReportError
        Cdd_Pwm_HrpwmSetRisingEdgeDelayLoadMode: reentrancy-level=NON-REENTRANT, implemented-entry=Cdd_Pwm_HrpwmSetRisingEdgeDelayLoadMode
          bsw direct call point Det: called-entry=Det_ReportError
        Cdd_Pwm_HrpwmSetFallingEdgeDelayLoadMode: reentrancy-level=NON-REENTRANT, implemented-entry=Cdd_Pwm_HrpwmSetFallingEdgeDelayLoadMode
          bsw direct call point Det: called-entry=Det_ReportError
        Cdd_Pwm_HrpwmLockRegisters: reentrancy-level=NON-REENTRANT, implemented-entry=Cdd_Pwm_HrpwmLockRegisters
          bsw direct call point Det: called-entry=Det_ReportError
        Cdd_Pwm_HrpwmSetXCmpRegValue: reentrancy-level=NON-REENTRANT, implemented-entry=Cdd_Pwm_HrpwmSetXCmpRegValue
          bsw direct call point Det: called-entry=Det_ReportError
        Cdd_Pwm_HrpwmSetHiResXCmpRegValueOnly: reentrancy-level=NON-REENTRANT, implemented-entry=Cdd_Pwm_HrpwmSetHiResXCmpRegValueOnly
          bsw direct call point Det: called-entry=Det_ReportError
        Cdd_Pwm_Sfo: reentrancy-level=NON-REENTRANT, implemented-entry=Cdd_Pwm_Sfo
          bsw direct call point Det: called-entry=Det_ReportError
  bsw implementation Cdd_Pwm_Impl: programming-language=C, sw-version=3.1.2, vendor-id=44, ar-release-version=4.3.1, behavior=Cdd_Pwm_Behavior, vendor-specific-module-def=Cdd
    code-descriptors:
      code Files
        artifact-descriptors:
          short-label=include::Cdd_Pwm.h, category=SWHDR
          short-label=include::Cdd_Pwm_Priv.h, category=SWHDR
          short-label=src::Cdd_Pwm.c, category=SWSRC
          short-label=src::Cdd_Pwm_Irq.c, category=SWSRC
          short-label=src::Cdd_Pwm_Priv.c, category=SWSRC
          short-label=generate::src::Cdd_Pwm_Cfg.c, category=SWSRC
          short-label=generate::include::Cdd_Pwm_Cfg.h, category=SWHDR
    compiler TI_C29Clang: name=TI_C29Clang, vendor=Texas Instruments, version=2.2.0
    linker TI_C29Linker: name=TI_C29Linker, vendor=Texas Instruments, version=2.2.0
    resource consumption ResourceConsumption
      7 x memory section:
        CDD_PWM_CODE: alignment=UNSPECIFIED, sw-addrmethod=CODE, symbol=CODE
        CDD_PWM_CONFIG_DATA_UNSPECIFIED: alignment=UNSPECIFIED, sw-addrmethod=CONST_PBCFG, symbol=CONFIG_DATA_UNSPECIFIED
        CDD_PWM_VAR_INIT_PTR: alignment=UNSPECIFIED, sw-addrmethod=VAR_INIT, symbol=VAR_INIT_PTR
        CDD_PWM_VAR_NO_INIT_UNSPECIFIED: alignment=UNSPECIFIED, sw-addrmethod=VAR_NO_INIT, symbol=VAR_NO_INIT_UNSPECIFIED
        CDD_PWM_ISR_CODE: alignment=UNSPECIFIED, sw-addrmethod=CODE, symbol=ISR_CODE
        CDD_PWM_VAR_INIT_BOOLEAN: alignment=BOOLEAN, sw-addrmethod=VAR_INIT, symbol=VAR_INIT_BOOLEAN
        CDD_PWM_VAR_INIT_16: alignment=16, sw-addrmethod=VAR_INIT, symbol=VAR_INIT_16
package /Cdd_Pwm_TI_F29H85x/Cdd_Pwm_ModuleEntry
  261 x bsw module entry, all with sw-service-impl-policy=STANDARD, bsw-entry-kind=CONCRETE:
    Cdd_Pwm_Epwm{1..4}_IntIsr: is-reentrant=false, is-synchronous=true, call-type=INTERRUPT, execution-context=INTERRUPT-CAT-1
    Cdd_Pwm_Epwm5_IntIsr: is-reentrant=false, is-synchronous=true, call-type=INTERRUPT
    Cdd_Pwm_Epwm6_IntIsr: is-reentrant=false, is-synchronous=true, call-type=INTERRUPT
    Cdd_Pwm_Epwm7_IntIsr: is-reentrant=false, is-synchronous=true, call-type=INTERRUPT, execution-context=INTERRUPT-CAT-1
    Cdd_Pwm_Epwm{8..18}_IntIsr: is-reentrant=false, is-synchronous=true, call-type=INTERRUPT
    Cdd_Pwm_EnableNotification: service-id=221, is-reentrant=true, is-synchronous=true, call-type=REGULAR, execution-context=UNSPECIFIED
    Cdd_Pwm_DisableNotification: service-id=222, is-reentrant=true, is-synchronous=true, call-type=REGULAR, execution-context=UNSPECIFIED
    Cdd_Pwm_Init: service-id=0, is-reentrant=false, is-synchronous=true, call-type=REGULAR, execution-context=UNSPECIFIED
    Cdd_Pwm_GetVersionInfo: service-id=7, is-reentrant=true, is-synchronous=false, call-type=REGULAR, execution-context=UNSPECIFIED
    Cdd_Pwm_SetInterruptEventCount: service-id=220, is-reentrant=true, is-synchronous=false, call-type=REGULAR, execution-context=UNSPECIFIED
    Cdd_Pwm_Epwm{1..4}_TzIntIsr: is-reentrant=false, is-synchronous=true, call-type=INTERRUPT, execution-context=INTERRUPT-CAT-1
    Cdd_Pwm_Epwm5_TzIntIsr: is-reentrant=false, is-synchronous=true, call-type=INTERRUPT
    Cdd_Pwm_Epwm6_TzIntIsr: is-reentrant=false, is-synchronous=true, call-type=INTERRUPT
    Cdd_Pwm_Epwm7_TzIntIsr: is-reentrant=false, is-synchronous=true, call-type=INTERRUPT, execution-context=INTERRUPT-CAT-1
    Cdd_Pwm_Epwm{8..18}_TzIntIsr: is-reentrant=false, is-synchronous=true, call-type=INTERRUPT
    Cdd_Pwm_SetEmulationMode: service-id=226, is-reentrant=false, is-synchronous=true, call-type=REGULAR, execution-context=UNSPECIFIED
    Cdd_Pwm_ConfigureTripZoneNotification: service-id=227, is-reentrant=false, is-synchronous=true, call-type=REGULAR, execution-context=UNSPECIFIED
    Cdd_Pwm_SetTimeBaseCounter: service-id=228, is-reentrant=false, is-synchronous=true, call-type=REGULAR, execution-context=UNSPECIFIED
    Cdd_Pwm_SetCountModeAfterSync: service-id=229, is-reentrant=false, is-synchronous=true, call-type=REGULAR, execution-context=UNSPECIFIED
    Cdd_Pwm_SetClockPrescaler: service-id=5, is-reentrant=false, is-synchronous=true, call-type=REGULAR, execution-context=UNSPECIFIED
    Cdd_Pwm_ForceSyncPulse: service-id=6, is-reentrant=false, is-synchronous=true, call-type=REGULAR, execution-context=UNSPECIFIED
    Cdd_Pwm_SetSyncInPulseSource: service-id=225, is-reentrant=false, is-synchronous=true, call-type=REGULAR, execution-context=UNSPECIFIED
    Cdd_Pwm_ConfigureSyncOutPulseSource: service-id=8, is-reentrant=false, is-synchronous=true, call-type=REGULAR, execution-context=UNSPECIFIED
    Cdd_Pwm_SetOneShotSyncOutTrigger: service-id=9, is-reentrant=false, is-synchronous=true, call-type=REGULAR, execution-context=UNSPECIFIED
    Cdd_Pwm_SetPeriodLoadMode: service-id=79, is-reentrant=false, is-synchronous=true, call-type=REGULAR, execution-context=UNSPECIFIED
    Cdd_Pwm_ConfigurePhaseShiftLoad: service-id=10, is-reentrant=false, is-synchronous=true, call-type=REGULAR, execution-context=UNSPECIFIED
    Cdd_Pwm_SetTimeBaseCounterMode: service-id=11, is-reentrant=false, is-synchronous=true, call-type=REGULAR, execution-context=UNSPECIFIED
    Cdd_Pwm_SelectPeriodLoadEvent: service-id=12, is-reentrant=false, is-synchronous=true, call-type=REGULAR, execution-context=UNSPECIFIED
    Cdd_Pwm_ConfigureOneShotSync: service-id=13, is-reentrant=false, is-synchronous=true, call-type=REGULAR, execution-context=UNSPECIFIED
    Cdd_Pwm_StartOneShotSync: service-id=14, is-reentrant=false, is-synchronous=true, call-type=REGULAR, execution-context=UNSPECIFIED
    Cdd_Pwm_GetTimeBaseCounterValue: service-id=15, is-reentrant=false, is-synchronous=true, call-type=REGULAR, execution-context=UNSPECIFIED
    Cdd_Pwm_GetTimeBaseCounterOverflowStatus: service-id=16, is-reentrant=false, is-synchronous=true, call-type=REGULAR, execution-context=UNSPECIFIED
    Cdd_Pwm_ClearTimeBaseCounterOverflowEvent: service-id=17, is-reentrant=false, is-synchronous=true, call-type=REGULAR, execution-context=UNSPECIFIED
    Cdd_Pwm_GetSyncStatus: service-id=18, is-reentrant=false, is-synchronous=true, call-type=REGULAR, execution-context=UNSPECIFIED
    Cdd_Pwm_ClearSyncEvent: service-id=19, is-reentrant=false, is-synchronous=true, call-type=REGULAR, execution-context=UNSPECIFIED
    Cdd_Pwm_GetTimeBaseCounterDirection: service-id=20, is-reentrant=false, is-synchronous=true, call-type=REGULAR, execution-context=UNSPECIFIED
    Cdd_Pwm_SetPhaseShift: service-id=21, is-reentrant=false, is-synchronous=true, call-type=REGULAR, execution-context=UNSPECIFIED
    Cdd_Pwm_SetTimeBasePeriod: service-id=22, is-reentrant=false, is-synchronous=true, call-type=REGULAR, execution-context=UNSPECIFIED
    Cdd_Pwm_GetTimeBasePeriod: service-id=23, is-reentrant=false, is-synchronous=true, call-type=REGULAR, execution-context=UNSPECIFIED
    Cdd_Pwm_SetCounterCompareShadowLoadMode: service-id=25, is-reentrant=false, is-synchronous=true, call-type=REGULAR, execution-context=UNSPECIFIED
    Cdd_Pwm_DisableCounterCompareShadowLoadMode: service-id=26, is-reentrant=false, is-synchronous=true, call-type=REGULAR, execution-context=UNSPECIFIED
    Cdd_Pwm_SetCounterCompareValue: service-id=27, is-reentrant=false, is-synchronous=true, call-type=REGULAR, execution-context=UNSPECIFIED
    Cdd_Pwm_GetCounterCompareValue: service-id=28, is-reentrant=false, is-synchronous=true, call-type=REGULAR, execution-context=UNSPECIFIED
    Cdd_Pwm_GetCounterCompareShadowStatus: service-id=29, is-reentrant=false, is-synchronous=true, call-type=REGULAR, execution-context=UNSPECIFIED
    Cdd_Pwm_ConfigureLinkDutyHR: service-id=30, is-reentrant=false, is-synchronous=true, call-type=REGULAR, execution-context=UNSPECIFIED
    Cdd_Pwm_SetActionQualifierShadowLoadMode: service-id=31, is-reentrant=false, is-synchronous=true, call-type=REGULAR, execution-context=UNSPECIFIED
    Cdd_Pwm_DisableActionQualifierShadowLoadMode: service-id=32, is-reentrant=false, is-synchronous=true, call-type=REGULAR, execution-context=UNSPECIFIED
    Cdd_Pwm_SetActionQualifierT1TriggerSource: service-id=33, is-reentrant=false, is-synchronous=true, call-type=REGULAR, execution-context=UNSPECIFIED
    Cdd_Pwm_SetActionQualifierT2TriggerSource: service-id=34, is-reentrant=false, is-synchronous=true, call-type=REGULAR, execution-context=UNSPECIFIED
    Cdd_Pwm_SetActionQualifierAction: service-id=35, is-reentrant=false, is-synchronous=true, call-type=REGULAR, execution-context=UNSPECIFIED
    Cdd_Pwm_SetActionQualifierActionComplete: service-id=36, is-reentrant=false, is-synchronous=true, call-type=REGULAR, execution-context=UNSPECIFIED
    Cdd_Pwm_SetAdditionalActionQualifierActionComplete: service-id=37, is-reentrant=false, is-synchronous=true, call-type=REGULAR, execution-context=UNSPECIFIED
    Cdd_Pwm_SetActionQualifierContSwForceShadowMode: service-id=38, is-reentrant=false, is-synchronous=true, call-type=REGULAR, execution-context=UNSPECIFIED
    Cdd_Pwm_SetActionQualifierContSwForceAction: service-id=39, is-reentrant=false, is-synchronous=true, call-type=REGULAR, execution-context=UNSPECIFIED
    Cdd_Pwm_SetActionQualifierSwAction: service-id=40, is-reentrant=false, is-synchronous=true, call-type=REGULAR, execution-context=UNSPECIFIED
    Cdd_Pwm_ForceActionQualifierSwAction: service-id=41, is-reentrant=false, is-synchronous=true, call-type=REGULAR, execution-context=UNSPECIFIED
    Cdd_Pwm_SetDeadBandOutputSwapMode: service-id=42, is-reentrant=false, is-synchronous=true, call-type=REGULAR, execution-context=UNSPECIFIED
    Cdd_Pwm_SetDeadBandDelayMode: service-id=43, is-reentrant=false, is-synchronous=true, call-type=REGULAR, execution-context=UNSPECIFIED
    Cdd_Pwm_SetDeadBandDelayPolarity: service-id=44, is-reentrant=false, is-synchronous=true, call-type=REGULAR, execution-context=UNSPECIFIED
    Cdd_Pwm_SetRisingEdgeDeadBandDelayInput: service-id=45, is-reentrant=false, is-synchronous=true, call-type=REGULAR, execution-context=UNSPECIFIED
    Cdd_Pwm_SetFallingEdgeDeadBandDelayInput: service-id=46, is-reentrant=false, is-synchronous=true, call-type=REGULAR, execution-context=UNSPECIFIED
    Cdd_Pwm_SetDeadBandControlShadowLoadMode: service-id=47, is-reentrant=false, is-synchronous=true, call-type=REGULAR, execution-context=UNSPECIFIED
    Cdd_Pwm_SetRisingEdgeDelayCountShadowLoadMode: service-id=48, is-reentrant=false, is-synchronous=true, call-type=REGULAR, execution-context=UNSPECIFIED
    Cdd_Pwm_DisableRisingEdgeDelayCountShadowLoadMode: service-id=49, is-reentrant=false, is-synchronous=true, call-type=REGULAR, execution-context=UNSPECIFIED
    Cdd_Pwm_SetFallingEdgeDelayCountShadowLoadMode: service-id=50, is-reentrant=false, is-synchronous=true, call-type=REGULAR, execution-context=UNSPECIFIED
    Cdd_Pwm_DisableFallingEdgeDelayCountShadowLoadMode: service-id=51, is-reentrant=false, is-synchronous=true, call-type=REGULAR, execution-context=UNSPECIFIED
    Cdd_Pwm_SetDeadBandCounterClock: service-id=52, is-reentrant=false, is-synchronous=true, call-type=REGULAR, execution-context=UNSPECIFIED
    Cdd_Pwm_SetRisingEdgeDelayCount: service-id=53, is-reentrant=false, is-synchronous=true, call-type=REGULAR, execution-context=UNSPECIFIED
    Cdd_Pwm_SetFallingEdgeDelayCount: service-id=54, is-reentrant=false, is-synchronous=true, call-type=REGULAR, execution-context=UNSPECIFIED
    Cdd_Pwm_ConfigureChopper: service-id=55, is-reentrant=false, is-synchronous=true, call-type=REGULAR, execution-context=UNSPECIFIED
    Cdd_Pwm_SetChopperDutyCycle: service-id=56, is-reentrant=false, is-synchronous=true, call-type=REGULAR, execution-context=UNSPECIFIED
    Cdd_Pwm_SetChopperFreq: service-id=57, is-reentrant=false, is-synchronous=true, call-type=REGULAR, execution-context=UNSPECIFIED
    Cdd_Pwm_SetChopperFirstPulseWidth: service-id=58, is-reentrant=false, is-synchronous=true, call-type=REGULAR, execution-context=UNSPECIFIED
    Cdd_Pwm_ConfigureTripZoneSignals: service-id=59, is-reentrant=false, is-synchronous=true, call-type=REGULAR, execution-context=UNSPECIFIED
    Cdd_Pwm_SetTripZoneDigitalCompareEventCondition: service-id=60, is-reentrant=false, is-synchronous=true, call-type=REGULAR, execution-context=UNSPECIFIED
    Cdd_Pwm_ConfigureTripZoneAdvAction: service-id=61, is-reentrant=false, is-synchronous=true, call-type=REGULAR, execution-context=UNSPECIFIED
    Cdd_Pwm_SetTripZoneAction: service-id=62, is-reentrant=false, is-synchronous=true, call-type=REGULAR, execution-context=UNSPECIFIED
    Cdd_Pwm_SetTripZoneAdvAction: service-id=63, is-reentrant=false, is-synchronous=true, call-type=REGULAR, execution-context=UNSPECIFIED
    Cdd_Pwm_SetTripZoneAdvDigitalCompareAction: service-id=64, is-reentrant=false, is-synchronous=true, call-type=REGULAR, execution-context=UNSPECIFIED
    Cdd_Pwm_ConfigureTripZoneInterrupt: service-id=65, is-reentrant=false, is-synchronous=true, call-type=REGULAR, execution-context=UNSPECIFIED
    Cdd_Pwm_GetTripZoneFlagStatus: service-id=66, is-reentrant=false, is-synchronous=true, call-type=REGULAR, execution-context=UNSPECIFIED
    Cdd_Pwm_GetCycleByCycleTripZoneFlagStatus: service-id=67, is-reentrant=false, is-synchronous=true, call-type=REGULAR, execution-context=UNSPECIFIED
    Cdd_Pwm_GetOneShotTripZoneFlagStatus: service-id=68, is-reentrant=false, is-synchronous=true, call-type=REGULAR, execution-context=UNSPECIFIED
    Cdd_Pwm_SelectCycleByCycleTripZoneClearEvent: service-id=69, is-reentrant=false, is-synchronous=true, call-type=REGULAR, execution-context=UNSPECIFIED
    Cdd_Pwm_ClearTripZoneFlag: service-id=70, is-reentrant=false, is-synchronous=true, call-type=REGULAR, execution-context=UNSPECIFIED
    Cdd_Pwm_ClearCycleByCycleTripZoneFlag: service-id=71, is-reentrant=false, is-synchronous=true, call-type=REGULAR, execution-context=UNSPECIFIED
    Cdd_Pwm_ClearOneShotTripZoneFlag: service-id=72, is-reentrant=false, is-synchronous=true, call-type=REGULAR, execution-context=UNSPECIFIED
    Cdd_Pwm_ForceTripZoneEvent: service-id=73, is-reentrant=false, is-synchronous=true, call-type=REGULAR, execution-context=UNSPECIFIED
    Cdd_Pwm_ConfigureTripOutSource: service-id=74, is-reentrant=false, is-synchronous=true, call-type=REGULAR, execution-context=UNSPECIFIED
    Cdd_Pwm_ConfigureInterrupt: service-id=75, is-reentrant=false, is-synchronous=true, call-type=REGULAR, execution-context=UNSPECIFIED
    Cdd_Pwm_SetInterruptSource: service-id=76, is-reentrant=false, is-synchronous=true, call-type=REGULAR, execution-context=UNSPECIFIED
    Cdd_Pwm_GetEventTriggerInterruptStatus: service-id=77, is-reentrant=false, is-synchronous=true, call-type=REGULAR, execution-context=UNSPECIFIED
    Cdd_Pwm_ClearEventTriggerInterruptFlag: service-id=78, is-reentrant=false, is-synchronous=true, call-type=REGULAR, execution-context=UNSPECIFIED
    Cdd_Pwm_ConfigureInterruptEventCountInit: service-id=80, is-reentrant=false, is-synchronous=true, call-type=REGULAR, execution-context=UNSPECIFIED
    Cdd_Pwm_ForceInterruptEventCountInit: service-id=81, is-reentrant=false, is-synchronous=true, call-type=REGULAR, execution-context=UNSPECIFIED
    Cdd_Pwm_SetInterruptEventCountInitValue: service-id=82, is-reentrant=false, is-synchronous=true, call-type=REGULAR, execution-context=UNSPECIFIED
    Cdd_Pwm_GetInterruptEventCount: service-id=83, is-reentrant=false, is-synchronous=true, call-type=REGULAR, execution-context=UNSPECIFIED
    Cdd_Pwm_ForceEventTriggerInterrupt: service-id=84, is-reentrant=false, is-synchronous=true, call-type=REGULAR, execution-context=UNSPECIFIED
    Cdd_Pwm_SetMixEvtTriggerSource: service-id=85, is-reentrant=false, is-synchronous=true, call-type=REGULAR, execution-context=UNSPECIFIED
    Cdd_Pwm_ConfigureAdcTrigger: service-id=86, is-reentrant=false, is-synchronous=true, call-type=REGULAR, execution-context=UNSPECIFIED
    Cdd_Pwm_SetAdcTriggerSource: service-id=87, is-reentrant=false, is-synchronous=true, call-type=REGULAR, execution-context=UNSPECIFIED
    Cdd_Pwm_SetAdcTriggerEventPrescale: service-id=88, is-reentrant=false, is-synchronous=true, call-type=REGULAR, execution-context=UNSPECIFIED
    Cdd_Pwm_GetAdcTriggerFlagStatus: service-id=89, is-reentrant=false, is-synchronous=true, call-type=REGULAR, execution-context=UNSPECIFIED
    Cdd_Pwm_ClearAdcTriggerFlag: service-id=90, is-reentrant=false, is-synchronous=true, call-type=REGULAR, execution-context=UNSPECIFIED
    Cdd_Pwm_ConfigureAdcTriggerEventCountInit: service-id=91, is-reentrant=false, is-synchronous=true, call-type=REGULAR, execution-context=UNSPECIFIED
    Cdd_Pwm_ForceAdcTriggerEventCountInit: service-id=92, is-reentrant=false, is-synchronous=true, call-type=REGULAR, execution-context=UNSPECIFIED
    Cdd_Pwm_SetAdcTriggerEventCountInitValue: service-id=93, is-reentrant=false, is-synchronous=true, call-type=REGULAR, execution-context=UNSPECIFIED
    Cdd_Pwm_GetAdcTriggerEventCount: service-id=94, is-reentrant=false, is-synchronous=true, call-type=REGULAR, execution-context=UNSPECIFIED
    Cdd_Pwm_ForceAdcTrigger: service-id=95, is-reentrant=false, is-synchronous=true, call-type=REGULAR, execution-context=UNSPECIFIED
    Cdd_Pwm_ConfigureDigitalCompareBlankingWindow: service-id=96, is-reentrant=false, is-synchronous=true, call-type=REGULAR, execution-context=UNSPECIFIED
    Cdd_Pwm_ConfigureDigitalCompareWindowInverseMode: service-id=97, is-reentrant=false, is-synchronous=true, call-type=REGULAR, execution-context=UNSPECIFIED
    Cdd_Pwm_SetDigitalCompareBlankingEvent: service-id=98, is-reentrant=false, is-synchronous=true, call-type=REGULAR, execution-context=UNSPECIFIED
    Cdd_Pwm_SetDigitalCompareFilterInput: service-id=99, is-reentrant=false, is-synchronous=true, call-type=REGULAR, execution-context=UNSPECIFIED
    Cdd_Pwm_ConfigureDigitalCompareEdgeFilter: service-id=100, is-reentrant=false, is-synchronous=true, call-type=REGULAR, execution-context=UNSPECIFIED
    Cdd_Pwm_SetDigitalCompareEdgeFilterMode: service-id=101, is-reentrant=false, is-synchronous=true, call-type=REGULAR, execution-context=UNSPECIFIED
    Cdd_Pwm_SetDigitalCompareEdgeFilterEdgeCount: service-id=102, is-reentrant=false, is-synchronous=true, call-type=REGULAR, execution-context=UNSPECIFIED
    Cdd_Pwm_GetDigitalCompareEdgeFilterEdgeCount: service-id=103, is-reentrant=false, is-synchronous=true, call-type=REGULAR, execution-context=UNSPECIFIED
    Cdd_Pwm_GetDigitalCompareEdgeFilterEdgeStatus: service-id=104, is-reentrant=false, is-synchronous=true, call-type=REGULAR, execution-context=UNSPECIFIED
    Cdd_Pwm_SetDigitalCompareWindowOffset: service-id=105, is-reentrant=false, is-synchronous=true, call-type=REGULAR, execution-context=UNSPECIFIED
    Cdd_Pwm_SetDigitalCompareWindowLength: service-id=106, is-reentrant=false, is-synchronous=true, call-type=REGULAR, execution-context=UNSPECIFIED
    Cdd_Pwm_GetDigitalCompareBlankingWindowOffsetCount: service-id=107, is-reentrant=false, is-synchronous=true, call-type=REGULAR, execution-context=UNSPECIFIED
    Cdd_Pwm_GetDigitalCompareBlankingWindowLengthCount: service-id=108, is-reentrant=false, is-synchronous=true, call-type=REGULAR, execution-context=UNSPECIFIED
    Cdd_Pwm_SetDigitalCompareEventSource: service-id=109, is-reentrant=false, is-synchronous=true, call-type=REGULAR, execution-context=UNSPECIFIED
    Cdd_Pwm_SetDigitalCompareEventSyncMode: service-id=110, is-reentrant=false, is-synchronous=true, call-type=REGULAR, execution-context=UNSPECIFIED
    Cdd_Pwm_ConfigureDigitalCompareAdcTrigger: service-id=111, is-reentrant=false, is-synchronous=true, call-type=REGULAR, execution-context=UNSPECIFIED
    Cdd_Pwm_ConfigureDigitalCompareSyncEvent: service-id=112, is-reentrant=false, is-synchronous=true, call-type=REGULAR, execution-context=UNSPECIFIED
    Cdd_Pwm_SetDigitalCompareCBCLatchMode: service-id=113, is-reentrant=false, is-synchronous=true, call-type=REGULAR, execution-context=UNSPECIFIED
    Cdd_Pwm_SelectDigitalCompareCBCLatchClearEvent: service-id=114, is-reentrant=false, is-synchronous=true, call-type=REGULAR, execution-context=UNSPECIFIED
    Cdd_Pwm_GetDigitalCompareCBCLatchStatus: service-id=115, is-reentrant=false, is-synchronous=true, call-type=REGULAR, execution-context=UNSPECIFIED
    Cdd_Pwm_ConfigureDigitalCompareCounterCapture: service-id=116, is-reentrant=false, is-synchronous=true, call-type=REGULAR, execution-context=UNSPECIFIED
    Cdd_Pwm_SetDigitalCompareCounterShadowMode: service-id=117, is-reentrant=false, is-synchronous=true, call-type=REGULAR, execution-context=UNSPECIFIED
    Cdd_Pwm_GetDigitalCompareCaptureStatus: service-id=118, is-reentrant=false, is-synchronous=true, call-type=REGULAR, execution-context=UNSPECIFIED
    Cdd_Pwm_ConfigureDigitalCompareCounterCaptureMode: service-id=119, is-reentrant=false, is-synchronous=true, call-type=REGULAR, execution-context=UNSPECIFIED
    Cdd_Pwm_ClearDigitalCompareCaptureStatusFlag: service-id=120, is-reentrant=false, is-synchronous=true, call-type=REGULAR, execution-context=UNSPECIFIED
    Cdd_Pwm_GetDigitalCompareCaptureCount: service-id=121, is-reentrant=false, is-synchronous=true, call-type=REGULAR, execution-context=UNSPECIFIED
    Cdd_Pwm_ConfigureDigitalCompareTripCombinationInput: service-id=122, is-reentrant=false, is-synchronous=true, call-type=REGULAR, execution-context=UNSPECIFIED
    Cdd_Pwm_ConfigureCaptureInEvent: service-id=123, is-reentrant=false, is-synchronous=true, call-type=REGULAR, execution-context=UNSPECIFIED
    Cdd_Pwm_ConfigCaptureGateInputPolarity: service-id=124, is-reentrant=false, is-synchronous=true, call-type=REGULAR, execution-context=UNSPECIFIED
    Cdd_Pwm_InvertCaptureInputPolarity: service-id=125, is-reentrant=false, is-synchronous=true, call-type=REGULAR, execution-context=UNSPECIFIED
    Cdd_Pwm_ConfigureIndependentPulseLogic: service-id=126, is-reentrant=false, is-synchronous=true, call-type=REGULAR, execution-context=UNSPECIFIED
    Cdd_Pwm_ForceCaptureEventLoad: service-id=127, is-reentrant=false, is-synchronous=true, call-type=REGULAR, execution-context=UNSPECIFIED
    Cdd_Pwm_SelectCaptureTripInput: service-id=128, is-reentrant=false, is-synchronous=true, call-type=REGULAR, execution-context=UNSPECIFIED
    Cdd_Pwm_ConfigureCaptureTripCombinationInput: service-id=129, is-reentrant=false, is-synchronous=true, call-type=REGULAR, execution-context=UNSPECIFIED
    Cdd_Pwm_ConfigureValleyCapture: service-id=130, is-reentrant=false, is-synchronous=true, call-type=REGULAR, execution-context=UNSPECIFIED
    Cdd_Pwm_StartValleyCapture: service-id=131, is-reentrant=false, is-synchronous=true, call-type=REGULAR, execution-context=UNSPECIFIED
    Cdd_Pwm_SetValleyTriggerSource: service-id=132, is-reentrant=false, is-synchronous=true, call-type=REGULAR, execution-context=UNSPECIFIED
    Cdd_Pwm_SetValleyTriggerEdgeCounts: service-id=133, is-reentrant=false, is-synchronous=true, call-type=REGULAR, execution-context=UNSPECIFIED
    Cdd_Pwm_ConfigureValleyHwDelay: service-id=134, is-reentrant=false, is-synchronous=true, call-type=REGULAR, execution-context=UNSPECIFIED
    Cdd_Pwm_SetValleySwDelayValue: service-id=135, is-reentrant=false, is-synchronous=true, call-type=REGULAR, execution-context=UNSPECIFIED
    Cdd_Pwm_SetValleyDelayDivider: service-id=136, is-reentrant=false, is-synchronous=true, call-type=REGULAR, execution-context=UNSPECIFIED
    Cdd_Pwm_GetValleyEdgeStatus: service-id=137, is-reentrant=false, is-synchronous=true, call-type=REGULAR, execution-context=UNSPECIFIED
    Cdd_Pwm_GetValleyCount: service-id=138, is-reentrant=false, is-synchronous=true, call-type=REGULAR, execution-context=UNSPECIFIED
    Cdd_Pwm_GetValleyHwDelay: service-id=139, is-reentrant=false, is-synchronous=true, call-type=REGULAR, execution-context=UNSPECIFIED
    Cdd_Pwm_ConfigureGlobalLoad: service-id=140, is-reentrant=false, is-synchronous=true, call-type=REGULAR, execution-context=UNSPECIFIED
    Cdd_Pwm_SetGlobalLoadTrigger: service-id=141, is-reentrant=false, is-synchronous=true, call-type=REGULAR, execution-context=UNSPECIFIED
    Cdd_Pwm_SetGlobalLoadEventPrescale: service-id=142, is-reentrant=false, is-synchronous=true, call-type=REGULAR, execution-context=UNSPECIFIED
    Cdd_Pwm_GetGlobalLoadEventCount: service-id=143, is-reentrant=false, is-synchronous=true, call-type=REGULAR, execution-context=UNSPECIFIED
    Cdd_Pwm_SetGlobalLoadOneShotLatch: service-id=144, is-reentrant=false, is-synchronous=true, call-type=REGULAR, execution-context=UNSPECIFIED
    Cdd_Pwm_ConfigureGlobalLoadOneShotMode: service-id=145, is-reentrant=false, is-synchronous=true, call-type=REGULAR, execution-context=UNSPECIFIED
    Cdd_Pwm_ForceGlobalLoadOneShotEvent: service-id=146, is-reentrant=false, is-synchronous=true, call-type=REGULAR, execution-context=UNSPECIFIED
    Cdd_Pwm_ConfigureGlobalLoadRegisters: service-id=147, is-reentrant=false, is-synchronous=true, call-type=REGULAR, execution-context=UNSPECIFIED
    Cdd_Pwm_LockRegisters: service-id=148, is-reentrant=false, is-synchronous=true, call-type=REGULAR, execution-context=UNSPECIFIED
    Cdd_Pwm_ConfigureXCmpMode: service-id=149, is-reentrant=false, is-synchronous=true, call-type=REGULAR, execution-context=UNSPECIFIED
    Cdd_Pwm_ConfigureSplitXCmp: service-id=150, is-reentrant=false, is-synchronous=true, call-type=REGULAR, execution-context=UNSPECIFIED
    Cdd_Pwm_AllocAXCmp: service-id=151, is-reentrant=false, is-synchronous=true, call-type=REGULAR, execution-context=UNSPECIFIED
    Cdd_Pwm_AllocBXCmp: service-id=152, is-reentrant=false, is-synchronous=true, call-type=REGULAR, execution-context=UNSPECIFIED
    Cdd_Pwm_SetXCmpRegValue: service-id=153, is-reentrant=false, is-synchronous=true, call-type=REGULAR, execution-context=UNSPECIFIED
    Cdd_Pwm_SetCmpShadowRegValue: service-id=154, is-reentrant=false, is-synchronous=true, call-type=REGULAR, execution-context=UNSPECIFIED
    Cdd_Pwm_SetXMinMaxRegValue: service-id=155, is-reentrant=false, is-synchronous=true, call-type=REGULAR, execution-context=UNSPECIFIED
    Cdd_Pwm_SetXCmpActionQualifierAction: service-id=156, is-reentrant=false, is-synchronous=true, call-type=REGULAR, execution-context=UNSPECIFIED
    Cdd_Pwm_EnableXLoad: service-id=157, is-reentrant=false, is-synchronous=true, call-type=REGULAR, execution-context=UNSPECIFIED
    Cdd_Pwm_ForceXLoad: service-id=158, is-reentrant=false, is-synchronous=true, call-type=REGULAR, execution-context=UNSPECIFIED
    Cdd_Pwm_SetXCmpLoadMode: service-id=159, is-reentrant=false, is-synchronous=true, call-type=REGULAR, execution-context=UNSPECIFIED
    Cdd_Pwm_SetXCmpShadowLevel: service-id=160, is-reentrant=false, is-synchronous=true, call-type=REGULAR, execution-context=UNSPECIFIED
    Cdd_Pwm_SetXCmpShadowBufPtrLoadOnce: service-id=161, is-reentrant=false, is-synchronous=true, call-type=REGULAR, execution-context=UNSPECIFIED
    Cdd_Pwm_SetXCmpShadowRepeatBufxCount: service-id=162, is-reentrant=false, is-synchronous=true, call-type=REGULAR, execution-context=UNSPECIFIED
    Cdd_Pwm_ConfigureMinimumDeadBand: service-id=163, is-reentrant=false, is-synchronous=true, call-type=REGULAR, execution-context=UNSPECIFIED
    Cdd_Pwm_InvertMinimumDeadBandSignal: service-id=164, is-reentrant=false, is-synchronous=true, call-type=REGULAR, execution-context=UNSPECIFIED
    Cdd_Pwm_SelectMinimumDeadBandAndOrLogic: service-id=165, is-reentrant=false, is-synchronous=true, call-type=REGULAR, execution-context=UNSPECIFIED
    Cdd_Pwm_SelectMinimumDeadBandBlockingSignal: service-id=166, is-reentrant=false, is-synchronous=true, call-type=REGULAR, execution-context=UNSPECIFIED
    Cdd_Pwm_SelectMinimumDeadBandReferenceSignal: service-id=167, is-reentrant=false, is-synchronous=true, call-type=REGULAR, execution-context=UNSPECIFIED
    Cdd_Pwm_DisableDeadBandControlShadowLoadMode: service-id=168, is-reentrant=false, is-synchronous=true, call-type=REGULAR, execution-context=UNSPECIFIED
    Cdd_Pwm_GetMinDeadBandDelay: service-id=169, is-reentrant=false, is-synchronous=true, call-type=REGULAR, execution-context=UNSPECIFIED
    Cdd_Pwm_SetMinimumDeadBandDelay: service-id=170, is-reentrant=false, is-synchronous=true, call-type=REGULAR, execution-context=UNSPECIFIED
    Cdd_Pwm_SelectDigitalCompareTripInput: service-id=171, is-reentrant=false, is-synchronous=true, call-type=REGULAR, execution-context=UNSPECIFIED
    Cdd_Pwm_ConfigureIllegalComboLogic: service-id=172, is-reentrant=false, is-synchronous=true, call-type=REGULAR, execution-context=UNSPECIFIED
    Cdd_Pwm_SelectXbarInput: service-id=173, is-reentrant=false, is-synchronous=true, call-type=REGULAR, execution-context=UNSPECIFIED
    Cdd_Pwm_SetLutDecX: service-id=174, is-reentrant=false, is-synchronous=true, call-type=REGULAR, execution-context=UNSPECIFIED
    Cdd_Pwm_ConfigureDiodeEmulationMode: service-id=175, is-reentrant=false, is-synchronous=true, call-type=REGULAR, execution-context=UNSPECIFIED
    Cdd_Pwm_SetDiodeEmulationMode: service-id=176, is-reentrant=false, is-synchronous=true, call-type=REGULAR, execution-context=UNSPECIFIED
    Cdd_Pwm_SetDiodeEmulationReentryDelay: service-id=177, is-reentrant=false, is-synchronous=true, call-type=REGULAR, execution-context=UNSPECIFIED
    Cdd_Pwm_ConfigureDiodeEmulationTripLowSources: service-id=178, is-reentrant=false, is-synchronous=true, call-type=REGULAR, execution-context=UNSPECIFIED
    Cdd_Pwm_ConfigureDiodeEmulationTripHighSources: service-id=179, is-reentrant=false, is-synchronous=true, call-type=REGULAR, execution-context=UNSPECIFIED
    Cdd_Pwm_SelectDiodeEmulationPwmSignal: service-id=180, is-reentrant=false, is-synchronous=true, call-type=REGULAR, execution-context=UNSPECIFIED
    Cdd_Pwm_SelectDiodeEmulationTripSignal: service-id=181, is-reentrant=false, is-synchronous=true, call-type=REGULAR, execution-context=UNSPECIFIED
    Cdd_Pwm_NoBypassDiodeEmulationLogic: service-id=182, is-reentrant=false, is-synchronous=true, call-type=REGULAR, execution-context=UNSPECIFIED
    Cdd_Pwm_ByPassDiodeEmulationLogic: service-id=183, is-reentrant=false, is-synchronous=true, call-type=REGULAR, execution-context=UNSPECIFIED
    Cdd_Pwm_ForceDiodeEmulationActive: service-id=184, is-reentrant=false, is-synchronous=true, call-type=REGULAR, execution-context=UNSPECIFIED
    Cdd_Pwm_ConfigureDiodeEmulationMonitorModeControl: service-id=185, is-reentrant=false, is-synchronous=true, call-type=REGULAR, execution-context=UNSPECIFIED
    Cdd_Pwm_SetDiodeEmulationMonitorModeStep: service-id=186, is-reentrant=false, is-synchronous=true, call-type=REGULAR, execution-context=UNSPECIFIED
    Cdd_Pwm_SetDiodeEmulationMonitorCounterThreshold: service-id=187, is-reentrant=false, is-synchronous=true, call-type=REGULAR, execution-context=UNSPECIFIED
    Cdd_Pwm_ClearDiodeEmulationActiveFlag: service-id=188, is-reentrant=false, is-synchronous=true, call-type=REGULAR, execution-context=UNSPECIFIED
    Cdd_Pwm_HrpwmSetPhaseShift: service-id=189, is-reentrant=false, is-synchronous=true, call-type=REGULAR, execution-context=UNSPECIFIED
    Cdd_Pwm_HrpwmSetHiResPhaseShiftOnly: service-id=190, is-reentrant=false, is-synchronous=true, call-type=REGULAR, execution-context=UNSPECIFIED
    Cdd_Pwm_HrpwmSetTimeBasePeriod: service-id=191, is-reentrant=false, is-synchronous=true, call-type=REGULAR, execution-context=UNSPECIFIED
    Cdd_Pwm_HrpwmSetHiResTimeBasePeriodOnly: service-id=192, is-reentrant=false, is-synchronous=true, call-type=REGULAR, execution-context=UNSPECIFIED
    Cdd_Pwm_HrpwmGetTimeBasePeriod: service-id=193, is-reentrant=false, is-synchronous=true, call-type=REGULAR, execution-context=UNSPECIFIED
    Cdd_Pwm_HrpwmGetHiResTimeBasePeriodOnly: service-id=194, is-reentrant=false, is-synchronous=true, call-type=REGULAR, execution-context=UNSPECIFIED
    Cdd_Pwm_HrpwmSetMepEdgeSelect: service-id=195, is-reentrant=false, is-synchronous=true, call-type=REGULAR, execution-context=UNSPECIFIED
    Cdd_Pwm_HrpwmSetMepControlMode: service-id=196, is-reentrant=false, is-synchronous=true, call-type=REGULAR, execution-context=UNSPECIFIED
    Cdd_Pwm_HrpwmSetCounterCompareShadowLoadEvent: service-id=197, is-reentrant=false, is-synchronous=true, call-type=REGULAR, execution-context=UNSPECIFIED
    Cdd_Pwm_HrpwmSetOutputSwapMode: service-id=198, is-reentrant=false, is-synchronous=true, call-type=REGULAR, execution-context=UNSPECIFIED
    Cdd_Pwm_HrpwmSetChannelBOutputPath: service-id=199, is-reentrant=false, is-synchronous=true, call-type=REGULAR, execution-context=UNSPECIFIED
    Cdd_Pwm_HrpwmConfigureAutoConversion: service-id=200, is-reentrant=false, is-synchronous=true, call-type=REGULAR, execution-context=UNSPECIFIED
    Cdd_Pwm_HrpwmConfigurePeriodControl: service-id=201, is-reentrant=false, is-synchronous=true, call-type=REGULAR, execution-context=UNSPECIFIED
    Cdd_Pwm_HrpwmConfigurePhaseShiftLoad: service-id=202, is-reentrant=false, is-synchronous=true, call-type=REGULAR, execution-context=UNSPECIFIED
    Cdd_Pwm_HrpwmSetSyncPulseSource: service-id=203, is-reentrant=false, is-synchronous=true, call-type=REGULAR, execution-context=UNSPECIFIED
    Cdd_Pwm_HrpwmSetTranslatorRemainder: service-id=204, is-reentrant=false, is-synchronous=true, call-type=REGULAR, execution-context=UNSPECIFIED
    Cdd_Pwm_HrpwmSetCounterCompareValue: service-id=205, is-reentrant=false, is-synchronous=true, call-type=REGULAR, execution-context=UNSPECIFIED
    Cdd_Pwm_HrpwmSetHiResCounterCompareValueOnly: service-id=206, is-reentrant=false, is-synchronous=true, call-type=REGULAR, execution-context=UNSPECIFIED
    Cdd_Pwm_HrpwmGetCounterCompareValue: service-id=207, is-reentrant=false, is-synchronous=true, call-type=REGULAR, execution-context=UNSPECIFIED
    Cdd_Pwm_GetHiResCounterCompareValueOnly: service-id=208, is-reentrant=false, is-synchronous=true, call-type=REGULAR, execution-context=UNSPECIFIED
    Cdd_Pwm_HrpwmSetRisingEdgeDelay: service-id=209, is-reentrant=false, is-synchronous=true, call-type=REGULAR, execution-context=UNSPECIFIED
    Cdd_Pwm_HrpwmSetHiResRisingEdgeDelayOnly: service-id=210, is-reentrant=false, is-synchronous=true, call-type=REGULAR, execution-context=UNSPECIFIED
    Cdd_Pwm_HrpwmSetFallingEdgeDelay: service-id=211, is-reentrant=false, is-synchronous=true, call-type=REGULAR, execution-context=UNSPECIFIED
    Cdd_Pwm_HrpwmSetHiResFallingEdgeDelayOnly: service-id=212, is-reentrant=false, is-synchronous=true, call-type=REGULAR, execution-context=UNSPECIFIED
    Cdd_Pwm_HrpwmSetMepStep: service-id=213, is-reentrant=false, is-synchronous=true, call-type=REGULAR, execution-context=UNSPECIFIED
    Cdd_Pwm_HrpwmSetDeadbandMepEdgeSelect: service-id=214, is-reentrant=false, is-synchronous=true, call-type=REGULAR, execution-context=UNSPECIFIED
    Cdd_Pwm_HrpwmSetRisingEdgeDelayLoadMode: service-id=215, is-reentrant=false, is-synchronous=true, call-type=REGULAR, execution-context=UNSPECIFIED
    Cdd_Pwm_HrpwmSetFallingEdgeDelayLoadMode: service-id=216, is-reentrant=false, is-synchronous=true, call-type=REGULAR, execution-context=UNSPECIFIED
    Cdd_Pwm_HrpwmLockRegisters: service-id=217, is-reentrant=false, is-synchronous=true, call-type=REGULAR, execution-context=UNSPECIFIED
    Cdd_Pwm_HrpwmSetXCmpRegValue: service-id=218, is-reentrant=false, is-synchronous=true, call-type=REGULAR, execution-context=UNSPECIFIED
    Cdd_Pwm_HrpwmSetHiResXCmpRegValueOnly: service-id=219, is-reentrant=false, is-synchronous=true, call-type=REGULAR, execution-context=UNSPECIFIED
    Cdd_Pwm_ConfigureTripZone2Signals: service-id=223, is-reentrant=false, is-synchronous=true, call-type=REGULAR, execution-context=UNSPECIFIED
    Cdd_Pwm_Sfo: service-id=224, is-reentrant=false, is-synchronous=true, call-type=REGULAR, execution-context=UNSPECIFIED
