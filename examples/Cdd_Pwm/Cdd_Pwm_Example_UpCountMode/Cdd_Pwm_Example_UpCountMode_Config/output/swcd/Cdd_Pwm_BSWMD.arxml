AUTOSAR XML (schema 00044)
package /Cdd_Pwm_TI_F29H85x
  bsw module description Cdd_Pwm: category=BSW_MODULE, module-id=255
    implemented-entrys:
      Cdd_Pwm_Epwm1_IntIsr
      Cdd_Pwm_Epwm2_IntIsr
      Cdd_Pwm_EnableNotification
      Cdd_Pwm_DisableNotification
      Cdd_Pwm_GetVersionInfo
      Cdd_Pwm_Init
      Cdd_Pwm_SetInterruptEventCount
      Cdd_Pwm_SetDutyCycle
      Cdd_Pwm_SetPeriod
      Cdd_Pwm_DeInit
      Cdd_Pwm_SetOutputToIdle
    bsw module dependency Det: target-module-id=15, target-module=Det
    bsw internal behavior Cdd_Pwm_Behavior
      exclusive area CDD_PWM_EXCLUSIVE_AREA_0
      bsw interrupt entity Cdd_Pwm_Epwm1_IntIsr: reentrancy-level=NON-REENTRANT, implemented-entry=Cdd_Pwm_Epwm1_IntIsr, interrupt-category=CAT-1
      bsw interrupt entity Cdd_Pwm_Epwm2_IntIsr: reentrancy-level=NON-REENTRANT, implemented-entry=Cdd_Pwm_Epwm2_IntIsr, interrupt-category=CAT-1
      9 x bsw called entity:
        Cdd_Pwm_Init: can-enter-exclusive-area=CDD_PWM_EXCLUSIVE_AREA_0, reentrancy-level=NON-REENTRANT, implemented-entry=Cdd_Pwm_Init
          bsw direct call point Det: called-entry=Det_ReportError
        Cdd_Pwm_SetInterruptEventCount: can-enter-exclusive-area=CDD_PWM_EXCLUSIVE_AREA_0, reentrancy-level=SINGLE-CORE-REENTRANT, implemented-entry=Cdd_Pwm_SetInterruptEventCount
          bsw direct call point Det: called-entry=Det_ReportError
          bsw direct call point Det_Runtime: called-entry=Det_ReportRuntimeError
        Cdd_Pwm_GetVersionInfo: reentrancy-level=SINGLE-CORE-REENTRANT, implemented-entry=Cdd_Pwm_GetVersionInfo
          bsw direct call point Det: called-entry=Det_ReportError
        Cdd_Pwm_EnableNotification: can-enter-exclusive-area=CDD_PWM_EXCLUSIVE_AREA_0, reentrancy-level=SINGLE-CORE-REENTRANT, implemented-entry=Cdd_Pwm_EnableNotification
          bsw direct call point Det: called-entry=Det_ReportError
          bsw direct call point Det_Runtime: called-entry=Det_ReportRuntimeError
        Cdd_Pwm_DisableNotification: can-enter-exclusive-area=CDD_PWM_EXCLUSIVE_AREA_0, reentrancy-level=SINGLE-CORE-REENTRANT, implemented-entry=Cdd_Pwm_DisableNotification
          bsw direct call point Det: called-entry=Det_ReportError
        Cdd_Pwm_SetDutyCycle: can-enter-exclusive-area=CDD_PWM_EXCLUSIVE_AREA_0, reentrancy-level=SINGLE-CORE-REENTRANT, implemented-entry=Cdd_Pwm_SetDutyCycle
          bsw direct call point Det: called-entry=Det_ReportError
        Cdd_Pwm_SetPeriod: can-enter-exclusive-area=CDD_PWM_EXCLUSIVE_AREA_0, reentrancy-level=SINGLE-CORE-REENTRANT, implemented-entry=Cdd_Pwm_SetPeriod
          bsw direct call point Det: called-entry=Det_ReportError
        Cdd_Pwm_SetOutputToIdle: can-enter-exclusive-area=CDD_PWM_EXCLUSIVE_AREA_0, reentrancy-level=SINGLE-CORE-REENTRANT, implemented-entry=Cdd_Pwm_SetOutputToIdle
          bsw direct call point Det: called-entry=Det_ReportError
        Cdd_Pwm_DeInit: can-enter-exclusive-area=CDD_PWM_EXCLUSIVE_AREA_0, reentrancy-level=NON-REENTRANT, implemented-entry=Cdd_Pwm_DeInit
          bsw direct call point Det: called-entry=Det_ReportError
  bsw implementation Cdd_Pwm_Impl: programming-language=C, sw-version=2.0.0, vendor-id=44, ar-release-version=4.3.1, behavior=Cdd_Pwm_Behavior, vendor-specific-module-def=Cdd
    code-descriptors:
      code Files
        artifact-descriptors:
          short-label=include::Cdd_Pwm.h, category=SWHDR
          short-label=include::Cdd_Pwm_Priv.h, category=SWHDR
          short-label=src::Cdd_Pwm.c, category=SWSRC
          short-label=src::Cdd_Pwm_Irq.c, category=SWSRC
          short-label=src::Cdd_Pwm_Priv.c, category=SWSRC
          short-label=generate::src::Cdd_Pwm_Cfg.c, category=SWSRC
          short-label=generate::include::Cdd_Pwm_Cfg.h, category=SWHDR
    compiler TI_C29Clang: name=TI_C29Clang, vendor=Texas Instruments, version=2.0.0
    linker TI_C29Linker: name=TI_C29Linker, vendor=Texas Instruments, version=2.0.0
    resource consumption ResourceConsumption
      6 x memory section:
        CDD_PWM_CODE: alignment=UNSPECIFIED, sw-addrmethod=CODE, symbol=CODE
        CDD_PWM_CONFIG_DATA_UNSPECIFIED: alignment=UNSPECIFIED, sw-addrmethod=CONST_PBCFG, symbol=CONFIG_DATA_UNSPECIFIED
        CDD_PWM_VAR_INIT_PTR: alignment=UNSPECIFIED, sw-addrmethod=VAR_INIT, symbol=VAR_INIT_PTR
        CDD_PWM_VAR_NO_INIT_UNSPECIFIED: alignment=UNSPECIFIED, sw-addrmethod=VAR_NO_INIT, symbol=VAR_NO_INIT_UNSPECIFIED
        CDD_PWM_ISR_CODE: alignment=UNSPECIFIED, sw-addrmethod=CODE, symbol=ISR_CODE
        CDD_PWM_VAR_INIT_BOOLEAN: alignment=BOOLEAN, sw-addrmethod=VAR_INIT, symbol=VAR_INIT_BOOLEAN
package /Cdd_Pwm_TI_F29H85x/Cdd_Pwm_ModuleEntry
  27 x bsw module entry, all with sw-service-impl-policy=STANDARD, bsw-entry-kind=CONCRETE:
    Cdd_Pwm_Epwm1_IntIsr: is-reentrant=false, is-synchronous=true, call-type=INTERRUPT, execution-context=INTERRUPT-CAT-1
    Cdd_Pwm_Epwm2_IntIsr: is-reentrant=false, is-synchronous=true, call-type=INTERRUPT, execution-context=INTERRUPT-CAT-1
    Cdd_Pwm_Epwm{3..18}_IntIsr: is-reentrant=false, is-synchronous=true, call-type=INTERRUPT
    Cdd_Pwm_EnableNotification: service-id=221, is-reentrant=true, is-synchronous=true, call-type=REGULAR, execution-context=UNSPECIFIED
    Cdd_Pwm_DisableNotification: service-id=222, is-reentrant=true, is-synchronous=true, call-type=REGULAR, execution-context=UNSPECIFIED
    Cdd_Pwm_Init: service-id=0, is-reentrant=false, is-synchronous=true, call-type=REGULAR, execution-context=UNSPECIFIED
    Cdd_Pwm_GetVersionInfo: service-id=6, is-reentrant=true, is-synchronous=false, call-type=REGULAR, execution-context=UNSPECIFIED
    Cdd_Pwm_SetInterruptEventCount: service-id=220, is-reentrant=true, is-synchronous=false, call-type=REGULAR, execution-context=UNSPECIFIED
    Cdd_Pwm_DeInit: service-id=1, is-reentrant=false, is-synchronous=true, call-type=REGULAR, execution-context=UNSPECIFIED
    Cdd_Pwm_SetOutputToIdle: service-id=4, is-reentrant=true, is-synchronous=true, call-type=REGULAR, execution-context=UNSPECIFIED
    Cdd_Pwm_SetPeriod: service-id=3, is-reentrant=true, is-synchronous=true, call-type=REGULAR, execution-context=UNSPECIFIED
    Cdd_Pwm_SetDutyCycle: service-id=2, is-reentrant=true, is-synchronous=true, call-type=REGULAR, execution-context=UNSPECIFIED
