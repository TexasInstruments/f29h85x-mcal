AUTOSAR XML (schema 00044)
package /Cdd_I2c_TI_F29H85x
  bsw module description Cdd_I2c: category=BSW_MODULE, module-id=255
    implemented-entrys:
      Cdd_I2c_Init
      Cdd_I2c_DeInit
      Cdd_I2c_GetVersionInfo
      Cdd_I2c_ResetHwUnit
      Cdd_I2c_SetupEB
      Cdd_I2c_SetupEBDynamic
      Cdd_I2c_AsyncTransmit
      Cdd_I2c_GetSequenceResult
      Cdd_I2c_GetResult
      Cdd_I2c_GetStatus
      Cdd_I2c_I2CB_ISR
      Cdd_I2c_TargetStart
      Cdd_I2c_TargetStop
      Cdd_I2c_TargetSubmitTxBuffer
      Cdd_I2c_TargetSubmitRxBuffer
    bsw module dependency Det: target-module-id=15, target-module=Det
    bsw internal behavior Cdd_I2c_Behavior
      exclusive area CDD_I2C_EXCLUSIVE_AREA_0
      14 x bsw called entity:
        Cdd_I2c_Init: reentrancy-level=NON-REENTRANT, implemented-entry=Cdd_I2c_Init
          bsw direct call point Det: called-entry=Det_ReportError
        Cdd_I2c_Deinit: reentrancy-level=NON-REENTRANT, implemented-entry=Cdd_I2c_DeInit
          bsw direct call point Det: called-entry=Det_ReportError
        Cdd_I2c_GetVersionInfo: reentrancy-level=SINGLE-CORE-REENTRANT, implemented-entry=Cdd_I2c_GetVersionInfo
          bsw direct call point Det: called-entry=Det_ReportError
        Cdd_I2c_ResetHwUnit: can-enter-exclusive-area=CDD_I2C_EXCLUSIVE_AREA_0, reentrancy-level=NON-REENTRANT, implemented-entry=Cdd_I2c_ResetHwUnit
          bsw direct call point Det: called-entry=Det_ReportError
        Cdd_I2c_SetupEB: can-enter-exclusive-area=CDD_I2C_EXCLUSIVE_AREA_0, reentrancy-level=SINGLE-CORE-REENTRANT, implemented-entry=Cdd_I2c_SetupEB
          bsw direct call point Det: called-entry=Det_ReportError
        Cdd_I2c_SetupEBDynamic: can-enter-exclusive-area=CDD_I2C_EXCLUSIVE_AREA_0, reentrancy-level=SINGLE-CORE-REENTRANT, implemented-entry=Cdd_I2c_SetupEBDynamic
          bsw direct call point Det: called-entry=Det_ReportError
        Cdd_I2c_AsyncTransmit: can-enter-exclusive-area=CDD_I2C_EXCLUSIVE_AREA_0, reentrancy-level=SINGLE-CORE-REENTRANT, implemented-entry=Cdd_I2c_AsyncTransmit
          bsw direct call point Det: called-entry=Det_ReportError
        Cdd_I2c_GetSequenceResult: reentrancy-level=SINGLE-CORE-REENTRANT, implemented-entry=Cdd_I2c_GetSequenceResult
          bsw direct call point Det: called-entry=Det_ReportError
        Cdd_I2c_GetResult: reentrancy-level=SINGLE-CORE-REENTRANT, implemented-entry=Cdd_I2c_GetResult
          bsw direct call point Det: called-entry=Det_ReportError
        Cdd_I2c_GetStatus: reentrancy-level=SINGLE-CORE-REENTRANT, implemented-entry=Cdd_I2c_GetStatus
        Cdd_I2c_TargetStart: reentrancy-level=SINGLE-CORE-REENTRANT, implemented-entry=Cdd_I2c_TargetStart
          bsw direct call point Det: called-entry=Det_ReportError
        Cdd_I2c_TargetStop: reentrancy-level=SINGLE-CORE-REENTRANT, implemented-entry=Cdd_I2c_TargetStop
          bsw direct call point Det: called-entry=Det_ReportError
        Cdd_I2c_TargetSubmitTxBuffer: reentrancy-level=SINGLE-CORE-REENTRANT, implemented-entry=Cdd_I2c_TargetSubmitTxBuffer
          bsw direct call point Det: called-entry=Det_ReportError
        Cdd_I2c_TargetSubmitRxBuffer: reentrancy-level=SINGLE-CORE-REENTRANT, implemented-entry=Cdd_I2c_TargetSubmitRxBuffer
          bsw direct call point Det: called-entry=Det_ReportError
      bsw interrupt entity Cdd_I2c_I2CB_ISR: reentrancy-level=NON-REENTRANT, implemented-entry=Cdd_I2c_I2CB_ISR, interrupt-category=CAT-2
  bsw implementation Cdd_I2c_Impl: programming-language=C, sw-version=1.2.0, vendor-id=44, ar-release-version=4.3.1, behavior=Cdd_I2c_Behavior, vendor-specific-module-def=Cdd
    code-descriptors:
      code Files
        artifact-descriptors:
          short-label=include::Cdd_I2c_Hw.h, category=SWHDR
          short-label=include::Cdd_I2c_Priv.h, category=SWHDR
          short-label=include::Cdd_I2c_Utils.h, category=SWHDR
          short-label=include::Cdd_I2c.h, category=SWHDR
          short-label=src::Cdd_I2c_Hw.c, category=SWSRC
          short-label=src::Cdd_I2c_Irq.c, category=SWSRC
          short-label=src::Cdd_I2c_Priv.c, category=SWSRC
          short-label=src::Cdd_I2c_Utils.c, category=SWSRC
          short-label=src::Cdd_I2c.c, category=SWSRC
          short-label=src::Cdd_I2c_Target.c, category=SWSRC
          short-label=generate::include::Cdd_I2c_Cfg.h, category=SWHDR
          short-label=generate::src::Cdd_I2c_Cfg.c, category=SWSRC
    compiler TI_C29Clang: name=TI_C29Clang, vendor=Texas Instruments, version=2.0.0
    linker TI_C29Linker: name=TI_C29Linker, vendor=Texas Instruments, version=2.0.0
    resource consumption ResourceConsumption
      6 x memory section:
        CDD_I2C_CODE: alignment=UNSPECIFIED, sw-addrmethod=CODE, symbol=CODE
        CDD_I2C_ISR_CODE: alignment=UNSPECIFIED, sw-addrmethod=CODE, symbol=ISR_CODE
        CDD_I2C_CONFIG_DATA: alignment=UNSPECIFIED, sw-addrmethod=CONST_PBCFG, symbol=CONFIG_DATA
        CDD_I2C_CONFIG_CONST_32: alignment=32, sw-addrmethod=CONST, symbol=CONFIG_CONST_32
        CDD_I2C_VAR_INIT_UNSPECIFIED: alignment=UNSPECIFIED, sw-addrmethod=VAR_INIT, symbol=VAR_INIT_UNSPECIFIED
        CDD_I2C_VAR_NO_INIT_UNSPECIFIED: alignment=UNSPECIFIED, sw-addrmethod=VAR_NO_INIT, symbol=VAR_NO_INIT_UNSPECIFIED
package /Cdd_I2c_TI_F29H85x/Cdd_I2c_ModuleEntry
  19 x bsw module entry, all with sw-service-impl-policy=STANDARD, bsw-entry-kind=CONCRETE:
    Cdd_I2c_Init: service-id=0, is-reentrant=false, is-synchronous=true, call-type=REGULAR, execution-context=UNSPECIFIED
    Cdd_I2c_DeInit: service-id=1, is-reentrant=false, is-synchronous=true, call-type=REGULAR, execution-context=UNSPECIFIED
    Cdd_I2c_GetVersionInfo: service-id=2, is-reentrant=true, is-synchronous=true, call-type=REGULAR, execution-context=UNSPECIFIED
    Cdd_I2c_ResetHwUnit: service-id=12, is-reentrant=false, is-synchronous=true, call-type=REGULAR, execution-context=UNSPECIFIED
    Cdd_I2c_SetupEB: service-id=3, is-reentrant=true, is-synchronous=true, call-type=REGULAR, execution-context=UNSPECIFIED
    Cdd_I2c_SetupEBDynamic: service-id=4, is-reentrant=true, is-synchronous=true, call-type=REGULAR, execution-context=UNSPECIFIED
    Cdd_I2c_AsyncTransmit: service-id=5, is-reentrant=true, is-synchronous=false, call-type=REGULAR, execution-context=UNSPECIFIED
    Cdd_I2c_Cancel: service-id=6, is-reentrant=false, is-synchronous=true, call-type=REGULAR, execution-context=UNSPECIFIED
    Cdd_I2c_MainFunction: service-id=9, is-reentrant=true, is-synchronous=true, call-type=SCHEDULED, execution-context=UNSPECIFIED
    Cdd_I2c_PollingModeProcessing: service-id=10, is-reentrant=true, is-synchronous=true, call-type=REGULAR, execution-context=UNSPECIFIED
    Cdd_I2c_GetSequenceResult: service-id=8, is-reentrant=true, is-synchronous=true, call-type=REGULAR, execution-context=UNSPECIFIED
    Cdd_I2c_GetResult: service-id=7, is-reentrant=true, is-synchronous=true, call-type=REGULAR, execution-context=UNSPECIFIED
    Cdd_I2c_GetStatus: service-id=11, is-reentrant=true, is-synchronous=true, call-type=REGULAR, execution-context=UNSPECIFIED
    Cdd_I2c_TargetStart: service-id=32, is-reentrant=true, is-synchronous=true, call-type=REGULAR, execution-context=UNSPECIFIED
    Cdd_I2c_TargetStop: service-id=33, is-reentrant=true, is-synchronous=true, call-type=REGULAR, execution-context=UNSPECIFIED
    Cdd_I2c_TargetSubmitTxBuffer: service-id=34, is-reentrant=true, is-synchronous=true, call-type=REGULAR, execution-context=UNSPECIFIED
    Cdd_I2c_TargetSubmitRxBuffer: service-id=35, is-reentrant=true, is-synchronous=true, call-type=REGULAR, execution-context=UNSPECIFIED
    Cdd_I2c_I2CA_ISR: is-reentrant=false, is-synchronous=true, call-type=INTERRUPT, execution-context=INTERRUPT-CAT-1
    Cdd_I2c_I2CB_ISR: is-reentrant=false, is-synchronous=true, call-type=INTERRUPT, execution-context=INTERRUPT-CAT-1
