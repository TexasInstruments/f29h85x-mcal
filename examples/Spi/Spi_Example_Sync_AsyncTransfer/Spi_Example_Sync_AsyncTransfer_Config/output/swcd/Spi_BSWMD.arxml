AUTOSAR XML (schema 00044)
package /Spi_TI_F29H85x
  bsw module description Spi: category=BSW_MODULE, module-id=83
    implemented-entrys:
      Spi_A_RxISR
      Spi_B_RxISR
      Spi_DeInit
      Spi_GetHWUnitStatus
      Spi_GetJobResult
      Spi_GetSequenceResult
      Spi_GetStatus
      Spi_GetVersionInfo
      Spi_Init
      Spi_MainFunction_Handling
      Spi_WriteIB
      Spi_ReadIB
      Spi_JobEndNotification
      Spi_SeqEndNotification
      Spi_SetAsyncMode
      Spi_SetupEB
      Spi_SyncTransmit
      Spi_AsyncTransmit
    bsw module dependency Det: target-module-id=15, target-module=Det
    bsw internal behavior Spi_Behavior
      exclusive area SPI_EXCLUSIVE_AREA_0
      bsw interrupt entity Spi_A_RxISR: reentrancy-level=NON-REENTRANT, implemented-entry=Spi_A_RxISR, interrupt-category=CAT-1
      bsw interrupt entity Spi_B_RxISR: reentrancy-level=NON-REENTRANT, implemented-entry=Spi_B_RxISR, interrupt-category=CAT-2
      8 x bsw called entity:
        Spi_AsyncTransmit: can-enter-exclusive-area=SPI_EXCLUSIVE_AREA_0, reentrancy-level=SINGLE-CORE-REENTRANT, implemented-entry=Spi_AsyncTransmit
          bsw direct call point Det_ReportError: called-entry=Det_ReportError
          bsw direct call point Det_ReportRuntimeError: called-entry=Det_ReportRuntimeError
        Spi_DeInit: reentrancy-level=NON-REENTRANT, implemented-entry=Spi_DeInit
          bsw direct call point Det_ReportError: called-entry=Det_ReportError
        Spi_GetHWUnitStatus: can-enter-exclusive-area=SPI_EXCLUSIVE_AREA_0, reentrancy-level=SINGLE-CORE-REENTRANT, implemented-entry=Spi_GetHWUnitStatus
          bsw direct call point Det_ReportError: called-entry=Det_ReportError
        Spi_GetJobResult: reentrancy-level=SINGLE-CORE-REENTRANT, implemented-entry=Spi_GetJobResult
          bsw direct call point Det_ReportError: called-entry=Det_ReportError
        Spi_GetSequenceResult: reentrancy-level=SINGLE-CORE-REENTRANT, implemented-entry=Spi_GetSequenceResult
          bsw direct call point Det_ReportError: called-entry=Det_ReportError
        Spi_GetStatus: reentrancy-level=SINGLE-CORE-REENTRANT, implemented-entry=Spi_GetStatus
          bsw direct call point Det_ReportError: called-entry=Det_ReportError
        Spi_GetVersionInfo: reentrancy-level=SINGLE-CORE-REENTRANT, implemented-entry=Spi_GetVersionInfo
          bsw direct call point Det_ReportError: called-entry=Det_ReportError
        Spi_Init: reentrancy-level=NON-REENTRANT, implemented-entry=Spi_Init
          bsw direct call point Det_ReportError: called-entry=Det_ReportError
      bsw schedulable entity Spi_MainFunction_Handling: reentrancy-level=NON-REENTRANT, implemented-entry=Spi_MainFunction_Handling
        bsw direct call point Dem_SetEventStatus: called-entry=Dem_SetEventStatus
        bsw direct call point Det_ReportError: called-entry=Det_ReportError
      5 x bsw called entity:
        Spi_ReadIB: can-enter-exclusive-area=SPI_EXCLUSIVE_AREA_0, reentrancy-level=SINGLE-CORE-REENTRANT, implemented-entry=Spi_ReadIB
          bsw direct call point Det_ReportError: called-entry=Det_ReportError
        Spi_SetAsyncMode: reentrancy-level=NON-REENTRANT, implemented-entry=Spi_SetAsyncMode
          bsw direct call point Det_ReportError: called-entry=Det_ReportError
        Spi_SetupEB: can-enter-exclusive-area=SPI_EXCLUSIVE_AREA_0, reentrancy-level=SINGLE-CORE-REENTRANT, implemented-entry=Spi_SetupEB
          bsw direct call point Det_ReportError: called-entry=Det_ReportError
        Spi_SyncTransmit: can-enter-exclusive-area=SPI_EXCLUSIVE_AREA_0, reentrancy-level=SINGLE-CORE-REENTRANT, implemented-entry=Spi_SyncTransmit
          bsw direct call point Det_ReportError: called-entry=Det_ReportError
          bsw direct call point Det_ReportRuntimeError: called-entry=Det_ReportRuntimeError
        Spi_WriteIB: can-enter-exclusive-area=SPI_EXCLUSIVE_AREA_0, reentrancy-level=SINGLE-CORE-REENTRANT, implemented-entry=Spi_WriteIB
          bsw direct call point Det_ReportError: called-entry=Det_ReportError
  bsw implementation Spi_Impl: programming-language=C, sw-version=2.0.0, vendor-id=44, ar-release-version=4.3.1, behavior=Spi_Behavior, vendor-specific-module-def=Spi
    code-descriptors:
      code Files
        artifact-descriptors:
          short-label=generate::include::Spi_Cfg.h, category=SWHDR
          short-label=generate::src::Spi_Cfg.c, category=SWSRC
          short-label=generate::src::Spi_Lcfg.c, category=SWSRC
          short-label=generate::src::Spi_PBcfg.c, category=SWSRC
          short-label=include::Spi.h, category=SWHDR
          short-label=include::Spi_Priv.h, category=SWHDR
          short-label=include::Spi_Utils.h, category=SWHDR
          short-label=src::Spi.c, category=SWSRC
          short-label=src::Spi_Irq.c, category=SWSRC
          short-label=src::Spi_Priv.c, category=SWSRC
          short-label=src::Spi_Utils.c, category=SWSRC
    compiler TI_C29Clang: name=TI_C29Clang, vendor=Texas Instruments, version=2.0.0
    linker TI_C29Linker: name=TI_C29Linker, vendor=Texas Instruments, version=2.0.0
    resource consumption ResourceConsumption
      5 x memory section, all with alignment=UNSPECIFIED:
        SPI_CODE: sw-addrmethod=CODE, symbol=CODE
        SPI_CONFIG_DATA: sw-addrmethod=CONST_PBCFG, symbol=CONFIG_DATA
        SPI_ISR_CODE: sw-addrmethod=CODE, symbol=ISR_CODE
        SPI_VAR_INIT_UNSPECIFIED: sw-addrmethod=VAR_INIT, symbol=VAR_INIT_UNSPECIFIED
        SPI_VAR_NO_INIT_UNSPECIFIED: sw-addrmethod=VAR_NO_INIT, symbol=VAR_NO_INIT_UNSPECIFIED
package /Spi_TI_F29H85x/BSWModuleEntry
  22 x bsw module entry:
    Spi_A_RxISR: is-reentrant=false, is-synchronous=true, call-type=INTERRUPT, execution-context=INTERRUPT-CAT-1, sw-service-impl-policy=STANDARD, bsw-entry-kind=CONCRETE
    Spi_B_RxISR: is-reentrant=false, is-synchronous=true, call-type=INTERRUPT, execution-context=INTERRUPT-CAT-2, sw-service-impl-policy=STANDARD, bsw-entry-kind=CONCRETE
    Spi_C_RxISR: is-reentrant=false, is-synchronous=true, call-type=INTERRUPT, execution-context=INTERRUPT-CAT-2, sw-service-impl-policy=STANDARD, bsw-entry-kind=CONCRETE
    Spi_D_RxISR: is-reentrant=false, is-synchronous=true, call-type=INTERRUPT, execution-context=INTERRUPT-CAT-2, sw-service-impl-policy=STANDARD, bsw-entry-kind=CONCRETE
    Spi_E_RxISR: is-reentrant=false, is-synchronous=true, call-type=INTERRUPT, execution-context=INTERRUPT-CAT-2, sw-service-impl-policy=STANDARD, bsw-entry-kind=CONCRETE
    Spi_AsyncTransmit: service-id=3, is-reentrant=true, is-synchronous=false, call-type=REGULAR, execution-context=UNSPECIFIED, sw-service-impl-policy=STANDARD, bsw-entry-kind=CONCRETE
    Spi_Cancel: service-id=12, is-reentrant=true, is-synchronous=false, call-type=REGULAR, execution-context=UNSPECIFIED, sw-service-impl-policy=STANDARD, bsw-entry-kind=CONCRETE
    Spi_DeInit: service-id=1, is-reentrant=false, is-synchronous=true, call-type=REGULAR, execution-context=UNSPECIFIED, sw-service-impl-policy=STANDARD, bsw-entry-kind=CONCRETE
    Spi_GetHWUnitStatus: service-id=11, is-reentrant=true, is-synchronous=true, call-type=REGULAR, execution-context=UNSPECIFIED, sw-service-impl-policy=STANDARD, bsw-entry-kind=CONCRETE
    Spi_GetJobResult: service-id=7, is-reentrant=true, is-synchronous=true, call-type=REGULAR, execution-context=UNSPECIFIED, sw-service-impl-policy=STANDARD, bsw-entry-kind=CONCRETE
    Spi_GetSequenceResult: service-id=8, is-reentrant=true, is-synchronous=true, call-type=REGULAR, execution-context=UNSPECIFIED, sw-service-impl-policy=STANDARD, bsw-entry-kind=CONCRETE
    Spi_GetStatus: service-id=6, is-reentrant=true, is-synchronous=true, call-type=REGULAR, execution-context=UNSPECIFIED, bsw-entry-kind=CONCRETE
    Spi_GetVersionInfo: service-id=9, is-reentrant=true, is-synchronous=true, call-type=REGULAR, execution-context=UNSPECIFIED, sw-service-impl-policy=STANDARD, bsw-entry-kind=CONCRETE
    Spi_Init: service-id=0, is-reentrant=false, is-synchronous=true, call-type=REGULAR, execution-context=UNSPECIFIED, sw-service-impl-policy=STANDARD, bsw-entry-kind=CONCRETE
    Spi_JobEndNotification: is-reentrant=true, is-synchronous=true, call-type=CALLBACK, execution-context=UNSPECIFIED, sw-service-impl-policy=STANDARD, bsw-entry-kind=ABSTRACT
    Spi_MainFunction_Handling: service-id=16, is-reentrant=false, is-synchronous=false, call-type=SCHEDULED, execution-context=UNSPECIFIED, sw-service-impl-policy=STANDARD, bsw-entry-kind=CONCRETE
    Spi_ReadIB: service-id=4, is-reentrant=true, is-synchronous=true, call-type=REGULAR, execution-context=UNSPECIFIED, sw-service-impl-policy=STANDARD, bsw-entry-kind=CONCRETE
    Spi_SeqEndNotification: is-reentrant=true, is-synchronous=true, call-type=CALLBACK, execution-context=UNSPECIFIED, sw-service-impl-policy=STANDARD, bsw-entry-kind=ABSTRACT
    Spi_SetAsyncMode: service-id=13, is-reentrant=false, is-synchronous=true, call-type=REGULAR, execution-context=UNSPECIFIED, sw-service-impl-policy=STANDARD, bsw-entry-kind=CONCRETE
    Spi_SetupEB: service-id=5, is-reentrant=true, is-synchronous=true, call-type=REGULAR, execution-context=UNSPECIFIED, sw-service-impl-policy=STANDARD, bsw-entry-kind=CONCRETE
    Spi_SyncTransmit: service-id=10, is-reentrant=true, is-synchronous=false, call-type=REGULAR, execution-context=UNSPECIFIED, sw-service-impl-policy=STANDARD, bsw-entry-kind=CONCRETE
    Spi_WriteIB: service-id=2, is-reentrant=true, is-synchronous=true, call-type=REGULAR, execution-context=UNSPECIFIED, sw-service-impl-policy=STANDARD, bsw-entry-kind=CONCRETE
