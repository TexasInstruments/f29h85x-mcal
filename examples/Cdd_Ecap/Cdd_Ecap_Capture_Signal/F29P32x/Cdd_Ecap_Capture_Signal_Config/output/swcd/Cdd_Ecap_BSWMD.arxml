AUTOSAR XML (schema 00044)
package /Cdd_Ecap_TI_F29H85x
  bsw module description Cdd_Ecap: category=BSW_MODULE, module-id=255
    implemented-entrys:
      Cdd_Ecap_Deinit
      Cdd_Ecap_DisableEdgeCount
      Cdd_Ecap_DisableEdgeDetection
      Cdd_Ecap_DisableNotification
      Cdd_Ecap_EnableEdgeCount
      Cdd_Ecap_EnableEdgeDetection
      Cdd_Ecap_EnableNotification
      Cdd_Ecap_GetDutyCycleValues
      Cdd_Ecap_GetEdgeNumbers
      Cdd_Ecap_GetInputState
      Cdd_Ecap_GetTimeElapsed
      Cdd_Ecap_GetTimestampIndex
      Cdd_Ecap_GetVersionInfo
      Cdd_Ecap_Init
      Cdd_Ecap_IntISR_Fun
      Cdd_Ecap_PeriodicReadback
      Cdd_Ecap_ResetEdgeCount
      Cdd_Ecap_SetActivationCondition
      Cdd_Ecap_StartSignalMeasurement
      Cdd_Ecap_StartTimestamp
      Cdd_Ecap_StopSignalMeasurement
      Cdd_Ecap_ConvertHrTimeStampToEcapTimeStamp
      Cdd_Ecap_ch{0..3}Notify
    bsw module dependency Det: target-module-id=15, target-module=Det
    bsw internal behavior Cdd_Ecap_Behavior
      exclusive area CDD_ECAP_EXCLUSIVE_AREA_0
      14 x bsw called entity:
        Cdd_Ecap_Deinit: reentrancy-level=NON-REENTRANT, implemented-entry=Cdd_Ecap_Deinit
          bsw direct call point Det_ReportError: called-entry=Det_ReportError
        Cdd_Ecap_DisableEdgeCount: can-enter-exclusive-area=CDD_ECAP_EXCLUSIVE_AREA_0, reentrancy-level=SINGLE-CORE-REENTRANT, implemented-entry=Cdd_Ecap_DisableEdgeCount
          bsw direct call point Det_ReportError: called-entry=Det_ReportError
        Cdd_Ecap_DisableEdgeDetection: can-enter-exclusive-area=CDD_ECAP_EXCLUSIVE_AREA_0, reentrancy-level=SINGLE-CORE-REENTRANT, implemented-entry=Cdd_Ecap_DisableEdgeDetection
          bsw direct call point Det_ReportError: called-entry=Det_ReportError
        Cdd_Ecap_DisableNotification: can-enter-exclusive-area=CDD_ECAP_EXCLUSIVE_AREA_0, reentrancy-level=SINGLE-CORE-REENTRANT, implemented-entry=Cdd_Ecap_DisableNotification
          bsw direct call point Det_ReportError: called-entry=Det_ReportError
        Cdd_Ecap_EnableEdgeCount: can-enter-exclusive-area=CDD_ECAP_EXCLUSIVE_AREA_0, reentrancy-level=SINGLE-CORE-REENTRANT, implemented-entry=Cdd_Ecap_EnableEdgeCount
          bsw direct call point Det_ReportError: called-entry=Det_ReportError
        Cdd_Ecap_EnableEdgeDetection: can-enter-exclusive-area=CDD_ECAP_EXCLUSIVE_AREA_0, reentrancy-level=SINGLE-CORE-REENTRANT, implemented-entry=Cdd_Ecap_EnableEdgeDetection
          bsw direct call point Det_ReportError: called-entry=Det_ReportError
        Cdd_Ecap_EnableNotification: can-enter-exclusive-area=CDD_ECAP_EXCLUSIVE_AREA_0, reentrancy-level=SINGLE-CORE-REENTRANT, implemented-entry=Cdd_Ecap_EnableNotification
          bsw direct call point Det_ReportError: called-entry=Det_ReportError
        Cdd_Ecap_GetDutyCycleValues: can-enter-exclusive-area=CDD_ECAP_EXCLUSIVE_AREA_0, reentrancy-level=SINGLE-CORE-REENTRANT, implemented-entry=Cdd_Ecap_GetDutyCycleValues
          bsw direct call point Det_ReportError: called-entry=Det_ReportError
        Cdd_Ecap_GetEdgeNumbers: can-enter-exclusive-area=CDD_ECAP_EXCLUSIVE_AREA_0, reentrancy-level=SINGLE-CORE-REENTRANT, implemented-entry=Cdd_Ecap_GetEdgeNumbers
          bsw direct call point Det_ReportError: called-entry=Det_ReportError
        Cdd_Ecap_GetInputState: can-enter-exclusive-area=CDD_ECAP_EXCLUSIVE_AREA_0, reentrancy-level=SINGLE-CORE-REENTRANT, implemented-entry=Cdd_Ecap_GetInputState
          bsw direct call point Det_ReportError: called-entry=Det_ReportError
        Cdd_Ecap_GetTimeElapsed: can-enter-exclusive-area=CDD_ECAP_EXCLUSIVE_AREA_0, reentrancy-level=SINGLE-CORE-REENTRANT, implemented-entry=Cdd_Ecap_GetTimeElapsed
          bsw direct call point Det_ReportError: called-entry=Det_ReportError
        Cdd_Ecap_GetTimestampIndex: can-enter-exclusive-area=CDD_ECAP_EXCLUSIVE_AREA_0, reentrancy-level=SINGLE-CORE-REENTRANT, implemented-entry=Cdd_Ecap_GetTimestampIndex
          bsw direct call point Det_ReportError: called-entry=Det_ReportError
        Cdd_Ecap_GetVersionInfo: can-enter-exclusive-area=CDD_ECAP_EXCLUSIVE_AREA_0, reentrancy-level=SINGLE-CORE-REENTRANT, implemented-entry=Cdd_Ecap_GetVersionInfo
          bsw direct call point Det_ReportError: called-entry=Det_ReportError
        Cdd_Ecap_Init: reentrancy-level=NON-REENTRANT, implemented-entry=Cdd_Ecap_Init
          bsw direct call point Det_ReportError: called-entry=Det_ReportError
      bsw interrupt entity Cdd_Ecap_IntISR_Fun: reentrancy-level=NON-REENTRANT, implemented-entry=Cdd_Ecap_IntISR_Fun, interrupt-category=CAT-1
        bsw direct call point Det_ReportError: called-entry=Det_ReportError
      7 x bsw called entity, all with reentrancy-level=SINGLE-CORE-REENTRANT:
        Cdd_Ecap_PeriodicReadback: implemented-entry=Cdd_Ecap_PeriodicReadback
          bsw direct call point Det_ReportError: called-entry=Det_ReportError
        Cdd_Ecap_ResetEdgeCount: can-enter-exclusive-area=CDD_ECAP_EXCLUSIVE_AREA_0, implemented-entry=Cdd_Ecap_ResetEdgeCount
          bsw direct call point Det_ReportError: called-entry=Det_ReportError
        Cdd_Ecap_SetActivationCondition: can-enter-exclusive-area=CDD_ECAP_EXCLUSIVE_AREA_0, implemented-entry=Cdd_Ecap_SetActivationCondition
          bsw direct call point Det_ReportError: called-entry=Det_ReportError
        Cdd_Ecap_StartSignalMeasurement: can-enter-exclusive-area=CDD_ECAP_EXCLUSIVE_AREA_0, implemented-entry=Cdd_Ecap_StartSignalMeasurement
          bsw direct call point Det_ReportError: called-entry=Det_ReportError
        Cdd_Ecap_StartTimestamp: can-enter-exclusive-area=CDD_ECAP_EXCLUSIVE_AREA_0, implemented-entry=Cdd_Ecap_StartTimestamp
          bsw direct call point Det_ReportError: called-entry=Det_ReportError
        Cdd_Ecap_StopSignalMeasurement: can-enter-exclusive-area=CDD_ECAP_EXCLUSIVE_AREA_0, implemented-entry=Cdd_Ecap_StopSignalMeasurement
          bsw direct call point Det_ReportError: called-entry=Det_ReportError
        Cdd_Ecap_StopTimestamp: can-enter-exclusive-area=CDD_ECAP_EXCLUSIVE_AREA_0, implemented-entry=Cdd_Ecap_StopTimestamp
          bsw direct call point Det_ReportError: called-entry=Det_ReportError
          bsw direct call point Det_ReportRuntimeError: called-entry=Det_ReportRuntimeError
      4 x bsw interrupt entity, all with reentrancy-level=NON-REENTRANT, interrupt-category=CAT-1:
        Cdd_Ecap_ch0Notify: implemented-entry=Cdd_Ecap_ch0Notify
          bsw direct call point Det_ReportError: called-entry=Det_ReportError
        Cdd_Ecap_ch1Notify: implemented-entry=Cdd_Ecap_ch1Notify
          bsw direct call point Det_ReportError: called-entry=Det_ReportError
        Cdd_Ecap_ch2Notify: implemented-entry=Cdd_Ecap_ch2Notify
          bsw direct call point Det_ReportError: called-entry=Det_ReportError
        Cdd_Ecap_ch3Notify: implemented-entry=Cdd_Ecap_ch3Notify
          bsw direct call point Det_ReportError: called-entry=Det_ReportError
  bsw implementation Cdd_Ecap_Impl: programming-language=C, sw-version=3.1.1, vendor-id=44, ar-release-version=4.3.1, behavior=Cdd_Ecap_Behavior, vendor-specific-module-def=Cdd
    code-descriptors:
      code Files
        artifact-descriptors:
          short-label=V0::Cdd_Ecap_Priv.h, category=SWHDR
          short-label=V0::Cdd_Ecap_priv.c, category=SWSRC
          short-label=V0::hw_ecap.h, category=SWHDR
          short-label=generate::include::Cdd_Ecap_Cfg.h, category=SWHDR
          short-label=generate::src::Cdd_Ecap_Cfg.c, category=SWSRC
          short-label=include::Cdd_Ecap.h, category=SWHDR
          short-label=src::Cdd_Ecap.c, category=SWSRC
          short-label=src::Cdd_Ecap_Irq.c, category=SWSRC
    compiler TI_C29Clang: name=TI_C29Clang, vendor=Texas Instruments, version=2.2.0
    linker TI_C29Linker: name=TI_C29Linker, vendor=Texas Instruments, version=2.2.0
    resource consumption ResourceConsumption
      6 x memory section:
        CDD_ECAP_CODE: alignment=UNSPECIFIED, sw-addrmethod=CODE, symbol=CODE
        CDD_ECAP_CONFIG_DATA: alignment=UNSPECIFIED, sw-addrmethod=CONST_PBCFG, symbol=CONFIG_DATA
        CDD_ECAP_ISR_CODE: alignment=UNSPECIFIED, sw-addrmethod=CODE, symbol=ISR_CODE
        CDD_ECAP_VAR_INIT_8: alignment=8, sw-addrmethod=VAR_INIT, symbol=VAR_INIT_8
        CDD_ECAP_VAR_NO_INIT_UNSPECIFIED: alignment=UNSPECIFIED, sw-addrmethod=VAR_NO_INIT, symbol=VAR_NO_INIT_UNSPECIFIED
        CDD_ECAP_VAR_INIT_PTR: alignment=UNSPECIFIED, sw-addrmethod=VAR_INIT, symbol=VAR_INIT_PTR
package /Cdd_Ecap_TI_F29H85x/Cdd_Ecap_ModuleEntry
  34 x bsw module entry, all with sw-service-impl-policy=STANDARD, bsw-entry-kind=CONCRETE:
    Cdd_Ecap_Deinit: service-id=1, is-reentrant=true, is-synchronous=false, call-type=REGULAR, execution-context=UNSPECIFIED
    Cdd_Ecap_DisableEdgeCount: service-id=14, is-reentrant=true, is-synchronous=true, call-type=REGULAR, execution-context=UNSPECIFIED
    Cdd_Ecap_DisableEdgeDetection: service-id=23, is-reentrant=true, is-synchronous=true, call-type=REGULAR, execution-context=UNSPECIFIED
    Cdd_Ecap_DisableNotification: service-id=6, is-reentrant=true, is-synchronous=true, call-type=REGULAR, execution-context=UNSPECIFIED
    Cdd_Ecap_EnableEdgeCount: service-id=13, is-reentrant=true, is-synchronous=true, call-type=REGULAR, execution-context=UNSPECIFIED
    Cdd_Ecap_SetStartLevelCondition: service-id=24, is-reentrant=true, is-synchronous=true, call-type=REGULAR, execution-context=UNSPECIFIED
    Cdd_Ecap_EnableEdgeDetection: service-id=22, is-reentrant=true, is-synchronous=true, call-type=REGULAR, execution-context=UNSPECIFIED
    Cdd_Ecap_EnableNotification: service-id=7, is-reentrant=true, is-synchronous=true, call-type=REGULAR, execution-context=UNSPECIFIED
    Cdd_Ecap_GetDutyCycleValues: service-id=17, is-reentrant=true, is-synchronous=true, call-type=REGULAR, execution-context=UNSPECIFIED
    Cdd_Ecap_GetEdgeNumbers: service-id=15, is-reentrant=true, is-synchronous=true, call-type=REGULAR, execution-context=UNSPECIFIED
    Cdd_Ecap_GetInputState: service-id=8, is-reentrant=true, is-synchronous=true, call-type=REGULAR, execution-context=UNSPECIFIED
    Cdd_Ecap_GetTimeElapsed: service-id=16, is-reentrant=true, is-synchronous=true, call-type=REGULAR, execution-context=UNSPECIFIED
    Cdd_Ecap_GetTimestampIndex: service-id=11, is-reentrant=true, is-synchronous=true, call-type=REGULAR, execution-context=UNSPECIFIED
    Cdd_Ecap_GetVersionInfo: service-id=18, is-reentrant=true, is-synchronous=true, call-type=REGULAR, execution-context=UNSPECIFIED
    Cdd_Ecap_Init: service-id=0, is-reentrant=false, is-synchronous=true, call-type=REGULAR, execution-context=UNSPECIFIED
    Cdd_Ecap_PeriodicReadback: service-id=34, is-reentrant=true, is-synchronous=true, call-type=REGULAR, execution-context=UNSPECIFIED
    Cdd_Ecap_IntISR_Fun: is-reentrant=false, is-synchronous=true, call-type=INTERRUPT, execution-context=INTERRUPT-CAT-1
    Cdd_Ecap_ResetEdgeCount: service-id=12, is-reentrant=true, is-synchronous=true, call-type=REGULAR, execution-context=UNSPECIFIED
    Cdd_Ecap_SetActivationCondition: service-id=5, is-reentrant=true, is-synchronous=true, call-type=REGULAR, execution-context=UNSPECIFIED
    Cdd_Ecap_SetMode: service-id=2, is-reentrant=false, is-synchronous=true, call-type=REGULAR, execution-context=UNSPECIFIED
    Cdd_Ecap_StartSignalMeasurement: service-id=19, is-reentrant=true, is-synchronous=false, call-type=REGULAR, execution-context=UNSPECIFIED
    Cdd_Ecap_StartTimestamp: service-id=9, is-reentrant=true, is-synchronous=false, call-type=REGULAR, execution-context=UNSPECIFIED
    Cdd_Ecap_GetHrScaleFactor: service-id=25, is-reentrant=true, is-synchronous=false, call-type=REGULAR, execution-context=UNSPECIFIED
    Cdd_Ecap_ConvertHrTimeStampToEcapTimeStamp: service-id=26, is-reentrant=true, is-synchronous=false, call-type=REGULAR, execution-context=UNSPECIFIED
    Cdd_Ecap_StopSignalMeasurement: service-id=20, is-reentrant=true, is-synchronous=true, call-type=REGULAR, execution-context=UNSPECIFIED
    Cdd_Ecap_StopTimestamp: service-id=10, is-reentrant=true, is-synchronous=true, call-type=REGULAR, execution-context=UNSPECIFIED
    Cdd_Ecap_ch{0..5}Notify: is-reentrant=false, is-synchronous=true, call-type=INTERRUPT, execution-context=INTERRUPT-CAT-1
    Cdd_Ecap_HR_ch4Notify: is-reentrant=false, is-synchronous=true, call-type=INTERRUPT, execution-context=INTERRUPT-CAT-1
    Cdd_Ecap_HR_ch5Notify: is-reentrant=false, is-synchronous=true, call-type=INTERRUPT, execution-context=INTERRUPT-CAT-1
