AUTOSAR XML (schema 00044)
package /Cdd_Uart_TI_F29H85x
  bsw module description Cdd_Uart: category=BSW_MODULE, module-id=255
    implemented-entrys:
      Cdd_Uart_0_ISR
      Cdd_Uart_GetVersionInfo
      Cdd_Uart_Init
      Cdd_Uart_Deinit
      Cdd_Uart_Write
      Cdd_Uart_Read
      Cdd_Uart_CancelWrite
      Cdd_Uart_CancelRead
      Cdd_Uart_GetWriteStatus
      Cdd_Uart_GetReadStatus
      Cdd_Uart_MainFunction_Write
      Cdd_Uart_Poll_Read
      Cdd_Uart_GetErrorStatus
      Cdd_Uart_FlushReadFIFO
    bsw module dependency Det: target-module-id=15, target-module=Det
    bsw internal behavior Cdd_Uart_Behavior
      exclusive area CDD_UART_EXCLUSIVE_AREA_0
      exclusive area CDD_UART_EXCLUSIVE_AREA_1
      bsw interrupt entity Cdd_Uart_0_ISR: reentrancy-level=NON-REENTRANT, implemented-entry=Cdd_Uart_0_ISR, interrupt-category=CAT-1
      9 x bsw called entity:
        Cdd_Uart_GetVersionInfo: reentrancy-level=SINGLE-CORE-REENTRANT, implemented-entry=Cdd_Uart_GetVersionInfo
          bsw direct call point Det: called-entry=Det_ReportError
        Cdd_Uart_Init: reentrancy-level=SINGLE-CORE-REENTRANT, implemented-entry=Cdd_Uart_Init
          bsw direct call point Det: called-entry=Det_ReportError
        Cdd_Uart_Deinit: reentrancy-level=SINGLE-CORE-REENTRANT, implemented-entry=Cdd_Uart_Deinit
          bsw direct call point Det: called-entry=Det_ReportError
        Cdd_Uart_Write: can-enter-exclusive-area=CDD_UART_EXCLUSIVE_AREA_0, reentrancy-level=NON-REENTRANT, implemented-entry=Cdd_Uart_Write
          bsw direct call point Det: called-entry=Det_ReportError
        Cdd_Uart_Read: can-enter-exclusive-area=CDD_UART_EXCLUSIVE_AREA_1, reentrancy-level=SINGLE-CORE-REENTRANT, implemented-entry=Cdd_Uart_Read
          bsw direct call point Det: called-entry=Det_ReportError
        Cdd_Uart_CancelWrite: can-enter-exclusive-area=CDD_UART_EXCLUSIVE_AREA_0, reentrancy-level=SINGLE-CORE-REENTRANT, implemented-entry=Cdd_Uart_CancelWrite
          bsw direct call point Det: called-entry=Det_ReportError
        Cdd_Uart_CancelRead: can-enter-exclusive-area=CDD_UART_EXCLUSIVE_AREA_1, reentrancy-level=SINGLE-CORE-REENTRANT, implemented-entry=Cdd_Uart_CancelRead
          bsw direct call point Det: called-entry=Det_ReportError
        Cdd_Uart_GetWriteStatus: can-enter-exclusive-area=CDD_UART_EXCLUSIVE_AREA_0, reentrancy-level=SINGLE-CORE-REENTRANT, implemented-entry=Cdd_Uart_GetWriteStatus
          bsw direct call point Det: called-entry=Det_ReportError
        Cdd_Uart_GetReadStatus: can-enter-exclusive-area=CDD_UART_EXCLUSIVE_AREA_1, reentrancy-level=SINGLE-CORE-REENTRANT, implemented-entry=Cdd_Uart_GetReadStatus
          bsw direct call point Det: called-entry=Det_ReportError
      bsw schedulable entity Cdd_Uart_MainFunction_Write: reentrancy-level=SINGLE-CORE-REENTRANT, implemented-entry=Cdd_Uart_MainFunction_Write
        bsw direct call point Det: called-entry=Det_ReportError
      bsw called entity Cdd_Uart_Poll_Read: reentrancy-level=NON-REENTRANT, implemented-entry=Cdd_Uart_Poll_Read
        bsw direct call point Det: called-entry=Det_ReportError
      bsw called entity Cdd_Uart_GetErrorStatus: reentrancy-level=SINGLE-CORE-REENTRANT, implemented-entry=Cdd_Uart_GetErrorStatus
        bsw direct call point Det: called-entry=Det_ReportError
      bsw called entity Cdd_Uart_FlushReadFIFO: reentrancy-level=SINGLE-CORE-REENTRANT, implemented-entry=Cdd_Uart_FlushReadFIFO
        bsw direct call point Det: called-entry=Det_ReportError
      bsw timing event CddUartMainFunctionWritePeriod: starts-on-event=Cdd_Uart_MainFunction_Write, period=0.01
  bsw implementation Cdd_Uart_Impl: programming-language=C, sw-version=3.1.0, vendor-id=44, ar-release-version=4.3.1, behavior=Cdd_Uart_Behavior, vendor-specific-module-def=Cdd
    code-descriptors:
      code Files
        artifact-descriptors:
          short-label=include::Cdd_Uart.h, category=SWHDR
          short-label=include::Cdd_Uart_Priv.h, category=SWHDR
          short-label=src::Cdd_Uart.c, category=SWSRC
          short-label=src::Cdd_Uart_Irq.c, category=SWSRC
          short-label=src::Cdd_Uart_Priv.c, category=SWSRC
          short-label=generate::src::Cdd_Uart_Cfg.c, category=SWSRC
          short-label=generate::include::Cdd_Uart_Cfg.h, category=SWHDR
          short-label=generate::Cdd_Uart_Cbk.h, category=SWHDR
    compiler TI_C29Clang: name=TI_C29Clang, vendor=Texas Instruments, version=2.2.0
    linker TI_C29Linker: name=TI_C29Linker, vendor=Texas Instruments, version=2.2.0
    resource consumption ResourceConsumption
      6 x memory section:
        CDD_UART_VAR_INIT_UNSPECIFIED: alignment=UNSPECIFIED, sw-addrmethod=VAR_INIT, symbol=VAR_INIT_UNSPECIFIED
        CDD_UART_CONFIG_DATA: alignment=UNSPECIFIED, sw-addrmethod=CONST_PBCFG, symbol=CONFIG_DATA
        CDD_UART_CODE: alignment=UNSPECIFIED, sw-addrmethod=CODE, symbol=CODE
        CDD_UART_ISR_CODE: alignment=UNSPECIFIED, sw-addrmethod=CODE, symbol=ISR_CODE
        CDD_UART_VAR_INIT_BOOLEAN: alignment=BOOLEAN, sw-addrmethod=VAR_INIT, symbol=VAR_INIT_BOOLEAN
        CDD_UART_VAR_NO_INIT_UNSPECIFIED: alignment=UNSPECIFIED, sw-addrmethod=VAR_NO_INIT, symbol=VAR_NO_INIT_UNSPECIFIED
package /Cdd_Uart_TI_F29H85x/Cdd_Uart_ModuleEntry
  19 x bsw module entry, all with sw-service-impl-policy=STANDARD, bsw-entry-kind=CONCRETE:
    Cdd_Uart_A_ISR: is-reentrant=false, is-synchronous=true, call-type=INTERRUPT, execution-context=INTERRUPT-CAT-1
    Cdd_Uart_B_ISR: is-reentrant=false, is-synchronous=true, call-type=INTERRUPT
    Cdd_Uart_C_ISR: is-reentrant=false, is-synchronous=true, call-type=INTERRUPT
    Cdd_Uart_D_ISR: is-reentrant=false, is-synchronous=true, call-type=INTERRUPT
    Cdd_Uart_E_ISR: is-reentrant=false, is-synchronous=true, call-type=INTERRUPT
    Cdd_Uart_F_ISR: is-reentrant=false, is-synchronous=true, call-type=INTERRUPT
    Cdd_Uart_GetVersionInfo: service-id=0, is-reentrant=true, is-synchronous=true, call-type=REGULAR, execution-context=UNSPECIFIED
    Cdd_Uart_Init: service-id=1, is-reentrant=false, is-synchronous=true, call-type=REGULAR, execution-context=UNSPECIFIED
    Cdd_Uart_Deinit: service-id=2, is-reentrant=false, is-synchronous=true, call-type=REGULAR, execution-context=UNSPECIFIED
    Cdd_Uart_Write: service-id=3, is-reentrant=false, is-synchronous=false, call-type=REGULAR, execution-context=UNSPECIFIED
    Cdd_Uart_Read: service-id=4, is-reentrant=false, is-synchronous=false, call-type=REGULAR, execution-context=UNSPECIFIED
    Cdd_Uart_CancelWrite: service-id=5, is-reentrant=true, is-synchronous=true, call-type=REGULAR, execution-context=UNSPECIFIED
    Cdd_Uart_CancelRead: service-id=6, is-reentrant=true, is-synchronous=true, call-type=REGULAR, execution-context=UNSPECIFIED
    Cdd_Uart_GetWriteStatus: service-id=7, is-reentrant=true, is-synchronous=true, call-type=REGULAR, execution-context=UNSPECIFIED
    Cdd_Uart_GetReadStatus: service-id=8, is-reentrant=true, is-synchronous=true, call-type=REGULAR, execution-context=UNSPECIFIED
    Cdd_Uart_MainFunction_Write: service-id=9, is-reentrant=false, is-synchronous=false, call-type=SCHEDULED, execution-context=TASK
    Cdd_Uart_Poll_Read: service-id=10, is-reentrant=false, is-synchronous=true, call-type=REGULAR, execution-context=UNSPECIFIED
    Cdd_Uart_GetErrorStatus: service-id=11, is-reentrant=true, is-synchronous=true, call-type=REGULAR, execution-context=UNSPECIFIED
    Cdd_Uart_FlushReadFIFO: service-id=12, is-reentrant=true, is-synchronous=true, call-type=REGULAR, execution-context=UNSPECIFIED
