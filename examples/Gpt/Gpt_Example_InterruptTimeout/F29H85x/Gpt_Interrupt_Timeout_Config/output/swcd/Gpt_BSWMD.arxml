AUTOSAR XML (schema 00044)
package /Gpt_TI_F29H85x
  bsw module description Gpt: module-id=100
    implemented-entrys:
      Gpt_Ch0Isr
      Gpt_Ch1Isr
      Gpt_DeInit
      Gpt_DisableNotification
      Gpt_EnableNotification
      Gpt_GetTimeElapsed
      Gpt_GetTimeRemaining
      Gpt_GetVersionInfo
      Gpt_Init
      Gpt_StartTimer
      Gpt_StopTimer
    bsw module dependency Det: target-module-id=15, target-module=Det
    bsw internal behavior Gpt_Behaviour
      exclusive area GPT_EXCLUSIVE_AREA_0
      bsw interrupt entity Gpt_Ch0Isr: reentrancy-level=NON-REENTRANT, implemented-entry=Gpt_Ch0Isr, interrupt-category=CAT-2
      bsw interrupt entity Gpt_Ch1Isr: reentrancy-level=NON-REENTRANT, implemented-entry=Gpt_Ch1Isr, interrupt-category=CAT-1
      bsw interrupt entity Gpt_Ch2Isr: reentrancy-level=NON-REENTRANT, implemented-entry=Gpt_Ch2Isr, interrupt-category=CAT-1
      9 x bsw called entity:
        Gpt_DeInit: reentrancy-level=NON-REENTRANT, implemented-entry=Gpt_DeInit
          bsw direct call point Det_ReportError: called-entry=Det_ReportError
          bsw direct call point Det_ReportRuntimeError: called-entry=Det_ReportRuntimeError
        Gpt_DisableNotification: can-enter-exclusive-area=GPT_EXCLUSIVE_AREA_0, reentrancy-level=SINGLE-CORE-REENTRANT, implemented-entry=Gpt_DisableNotification
          bsw direct call point Det_ReportError: called-entry=Det_ReportError
        Gpt_EnableNotification: can-enter-exclusive-area=GPT_EXCLUSIVE_AREA_0, reentrancy-level=SINGLE-CORE-REENTRANT, implemented-entry=Gpt_EnableNotification
          bsw direct call point Det_ReportError: called-entry=Det_ReportError
        Gpt_GetTimeElapsed: reentrancy-level=SINGLE-CORE-REENTRANT, implemented-entry=Gpt_GetTimeElapsed
          bsw direct call point Det_ReportError: called-entry=Det_ReportError
        Gpt_GetTimeRemaining: reentrancy-level=SINGLE-CORE-REENTRANT, implemented-entry=Gpt_GetTimeRemaining
          bsw direct call point Det_ReportError: called-entry=Det_ReportError
        Gpt_GetVersionInfo: reentrancy-level=SINGLE-CORE-REENTRANT, implemented-entry=Gpt_GetVersionInfo
          bsw direct call point Det_ReportError: called-entry=Det_ReportError
        Gpt_Init: reentrancy-level=NON-REENTRANT, implemented-entry=Gpt_Init
          bsw direct call point Det_ReportError
        Gpt_StartTimer: can-enter-exclusive-area=GPT_EXCLUSIVE_AREA_0, reentrancy-level=SINGLE-CORE-REENTRANT, implemented-entry=Gpt_StartTimer
          bsw direct call point Det_ReportError: called-entry=Det_ReportError
          bsw direct call point Det_ReportRuntimeError: called-entry=Det_ReportRuntimeError
        Gpt_StopTimer: can-enter-exclusive-area=GPT_EXCLUSIVE_AREA_0, reentrancy-level=SINGLE-CORE-REENTRANT, implemented-entry=Gpt_StopTimer
          bsw direct call point Det_ReportError: called-entry=Det_ReportError
  bsw implementation Gpt_impl: sw-version=2.0.3, vendor-id=44, ar-release-version=4.3.1, behavior=Gpt_Behaviour, vendor-specific-module-def=Gpt
    code-descriptors:
      code Files
        artifact-descriptors:
          short-label=generate::Gpt_Cfg.h, category=SWHDR
          short-label=generate::src::Gpt_Cfg.c, category=SWSRC
          short-label=generate::src::Gpt_PBcfg.c, category=SWSRC
          short-label=include::Gpt.h, category=SWHDR
          short-label=include::Gpt_Priv.h, category=SWHDR
          short-label=src::Gpt.c, category=SWSRC
          short-label=src::Gpt_Irq.c, category=SWSRC
          short-label=src::Gpt_Priv.c, category=SWSRC
    compiler TI_C29Clang: name=TI_C29Clang, vendor=Texas Instruments, version=2.2.0
    linker TI_C29Linker: name=TI_C29Linker, vendor=Texas Instruments, version=2.2.0
    resource consumption ResourceConsumption
      6 x memory section:
        GPT_CODE: alignment=UNSPECIFIED, sw-addrmethod=CODE, symbol=CODE
        GPT_CONFIG_DATA: alignment=UNSPECIFIED, sw-addrmethod=CONST_PBCFG, symbol=CONFIG_DATA
        GPT_ISR_CODE: alignment=UNSPECIFIED, sw-addrmethod=CODE, symbol=ISR_CODE
        GPT_VAR_INIT_BOOLEAN: alignment=BOOLEAN, sw-addrmethod=VAR_INIT, symbol=VAR_INIT_BOOLEAN
        GPT_VAR_NO_INIT_UNSPECIFIED: alignment=UNSPECIFIED, sw-addrmethod=VAR_NO_INIT, symbol=VAR_NO_INIT_UNSPECIFIED
        GPT_VAR_INIT_UNSPECIFIED: alignment=UNSPECIFIED, sw-addrmethod=VAR_INIT, symbol=VAR_INIT_UNSPECIFIED
package /Gpt_TI_F29H85x/Gpt_ModuleEntry
  17 x bsw module entry, all with is-synchronous=true, sw-service-impl-policy=STANDARD, bsw-entry-kind=CONCRETE:
    Gpt_Ch{0..2}Isr: is-reentrant=false, call-type=INTERRUPT, execution-context=INTERRUPT-CAT-1
    Gpt_CheckWakeup: service-id=12, is-reentrant=true, call-type=REGULAR, execution-context=UNSPECIFIED
    Gpt_DeInit: service-id=2, is-reentrant=false, call-type=REGULAR, execution-context=UNSPECIFIED
    Gpt_DisableNotification: service-id=8, is-reentrant=true, call-type=REGULAR, execution-context=UNSPECIFIED
    Gpt_DisableWakeup: service-id=10, is-reentrant=true, call-type=REGULAR, execution-context=UNSPECIFIED
    Gpt_EnableNotification: service-id=7, is-reentrant=true, call-type=REGULAR, execution-context=UNSPECIFIED
    Gpt_EnableWakeup: service-id=11, is-reentrant=true, call-type=REGULAR, execution-context=UNSPECIFIED
    Gpt_GetPredefTimerValue: service-id=13, is-reentrant=true, call-type=REGULAR
    Gpt_GetTimeElapsed: service-id=3, is-reentrant=true, call-type=REGULAR, execution-context=UNSPECIFIED
    Gpt_GetTimeRemaining: service-id=4, is-reentrant=true, call-type=REGULAR, execution-context=UNSPECIFIED
    Gpt_GetVersionInfo: service-id=0, is-reentrant=true, call-type=REGULAR, execution-context=UNSPECIFIED
    Gpt_Init: service-id=1, is-reentrant=false, call-type=REGULAR, execution-context=UNSPECIFIED
    Gpt_SetMode: service-id=9, is-reentrant=false, call-type=REGULAR, execution-context=UNSPECIFIED
    Gpt_StartTimer: service-id=5, is-reentrant=true, call-type=REGULAR, execution-context=UNSPECIFIED
    Gpt_StopTimer: service-id=6, is-reentrant=true, call-type=REGULAR, execution-context=UNSPECIFIED
