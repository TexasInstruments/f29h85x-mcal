AUTOSAR XML (schema 00044)
package /LIN_TI_F29H85x
  bsw module description Lin: category=BSW_MODULE, module-id=82
    implemented-entrys:
      Lin_B_Int0ISR
      Lin_CheckWakeup
      Lin_GetStatus
      Lin_GetVersionInfo
      Lin_GoToSleep
      Lin_GoToSleepInternal
      Lin_Init
      Lin_SendFrame
      Lin_Wakeup
      Lin_WakeupInternal
    5 x bsw module dependency:
      Dem: target-module-id=54, target-module=Dem
      Det: target-module-id=15, target-module=Det
      EcuM: target-module-id=10, target-module=EcuM
      LinIf: target-module=Lin
      Os: target-module-id=1, target-module=Os
    bsw internal behavior Lin_Behaviour
      exclusive area LIN_EXCLUSIVE_AREA_0
      bsw interrupt entity Lin_B_Int0ISR: reentrancy-level=NON-REENTRANT, implemented-entry=Lin_B_Int0ISR, interrupt-category=CAT-1
        bsw direct call point EcuM_CheckWakeup: called-entry=EcuM_CheckWakeup
        bsw direct call point LinIf_WakeupConfirmation: called-entry=LinIf_WakeupConfirmation
      9 x bsw called entity:
        Lin_CheckWakeup: reentrancy-level=NON-REENTRANT, implemented-entry=Lin_CheckWakeup
          bsw direct call point Det_ReportError: called-entry=Det_ReportError
        Lin_GetStatus: can-enter-exclusive-area=LIN_EXCLUSIVE_AREA_0, reentrancy-level=NON-REENTRANT, implemented-entry=Lin_GetStatus
          bsw direct call point Det_ReportError: called-entry=Det_ReportError
        Lin_GetVersionInfo: reentrancy-level=SINGLE-CORE-REENTRANT, implemented-entry=Lin_GetVersionInfo
          bsw direct call point Det_ReportError: called-entry=Det_ReportError
        Lin_GoToSleep: can-enter-exclusive-area=LIN_EXCLUSIVE_AREA_0, reentrancy-level=NON-REENTRANT, implemented-entry=Lin_GoToSleep
          bsw direct call point Dem_SetEventStatus: called-entry=Dem_SetEventStatus
          bsw direct call point Det_ReportError: called-entry=Det_ReportError
        Lin_GoToSleepInternal: can-enter-exclusive-area=LIN_EXCLUSIVE_AREA_0, reentrancy-level=NON-REENTRANT, implemented-entry=Lin_GoToSleepInternal
          bsw direct call point Det_ReportError: called-entry=Det_ReportError
        Lin_Init: reentrancy-level=NON-REENTRANT, implemented-entry=Lin_Init
          bsw direct call point Det_ReportError: called-entry=Det_ReportError
        Lin_SendFrame: can-enter-exclusive-area=LIN_EXCLUSIVE_AREA_0, reentrancy-level=NON-REENTRANT, implemented-entry=Lin_SendFrame
          bsw direct call point Det_ReportError: called-entry=Det_ReportError
        Lin_Wakeup: can-enter-exclusive-area=LIN_EXCLUSIVE_AREA_0, reentrancy-level=NON-REENTRANT, implemented-entry=Lin_Wakeup
          bsw direct call point Det_ReportError: called-entry=Det_ReportError
        Lin_WakeupInternal: can-enter-exclusive-area=LIN_EXCLUSIVE_AREA_0, reentrancy-level=NON-REENTRANT, implemented-entry=Lin_WakeupInternal
          bsw direct call point Det_ReportError: called-entry=Det_ReportError
  bsw implementation Lin_Impl: programming-language=C, sw-version=3.1.2, vendor-id=44, ar-release-version=4.3.1, behavior=Lin_Behaviour, vendor-specific-module-def=Lin
    code-descriptors:
      code Files
        artifact-descriptors:
          short-label=generate::include::Lin_Cfg.c, category=SWSRC
          short-label=generate::include::Lin_Cfg.h, category=SWHDR
          short-label=generate::src::Lin_PBcfg.c, category=SWSRC
          short-label=include::Lin.h, category=SWHDR
          short-label=include::Lin_Priv.h, category=SWHDR
          short-label=src::Lin.c, category=SWSRC
          short-label=src::Lin_Irq.c, category=SWSRC
          short-label=src::Lin_Priv.c, category=SWSRC
    compiler TI_C29Clang: name=TI_C29Clang, vendor=Texas Instruments, version=2.2.0
    linker TI_C29Linker: name=TI_C29Linker, vendor=Texas Instruments, version=2.2.0
    resource consumption ResourceConsumption
      7 x memory section:
        LIN_CODE: alignment=UNSPECIFIED, sw-addrmethod=CODE, symbol=CODE
        LIN_CONFIG_DATA: alignment=UNSPECIFIED, sw-addrmethod=CONST_PBCFG, symbol=CONFIG_DATA
        LIN_ISR_CODE: alignment=UNSPECIFIED, sw-addrmethod=CODE, symbol=ISR_CODE
        LIN_VAR_INIT_8: alignment=8, sw-addrmethod=VAR_INIT, symbol=VAR_INIT_8
        LIN_VAR_INIT_PTR: alignment=UNSPECIFIED, sw-addrmethod=VAR_INIT, symbol=VAR_INIT_PTR
        LIN_VAR_INIT_UNSPECIFIED: alignment=UNSPECIFIED, sw-addrmethod=VAR_INIT, symbol=VAR_INIT_UNSPECIFIED
        LIN_VAR_NO_INIT_8: alignment=8, sw-addrmethod=VAR_NO_INIT, symbol=VAR_NO_INIT_8
package /LIN_TI_F29H85x/BSWModuleEntry
  10 x bsw module entry, all with sw-service-impl-policy=STANDARD, bsw-entry-kind=CONCRETE:
    Lin_B_Int0ISR: is-reentrant=false, is-synchronous=true, call-type=INTERRUPT, execution-context=INTERRUPT-CAT-1
    Lin_CheckWakeup: service-id=10, is-reentrant=false, is-synchronous=false, call-type=REGULAR, execution-context=UNSPECIFIED
    Lin_GetStatus: service-id=8, is-reentrant=false, is-synchronous=true, call-type=REGULAR, execution-context=UNSPECIFIED
    Lin_GetVersionInfo: service-id=1, is-reentrant=true, is-synchronous=true, call-type=REGULAR, execution-context=UNSPECIFIED
    Lin_GoToSleep: service-id=6, is-reentrant=false, is-synchronous=false, call-type=REGULAR, execution-context=UNSPECIFIED
    Lin_GoToSleepInternal: service-id=9, is-reentrant=false, is-synchronous=true, call-type=REGULAR, execution-context=UNSPECIFIED
    Lin_Init: service-id=0, is-reentrant=false, is-synchronous=true, call-type=REGULAR, execution-context=UNSPECIFIED
    Lin_SendFrame: service-id=4, is-reentrant=false, is-synchronous=false, call-type=REGULAR, execution-context=UNSPECIFIED
    Lin_Wakeup: service-id=7, is-reentrant=false, is-synchronous=false, call-type=REGULAR, execution-context=UNSPECIFIED
    Lin_WakeupInternal: service-id=11, is-reentrant=false, is-synchronous=false, call-type=REGULAR, execution-context=UNSPECIFIED
