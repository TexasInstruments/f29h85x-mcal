AUTOSAR XML (schema 00044)
package /Fls_TI_F29H85x
  bsw module description Fls: module-id=92
    implemented-entrys:
      Fls_BlankCheck
      Fls_Cancel
      Fls_Compare
      Fls_Erase
      Fls_GetJobResult
      Fls_GetStatus
      Fls_GetVersionInfo
      Fls_Init
      Fls_MainFunction
      Fls_Read
      Fls_SetEraseType
      Fls_Write
    bsw module dependency Det: target-module-id=15, target-module=Det
    bsw internal behavior Fls_Behavior
      exclusive area FLS_EXCLUSIVE_AREA_0
      8 x bsw called entity:
        Fls_BlankCheck: reentrancy-level=NON-REENTRANT, implemented-entry=Fls_BlankCheck
          bsw direct call point Det_ReportError: called-entry=Det_ReportError
        Fls_Cancel: reentrancy-level=NON-REENTRANT, implemented-entry=Fls_Cancel
          bsw direct call point Det_ReportError: called-entry=Det_ReportError
        Fls_Compare: reentrancy-level=NON-REENTRANT, implemented-entry=Fls_Compare
          bsw direct call point Det_ReportError: called-entry=Det_ReportError
        Fls_Erase: reentrancy-level=NON-REENTRANT, implemented-entry=Fls_Erase
          bsw direct call point Det_ReportError: called-entry=Det_ReportError
        Fls_GetJobResult: reentrancy-level=SINGLE-CORE-REENTRANT, implemented-entry=Fls_GetJobResult
          bsw direct call point Det_ReportError: called-entry=Det_ReportError
        Fls_GetStatus: reentrancy-level=SINGLE-CORE-REENTRANT, implemented-entry=Fls_GetStatus
        Fls_GetVersionInfo: reentrancy-level=SINGLE-CORE-REENTRANT, implemented-entry=Fls_GetVersionInfo
          bsw direct call point Det_ReportError: called-entry=Det_ReportError
        Fls_Init: reentrancy-level=NON-REENTRANT, implemented-entry=Fls_Init
          bsw direct call point Det_ReportError: called-entry=Det_ReportError
          bsw direct call point Det_ReportRuntimeError: called-entry=Det_ReportRuntimeError
      bsw schedulable entity Fls_MainFunction: can-enter-exclusive-area=FLS_EXCLUSIVE_AREA_0, reentrancy-level=NON-REENTRANT, implemented-entry=Fls_MainFunction
        bsw direct call point Det_ReportError: called-entry=Det_ReportError
        bsw direct call point Det_ReportRuntimeError: called-entry=Det_ReportRuntimeError
      bsw called entity Fls_Read: reentrancy-level=NON-REENTRANT, implemented-entry=Fls_Read
        bsw direct call point Det_ReportError: called-entry=Det_ReportError
      bsw called entity Fls_SetEraseType: reentrancy-level=NON-REENTRANT, implemented-entry=Fls_SetEraseType
      bsw called entity Fls_Write: reentrancy-level=NON-REENTRANT, implemented-entry=Fls_Write
        bsw direct call point Det_ReportError: called-entry=Det_ReportError
      bsw timing event Fls_MainFunctionTimingEvent: starts-on-event=Fls_MainFunction, period=0.01
  bsw implementation Fls_Impl: programming-language=C, sw-version=3.3.0, vendor-id=44, ar-release-version=4.3.1, behavior=Fls_Behavior, vendor-specific-module-def=Fls
    code-descriptors:
      code Files
        artifact-descriptors:
          short-label=generate::include::Fls_Cfg.h, category=SWHDR
          short-label=generate::src::Fls_Cfg.c, category=SWSRC
          short-label=include::Fls.h, category=SWHDR
          short-label=include::Fls_Cbk.h, category=SWHDR
          short-label=include::Fls_Ac.h, category=SWHDR
          short-label=include::Fls_Priv.h, category=SWHDR
          short-label=src::Fls.c, category=SWSRC
          short-label=src::Fls_Ac.c, category=SWSRC
          short-label=src::Fls_Priv.c, category=SWSRC
          short-label=generate::src::Fls_PBcfg.c, category=SWSRC
    compiler TI_C29Clang: name=TI_C29Clang, vendor=Texas Instruments, version=2.2.0
    linker TI_C29Linker: name=TI_C29Linker, vendor=Texas Instruments, version=2.2.0
    resource consumption ResourceConsumption
      8 x memory section:
        FLS_CODE: sw-addrmethod=CODE, symbol=CODE
        FLS_CONFIG_DATA: alignment=UNSPECIFIED, sw-addrmethod=CONST_PBCFG, symbol=CONFIG_DATA
        FLS_VAR_INIT_32: alignment=32, sw-addrmethod=VAR_INIT, symbol=VAR_INIT_32
        FLS_VAR_INIT_8: alignment=8, sw-addrmethod=VAR_INIT, symbol=VAR_INIT_8
        FLS_VAR_INIT_UNSPECIFIED: alignment=UNSPECIFIED, sw-addrmethod=VAR_INIT, symbol=VAR_INIT_UNSPECIFIED
        FLS_VAR_NO_INIT_32: alignment=32, sw-addrmethod=VAR_NO_INIT, symbol=VAR_NO_INIT_32
        FLS_VAR_NO_INIT_8: alignment=8, sw-addrmethod=VAR_NO_INIT, symbol=VAR_NO_INIT_8
        FLS_VAR_NO_INIT_UNSPECIFIED: alignment=UNSPECIFIED, sw-addrmethod=VAR_NO_INIT, symbol=VAR_NO_INIT_UNSPECIFIED
package /Fls_TI_F29H85x/Fls_ModuleEntry
  13 x bsw module entry, all with sw-service-impl-policy=STANDARD, bsw-entry-kind=CONCRETE:
    Fls_BlankCheck: service-id=10, is-reentrant=false, is-synchronous=false, call-type=REGULAR, execution-context=UNSPECIFIED
    Fls_Cancel: service-id=3, is-reentrant=false, is-synchronous=true, call-type=REGULAR, execution-context=UNSPECIFIED
    Fls_Compare: service-id=8, is-reentrant=false, is-synchronous=false, call-type=REGULAR, execution-context=UNSPECIFIED
    Fls_Erase: service-id=1, is-reentrant=false, is-synchronous=false, call-type=REGULAR, execution-context=UNSPECIFIED
    Fls_GetJobResult: service-id=5, is-reentrant=true, is-synchronous=true, call-type=REGULAR, execution-context=UNSPECIFIED
    Fls_GetStatus: service-id=4, is-reentrant=true, is-synchronous=true, call-type=REGULAR, execution-context=UNSPECIFIED
    Fls_GetVersionInfo: service-id=16, is-reentrant=true, is-synchronous=true, call-type=REGULAR, execution-context=UNSPECIFIED
    Fls_Init: service-id=0, is-reentrant=false, is-synchronous=true, call-type=REGULAR, execution-context=UNSPECIFIED
    Fls_MainFunction: service-id=6, is-reentrant=false, is-synchronous=true, call-type=SCHEDULED, execution-context=TASK
    Fls_Read: service-id=7, is-reentrant=false, is-synchronous=false, call-type=REGULAR, execution-context=UNSPECIFIED
    Fls_SetEraseType: service-id=12, is-reentrant=false, is-synchronous=true, call-type=REGULAR, execution-context=UNSPECIFIED
    Fls_SetMode: service-id=9, is-reentrant=false, is-synchronous=true, call-type=REGULAR, execution-context=UNSPECIFIED
    Fls_Write: service-id=2, is-reentrant=false, is-synchronous=false, call-type=REGULAR, execution-context=UNSPECIFIED
