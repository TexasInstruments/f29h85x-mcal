AUTOSAR XML (schema 00044)
package /Cdd_Ipc_TI_F29H85x
  bsw module description Cdd_Ipc: category=BSW_MODULE, module-id=255
    implemented-entrys:
      Cdd_Ipc_CPU1_L_CPU3_R_INST1_ISR
      Cdd_Ipc_GetCounter
      Cdd_Ipc_GetVersionInfo
      Cdd_Ipc_Init
      Cdd_Ipc_IsTxInstanceFree
      Cdd_Ipc_MainFunction_Read
      Cdd_Ipc_Sync
      Cdd_Ipc_Transmit
    bsw module dependency Det: target-module-id=15, target-module=Det
    bsw internal behavior Cdd_Ipc_Behavior
      exclusive area CDD_IPC_EXCLUSIVE_AREA_0
      exclusive area CDD_IPC_EXCLUSIVE_AREA_1
      bsw interrupt entity Cdd_Ipc_CPU1_L_CPU3_R_INST1_ISR: reentrancy-level=NON-REENTRANT, implemented-entry=Cdd_Ipc_CPU1_L_CPU3_R_INST1_ISR, interrupt-category=CAT-2
      4 x bsw called entity:
        Cdd_Ipc_GetCounter: reentrancy-level=SINGLE-CORE-REENTRANT, implemented-entry=Cdd_Ipc_GetCounter
        Cdd_Ipc_GetVersionInfo: reentrancy-level=SINGLE-CORE-REENTRANT, implemented-entry=Cdd_Ipc_GetVersionInfo
          bsw direct call point Det_ReportError: called-entry=Det_ReportError
        Cdd_Ipc_Init: reentrancy-level=NON-REENTRANT, implemented-entry=Cdd_Ipc_Init
          bsw direct call point Det_ReportError: called-entry=Det_ReportError
        Cdd_Ipc_IsTxInstanceFree: reentrancy-level=SINGLE-CORE-REENTRANT, implemented-entry=Cdd_Ipc_IsTxInstanceFree
          bsw direct call point Det_ReportError: called-entry=Det_ReportError
      bsw schedulable entity Cdd_Ipc_MainFunction_Read: can-enter-exclusive-area=CDD_IPC_EXCLUSIVE_AREA_1, reentrancy-level=SINGLE-CORE-REENTRANT, implemented-entry=Cdd_Ipc_MainFunction_Read
      bsw called entity Cdd_Ipc_Sync: reentrancy-level=NON-REENTRANT, implemented-entry=Cdd_Ipc_Sync
        bsw direct call point Det_ReportError: called-entry=Det_ReportError
      bsw called entity Cdd_Ipc_Transmit: can-enter-exclusive-area=CDD_IPC_EXCLUSIVE_AREA_0, reentrancy-level=SINGLE-CORE-REENTRANT, implemented-entry=Cdd_Ipc_Transmit
        bsw direct call point Det_ReportError: called-entry=Det_ReportError
      bsw timing event Cdd_Ipc_MainFunctionTimingEvent_Read: starts-on-event=Cdd_Ipc_MainFunction_Read, period=0.01
  bsw implementation Cdd_Ipc_Impl: programming-language=C, sw-version=1.0.2, vendor-id=44, ar-release-version=4.3.1, behavior=Cdd_Ipc_Behavior, vendor-specific-module-def=Cdd
    code-descriptors:
      code Files
        artifact-descriptors:
          short-label=generate::include::Cdd_Ipc_Cfg.h, category=SWHDR
          short-label=generate::src::Cdd_Ipc_Cfg.c, category=SWSRC
          short-label=include::Cdd_Ipc.h, category=SWHDR
          short-label=include::Cdd_Ipc_Priv.h, category=SWHDR
          short-label=src::Cdd_Ipc.c, category=SWSRC
          short-label=src::Cdd_Ipc_Irq.c, category=SWSRC
          short-label=src::Cdd_Ipc_Priv.c, category=SWSRC
    compiler c29clang: name=TI C29 Clang Compiler, vendor=Texas Instruments, version=2.0.0
    linker c29lnk: name=TI C29 Linker, vendor=Texas Instruments, version=2.0.0
    resource consumption ResourceConsumption
      6 x memory section:
        CDD_IPC_CODE: alignment=UNSPECIFIED, sw-addrmethod=CODE, symbol=CODE
        CDD_IPC_CONFIG_DATA: alignment=UNSPECIFIED, sw-addrmethod=CONST_PBCFG, symbol=CONFIG_DATA
        CDD_IPC_CONST_32: alignment=8, sw-addrmethod=CONST_32, symbol=CONST_32
        CDD_IPC_ISR_CODE: alignment=UNSPECIFIED, sw-addrmethod=CODE, symbol=ISR_CODE
        CDD_IPC_VAR_INIT_BOOLEAN: alignment=8, sw-addrmethod=VAR_INIT, symbol=VAR_INIT_BOOLEAN
        CDD_IPC_VAR_INIT_PTR: alignment=UNSPECIFIED, sw-addrmethod=VAR_INIT, symbol=VAR_INIT_PTR
package /Cdd_Ipc_TI_F29H85x/BSWModuleEntry
  31 x bsw module entry, all with sw-service-impl-policy=STANDARD, bsw-entry-kind=CONCRETE:
    Cdd_Ipc_CPU1_L_CPU2_R_INST{0..3}_ISR: is-reentrant=false, is-synchronous=true, call-type=INTERRUPT, execution-context=INTERRUPT-CAT-1
    Cdd_Ipc_CPU1_L_CPU3_R_INST0_ISR: is-reentrant=false, is-synchronous=true, call-type=INTERRUPT, execution-context=INTERRUPT-CAT-1
    Cdd_Ipc_CPU1_L_CPU3_R_INST1_ISR: is-reentrant=false, is-synchronous=true, call-type=INTERRUPT, execution-context=INTERRUPT-CAT-2
    Cdd_Ipc_CPU1_L_CPU3_R_INST2_ISR: is-reentrant=false, is-synchronous=true, call-type=INTERRUPT, execution-context=INTERRUPT-CAT-1
    Cdd_Ipc_CPU1_L_CPU3_R_INST3_ISR: is-reentrant=false, is-synchronous=true, call-type=INTERRUPT, execution-context=INTERRUPT-CAT-1
    Cdd_Ipc_CPU2_L_CPU1_R_INST{0..3}_ISR: is-reentrant=false, is-synchronous=true, call-type=INTERRUPT, execution-context=INTERRUPT-CAT-1
    Cdd_Ipc_CPU2_L_CPU3_R_INST{0..3}_ISR: is-reentrant=false, is-synchronous=true, call-type=INTERRUPT, execution-context=INTERRUPT-CAT-1
    Cdd_Ipc_CPU3_L_CPU1_R_INST{0..3}_ISR: is-reentrant=false, is-synchronous=true, call-type=INTERRUPT, execution-context=INTERRUPT-CAT-1
    Cdd_Ipc_CPU3_L_CPU2_R_INST{0..3}_ISR: is-reentrant=false, is-synchronous=true, call-type=INTERRUPT, execution-context=INTERRUPT-CAT-1
    Cdd_Ipc_GetCounter: service-id=6, is-reentrant=true, is-synchronous=true, call-type=REGULAR, execution-context=UNSPECIFIED
    Cdd_Ipc_GetVersionInfo: service-id=0, is-reentrant=true, is-synchronous=true, call-type=REGULAR, execution-context=UNSPECIFIED
    Cdd_Ipc_Init: service-id=1, is-reentrant=false, is-synchronous=true, call-type=REGULAR, execution-context=UNSPECIFIED
    Cdd_Ipc_IsTxInstanceFree: service-id=5, is-reentrant=true, is-synchronous=true, call-type=REGULAR, execution-context=UNSPECIFIED
    Cdd_Ipc_MainFunction_Read: service-id=4, is-reentrant=true, is-synchronous=true, call-type=SCHEDULED, execution-context=UNSPECIFIED
    Cdd_Ipc_Sync: service-id=2, is-reentrant=false, is-synchronous=true, call-type=REGULAR, execution-context=UNSPECIFIED
    Cdd_Ipc_Transmit: service-id=3, is-reentrant=true, is-synchronous=false, call-type=REGULAR, execution-context=UNSPECIFIED
