AUTOSAR XML (schema 00044)
package /Cdd_Adc_TI_F29H85x
  bsw module description Cdd_Adc: category=BSW_MODULE, module-id=255
    implemented-entrys:
      Cdd_Adc_ADCA_Int1Isr
      Cdd_Adc_ADCA_Int1Isr
      Cdd_Adc_ADCA_PpbIntIsr
      Cdd_Adc_ADCB_Int1Isr
      Cdd_Adc_ADCB_Int2Isr
      Cdd_Adc_ADCC_Int1Isr
      Cdd_Adc_ADCC_Int2Isr
      Cdd_Adc_ADCD_Int1Isr
      Cdd_Adc_ADCE_Int1Isr
      Cdd_Adc_ClearPpbEvt
      Cdd_Adc_ReadPpbValue
      Cdd_Adc_ReadPartialPpbValue
      Cdd_Adc_ReadPpb
      Cdd_Adc_GetDelayStamp
      Cdd_Adc_DeInit
      Cdd_Adc_EnableGroupNotification
      Cdd_Adc_DisableGroupNotification
      Cdd_Adc_DisableHardwareTrigger
      Cdd_Adc_EnableHardwareTrigger
      Cdd_Adc_GetGroupStatus
      Cdd_Adc_GetStreamLastPointer
      Cdd_Adc_SetInternalTestNode
      Cdd_Adc_Init
      Cdd_Adc_ReadGroup
      Cdd_Adc_StartGlobalSwTrig
      Cdd_Adc_StopGlobalSwTrig
      Cdd_Adc_StartGroupConversion
      Cdd_Adc_StopGroupConversion
      Cdd_Adc_SetupResultBuffer
    bsw module dependency Det: target-module-id=15, target-module=Det
    bsw internal behavior Cdd_Adc_Behavior
      exclusive area CDD_ADC_EXCLUSIVE_AREA_0
      9 x bsw interrupt entity, all with reentrancy-level=NON-REENTRANT, interrupt-category=CAT-1:
        Cdd_Adc_ADCA_Int1Isr: implemented-entry=Cdd_Adc_ADCA_Int1Isr
        Cdd_Adc_ADCA_Int2Isr: implemented-entry=Cdd_Adc_ADCA_Int2Isr
        Cdd_Adc_ADCA_PpbIntIsr: implemented-entry=Cdd_Adc_ADCA_PpbIntIsr
        Cdd_Adc_ADCB_Int1Isr: implemented-entry=Cdd_Adc_ADCB_Int1Isr
        Cdd_Adc_ADCB_Int2Isr: implemented-entry=Cdd_Adc_ADCB_Int2Isr
        Cdd_Adc_ADCC_Int1Isr: implemented-entry=Cdd_Adc_ADCC_Int1Isr
        Cdd_Adc_ADCC_Int2Isr: implemented-entry=Cdd_Adc_ADCC_Int2Isr
        Cdd_Adc_ADCD_Int1Isr: implemented-entry=Cdd_Adc_ADCD_Int1Isr
        Cdd_Adc_ADCE_Int1Isr: implemented-entry=Cdd_Adc_ADCE_Int1Isr
      20 x bsw called entity:
        Cdd_Adc_ClearPpbEvt: can-enter-exclusive-area=CDD_ADC_EXCLUSIVE_AREA_0, reentrancy-level=SINGLE-CORE-REENTRANT, implemented-entry=Cdd_Adc_ClearPpbEvt
          bsw direct call point Det: called-entry=Det_ReportError
          bsw direct call point Det_Runtime: called-entry=Det_ReportRuntimeError
        Cdd_Adc_GetDelayStamp: can-enter-exclusive-area=CDD_ADC_EXCLUSIVE_AREA_0, reentrancy-level=SINGLE-CORE-REENTRANT, implemented-entry=Cdd_Adc_GetDelayStamp
          bsw direct call point Det: called-entry=Det_ReportError
          bsw direct call point Det_Runtime: called-entry=Det_ReportRuntimeError
        Cdd_Adc_ReadPartialPpbValue: can-enter-exclusive-area=CDD_ADC_EXCLUSIVE_AREA_0, reentrancy-level=SINGLE-CORE-REENTRANT, implemented-entry=Cdd_Adc_ReadPartialPpbValue
          bsw direct call point Det: called-entry=Det_ReportError
        Cdd_Adc_ReadPpb: reentrancy-level=SINGLE-CORE-REENTRANT, implemented-entry=Cdd_Adc_ReadPpb
          bsw direct call point Det: called-entry=Det_ReportError
        Cdd_Adc_ReadPpbValue: can-enter-exclusive-area=CDD_ADC_EXCLUSIVE_AREA_0, reentrancy-level=SINGLE-CORE-REENTRANT, implemented-entry=Cdd_Adc_ReadPpbValue
          bsw direct call point Det: called-entry=Det_ReportError
        Cdd_Adc_DeInit: can-enter-exclusive-area=CDD_ADC_EXCLUSIVE_AREA_0, reentrancy-level=NON-REENTRANT, implemented-entry=Cdd_Adc_DeInit
          bsw direct call point Det: called-entry=Det_ReportError
        Cdd_Adc_EnableGroupNotification: can-enter-exclusive-area=CDD_ADC_EXCLUSIVE_AREA_0, reentrancy-level=SINGLE-CORE-REENTRANT, implemented-entry=Cdd_Adc_EnableGroupNotification
          bsw direct call point Det: called-entry=Det_ReportError
        Cdd_Adc_DisableGroupNotification: can-enter-exclusive-area=CDD_ADC_EXCLUSIVE_AREA_0, reentrancy-level=SINGLE-CORE-REENTRANT, implemented-entry=Cdd_Adc_DisableGroupNotification
          bsw direct call point Det: called-entry=Det_ReportError
        Cdd_Adc_DisableHardwareTrigger: can-enter-exclusive-area=CDD_ADC_EXCLUSIVE_AREA_0, reentrancy-level=SINGLE-CORE-REENTRANT, implemented-entry=Cdd_Adc_DisableHardwareTrigger
          bsw direct call point Det: called-entry=Det_ReportError
          bsw direct call point Det_Runtime: called-entry=Det_ReportRuntimeError
        Cdd_Adc_EnableHardwareTrigger: can-enter-exclusive-area=CDD_ADC_EXCLUSIVE_AREA_0, reentrancy-level=SINGLE-CORE-REENTRANT, implemented-entry=Cdd_Adc_EnableHardwareTrigger
          bsw direct call point Det: called-entry=Det_ReportError
          bsw direct call point Det_Runtime: called-entry=Det_ReportRuntimeError
        Cdd_Adc_GetGroupStatus: can-enter-exclusive-area=CDD_ADC_EXCLUSIVE_AREA_0, reentrancy-level=SINGLE-CORE-REENTRANT, implemented-entry=Cdd_Adc_GetGroupStatus
          bsw direct call point Det: called-entry=Det_ReportError
        Cdd_Adc_SetInternalTestNode: can-enter-exclusive-area=CDD_ADC_EXCLUSIVE_AREA_0, reentrancy-level=SINGLE-CORE-REENTRANT, implemented-entry=Cdd_Adc_SetInternalTestNode
          bsw direct call point Det: called-entry=Det_ReportError
        Cdd_Adc_GetStreamLastPointer: can-enter-exclusive-area=CDD_ADC_EXCLUSIVE_AREA_0, reentrancy-level=SINGLE-CORE-REENTRANT, implemented-entry=Cdd_Adc_GetStreamLastPointer
          bsw direct call point Det: called-entry=Det_ReportError
          bsw direct call point Det_Runtime: called-entry=Det_ReportRuntimeError
        Cdd_Adc_Init: can-enter-exclusive-area=CDD_ADC_EXCLUSIVE_AREA_0, reentrancy-level=NON-REENTRANT, implemented-entry=Cdd_Adc_Init
          bsw direct call point Det: called-entry=Det_ReportError
        Cdd_Adc_ReadGroup: can-enter-exclusive-area=CDD_ADC_EXCLUSIVE_AREA_0, reentrancy-level=SINGLE-CORE-REENTRANT, implemented-entry=Cdd_Adc_ReadGroup
          bsw direct call point Det: called-entry=Det_ReportError
          bsw direct call point Det_Runtime: called-entry=Det_ReportRuntimeError
        Cdd_Adc_SetupResultBuffer: can-enter-exclusive-area=CDD_ADC_EXCLUSIVE_AREA_0, reentrancy-level=SINGLE-CORE-REENTRANT, implemented-entry=Cdd_Adc_SetupResultBuffer
          bsw direct call point Det: called-entry=Det_ReportError
          bsw direct call point Det_Runtime: called-entry=Det_ReportRuntimeError
        Cdd_Adc_StartGlobalSwTrig: can-enter-exclusive-area=CDD_ADC_EXCLUSIVE_AREA_0, reentrancy-level=SINGLE-CORE-REENTRANT, implemented-entry=Cdd_Adc_StartGlobalSwTrig
          bsw direct call point Det: called-entry=Det_ReportError
          bsw direct call point Det_Runtime: called-entry=Det_ReportRuntimeError
        Cdd_Adc_StopGlobalSwTrig: can-enter-exclusive-area=CDD_ADC_EXCLUSIVE_AREA_0, reentrancy-level=SINGLE-CORE-REENTRANT, implemented-entry=Cdd_Adc_StopGlobalSwTrig
          bsw direct call point Det: called-entry=Det_ReportError
          bsw direct call point Det_Runtime: called-entry=Det_ReportRuntimeError
        Cdd_Adc_StartGroupConversion: can-enter-exclusive-area=CDD_ADC_EXCLUSIVE_AREA_0, reentrancy-level=SINGLE-CORE-REENTRANT, implemented-entry=Cdd_Adc_StartGroupConversion
          bsw direct call point Det: called-entry=Det_ReportError
          bsw direct call point Det_Runtime: called-entry=Det_ReportRuntimeError
        Cdd_Adc_StopGroupConversion: can-enter-exclusive-area=CDD_ADC_EXCLUSIVE_AREA_0, reentrancy-level=SINGLE-CORE-REENTRANT, implemented-entry=Cdd_Adc_StopGroupConversion
          bsw direct call point Det: called-entry=Det_ReportError
          bsw direct call point Det_Runtime: called-entry=Det_ReportRuntimeError
  bsw implementation Cdd_Adc_Impl: programming-language=C, sw-version=2.0.0, vendor-id=44, ar-release-version=4.3.1, behavior=Cdd_Adc_Behavior, vendor-specific-module-def=Cdd
    code-descriptors:
      code Files
        artifact-descriptors:
          short-label=include::Cdd_Adc.h, category=SWHDR
          short-label=include::Cdd_Adc_Priv.h, category=SWHDR
          short-label=src::Cdd_Adc.c, category=SWSRC
          short-label=src::Cdd_Adc_Irq.c, category=SWSRC
          short-label=src::Cdd_Adc_Priv.c, category=SWSRC
          short-label=generate::src::Cdd_Adc_Cfg.c, category=SWSRC
          short-label=generate::include::Cdd_Adc_Cfg.h, category=SWHDR
    compiler TI_C29Clang: name=TI_C29Clang, vendor=Texas Instruments, version=1.0.0
    linker TI_C29Linker: name=TI_C29Linker, vendor=Texas Instruments, version=1.0.0
    resource consumption ResourceConsumption
      6 x memory section:
        CDD_ADC_CODE: alignment=UNSPECIFIED, sw-addrmethod=CODE, symbol=CODE
        CDD_ADC_CONFIG_DATA_UNSPECIFIED: alignment=UNSPECIFIED, sw-addrmethod=CONST_PBCFG, symbol=CONFIG_DATA_UNSPECIFIED
        CDD_ADC_VAR_INIT_PTR: alignment=UNSPECIFIED, sw-addrmethod=VAR_INIT, symbol=VAR_INIT_PTR
        CDD_ADC_ISR_CODE: alignment=UNSPECIFIED, sw-addrmethod=CODE, symbol=ISR_CODE
        CDD_ADC_VAR_FAST_INIT_UNSPECIFIED: alignment=UNSPECIFIED, sw-addrmethod=VAR_INIT, symbol=VAR_FAST_INIT_UNSPECIFIED
        CDD_ADC_VAR_INIT_BOOLEAN: alignment=BOOLEAN, sw-addrmethod=VAR_INIT, symbol=VAR_INIT_BOOLEAN
package /Cdd_Adc_TI_F29H85x/Cdd_Adc_ModuleEntry
  53 x bsw module entry, all with sw-service-impl-policy=STANDARD, bsw-entry-kind=CONCRETE:
    Cdd_Adc_ADCA_Int1Isr: is-reentrant=false, is-synchronous=true, call-type=INTERRUPT, execution-context=INTERRUPT-CAT-1
    Cdd_Adc_ADCA_Int2Isr: is-reentrant=false, is-synchronous=true, call-type=INTERRUPT, execution-context=INTERRUPT-CAT-1
    Cdd_Adc_ADCA_Int3Isr: is-reentrant=false, is-synchronous=true, call-type=INTERRUPT
    Cdd_Adc_ADCA_Int4Isr: is-reentrant=false, is-synchronous=true, call-type=INTERRUPT
    Cdd_Adc_ADCA_PpbIntIsr: is-reentrant=false, is-synchronous=true, call-type=INTERRUPT, execution-context=INTERRUPT-CAT-1
    Cdd_Adc_ADCB_Int1Isr: is-reentrant=false, is-synchronous=true, call-type=INTERRUPT, execution-context=INTERRUPT-CAT-1
    Cdd_Adc_ADCB_Int2Isr: is-reentrant=false, is-synchronous=true, call-type=INTERRUPT, execution-context=INTERRUPT-CAT-1
    Cdd_Adc_ADCB_Int3Isr: is-reentrant=false, is-synchronous=true, call-type=INTERRUPT
    Cdd_Adc_ADCB_Int4Isr: is-reentrant=false, is-synchronous=true, call-type=INTERRUPT
    Cdd_Adc_ADCB_PpbIntIsr: is-reentrant=false, is-synchronous=true, call-type=INTERRUPT
    Cdd_Adc_ADCC_Int1Isr: is-reentrant=false, is-synchronous=true, call-type=INTERRUPT, execution-context=INTERRUPT-CAT-1
    Cdd_Adc_ADCC_Int2Isr: is-reentrant=false, is-synchronous=true, call-type=INTERRUPT, execution-context=INTERRUPT-CAT-1
    Cdd_Adc_ADCC_Int3Isr: is-reentrant=false, is-synchronous=true, call-type=INTERRUPT
    Cdd_Adc_ADCC_Int4Isr: is-reentrant=false, is-synchronous=true, call-type=INTERRUPT
    Cdd_Adc_ADCC_PpbIntIsr: is-reentrant=false, is-synchronous=true, call-type=INTERRUPT
    Cdd_Adc_ADCD_Int1Isr: is-reentrant=false, is-synchronous=true, call-type=INTERRUPT, execution-context=INTERRUPT-CAT-1
    Cdd_Adc_ADCD_Int{2..4}Isr: is-reentrant=false, is-synchronous=true, call-type=INTERRUPT
    Cdd_Adc_ADCD_PpbIntIsr: is-reentrant=false, is-synchronous=true, call-type=INTERRUPT
    Cdd_Adc_ADCE_Int1Isr: is-reentrant=false, is-synchronous=true, call-type=INTERRUPT, execution-context=INTERRUPT-CAT-1
    Cdd_Adc_ADCE_Int{2..4}Isr: is-reentrant=false, is-synchronous=true, call-type=INTERRUPT
    Cdd_Adc_ADCE_PpbIntIsr: is-reentrant=false, is-synchronous=true, call-type=INTERRUPT
    Cdd_Adc_ClearCheckerEvt: service-id=16, is-reentrant=true, is-synchronous=true, call-type=REGULAR
    Cdd_Adc_ClearPpbEvt: service-id=23, is-reentrant=true, is-synchronous=true, call-type=REGULAR
    Cdd_Adc_DeInit: service-id=1, is-reentrant=false, is-synchronous=true, call-type=REGULAR, execution-context=UNSPECIFIED
    Cdd_Adc_DisableGroupNotification: service-id=8, is-reentrant=true, is-synchronous=true, call-type=REGULAR, execution-context=UNSPECIFIED
    Cdd_Adc_DisableHardwareTrigger: service-id=6, is-reentrant=true, is-synchronous=true, call-type=REGULAR, execution-context=UNSPECIFIED
    Cdd_Adc_EnableGroupNotification: service-id=7, is-reentrant=true, is-synchronous=true, call-type=REGULAR, execution-context=UNSPECIFIED
    Cdd_Adc_EnableHardwareTrigger: service-id=5, is-reentrant=true, is-synchronous=true, call-type=REGULAR, execution-context=UNSPECIFIED
    Cdd_Adc_GetDelayStamp: service-id=24, is-reentrant=true, is-synchronous=true, call-type=REGULAR, execution-context=UNSPECIFIED
    Cdd_Adc_GetGroupStatus: service-id=9, is-reentrant=true, is-synchronous=true, call-type=REGULAR, execution-context=UNSPECIFIED
    Cdd_Adc_GetStreamLastPointer: service-id=11, is-reentrant=true, is-synchronous=true, call-type=REGULAR, execution-context=UNSPECIFIED
    Cdd_Adc_GetTemperatureC: service-id=25, is-reentrant=true, is-synchronous=true, call-type=REGULAR, execution-context=UNSPECIFIED
    Cdd_Adc_GetTemperatureK: service-id=26, is-reentrant=true, is-synchronous=true, call-type=REGULAR, execution-context=UNSPECIFIED
    Cdd_Adc_GetVersionInfo: service-id=10, is-reentrant=true, is-synchronous=false, call-type=REGULAR, execution-context=UNSPECIFIED
    Cdd_Adc_Init: service-id=0, is-reentrant=false, is-synchronous=true, call-type=REGULAR, execution-context=UNSPECIFIED
    Cdd_Adc_ReadCheckerStatus: service-id=15, is-reentrant=false, is-synchronous=true, call-type=REGULAR, execution-context=UNSPECIFIED
    Cdd_Adc_ReadGroup: service-id=4, is-reentrant=true, is-synchronous=true, call-type=REGULAR, execution-context=UNSPECIFIED
    Cdd_Adc_ReadPartialPpbValue: service-id=20, is-reentrant=true, is-synchronous=true, call-type=REGULAR, execution-context=UNSPECIFIED
    Cdd_Adc_ReadPpb: service-id=22, is-reentrant=true, is-synchronous=true, call-type=REGULAR, execution-context=UNSPECIFIED
    Cdd_Adc_ReadPpbValue: service-id=21, is-reentrant=true, is-synchronous=true, call-type=REGULAR, execution-context=UNSPECIFIED
    Cdd_Adc_SetResolution: service-id=19, is-reentrant=true, is-synchronous=true, call-type=REGULAR, execution-context=UNSPECIFIED
    Cdd_Adc_SetupResultBuffer: service-id=12, is-reentrant=true, is-synchronous=true, call-type=REGULAR, execution-context=UNSPECIFIED
    Cdd_Adc_StartGlobalSwTrig: service-id=17, is-reentrant=true, is-synchronous=true, call-type=REGULAR, execution-context=UNSPECIFIED
    Cdd_Adc_StopGlobalSwTrig: service-id=18, is-reentrant=true, is-synchronous=true, call-type=REGULAR, execution-context=UNSPECIFIED
    Cdd_Adc_StartGroupConversion: service-id=2, is-reentrant=true, is-synchronous=true, call-type=REGULAR, execution-context=UNSPECIFIED
    Cdd_Adc_StartResultChecker: service-id=13, is-reentrant=true, is-synchronous=true, call-type=REGULAR, execution-context=UNSPECIFIED
    Cdd_Adc_StopGroupConversion: service-id=3, is-reentrant=true, is-synchronous=true, call-type=REGULAR, execution-context=UNSPECIFIED
    Cdd_Adc_StopResultChecker: service-id=14, is-reentrant=true, is-synchronous=true, call-type=REGULAR, execution-context=UNSPECIFIED
    Cdd_Adc_SetInternalTestNode: service-id=27, is-reentrant=true, is-synchronous=true, call-type=REGULAR, execution-context=UNSPECIFIED
