AUTOSAR XML (schema 00044)
package /Mcal_Lib_TI_F29H85x
  bsw module description Mcal_Lib
    resource consumption MemoryMappedSections
      memory section MCAL_LIB_CODE: alignment=UNSPECIFIED, sw-addrmethod=CODE, symbol=CODE
