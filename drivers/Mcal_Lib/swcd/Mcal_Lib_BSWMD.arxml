AUTOSAR XML (schema 00044)
package /TI_F29H85x
  ecuc definition collection myEcuParameterDefinition: module=Mcal_Lib
  module definition Mcal_Lib [0..1]: variants pre-compile  # MCAL Library module providing common utility functions for MCAL drivers such as delay functions and timer utilities.
package /Mcal_Lib_TI_F29H85x
  bsw module description Mcal_Lib: category=BSW_MODULE, module-id=255
    implemented-entrys:
      McalLib_Delay
      McalLib_DelayUsec
      McalLib_DelayMsec
      McalLib_GetCounterValue
      McalLib_GetElapsedValue
      McalLib_GetTimerTickFromUs
      McalLib_BootRomStructure
    bsw internal behavior Mcal_Lib_Behavior
      7 x bsw called entity, all with reentrancy-level=SINGLE-CORE-REENTRANT:
        McalLib_Delay: implemented-entry=McalLib_Delay
        McalLib_DelayUsec: implemented-entry=McalLib_DelayUsec
        McalLib_DelayMsec: implemented-entry=McalLib_DelayMsec
        McalLib_GetCounterValue: implemented-entry=McalLib_GetCounterValue
        McalLib_GetElapsedValue: implemented-entry=McalLib_GetElapsedValue
        McalLib_GetTimerTickFromUs: implemented-entry=McalLib_GetTimerTickFromUs
        McalLib_BootRomStructure: implemented-entry=McalLib_BootRomStructure
  bsw implementation Mcal_Lib_Impl: programming-language=C, sw-version=1.0.0, vendor-id=44, ar-release-version=4.3.1, behavior=Mcal_Lib_Behavior, vendor-specific-module-def=Mcal_Lib
    code-descriptors:
      code Files
        artifact-descriptors:
          short-label=include::Mcal_Lib.h, category=SWHDR
          short-label=src::Mcal_Lib.c, category=SWSRC
          short-label=include::Mcal_Lib_BootRom.h, category=SWHDR
          short-label=src::Mcal_Lib_BootRom.c, category=SWSRC
          short-label=include::Mcal_Lib_Cpu.h, category=SWHDR
          short-label=include::Mcal_Lib_RegAccess.h, category=SWHDR
    compiler TI_C29Clang: name=TI_C29Clang, vendor=Texas Instruments, version=2.2.0
    linker TI_C29Linker: name=TI_C29Linker, vendor=Texas Instruments, version=2.2.0
    resource consumption ResourceConsumption
      memory section MCAL_LIB_CODE: alignment=UNSPECIFIED, sw-addrmethod=CODE, symbol=CODE
package /Mcal_Lib_TI_F29H85x/BSWModuleEntry
  7 x bsw module entry, all with is-reentrant=true, is-synchronous=true, call-type=REGULAR, execution-context=UNSPECIFIED, sw-service-impl-policy=STANDARD, bsw-entry-kind=CONCRETE:
    McalLib_Delay
    McalLib_DelayUsec
    McalLib_DelayMsec
    McalLib_GetCounterValue
    McalLib_GetElapsedValue
    McalLib_GetTimerTickFromUs
    McalLib_BootRomStructure
